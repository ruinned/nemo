AUTOSAR XML (schema 4-0-3)
package /DaVinci_Project
  module config Com
    ComConfig
      269 x ComSignal:
        ABSInhibitRqstDenied_oCIOM_BB2_25P_oBackbone2_b939a8e2_Tx: ComSignalType=UINT8
        ABS_Indication_oMastertoTCP_oLIN02_826b948e_Tx: ComSignalType=UINT8
        ATC_Indication_oMastertoTCP_oLIN02_f0d69bff_Tx: ComSignalType=UINT8
        Debug_PVT_PEPS_AntCtrl_stat_oDebug15_SCIM_BB2_oBackbone2_2877d1d6_Tx: ComSignalType=SINT8
        Debug_PVT_PEPS_AntP1_X_Ctrl_oDebugCtrl9_SCIM_BB2_oBackbone2_fb66dba7_Rx: ComNotification=Rte_COMCbk_Debug_PVT_PEPS_AntP1_X_Ctrl_oDebugCtrl9_SCIM_BB2_oBackbone2_fb66dba7_Rx, ComSignalType=SINT16
        Debug_PVT_PEPS_AntP1_X_oDebug22_SCIM_BB2_oBackbone2_3e4f02fb_Tx: ComSignalType=SINT16
        Debug_PVT_PEPS_AntP1_Y_Ctrl_oDebugCtrl9_SCIM_BB2_oBackbone2_76ee2645_Rx: ComNotification=Rte_COMCbk_Debug_PVT_PEPS_AntP1_Y_Ctrl_oDebugCtrl9_SCIM_BB2_oBackbone2_76ee2645_Rx, ComSignalType=SINT16
        Debug_PVT_PEPS_AntP1_Y_oDebug22_SCIM_BB2_oBackbone2_022fe1f3_Tx: ComSignalType=SINT16
        Debug_PVT_PEPS_AntPi_X_Ctrl_oDebugCtrl9_SCIM_BB2_oBackbone2_108c5adc_Rx: ComNotification=Rte_COMCbk_Debug_PVT_PEPS_AntPi_X_Ctrl_oDebugCtrl9_SCIM_BB2_oBackbone2_108c5adc_Rx, ComSignalType=SINT16
        Debug_PVT_PEPS_AntPi_X_oDebug22_SCIM_BB2_oBackbone2_b567e3e2_Tx: ComSignalType=SINT16
        Debug_PVT_PEPS_AntPi_Y_Ctrl_oDebugCtrl9_SCIM_BB2_oBackbone2_9d04a73e_Rx: ComNotification=Rte_COMCbk_Debug_PVT_PEPS_AntPi_Y_Ctrl_oDebugCtrl9_SCIM_BB2_oBackbone2_9d04a73e_Rx, ComSignalType=SINT16
        Debug_PVT_PEPS_AntPi_Y_oDebug22_SCIM_BB2_oBackbone2_890700ea_Tx: ComSignalType=SINT16
        Debug_PVT_PEPS_Ant_Ctrl_oDebugCtrl3_SCIM_BB2_oBackbone2_f212143a_Rx: ComNotification=Rte_COMCbk_Debug_PVT_PEPS_Ant_Ctrl_oDebugCtrl3_SCIM_BB2_oBackbone2_f212143a_Rx, ComSignalType=UINT8
        Debug_PVT_PEPS_GainP1_Ctrl_oDebugCtrl3_SCIM_BB2_oBackbone2_7b701f8e_Rx: ComNotification=Rte_COMCbk_Debug_PVT_PEPS_GainP1_Ctrl_oDebugCtrl3_SCIM_BB2_oBackbone2_7b701f8e_Rx, ComSignalType=UINT8
        Debug_PVT_PEPS_GainP1_stat_oDebug15_SCIM_BB2_oBackbone2_7d778ea0_Tx: ComSignalType=UINT8
        Debug_PVT_PEPS_GainP2_Ctrl_oDebugCtrl3_SCIM_BB2_oBackbone2_36981fe9_Rx: ComNotification=Rte_COMCbk_Debug_PVT_PEPS_GainP2_Ctrl_oDebugCtrl3_SCIM_BB2_oBackbone2_36981fe9_Rx, ComSignalType=UINT8
        Debug_PVT_PEPS_GainP2_stat_oDebug15_SCIM_BB2_oBackbone2_f6a4b0b9_Tx: ComSignalType=UINT8
        Debug_PVT_PEPS_GainP3_Ctrl_oDebugCtrl3_SCIM_BB2_oBackbone2_bb10e20b_Rx: ComNotification=Rte_COMCbk_Debug_PVT_PEPS_GainP3_Ctrl_oDebugCtrl3_SCIM_BB2_oBackbone2_bb10e20b_Rx, ComSignalType=UINT8
        Debug_PVT_PEPS_GainP3_stat_oDebug15_SCIM_BB2_oBackbone2_393aa771_Tx: ComSignalType=UINT8
        Debug_PVT_PEPS_GainP4_Ctrl_oDebugCtrl3_SCIM_BB2_oBackbone2_ad481f27_Rx: ComNotification=Rte_COMCbk_Debug_PVT_PEPS_GainP4_Ctrl_oDebugCtrl3_SCIM_BB2_oBackbone2_ad481f27_Rx, ComSignalType=UINT8
        Debug_PVT_PEPS_GainP4_stat_oDebug15_SCIM_BB2_oBackbone2_3a73caca_Tx: ComSignalType=UINT8
        Debug_PVT_PEPS_Logic_Ctrl_oDebugCtrl3_SCIM_BB2_oBackbone2_f1a79db4_Rx: ComNotification=Rte_COMCbk_Debug_PVT_PEPS_Logic_Ctrl_oDebugCtrl3_SCIM_BB2_oBackbone2_f1a79db4_Rx, ComSignalType=UINT8
        Debug_PVT_PEPS_Logic_stat_oDebug15_SCIM_BB2_oBackbone2_19626c75_Tx: ComSignalType=UINT8
        Debug_PVT_PEPS_P1_MaxRSSI_oDebug16_SCIM_BB2_oBackbone2_6c5ea403_Tx: ComSignalType=UINT16
        Debug_PVT_PEPS_P2_MaxRSSI_oDebug16_SCIM_BB2_oBackbone2_21b6a464_Tx: ComSignalType=UINT16
        Debug_PVT_PEPS_P3_MaxRSSI_oDebug16_SCIM_BB2_oBackbone2_ac3e5986_Tx: ComSignalType=UINT16
        Debug_PVT_PEPS_P4_MaxRSSI_oDebug16_SCIM_BB2_oBackbone2_ba66a4aa_Tx: ComSignalType=UINT16
        Debug_PVT_PEPS_VDSI_Ctrl_oDebugCtrl3_SCIM_BB2_oBackbone2_e74c4cec_Rx: ComNotification=Rte_COMCbk_Debug_PVT_PEPS_VDSI_Ctrl_oDebugCtrl3_SCIM_BB2_oBackbone2_e74c4cec_Rx, ComSignalType=UINT16
        Debug_PVT_PEPS_VDSI_stat_oDebug15_SCIM_BB2_oBackbone2_cba0b8aa_Tx: ComSignalType=UINT16
        Debug_PVT_SCIM_Ctrl_12VDCDC_oDebugCtrl1_SCIM_BB2_oBackbone2_052e0dec_Rx: ComNotification=Rte_COMCbk_Debug_PVT_SCIM_Ctrl_12VDCDC_oDebugCtrl1_SCIM_BB2_oBackbone2_052e0dec_Rx, ComSignalType=BOOLEAN
        Debug_PVT_SCIM_Ctrl_12VLiving_oDebugCtrl1_SCIM_BB2_oBackbone2_1cf3479b_Rx: ComNotification=Rte_COMCbk_Debug_PVT_SCIM_Ctrl_12VLiving_oDebugCtrl1_SCIM_BB2_oBackbone2_1cf3479b_Rx, ComSignalType=BOOLEAN
        Debug_PVT_SCIM_Ctrl_12VParked_oDebugCtrl1_SCIM_BB2_oBackbone2_2cd9a2ad_Rx: ComNotification=Rte_COMCbk_Debug_PVT_SCIM_Ctrl_12VParked_oDebugCtrl1_SCIM_BB2_oBackbone2_2cd9a2ad_Rx, ComSignalType=BOOLEAN
        Debug_PVT_SCIM_Ctrl_BHS1_oDebugCtrl1_SCIM_BB2_oBackbone2_e91d1062_Rx: ComNotification=Rte_COMCbk_Debug_PVT_SCIM_Ctrl_BHS1_oDebugCtrl1_SCIM_BB2_oBackbone2_e91d1062_Rx, ComSignalType=BOOLEAN
        Debug_PVT_SCIM_Ctrl_BHS2_oDebugCtrl1_SCIM_BB2_oBackbone2_b20aa177_Rx: ComNotification=Rte_COMCbk_Debug_PVT_SCIM_Ctrl_BHS2_oDebugCtrl1_SCIM_BB2_oBackbone2_b20aa177_Rx, ComSignalType=BOOLEAN
        Debug_PVT_SCIM_Ctrl_BHS3_oDebugCtrl1_SCIM_BB2_oBackbone2_84f83184_Rx: ComNotification=Rte_COMCbk_Debug_PVT_SCIM_Ctrl_BHS3_oDebugCtrl1_SCIM_BB2_oBackbone2_84f83184_Rx, ComSignalType=BOOLEAN
        Debug_PVT_SCIM_Ctrl_BHS4_oDebugCtrl1_SCIM_BB2_oBackbone2_0425c35d_Rx: ComNotification=Rte_COMCbk_Debug_PVT_SCIM_Ctrl_BHS4_oDebugCtrl1_SCIM_BB2_oBackbone2_0425c35d_Rx, ComSignalType=BOOLEAN
        Debug_PVT_SCIM_Ctrl_DAIPullUp_oDebugCtrl1_SCIM_BB2_oBackbone2_2731869d_Rx: ComNotification=Rte_COMCbk_Debug_PVT_SCIM_Ctrl_DAIPullUp_oDebugCtrl1_SCIM_BB2_oBackbone2_2731869d_Rx, ComSignalType=BOOLEAN
        Debug_PVT_SCIM_Ctrl_LivingPullUp_oDebugCtrl1_SCIM_BB2_oBackbone2_666b21d3_Rx: ComNotification=Rte_COMCbk_Debug_PVT_SCIM_Ctrl_LivingPullUp_oDebugCtrl1_SCIM_BB2_oBackbone2_666b21d3_Rx, ComSignalType=BOOLEAN
        Debug_PVT_SCIM_Ctrl_ParkedPullUp_oDebugCtrl1_SCIM_BB2_oBackbone2_bf982706_Rx: ComNotification=Rte_COMCbk_Debug_PVT_SCIM_Ctrl_ParkedPullUp_oDebugCtrl1_SCIM_BB2_oBackbone2_bf982706_Rx, ComSignalType=BOOLEAN
        Debug_PVT_SCIM_Ctrl_WHS1_Duty_oDebugCtrl1_SCIM_BB2_oBackbone2_aec1e12e_Rx: ComNotification=Rte_COMCbk_Debug_PVT_SCIM_Ctrl_WHS1_Duty_oDebugCtrl1_SCIM_BB2_oBackbone2_aec1e12e_Rx, ComSignalType=UINT8
        Debug_PVT_SCIM_Ctrl_WHS1_Freq_oDebugCtrl1_SCIM_BB2_oBackbone2_31c9eab2_Rx: ComNotification=Rte_COMCbk_Debug_PVT_SCIM_Ctrl_WHS1_Freq_oDebugCtrl1_SCIM_BB2_oBackbone2_31c9eab2_Rx, ComSignalType=UINT16
        Debug_PVT_SCIM_Ctrl_WHS1_oDebugCtrl1_SCIM_BB2_oBackbone2_a57cfe3c_Rx: ComNotification=Rte_COMCbk_Debug_PVT_SCIM_Ctrl_WHS1_oDebugCtrl1_SCIM_BB2_oBackbone2_a57cfe3c_Rx, ComSignalType=BOOLEAN
        Debug_PVT_SCIM_Ctrl_WHS2_Duty_oDebugCtrl1_SCIM_BB2_oBackbone2_e329e149_Rx: ComNotification=Rte_COMCbk_Debug_PVT_SCIM_Ctrl_WHS2_Duty_oDebugCtrl1_SCIM_BB2_oBackbone2_e329e149_Rx, ComSignalType=UINT8
        Debug_PVT_SCIM_Ctrl_WHS2_Freq_oDebugCtrl1_SCIM_BB2_oBackbone2_7c21ead5_Rx: ComNotification=Rte_COMCbk_Debug_PVT_SCIM_Ctrl_WHS2_Freq_oDebugCtrl1_SCIM_BB2_oBackbone2_7c21ead5_Rx, ComSignalType=UINT16
        Debug_PVT_SCIM_Ctrl_WHS2_oDebugCtrl1_SCIM_BB2_oBackbone2_fe6b4f29_Rx: ComNotification=Rte_COMCbk_Debug_PVT_SCIM_Ctrl_WHS2_oDebugCtrl1_SCIM_BB2_oBackbone2_fe6b4f29_Rx, ComSignalType=BOOLEAN
        Debug_PVT_SCIM_Ctrl_WLS1_Duty_oDebugCtrl2_SCIM_BB2_oBackbone2_055e2012_Rx: ComNotification=Rte_COMCbk_Debug_PVT_SCIM_Ctrl_WLS1_Duty_oDebugCtrl2_SCIM_BB2_oBackbone2_055e2012_Rx, ComSignalType=UINT8
        Debug_PVT_SCIM_Ctrl_WLS1_Freq_oDebugCtrl2_SCIM_BB2_oBackbone2_9a562b8e_Rx: ComNotification=Rte_COMCbk_Debug_PVT_SCIM_Ctrl_WLS1_Freq_oDebugCtrl2_SCIM_BB2_oBackbone2_9a562b8e_Rx, ComSignalType=UINT16
        Debug_PVT_SCIM_Ctrl_WLS1_oDebugCtrl2_SCIM_BB2_oBackbone2_56f82f7d_Rx: ComNotification=Rte_COMCbk_Debug_PVT_SCIM_Ctrl_WLS1_oDebugCtrl2_SCIM_BB2_oBackbone2_56f82f7d_Rx, ComSignalType=BOOLEAN
        Debug_PVT_SCIM_Ctrl_WLS2Duty_oDebugCtrl2_SCIM_BB2_oBackbone2_1529858b_Rx: ComNotification=Rte_COMCbk_Debug_PVT_SCIM_Ctrl_WLS2Duty_oDebugCtrl2_SCIM_BB2_oBackbone2_1529858b_Rx, ComSignalType=UINT8
        Debug_PVT_SCIM_Ctrl_WLS2Freq_oDebugCtrl2_SCIM_BB2_oBackbone2_8a218e17_Rx: ComNotification=Rte_COMCbk_Debug_PVT_SCIM_Ctrl_WLS2Freq_oDebugCtrl2_SCIM_BB2_oBackbone2_8a218e17_Rx, ComSignalType=UINT16
        Debug_PVT_SCIM_Ctrl_WLS2_oDebugCtrl2_SCIM_BB2_oBackbone2_0def9e68_Rx: ComNotification=Rte_COMCbk_Debug_PVT_SCIM_Ctrl_WLS2_oDebugCtrl2_SCIM_BB2_oBackbone2_0def9e68_Rx, ComSignalType=BOOLEAN
        Debug_PVT_SCIM_Ctrl_WLS3Duty_oDebugCtrl2_SCIM_BB2_oBackbone2_95d99294_Rx: ComNotification=Rte_COMCbk_Debug_PVT_SCIM_Ctrl_WLS3Duty_oDebugCtrl2_SCIM_BB2_oBackbone2_95d99294_Rx, ComSignalType=UINT8
        Debug_PVT_SCIM_Ctrl_WLS3Freq_oDebugCtrl2_SCIM_BB2_oBackbone2_0ad19908_Rx: ComNotification=Rte_COMCbk_Debug_PVT_SCIM_Ctrl_WLS3Freq_oDebugCtrl2_SCIM_BB2_oBackbone2_0ad19908_Rx, ComSignalType=UINT16
        Debug_PVT_SCIM_Ctrl_WLS3_oDebugCtrl2_SCIM_BB2_oBackbone2_3b1d0e9b_Rx: ComNotification=Rte_COMCbk_Debug_PVT_SCIM_Ctrl_WLS3_oDebugCtrl2_SCIM_BB2_oBackbone2_3b1d0e9b_Rx, ComSignalType=BOOLEAN
        Debug_PVT_SCIM_RD_12VDCDCFault_oDebug2_SCIM_BB2_oBackbone2_a76feb3e_Tx: ComSignalType=UINT8
        Debug_PVT_SCIM_RD_12VDCDCVolt_oDebug2_SCIM_BB2_oBackbone2_cecf5c09_Tx: ComSignalType=UINT8
        Debug_PVT_SCIM_RD_12VLivingVolt_oDebug2_SCIM_BB2_oBackbone2_74d816f4_Tx: ComSignalType=UINT8
        Debug_PVT_SCIM_RD_12VParkedVolt_oDebug2_SCIM_BB2_oBackbone2_44f2f3c2_Tx: ComSignalType=UINT8
        Debug_PVT_SCIM_RD_ADI01_oDebug7_SCIM_BB2_oBackbone2_d2059597_Tx: ComSignalType=UINT16
        Debug_PVT_SCIM_RD_ADI02_oDebug7_SCIM_BB2_oBackbone2_770dfefb_Tx: ComSignalType=UINT16
        Debug_PVT_SCIM_RD_ADI03_oDebug7_SCIM_BB2_oBackbone2_140a27df_Tx: ComSignalType=UINT16
        Debug_PVT_SCIM_RD_ADI04_oDebug7_SCIM_BB2_oBackbone2_e66c2e62_Tx: ComSignalType=UINT16
        Debug_PVT_SCIM_RD_ADI05_oDebug7_SCIM_BB2_oBackbone2_856bf746_Tx: ComSignalType=UINT16
        Debug_PVT_SCIM_RD_ADI06_oDebug7_SCIM_BB2_oBackbone2_20639c2a_Tx: ComSignalType=UINT16
        Debug_PVT_SCIM_RD_ADI07_oDebug8_SCIM_BB2_oBackbone2_0f71ca20_Tx: ComSignalType=UINT16
        Debug_PVT_SCIM_RD_ADI08_oDebug8_SCIM_BB2_oBackbone2_53cb063f_Tx: ComSignalType=UINT16
        Debug_PVT_SCIM_RD_ADI09_oDebug8_SCIM_BB2_oBackbone2_30ccdf1b_Tx: ComSignalType=UINT16
        Debug_PVT_SCIM_RD_ADI10_oDebug8_SCIM_BB2_oBackbone2_c1772095_Tx: ComSignalType=UINT16
        Debug_PVT_SCIM_RD_ADI11_oDebug8_SCIM_BB2_oBackbone2_a270f9b1_Tx: ComSignalType=UINT16
        Debug_PVT_SCIM_RD_ADI12_oDebug8_SCIM_BB2_oBackbone2_077892dd_Tx: ComSignalType=UINT16
        Debug_PVT_SCIM_RD_ADI13_oDebug28_SCIM_BB2_oBackbone2_f1e56b1c_Tx: ComSignalType=UINT16
        Debug_PVT_SCIM_RD_ADI14_oDebug28_SCIM_BB2_oBackbone2_44c7c224_Tx: ComSignalType=UINT16
        Debug_PVT_SCIM_RD_ADI15_oDebug28_SCIM_BB2_oBackbone2_78a7212c_Tx: ComSignalType=UINT16
        Debug_PVT_SCIM_RD_ADI16_oDebug28_SCIM_BB2_oBackbone2_3c060434_Tx: ComSignalType=UINT16
        Debug_PVT_SCIM_RD_BHS1_Fault_oDebug3_SCIM_BB2_oBackbone2_66b07d64_Tx: ComSignalType=UINT8
        Debug_PVT_SCIM_RD_BHS1_Volt_oDebug3_SCIM_BB2_oBackbone2_8af915ef_Tx: ComSignalType=UINT16
        Debug_PVT_SCIM_RD_BHS2_Fault_oDebug3_SCIM_BB2_oBackbone2_ed63437d_Tx: ComSignalType=UINT8
        Debug_PVT_SCIM_RD_BHS2_Volt_oDebug3_SCIM_BB2_oBackbone2_e77fe6b5_Tx: ComSignalType=UINT16
        Debug_PVT_SCIM_RD_BHS3_Fault_oDebug3_SCIM_BB2_oBackbone2_22fd54b5_Tx: ComSignalType=UINT8
        Debug_PVT_SCIM_RD_BHS3_Volt_oDebug3_SCIM_BB2_oBackbone2_c3fdb783_Tx: ComSignalType=UINT16
        Debug_PVT_SCIM_RD_BHS4_Fault_oDebug3_SCIM_BB2_oBackbone2_21b4390e_Tx: ComSignalType=UINT8
        Debug_PVT_SCIM_RD_BHS4_Volt_oDebug3_SCIM_BB2_oBackbone2_3c720001_Tx: ComSignalType=UINT16
        Debug_PVT_SCIM_RD_DAI1_oDebug9_SCIM_BB2_oBackbone2_179e2272_Tx: ComSignalType=UINT8
        Debug_PVT_SCIM_RD_DAI2_oDebug9_SCIM_BB2_oBackbone2_b296491e_Tx: ComSignalType=UINT8
        Debug_PVT_SCIM_RD_VBAT_oDebug2_SCIM_BB2_oBackbone2_d3887400_Tx: ComSignalType=UINT16
        Debug_PVT_SCIM_RD_WHS1_Duty_oDebug10_SCIM_BB2_oBackbone2_e4964bec_Tx: ComSignalType=UINT8
        Debug_PVT_SCIM_RD_WHS1_Fault_oDebug10_SCIM_BB2_oBackbone2_7f82e8ff_Tx: ComSignalType=UINT8
        Debug_PVT_SCIM_RD_WHS1_Freq_oDebug10_SCIM_BB2_oBackbone2_e909035f_Tx: ComSignalType=UINT16
        Debug_PVT_SCIM_RD_WHS1_Volt_oDebug10_SCIM_BB2_oBackbone2_fae484a1_Tx: ComSignalType=UINT16
        Debug_PVT_SCIM_RD_WHS2_Duty_oDebug10_SCIM_BB2_oBackbone2_6f4575f5_Tx: ComSignalType=UINT8
        Debug_PVT_SCIM_RD_WHS2_Fault_oDebug10_SCIM_BB2_oBackbone2_1b629301_Tx: ComSignalType=UINT8
        Debug_PVT_SCIM_RD_WHS2_Freq_oDebug10_SCIM_BB2_oBackbone2_62da3d46_Tx: ComSignalType=UINT16
        Debug_PVT_SCIM_RD_WHS2_Volt_oDebug10_SCIM_BB2_oBackbone2_7137bab8_Tx: ComSignalType=UINT16
        Debug_PVT_SCIM_RD_WLS1_Duty_oDebug11_SCIM_BB2_oBackbone2_151f9ecd_Tx: ComSignalType=UINT8
        Debug_PVT_SCIM_RD_WLS1_Fault_oDebug11_SCIM_BB2_oBackbone2_bbe8962a_Tx: ComSignalType=UINT8
        Debug_PVT_SCIM_RD_WLS1_Freq_oDebug11_SCIM_BB2_oBackbone2_1880d67e_Tx: ComSignalType=UINT16
        Debug_PVT_SCIM_RD_WLS1_Volt_oDebug11_SCIM_BB2_oBackbone2_0b6d5180_Tx: ComSignalType=UINT16
        Debug_PVT_SCIM_RD_WLS2_Duty_oDebug11_SCIM_BB2_oBackbone2_9ecca0d4_Tx: ComSignalType=UINT8
        Debug_PVT_SCIM_RD_WLS2_Fault_oDebug11_SCIM_BB2_oBackbone2_df08edd4_Tx: ComSignalType=UINT8
        Debug_PVT_SCIM_RD_WLS2_Freq_oDebug11_SCIM_BB2_oBackbone2_9353e867_Tx: ComSignalType=UINT16
        Debug_PVT_SCIM_RD_WLS2_Volt_oDebug11_SCIM_BB2_oBackbone2_80be6f99_Tx: ComSignalType=UINT16
        Debug_PVT_SCIM_RD_WLS3_Duty_oDebug9_SCIM_BB2_oBackbone2_c539df90_Tx: ComSignalType=UINT8
        Debug_PVT_SCIM_RD_WLS3_Fault_oDebug9_SCIM_BB2_oBackbone2_ee12f9c5_Tx: ComSignalType=UINT8
        Debug_PVT_SCIM_RD_WLS3_Freq_oDebug9_SCIM_BB2_oBackbone2_371b521a_Tx: ComSignalType=UINT16
        Debug_PVT_SCIM_RD_WLS3_Volt_oDebug9_SCIM_BB2_oBackbone2_b604fa02_Tx: ComSignalType=UINT16
        DiagInfoCCFW_oCCFWtoCIOM_L4_oLIN03_69083ad8_Rx: ComNotification=Rte_COMCbk_DiagInfoCCFW_oCCFWtoCIOM_L4_oLIN03_69083ad8_Rx, ComSignalType=UINT8
        DiagInfoDLFW_oDLFWtoCIOM_L4_oLIN03_f14b1ebc_Rx: ComNotification=Rte_COMCbk_DiagInfoDLFW_oDLFWtoCIOM_L4_oLIN03_f14b1ebc_Rx, ComSignalType=UINT8
        DiagInfoELCP1_oELCP1toCIOM_L4_oLIN03_e88000c8_Rx: ComNotification=Rte_COMCbk_DiagInfoELCP1_oELCP1toCIOM_L4_oLIN03_e88000c8_Rx, ComSignalType=UINT8
        DiagInfoELCP2_oELCP2toCIOM_L4_oLIN03_e304f264_Rx: ComNotification=Rte_COMCbk_DiagInfoELCP2_oELCP2toCIOM_L4_oLIN03_e304f264_Rx, ComSignalType=UINT8
        DiagInfoILCP1_oILCP1toCIOM_L1_oLIN00_051a4e47_Rx: ComNotification=Rte_COMCbk_DiagInfoILCP1_oILCP1toCIOM_L1_oLIN00_051a4e47_Rx, ComTimeoutNotification=Rte_COMCbkRxTOut_DiagInfoILCP1_oILCP1toCIOM_L1_oLIN00_051a4e47_Rx, ComSignalType=UINT8
        DiagInfoILCP2_oILCP2toCIOM_L4_oLIN03_df77e335_Rx: ComNotification=Rte_COMCbk_DiagInfoILCP2_oILCP2toCIOM_L4_oLIN03_df77e335_Rx, ComSignalType=UINT8
        DiagInfoLECM2_oLECM2toCIOM_FR1_L1_oLIN00_427132ed_Rx: ComNotification=Rte_COMCbk_DiagInfoLECM2_oLECM2toCIOM_FR1_L1_oLIN00_427132ed_Rx, ComSignalType=UINT8
        DiagInfoLECMBasic_oLECMBasic2CIOM_L1_oLIN00_209584a0_Rx: ComNotification=Rte_COMCbk_DiagInfoLECMBasic_oLECMBasic2CIOM_L1_oLIN00_209584a0_Rx, ComSignalType=UINT8
        DiagInfoRCECS_oRCECStoCIOM_L5_oLIN04_46e60a03_Rx: ComNotification=Rte_COMCbk_DiagInfoRCECS_oRCECStoCIOM_L5_oLIN04_46e60a03_Rx, ComSignalType=UINT8
        DiagInfoTCP_oTCPtoMaster_oLIN02_23eac2a6_Rx: ComNotification=Rte_COMCbk_DiagInfoTCP_oTCPtoMaster_oLIN02_23eac2a6_Rx, ComSignalType=UINT8
        DoorLock_stat_ISig_13_oCIOMtoSlaves2_FR1_L1_oLIN00_66228e20_Tx: ComSignalType=UINT8
        DoorLock_stat_ISig_4_oCIOM_BB2_06P_oBackbone2_3a170244_Tx: ComSignalType=UINT8
        DoorLock_stat_ISig_5_oCIOM_Cab_06P_oCabSubnet_61085ef5_Tx: ComSignalType=UINT8
        DynamicCode_value_oCIOM_BB2_21S_oBackbone2_04b10010_Tx: ComSignalType=UINT32
        ESC_Indication_oMastertoTCP_oLIN02_e2022dfe_Tx: ComSignalType=UINT8
        EngineGasRate_oEMS_BB2_05P_oBackbone2_96ec243f_Rx: ComNotification=Rte_COMCbk_EngineGasRate_oEMS_BB2_05P_oBackbone2_96ec243f_Rx, ComSignalType=UINT16
        FSP1DiagInfoL1_oFSP1_Frame_L1_oLIN00_f04712d6_Rx: ComNotification=Rte_COMCbk_FSP1DiagInfoL1_oFSP1_Frame_L1_oLIN00_f04712d6_Rx, ComTimeoutNotification=Rte_COMCbkRxTOut_FSP1DiagInfoL1_oFSP1_Frame_L1_oLIN00_f04712d6_Rx, ComSignalType=UINT8
        FSP1DiagInfoL2_oFSP1_Frame_L2_oLIN01_7f2a1c9e_Rx: ComNotification=Rte_COMCbk_FSP1DiagInfoL2_oFSP1_Frame_L2_oLIN01_7f2a1c9e_Rx, ComSignalType=UINT8
        FSP1DiagInfoL3_oFSP1_Frame_L3_oLIN02_b1faa76e_Rx: ComNotification=Rte_COMCbk_FSP1DiagInfoL3_oFSP1_Frame_L3_oLIN02_b1faa76e_Rx, ComSignalType=UINT8
        FSP1DiagInfoL4_oFSP1_Frame_L4_oLIN03_ba81064f_Rx: ComNotification=Rte_COMCbk_FSP1DiagInfoL4_oFSP1_Frame_L4_oLIN03_ba81064f_Rx, ComSignalType=UINT8
        FSP1DiagInfoL5_oFSP1_Frame_L5_oLIN04_733c79a6_Rx: ComNotification=Rte_COMCbk_FSP1DiagInfoL5_oFSP1_Frame_L5_oLIN04_733c79a6_Rx, ComSignalType=UINT8
        FSP1IndicationCmdL1_oFSP_1_2_Req_L1_oLIN00_c2c0fe90_Tx: ComSignalType=UINT16
        FSP1IndicationCmdL2_oFSP_1_2_Req_L2_oLIN01_635660cd_Tx: ComSignalType=UINT16
        FSP1IndicationCmdL3_oFSP_1_2_Req_L3_oLIN02_b7d054ce_Tx: ComSignalType=UINT16
        FSP1IndicationCmdL4_oFSP_1_2_Req_L4_oLIN03_fb0a5a36_Tx: ComSignalType=UINT16
        FSP1IndicationCmdL5_oFSP_1_2_Req_L5_oLIN04_28e1aa2c_Tx: ComSignalType=UINT16
        FSP1ResponseErrorL1_oFSP1_Frame_L1_oLIN00_b9e1fc6c_Rx: ComNotification=Rte_COMCbk_FSP1ResponseErrorL1_oFSP1_Frame_L1_oLIN00_b9e1fc6c_Rx, ComTimeoutNotification=Rte_COMCbkRxTOut_FSP1ResponseErrorL1_oFSP1_Frame_L1_oLIN00_b9e1fc6c_Rx, ComSignalType=BOOLEAN
        FSP1ResponseErrorL2_oFSP1_Frame_L2_oLIN01_368cf224_Rx: ComNotification=Rte_COMCbk_FSP1ResponseErrorL2_oFSP1_Frame_L2_oLIN01_368cf224_Rx, ComSignalType=BOOLEAN
        FSP1ResponseErrorL3_oFSP1_Frame_L3_oLIN02_f85c49d4_Rx: ComNotification=Rte_COMCbk_FSP1ResponseErrorL3_oFSP1_Frame_L3_oLIN02_f85c49d4_Rx, ComSignalType=BOOLEAN
        FSP1ResponseErrorL4_oFSP1_Frame_L4_oLIN03_f327e8f5_Rx: ComNotification=Rte_COMCbk_FSP1ResponseErrorL4_oFSP1_Frame_L4_oLIN03_f327e8f5_Rx, ComSignalType=BOOLEAN
        FSP1ResponseErrorL5_oFSP1_Frame_L5_oLIN04_3a9a971c_Rx: ComNotification=Rte_COMCbk_FSP1ResponseErrorL5_oFSP1_Frame_L5_oLIN04_3a9a971c_Rx, ComSignalType=BOOLEAN
        FSP1SwitchStatusL2_oFSP1_Frame_L2_oLIN01_68e68ffa_Rx: ComNotification=Rte_COMCbk_FSP1SwitchStatusL2_oFSP1_Frame_L2_oLIN01_68e68ffa_Rx, ComSignalType=UINT8
        FSP1SwitchStatusL3_oFSP1_Frame_L3_oLIN02_a636340a_Rx: ComNotification=Rte_COMCbk_FSP1SwitchStatusL3_oFSP1_Frame_L3_oLIN02_a636340a_Rx, ComSignalType=UINT8
        FSP1SwitchStatusL4_oFSP1_Frame_L4_oLIN03_ad4d952b_Rx: ComNotification=Rte_COMCbk_FSP1SwitchStatusL4_oFSP1_Frame_L4_oLIN03_ad4d952b_Rx, ComSignalType=UINT8
        FSP1SwitchStatusL5_oFSP1_Frame_L5_oLIN04_64f0eac2_Rx: ComNotification=Rte_COMCbk_FSP1SwitchStatusL5_oFSP1_Frame_L5_oLIN04_64f0eac2_Rx, ComSignalType=UINT8
        FSP2DiagInfoL1_oFSP2_Frame_L1_oLIN00_f8caf847_Rx: ComNotification=Rte_COMCbk_FSP2DiagInfoL1_oFSP2_Frame_L1_oLIN00_f8caf847_Rx, ComTimeoutNotification=Rte_COMCbkRxTOut_FSP2DiagInfoL1_oFSP2_Frame_L1_oLIN00_f8caf847_Rx, ComSignalType=UINT8
        FSP2DiagInfoL2_oFSP2_Frame_L2_oLIN01_77a7f60f_Rx: ComNotification=Rte_COMCbk_FSP2DiagInfoL2_oFSP2_Frame_L2_oLIN01_77a7f60f_Rx, ComSignalType=UINT8
        FSP2DiagInfoL3_oFSP2_Frame_L3_oLIN02_b9774dff_Rx: ComNotification=Rte_COMCbk_FSP2DiagInfoL3_oFSP2_Frame_L3_oLIN02_b9774dff_Rx, ComSignalType=UINT8
        FSP2IndicationCmdL1_oFSP_1_2_Req_L1_oLIN00_115be26b_Tx: ComSignalType=UINT16
        FSP2IndicationCmdL2_oFSP_1_2_Req_L2_oLIN01_b0cd7c36_Tx: ComSignalType=UINT16
        FSP2IndicationCmdL3_oFSP_1_2_Req_L3_oLIN02_644b4835_Tx: ComSignalType=UINT16
        FSP2ResponseErrorL1_oFSP2_Frame_L1_oLIN00_a793a78f_Rx: ComNotification=Rte_COMCbk_FSP2ResponseErrorL1_oFSP2_Frame_L1_oLIN00_a793a78f_Rx, ComTimeoutNotification=Rte_COMCbkRxTOut_FSP2ResponseErrorL1_oFSP2_Frame_L1_oLIN00_a793a78f_Rx, ComSignalType=BOOLEAN
        FSP2ResponseErrorL2_oFSP2_Frame_L2_oLIN01_28fea9c7_Rx: ComNotification=Rte_COMCbk_FSP2ResponseErrorL2_oFSP2_Frame_L2_oLIN01_28fea9c7_Rx, ComSignalType=BOOLEAN
        FSP2ResponseErrorL3_oFSP2_Frame_L3_oLIN02_e62e1237_Rx: ComNotification=Rte_COMCbk_FSP2ResponseErrorL3_oFSP2_Frame_L3_oLIN02_e62e1237_Rx, ComSignalType=BOOLEAN
        FSP2SwitchStatusL1_oFSP2_Frame_L1_oLIN00_ee70e556_Rx: ComSignalType=UINT8
        FSP2SwitchStatusL2_oFSP2_Frame_L2_oLIN01_611deb1e_Rx: ComNotification=Rte_COMCbk_FSP2SwitchStatusL2_oFSP2_Frame_L2_oLIN01_611deb1e_Rx, ComSignalType=UINT8
        FSP2SwitchStatusL3_oFSP2_Frame_L3_oLIN02_afcd50ee_Rx: ComNotification=Rte_COMCbk_FSP2SwitchStatusL3_oFSP2_Frame_L3_oLIN02_afcd50ee_Rx, ComSignalType=UINT8
        FSP3DiagInfoL2_oFSP3_Frame_L2_oLIN01_c6f3adbf_Rx: ComNotification=Rte_COMCbk_FSP3DiagInfoL2_oFSP3_Frame_L2_oLIN01_c6f3adbf_Rx, ComSignalType=UINT8
        FSP3IndicationCmdL2_oFSP_3_4_Req_L2_oLIN01_088233aa_Tx: ComSignalType=UINT16
        FSP3ResponseErrorL2_oFSP3_Frame_L2_oLIN01_22d09f66_Rx: ComNotification=Rte_COMCbk_FSP3ResponseErrorL2_oFSP3_Frame_L2_oLIN01_22d09f66_Rx, ComSignalType=BOOLEAN
        FSP3SwitchStatusL2_oFSP3_Frame_L2_oLIN01_664b3742_Rx: ComNotification=Rte_COMCbk_FSP3SwitchStatusL2_oFSP3_Frame_L2_oLIN01_664b3742_Rx, ComSignalType=UINT8
        FSP4DiagInfoL2_oFSP4_Frame_L2_oLIN01_66bc232d_Rx: ComNotification=Rte_COMCbk_FSP4DiagInfoL2_oFSP4_Frame_L2_oLIN01_66bc232d_Rx, ComSignalType=UINT8
        FSP4IndicationCmdL2_oFSP_3_4_Req_L2_oLIN01_3a4c07b4_Tx: ComSignalType=UINT16
        FSP4ResponseErrorL2_oFSP4_Frame_L2_oLIN01_141a1e01_Rx: ComNotification=Rte_COMCbk_FSP4ResponseErrorL2_oFSP4_Frame_L2_oLIN01_141a1e01_Rx, ComSignalType=BOOLEAN
        FSP4SwitchStatusL2_oFSP4_Frame_L2_oLIN01_72eb22d6_Rx: ComNotification=Rte_COMCbk_FSP4SwitchStatusL2_oFSP4_Frame_L2_oLIN01_72eb22d6_Rx, ComSignalType=UINT8
        LIN_ACCOrCCIndication_oCIOMtoSlaves2_L4_oLIN03_9dcb84e7_Tx: ComSignalType=UINT8
        LIN_ASLIndication_oCIOMtoSlaves2_L4_oLIN03_70f56c35_Tx: ComSignalType=UINT8
        LIN_AdjustButtonStatus_oRCECStoCIOM_L5_oLIN04_52fa0034_Rx: ComNotification=Rte_COMCbk_LIN_AdjustButtonStatus_oRCECStoCIOM_L5_oLIN04_52fa0034_Rx, ComSignalType=UINT8
        LIN_Adjust_DeviceIndication_oCIOMtoSlaves_L5_oLIN04_2e36f0fb_Tx: ComSignalType=UINT8
        LIN_AudioSystemStatus_oCIOMtoSlaves2_FR1_L1_oLIN00_13393810_Tx: ComSignalType=UINT8
        LIN_AudioVolumeIndicationCmd_oCIOMtoSlaves2_FR1_L1_oLIN00_e9108a0f_Tx: ComSignalType=UINT8
        LIN_BTStatus_oCIOMtoSlaves2_FR2_L1_oLIN00_71f34a0b_Tx: ComSignalType=UINT8
        LIN_BackButtonStatus_oRCECStoCIOM_L5_oLIN04_91249976_Rx: ComNotification=Rte_COMCbk_LIN_BackButtonStatus_oRCECStoCIOM_L5_oLIN04_91249976_Rx, ComSignalType=UINT8
        LIN_BackLightDimming_Status_oELCP1toCIOM_L4_oLIN03_ff25f41e_Rx: ComNotification=Rte_COMCbk_LIN_BackLightDimming_Status_oELCP1toCIOM_L4_oLIN03_ff25f41e_Rx, ComSignalType=UINT8
        LIN_BlackPanelMode_ButtonStat_oELCP1toCIOM_L4_oLIN03_dece2221_Rx: ComNotification=Rte_COMCbk_LIN_BlackPanelMode_ButtonStat_oELCP1toCIOM_L4_oLIN03_dece2221_Rx, ComSignalType=UINT8
        LIN_BunkBAudioOnOff_ButtonStat_oLECMBasic2CIOM_L1_oLIN00_a735a09a_Rx: ComNotification=Rte_COMCbk_LIN_BunkBAudioOnOff_ButtonStat_oLECMBasic2CIOM_L1_oLIN00_a735a09a_Rx, ComSignalType=UINT8
        LIN_BunkBIntLightActvnBtn_stat_oLECMBasic2CIOM_L1_oLIN00_5d53684c_Rx: ComNotification=Rte_COMCbk_LIN_BunkBIntLightActvnBtn_stat_oLECMBasic2CIOM_L1_oLIN00_5d53684c_Rx, ComSignalType=UINT8
        LIN_BunkBParkHeater_ButtonStat_oLECMBasic2CIOM_L1_oLIN00_0c567d49_Rx: ComNotification=Rte_COMCbk_LIN_BunkBParkHeater_ButtonStat_oLECMBasic2CIOM_L1_oLIN00_0c567d49_Rx, ComSignalType=UINT8
        LIN_BunkBTempDec_ButtonStat_oLECMBasic2CIOM_L1_oLIN00_bad7c8e9_Rx: ComNotification=Rte_COMCbk_LIN_BunkBTempDec_ButtonStat_oLECMBasic2CIOM_L1_oLIN00_bad7c8e9_Rx, ComSignalType=UINT8
        LIN_BunkBTempInc_ButtonStat_oLECMBasic2CIOM_L1_oLIN00_7521d3fe_Rx: ComNotification=Rte_COMCbk_LIN_BunkBTempInc_ButtonStat_oLECMBasic2CIOM_L1_oLIN00_7521d3fe_Rx, ComSignalType=UINT8
        LIN_BunkBVolumeDown_ButtonStat_oLECMBasic2CIOM_L1_oLIN00_c7ff11cb_Rx: ComNotification=Rte_COMCbk_LIN_BunkBVolumeDown_ButtonStat_oLECMBasic2CIOM_L1_oLIN00_c7ff11cb_Rx, ComSignalType=UINT8
        LIN_BunkBVolumeUp_ButtonStat_oLECMBasic2CIOM_L1_oLIN00_4fd90c4b_Rx: ComNotification=Rte_COMCbk_LIN_BunkBVolumeUp_ButtonStat_oLECMBasic2CIOM_L1_oLIN00_4fd90c4b_Rx, ComSignalType=UINT8
        LIN_BunkH2AudioOnOff_ButtonSta_oLECM2toCIOM_FR1_L1_oLIN00_8085e670_Rx: ComNotification=Rte_COMCbk_LIN_BunkH2AudioOnOff_ButtonSta_oLECM2toCIOM_FR1_L1_oLIN00_8085e670_Rx, ComSignalType=UINT8
        LIN_BunkH2Fade_ButtonStatus_oLECM2toCIOM_FR1_L1_oLIN00_64ae31ec_Rx: ComNotification=Rte_COMCbk_LIN_BunkH2Fade_ButtonStatus_oLECM2toCIOM_FR1_L1_oLIN00_64ae31ec_Rx, ComSignalType=UINT8
        LIN_BunkH2IntLightActvnBtn_sta_oLECM2toCIOM_FR1_L1_oLIN00_7ae32ea6_Rx: ComNotification=Rte_COMCbk_LIN_BunkH2IntLightActvnBtn_sta_oLECM2toCIOM_FR1_L1_oLIN00_7ae32ea6_Rx, ComSignalType=UINT8
        LIN_BunkH2IntLightDecBtn_stat_oLECM2toCIOM_FR1_L1_oLIN00_445fc32a_Rx: ComNotification=Rte_COMCbk_LIN_BunkH2IntLightDecBtn_stat_oLECM2toCIOM_FR1_L1_oLIN00_445fc32a_Rx, ComSignalType=UINT8
        LIN_BunkH2IntLightIncBtn_stat_oLECM2toCIOM_FR1_L1_oLIN00_a3c1ab0b_Rx: ComNotification=Rte_COMCbk_LIN_BunkH2IntLightIncBtn_stat_oLECM2toCIOM_FR1_L1_oLIN00_a3c1ab0b_Rx, ComSignalType=UINT8
        LIN_BunkH2LockButtonStatus_oLECM2toCIOM_FR1_L1_oLIN00_d71d2857_Rx: ComNotification=Rte_COMCbk_LIN_BunkH2LockButtonStatus_oLECM2toCIOM_FR1_L1_oLIN00_d71d2857_Rx, ComSignalType=UINT8
        LIN_BunkH2OnOFF_ButtonStatus_oLECM2toCIOM_FR1_L1_oLIN00_6a259b90_Rx: ComNotification=Rte_COMCbk_LIN_BunkH2OnOFF_ButtonStatus_oLECM2toCIOM_FR1_L1_oLIN00_6a259b90_Rx, ComSignalType=UINT8
        LIN_BunkH2ParkHeater_ButtonSta_oLECM2toCIOM_FR1_L1_oLIN00_2be63ba3_Rx: ComNotification=Rte_COMCbk_LIN_BunkH2ParkHeater_ButtonSta_oLECM2toCIOM_FR1_L1_oLIN00_2be63ba3_Rx, ComSignalType=UINT8
        LIN_BunkH2Phone_ButtonStatus_oLECM2toCIOM_FR1_L1_oLIN00_99e0fe87_Rx: ComNotification=Rte_COMCbk_LIN_BunkH2Phone_ButtonStatus_oLECM2toCIOM_FR1_L1_oLIN00_99e0fe87_Rx, ComSignalType=UINT8
        LIN_BunkH2PowerWinCloseDSBtn_s_oLECM2toCIOM_FR2_L1_oLIN00_9fa2715d_Rx: ComNotification=Rte_COMCbk_LIN_BunkH2PowerWinCloseDSBtn_s_oLECM2toCIOM_FR2_L1_oLIN00_9fa2715d_Rx, ComSignalType=UINT8
        LIN_BunkH2PowerWinClosePSBtn_s_oLECM2toCIOM_FR2_L1_oLIN00_281d2c26_Rx: ComNotification=Rte_COMCbk_LIN_BunkH2PowerWinClosePSBtn_s_oLECM2toCIOM_FR2_L1_oLIN00_281d2c26_Rx, ComSignalType=UINT8
        LIN_BunkH2PowerWinOpenDSBtn_st_oLECM2toCIOM_FR2_L1_oLIN00_0df6d397_Rx: ComNotification=Rte_COMCbk_LIN_BunkH2PowerWinOpenDSBtn_st_oLECM2toCIOM_FR2_L1_oLIN00_0df6d397_Rx, ComSignalType=UINT8
        LIN_BunkH2PowerWinOpenPSBtn_st_oLECM2toCIOM_FR2_L1_oLIN00_ca96c47e_Rx: ComNotification=Rte_COMCbk_LIN_BunkH2PowerWinOpenPSBtn_st_oLECM2toCIOM_FR2_L1_oLIN00_ca96c47e_Rx, ComSignalType=UINT8
        LIN_BunkH2RoofhatchCloseBtn_St_oLECM2toCIOM_FR1_L1_oLIN00_c184d263_Rx: ComNotification=Rte_COMCbk_LIN_BunkH2RoofhatchCloseBtn_St_oLECM2toCIOM_FR1_L1_oLIN00_c184d263_Rx, ComSignalType=UINT8
        LIN_BunkH2RoofhatchOpenBtn_Sta_oLECM2toCIOM_FR1_L1_oLIN00_dd2458bc_Rx: ComNotification=Rte_COMCbk_LIN_BunkH2RoofhatchOpenBtn_Sta_oLECM2toCIOM_FR1_L1_oLIN00_dd2458bc_Rx, ComSignalType=UINT8
        LIN_BunkH2TempDec_ButtonStatus_oLECM2toCIOM_FR1_L1_oLIN00_857664ae_Rx: ComNotification=Rte_COMCbk_LIN_BunkH2TempDec_ButtonStatus_oLECM2toCIOM_FR1_L1_oLIN00_857664ae_Rx, ComSignalType=UINT8
        LIN_BunkH2TempInc_ButtonStatus_oLECM2toCIOM_FR1_L1_oLIN00_61f74d27_Rx: ComNotification=Rte_COMCbk_LIN_BunkH2TempInc_ButtonStatus_oLECM2toCIOM_FR1_L1_oLIN00_61f74d27_Rx, ComSignalType=UINT8
        LIN_BunkH2VolumeDown_ButtonSta_oLECM2toCIOM_FR1_L1_oLIN00_e04f5721_Rx: ComNotification=Rte_COMCbk_LIN_BunkH2VolumeDown_ButtonSta_oLECM2toCIOM_FR1_L1_oLIN00_e04f5721_Rx, ComSignalType=UINT8
        LIN_BunkH2VolumeUp_ButtonStatu_oLECM2toCIOM_FR1_L1_oLIN00_92cefa8d_Rx: ComNotification=Rte_COMCbk_LIN_BunkH2VolumeUp_ButtonStatu_oLECM2toCIOM_FR1_L1_oLIN00_92cefa8d_Rx, ComSignalType=UINT8
        LIN_DRL_ButtonStatus_oELCP2toCIOM_L4_oLIN03_e8cb5735_Rx: ComNotification=Rte_COMCbk_LIN_DRL_ButtonStatus_oELCP2toCIOM_L4_oLIN03_e8cb5735_Rx, ComSignalType=UINT8
        LIN_DaytimeRunningLight_Indica_oCIOMtoSlaves1_L4_oLIN03_f7c9701b_Tx: ComSignalType=UINT8
        LIN_DifflockDeactivationBtn_st_oDLFWtoCIOM_L4_oLIN03_7700113d_Rx: ComNotification=Rte_COMCbk_LIN_DifflockDeactivationBtn_st_oDLFWtoCIOM_L4_oLIN03_7700113d_Rx, ComSignalType=UINT8
        LIN_DifflockMode_Wheelstatus_oDLFWtoCIOM_L4_oLIN03_80a746c7_Rx: ComNotification=Rte_COMCbk_LIN_DifflockMode_Wheelstatus_oDLFWtoCIOM_L4_oLIN03_80a746c7_Rx, ComSignalType=UINT8
        LIN_DifflockOnOff_Indication_oCIOMtoSlaves2_L4_oLIN03_eaa1e19e_Tx: ComSignalType=UINT8
        LIN_DoorAutoFuncBtn_stat_oILCP1toCIOM_L1_oLIN00_0dc2e67f_Rx: ComNotification=Rte_COMCbk_LIN_DoorAutoFuncBtn_stat_oILCP1toCIOM_L1_oLIN00_0dc2e67f_Rx, ComTimeoutNotification=Rte_COMCbkRxTOut_LIN_DoorAutoFuncBtn_stat_oILCP1toCIOM_L1_oLIN00_0dc2e67f_Rx, ComSignalType=UINT8
        LIN_DoorAutoFuncInd_cmd_oCIOMtoSlaves1_L1_oLIN00_52fafc3c_Tx: ComSignalType=UINT8
        LIN_Down_DeviceIndication_oCIOMtoSlaves_L5_oLIN04_c9ef6b77_Tx: ComSignalType=UINT8
        LIN_DrivingLightPlus_Indicatio_oCIOMtoSlaves1_L4_oLIN03_e75acc52_Tx: ComSignalType=UINT8
        LIN_DrivingLight_Indication_oCIOMtoSlaves1_L4_oLIN03_e3d131c9_Tx: ComSignalType=UINT8
        LIN_EscButtonMuddySiteDeviceIn_oCIOMtoSlaves2_L4_oLIN03_b87af696_Tx: ComSignalType=UINT8
        LIN_EscButtonMuddySiteStatus_oDLFWtoCIOM_L4_oLIN03_ac37f393_Rx: ComNotification=Rte_COMCbk_LIN_EscButtonMuddySiteStatus_oDLFWtoCIOM_L4_oLIN03_ac37f393_Rx, ComSignalType=UINT8
        LIN_FCWPushButton_oCCFWtoCIOM_L4_oLIN03_242f5462_Rx: ComNotification=Rte_COMCbk_LIN_FCWPushButton_oCCFWtoCIOM_L4_oLIN03_242f5462_Rx, ComSignalType=UINT8
        LIN_FCW_DeviceIndication_oCIOMtoSlaves2_L4_oLIN03_246586c3_Tx: ComSignalType=UINT8
        LIN_FogLightFront_ButtonStat_1_oELCP1toCIOM_L4_oLIN03_e1a5bfc2_Rx: ComNotification=Rte_COMCbk_LIN_FogLightFront_ButtonStat_1_oELCP1toCIOM_L4_oLIN03_e1a5bfc2_Rx, ComSignalType=UINT8
        LIN_FogLightFront_ButtonStat_2_oELCP2toCIOM_L4_oLIN03_ea214d6e_Rx: ComNotification=Rte_COMCbk_LIN_FogLightFront_ButtonStat_2_oELCP2toCIOM_L4_oLIN03_ea214d6e_Rx, ComSignalType=UINT8
        LIN_FogLightRear_ButtonStat_1_oELCP1toCIOM_L4_oLIN03_14baadea_Rx: ComNotification=Rte_COMCbk_LIN_FogLightRear_ButtonStat_1_oELCP1toCIOM_L4_oLIN03_14baadea_Rx, ComSignalType=UINT8
        LIN_FogLightRear_ButtonStat_2_oELCP2toCIOM_L4_oLIN03_1f3e5f46_Rx: ComNotification=Rte_COMCbk_LIN_FogLightRear_ButtonStat_2_oELCP2toCIOM_L4_oLIN03_1f3e5f46_Rx, ComSignalType=UINT8
        LIN_FrontFog_Indication_oCIOMtoSlaves1_L4_oLIN03_890ecb12_Tx: ComSignalType=UINT8
        LIN_HeadLampUpDown_SwitchStatu_oELCP2toCIOM_L4_oLIN03_ea48cea1_Rx: ComNotification=Rte_COMCbk_LIN_HeadLampUpDown_SwitchStatu_oELCP2toCIOM_L4_oLIN03_ea48cea1_Rx, ComSignalType=UINT8
        LIN_IntLghtCenterBtnFreeWhl_s_oILCP2toCIOM_L4_oLIN03_27a7dc09_Rx: ComNotification=Rte_COMCbk_LIN_IntLghtCenterBtnFreeWhl_s_oILCP2toCIOM_L4_oLIN03_27a7dc09_Rx, ComSignalType=UINT8
        LIN_IntLghtDimmingLvlDecBtn_s_oILCP1toCIOM_L1_oLIN00_0a50c243_Rx: ComNotification=Rte_COMCbk_LIN_IntLghtDimmingLvlDecBtn_s_oILCP1toCIOM_L1_oLIN00_0a50c243_Rx, ComTimeoutNotification=Rte_COMCbkRxTOut_LIN_IntLghtDimmingLvlDecBtn_s_oILCP1toCIOM_L1_oLIN00_0a50c243_Rx, ComSignalType=UINT8
        LIN_IntLghtDimmingLvlFreeWhl_s_oILCP2toCIOM_L4_oLIN03_9d9afdd7_Rx: ComNotification=Rte_COMCbk_LIN_IntLghtDimmingLvlFreeWhl_s_oILCP2toCIOM_L4_oLIN03_9d9afdd7_Rx, ComSignalType=UINT8
        LIN_IntLghtDimmingLvlIncBtn_s_oILCP1toCIOM_L1_oLIN00_34c0f447_Rx: ComNotification=Rte_COMCbk_LIN_IntLghtDimmingLvlIncBtn_s_oILCP1toCIOM_L1_oLIN00_34c0f447_Rx, ComTimeoutNotification=Rte_COMCbkRxTOut_LIN_IntLghtDimmingLvlIncBtn_s_oILCP1toCIOM_L1_oLIN00_34c0f447_Rx, ComSignalType=UINT8
        LIN_IntLghtLvlIndScaled_cmd_oCIOMtoSlaves2_FR1_L1_oLIN00_9d28ed83_Tx: ComSignalType=UINT8
        LIN_IntLghtMaxModeBtnPnl2_s_oILCP2toCIOM_L4_oLIN03_eeb895fc_Rx: ComNotification=Rte_COMCbk_LIN_IntLghtMaxModeBtnPnl2_s_oILCP2toCIOM_L4_oLIN03_eeb895fc_Rx, ComSignalType=UINT8
        LIN_IntLghtModeSelrFreeWheel_s_oILCP1toCIOM_L1_oLIN00_98c2e509_Rx: ComNotification=Rte_COMCbk_LIN_IntLghtModeSelrFreeWheel_s_oILCP1toCIOM_L1_oLIN00_98c2e509_Rx, ComTimeoutNotification=Rte_COMCbkRxTOut_LIN_IntLghtModeSelrFreeWheel_s_oILCP1toCIOM_L1_oLIN00_98c2e509_Rx, ComSignalType=UINT8
        LIN_IntLghtNightModeBt2_s_oILCP2toCIOM_L4_oLIN03_c1a85f21_Rx: ComNotification=Rte_COMCbk_LIN_IntLghtNightModeBt2_s_oILCP2toCIOM_L4_oLIN03_c1a85f21_Rx, ComSignalType=UINT8
        LIN_IntLghtOffModeInd_cmd_oCIOMtoSlaves1_L1_oLIN00_00d309d6_Tx: ComSignalType=UINT8
        LIN_IntLghtRestModeBtnPnl2_s_oILCP2toCIOM_L4_oLIN03_46e1f77a_Rx: ComNotification=Rte_COMCbk_LIN_IntLghtRestModeBtnPnl2_s_oILCP2toCIOM_L4_oLIN03_46e1f77a_Rx, ComSignalType=UINT8
        LIN_IntLightMaxModeInd_cmd_oCIOMtoSlaves1_L1_oLIN00_523a53e3_Tx: ComSignalType=UINT8
        LIN_IntLightNightModeInd_cmd_oCIOMtoSlaves1_L1_oLIN00_8c1fb2a2_Tx: ComSignalType=UINT8
        LIN_IntLightRestingModeInd_cmd_oCIOMtoSlaves1_L1_oLIN00_df4802bd_Tx: ComSignalType=UINT8
        LIN_LKSPushButton_oCCFWtoCIOM_L4_oLIN03_8e8e108b_Rx: ComNotification=Rte_COMCbk_LIN_LKSPushButton_oCCFWtoCIOM_L4_oLIN03_8e8e108b_Rx, ComSignalType=UINT8
        LIN_LKS_DeviceIndication_oCIOMtoSlaves2_L4_oLIN03_e9d09941_Tx: ComSignalType=UINT8
        LIN_LevelingThumbwheel_stat_oELCP1toCIOM_L4_oLIN03_cb03d712_Rx: ComNotification=Rte_COMCbk_LIN_LevelingThumbwheel_stat_oELCP1toCIOM_L4_oLIN03_cb03d712_Rx, ComSignalType=UINT8
        LIN_LightMode_Status_1_oELCP1toCIOM_L4_oLIN03_c62c6da2_Rx: ComNotification=Rte_COMCbk_LIN_LightMode_Status_1_oELCP1toCIOM_L4_oLIN03_c62c6da2_Rx, ComSignalType=UINT8
        LIN_LightMode_Status_2_oELCP2toCIOM_L4_oLIN03_cda89f0e_Rx: ComNotification=Rte_COMCbk_LIN_LightMode_Status_2_oELCP2toCIOM_L4_oLIN03_cda89f0e_Rx, ComSignalType=UINT8
        LIN_M1_DeviceIndication_oCIOMtoSlaves_L5_oLIN04_d4ecc99f_Tx: ComSignalType=UINT8
        LIN_M2_DeviceIndication_oCIOMtoSlaves_L5_oLIN04_ecd742ec_Tx: ComSignalType=UINT8
        LIN_M3_DeviceIndication_oCIOMtoSlaves_L5_oLIN04_4deec602_Tx: ComSignalType=UINT8
        LIN_MemButtonStatus_oRCECStoCIOM_L5_oLIN04_0975e3a6_Rx: ComNotification=Rte_COMCbk_LIN_MemButtonStatus_oRCECStoCIOM_L5_oLIN04_0975e3a6_Rx, ComSignalType=UINT8
        LIN_Offroad_ButtonStatus_oDLFWtoCIOM_L4_oLIN03_2199360f_Rx: ComNotification=Rte_COMCbk_LIN_Offroad_ButtonStatus_oDLFWtoCIOM_L4_oLIN03_2199360f_Rx, ComSignalType=UINT8
        LIN_Offroad_Indication_oCIOMtoSlaves2_L4_oLIN03_f70e4ef2_Tx: ComSignalType=UINT8
        LIN_ParkingLight_Indication_oCIOMtoSlaves1_L4_oLIN03_de9a5a8c_Tx: ComSignalType=UINT8
        LIN_PhoneButtonIndication_cmd_oCIOMtoSlaves2_FR1_L1_oLIN00_a04041c2_Tx: ComSignalType=UINT8
        LIN_RearFog_Indication_oCIOMtoSlaves1_L4_oLIN03_9af57169_Tx: ComSignalType=UINT8
        LIN_RearWorkProjector_BtnStat_oELCP2toCIOM_L4_oLIN03_bb9bb1f8_Rx: ComNotification=Rte_COMCbk_LIN_RearWorkProjector_BtnStat_oELCP2toCIOM_L4_oLIN03_bb9bb1f8_Rx, ComSignalType=UINT8
        LIN_RearWorkProjector_Indicati_oCIOMtoSlaves2_L4_oLIN03_d4496a61_Tx: ComSignalType=UINT8
        LIN_SelectButtonStatus_oRCECStoCIOM_L5_oLIN04_07d81d0f_Rx: ComNotification=Rte_COMCbk_LIN_SelectButtonStatus_oRCECStoCIOM_L5_oLIN04_07d81d0f_Rx, ComSignalType=UINT8
        LIN_ShortPulseMaxLength_oCIOMtoSlaves_L5_oLIN04_83fa06d3_Tx: ComSignalType=UINT8
        LIN_SpeedControlModeButtonStat_oCCFWtoCIOM_L4_oLIN03_0f6013d7_Rx: ComNotification=Rte_COMCbk_LIN_SpeedControlModeButtonStat_oCCFWtoCIOM_L4_oLIN03_0f6013d7_Rx, ComSignalType=UINT8
        LIN_SpeedControlModeWheelStat_oCCFWtoCIOM_L4_oLIN03_cc9e59ce_Rx: ComNotification=Rte_COMCbk_LIN_SpeedControlModeWheelStat_oCCFWtoCIOM_L4_oLIN03_cc9e59ce_Rx, ComSignalType=UINT8
        LIN_StopButtonStatus_oRCECStoCIOM_L5_oLIN04_c8659d40_Rx: ComNotification=Rte_COMCbk_LIN_StopButtonStatus_oRCECStoCIOM_L5_oLIN04_c8659d40_Rx, ComSignalType=UINT8
        LIN_TCP_ABS_ButtonStatus_oTCPtoMaster_oLIN02_7968eb64_Rx: ComNotification=Rte_COMCbk_LIN_TCP_ABS_ButtonStatus_oTCPtoMaster_oLIN02_7968eb64_Rx, ComSignalType=UINT8
        LIN_TCP_ATC_ButtonStatus_oTCPtoMaster_oLIN02_dff3ccff_Rx: ComNotification=Rte_COMCbk_LIN_TCP_ATC_ButtonStatus_oTCPtoMaster_oLIN02_dff3ccff_Rx, ComSignalType=UINT8
        LIN_TCP_ESC_ButtonStatus_oTCPtoMaster_oLIN02_e4eaf9d3_Rx: ComNotification=Rte_COMCbk_LIN_TCP_ESC_ButtonStatus_oTCPtoMaster_oLIN02_e4eaf9d3_Rx, ComSignalType=UINT8
        LIN_TCP_KnobPostionStatus_oTCPtoMaster_oLIN02_d1058f2b_Rx: ComNotification=Rte_COMCbk_LIN_TCP_KnobPostionStatus_oTCPtoMaster_oLIN02_d1058f2b_Rx, ComSignalType=UINT8
        LIN_TCP_TCS_ButtonStatus_oTCPtoMaster_oLIN02_fa9712f2_Rx: ComNotification=Rte_COMCbk_LIN_TCP_TCS_ButtonStatus_oTCPtoMaster_oLIN02_fa9712f2_Rx, ComSignalType=UINT8
        LIN_Up_DeviceIndication_oCIOMtoSlaves_L5_oLIN04_c6192fe4_Tx: ComSignalType=UINT8
        LIN_WRDownButtonStatus_oRCECStoCIOM_L5_oLIN04_48a8dab2_Rx: ComNotification=Rte_COMCbk_LIN_WRDownButtonStatus_oRCECStoCIOM_L5_oLIN04_48a8dab2_Rx, ComSignalType=UINT8
        LIN_WRUpButtonStatus_oRCECStoCIOM_L5_oLIN04_a2873536_Rx: ComNotification=Rte_COMCbk_LIN_WRUpButtonStatus_oRCECStoCIOM_L5_oLIN04_a2873536_Rx, ComSignalType=UINT8
        PinCode_validity_time_oCIOM_BB2_10P_oBackbone2_d8b8c81c_Tx: ComSignalType=UINT8
        ResponseErrorCCFW_oCCFWtoCIOM_L4_oLIN03_38ff59f8_Rx: ComNotification=Rte_COMCbk_ResponseErrorCCFW_oCCFWtoCIOM_L4_oLIN03_38ff59f8_Rx, ComSignalType=BOOLEAN
        ResponseErrorDLFW_oDLFWtoCIOM_L4_oLIN03_a0bc7d9c_Rx: ComNotification=Rte_COMCbk_ResponseErrorDLFW_oDLFWtoCIOM_L4_oLIN03_a0bc7d9c_Rx, ComSignalType=BOOLEAN
        ResponseErrorELCP1_oELCP1toCIOM_L4_oLIN03_a9bf457f_Rx: ComNotification=Rte_COMCbk_ResponseErrorELCP1_oELCP1toCIOM_L4_oLIN03_a9bf457f_Rx, ComSignalType=BOOLEAN
        ResponseErrorELCP2_oELCP2toCIOM_L4_oLIN03_a23bb7d3_Rx: ComNotification=Rte_COMCbk_ResponseErrorELCP2_oELCP2toCIOM_L4_oLIN03_a23bb7d3_Rx, ComSignalType=BOOLEAN
        ResponseErrorILCP1_oILCP1toCIOM_L1_oLIN00_44250bf0_Rx: ComNotification=Rte_COMCbk_ResponseErrorILCP1_oILCP1toCIOM_L1_oLIN00_44250bf0_Rx, ComTimeoutNotification=Rte_COMCbkRxTOut_ResponseErrorILCP1_oILCP1toCIOM_L1_oLIN00_44250bf0_Rx, ComSignalType=BOOLEAN
        ResponseErrorILCP2_oILCP2toCIOM_L4_oLIN03_9e48a682_Rx: ComNotification=Rte_COMCbk_ResponseErrorILCP2_oILCP2toCIOM_L4_oLIN03_9e48a682_Rx, ComSignalType=BOOLEAN
        ResponseErrorLECM2_oLECM2toCIOM_FR1_L1_oLIN00_ed8050df_Rx: ComNotification=Rte_COMCbk_ResponseErrorLECM2_oLECM2toCIOM_FR1_L1_oLIN00_ed8050df_Rx, ComSignalType=BOOLEAN
        ResponseErrorLECMBasic_oLECMBasic2CIOM_L1_oLIN00_9a0b7e5e_Rx: ComNotification=Rte_COMCbk_ResponseErrorLECMBasic_oLECMBasic2CIOM_L1_oLIN00_9a0b7e5e_Rx, ComSignalType=BOOLEAN
        ResponseErrorRCECS_oRCECStoCIOM_L5_oLIN04_07d94fb4_Rx: ComNotification=Rte_COMCbk_ResponseErrorRCECS_oRCECStoCIOM_L5_oLIN04_07d94fb4_Rx, ComSignalType=BOOLEAN
        ResponseErrorTCP_oTCPtoMaster_oLIN02_2075be52_Rx: ComNotification=Rte_COMCbk_ResponseErrorTCP_oTCPtoMaster_oLIN02_2075be52_Rx, ComSignalType=BOOLEAN
      4 x ComSignalGroup:
        SG_LIN_AlmClkCurAlarm_stat_sg_oCIOMtoSlaves2_FR2_L1_oLIN00_ff5b96ab_Tx
          5 x ComGroupSignal, all with ComSignalType=UINT8:
            LIN_AlmClkCurAlarm_stat_ID_oCIOMtoSlaves2_FR2_L1_oLIN00_19fc9ce3_Tx
            LIN_AlmClkCurAlarm_stat_SetHr_oCIOMtoSlaves2_FR2_L1_oLIN00_88ecba00_Tx
            LIN_AlmClkCurAlarm_stat_SetMin_oCIOMtoSlaves2_FR2_L1_oLIN00_ffefc0f0_Tx
            LIN_AlmClkCurAlarm_stat_Stat_oCIOMtoSlaves2_FR2_L1_oLIN00_a5dbc118_Tx
            LIN_AlmClkCurAlarm_stat_Type_oCIOMtoSlaves2_FR2_L1_oLIN00_ea57a2de_Tx
        SG_LIN_AlmClkSetCurAlm_rqst_sg_oLECM2toCIOM_FR1_L1_oLIN00_05d68799_Rx: ComNotification=Rte_COMCbk_SG_LIN_AlmClkSetCurAlm_rqst_sg_oLECM2toCIOM_FR1_L1_oLIN00_05d68799_Rx
          5 x ComGroupSignal, all with ComSignalType=UINT8:
            LIN_AlmClkSetCurAlm_rqst_ID_oLECM2toCIOM_FR1_L1_oLIN00_6f7167c5_Rx
            LIN_AlmClkSetCurAlm_rqst_SetHr_oLECM2toCIOM_FR1_L1_oLIN00_a212d04d_Rx
            LIN_AlmClkSetCurAlm_rqst_SetMin_oLECM2toCIOM_FR1_L1_oLIN00_ef20f768_Rx
            LIN_AlmClkSetCurAlm_rqst_Stat_oLECM2toCIOM_FR1_L1_oLIN00_2711b94b_Rx
            LIN_AlmClkSetCurAlm_rqst_Type_oLECM2toCIOM_FR1_L1_oLIN00_05162ab9_Rx
        SG_LIN_BunkH2PHTi_rqs_sg_oLECM2toCIOM_FR3_L1_oLIN00_0bf5fe80_Rx: ComNotification=Rte_COMCbk_SG_LIN_BunkH2PHTi_rqs_sg_oLECM2toCIOM_FR3_L1_oLIN00_0bf5fe80_Rx
          5 x ComGroupSignal, all with ComSignalType=UINT8:
            LIN_BunkH2PHTi_rqs_DurnTimeHr_oLECM2toCIOM_FR3_L1_oLIN00_5d2e274e_Rx
            LIN_BunkH2PHTi_rqs_DurnTimeMin_oLECM2toCIOM_FR3_L1_oLIN00_c281bd7b_Rx
            LIN_BunkH2PHTi_rqs_StartTimeHr_oLECM2toCIOM_FR3_L1_oLIN00_68595ad8_Rx
            LIN_BunkH2PHTi_rqs_StartTimeMin_oLECM2toCIOM_FR3_L1_oLIN00_dbd8fc77_Rx
            LIN_BunkH2PHTi_rqs_Timer_cmd_oLECM2toCIOM_FR3_L1_oLIN00_f01ce601_Rx
        SG_LIN_IntLghtModeInd_cmd_sg_oCIOMtoSlaves2_FR1_L1_oLIN00_daaab64c_Tx
          LIN_IntLghtModeInd_cmd_EventFlag_oCIOMtoSlaves2_FR1_L1_oLIN00_b8366a71_Tx (ComGroupSignal): ComSignalType=BOOLEAN
          LIN_IntLghtModeInd_cmd_IL_Mode_oCIOMtoSlaves2_FR1_L1_oLIN00_dfc63d22_Tx (ComGroupSignal): ComSignalType=UINT8
      21 x ComSignal:
        SwitchDetectionNeeded1L1_oFSP1_Frame_L1_oLIN00_099b825d_Rx: ComNotification=Rte_COMCbk_SwitchDetectionNeeded1L1_oFSP1_Frame_L1_oLIN00_099b825d_Rx, ComTimeoutNotification=Rte_COMCbkRxTOut_SwitchDetectionNeeded1L1_oFSP1_Frame_L1_oLIN00_099b825d_Rx, ComSignalType=BOOLEAN
        SwitchDetectionNeeded1L2_oFSP1_Frame_L2_oLIN01_86f68c15_Rx: ComNotification=Rte_COMCbk_SwitchDetectionNeeded1L2_oFSP1_Frame_L2_oLIN01_86f68c15_Rx, ComSignalType=BOOLEAN
        SwitchDetectionNeeded1L3_oFSP1_Frame_L3_oLIN02_482637e5_Rx: ComNotification=Rte_COMCbk_SwitchDetectionNeeded1L3_oFSP1_Frame_L3_oLIN02_482637e5_Rx, ComSignalType=BOOLEAN
        SwitchDetectionNeeded1L4_oFSP1_Frame_L4_oLIN03_435d96c4_Rx: ComNotification=Rte_COMCbk_SwitchDetectionNeeded1L4_oFSP1_Frame_L4_oLIN03_435d96c4_Rx, ComSignalType=BOOLEAN
        SwitchDetectionNeeded1L5_oFSP1_Frame_L5_oLIN04_8ae0e92d_Rx: ComNotification=Rte_COMCbk_SwitchDetectionNeeded1L5_oFSP1_Frame_L5_oLIN04_8ae0e92d_Rx, ComSignalType=BOOLEAN
        SwitchDetectionNeeded2L1_oFSP2_Frame_L1_oLIN00_6fec6f8a_Rx: ComNotification=Rte_COMCbk_SwitchDetectionNeeded2L1_oFSP2_Frame_L1_oLIN00_6fec6f8a_Rx, ComTimeoutNotification=Rte_COMCbkRxTOut_SwitchDetectionNeeded2L1_oFSP2_Frame_L1_oLIN00_6fec6f8a_Rx, ComSignalType=BOOLEAN
        SwitchDetectionNeeded2L2_oFSP2_Frame_L2_oLIN01_e08161c2_Rx: ComNotification=Rte_COMCbk_SwitchDetectionNeeded2L2_oFSP2_Frame_L2_oLIN01_e08161c2_Rx, ComSignalType=BOOLEAN
        SwitchDetectionNeeded2L3_oFSP2_Frame_L3_oLIN02_2e51da32_Rx: ComNotification=Rte_COMCbk_SwitchDetectionNeeded2L3_oFSP2_Frame_L3_oLIN02_2e51da32_Rx, ComSignalType=BOOLEAN
        SwitchDetectionNeeded3L2_oFSP3_Frame_L2_oLIN01_c2ac3a8f_Rx: ComNotification=Rte_COMCbk_SwitchDetectionNeeded3L2_oFSP3_Frame_L2_oLIN01_c2ac3a8f_Rx, ComSignalType=BOOLEAN
        SwitchDetectionNeeded4L2_oFSP4_Frame_L2_oLIN01_2c6eba6c_Rx: ComNotification=Rte_COMCbk_SwitchDetectionNeeded4L2_oFSP4_Frame_L2_oLIN01_2c6eba6c_Rx, ComSignalType=BOOLEAN
        SwitchDetectionResp1L1_oFSP1_SwitchDetResp_L1_oLIN00_e8a163d5_Rx: ComNotification=Rte_COMCbk_SwitchDetectionResp1L1_oFSP1_SwitchDetResp_L1_oLIN00_e8a163d5_Rx, ComSignalType=UINT8_N
        SwitchDetectionResp1L2_oFSP1_SwitchDetResp_L2_oLIN01_02016dd3_Rx: ComNotification=Rte_COMCbk_SwitchDetectionResp1L2_oFSP1_SwitchDetResp_L2_oLIN01_02016dd3_Rx, ComSignalType=UINT8_N
        SwitchDetectionResp1L3_oFSP1_SwitchDetResp_L3_oLIN02_5945d426_Rx: ComNotification=Rte_COMCbk_SwitchDetectionResp1L3_oFSP1_SwitchDetResp_L3_oLIN02_5945d426_Rx, ComSignalType=UINT8_N
        SwitchDetectionResp1L4_oFSP1_SwitchDetResp_L4_oLIN03_0c30779e_Rx: ComNotification=Rte_COMCbk_SwitchDetectionResp1L4_oFSP1_SwitchDetResp_L4_oLIN03_0c30779e_Rx, ComSignalType=UINT8_N
        SwitchDetectionResp1L5_oFSP1_SwitchDetResp_L5_oLIN04_50190a72_Rx: ComNotification=Rte_COMCbk_SwitchDetectionResp1L5_oFSP1_SwitchDetResp_L5_oLIN04_50190a72_Rx, ComSignalType=UINT8_N
        SwitchDetectionResp2L1_oFSP2_SwitchDetResp_L1_oLIN00_865b6493_Rx: ComNotification=Rte_COMCbk_SwitchDetectionResp2L1_oFSP2_SwitchDetResp_L1_oLIN00_865b6493_Rx, ComSignalType=UINT8_N
        SwitchDetectionResp2L2_oFSP2_SwitchDetResp_L2_oLIN01_6cfb6a95_Rx: ComNotification=Rte_COMCbk_SwitchDetectionResp2L2_oFSP2_SwitchDetResp_L2_oLIN01_6cfb6a95_Rx, ComSignalType=UINT8_N
        SwitchDetectionResp2L3_oFSP2_SwitchDetResp_L3_oLIN02_37bfd360_Rx: ComNotification=Rte_COMCbk_SwitchDetectionResp2L3_oFSP2_SwitchDetResp_L3_oLIN02_37bfd360_Rx, ComSignalType=UINT8_N
        SwitchDetectionResp3L2_oFSP3_SwitchDetResp_L2_oLIN01_ff826a68_Rx: ComNotification=Rte_COMCbk_SwitchDetectionResp3L2_oFSP3_SwitchDetResp_L2_oLIN01_ff826a68_Rx, ComSignalType=UINT8_N
        SwitchDetectionResp4L2_oFSP4_SwitchDetResp_L2_oLIN01_b10f6419_Rx: ComNotification=Rte_COMCbk_SwitchDetectionResp4L2_oFSP4_SwitchDetResp_L2_oLIN01_b10f6419_Rx, ComSignalType=UINT8_N
        TCS_Indication_oMastertoTCP_oLIN02_27a40830_Tx: ComSignalType=UINT8
  module config Rte
    36 x RteBswModuleInstance:
      Adc
      BswM
        BswM_MainFunctionTimingEvent0 (RteBswEventToTaskMapping): RteBswUsedOsEventRef=Rte_Ev_Cyclic2_Default_BSW_Async_Task_0_10ms, RteBswUsedOsAlarmRef=Os/Rte_Al_TE2_Default_BSW_Async_Task_0_10ms
      Can
        3 x RteBswEventToTaskMapping, all with RteBswUsedOsEventRef=Rte_Ev_Cyclic2_Default_BSW_Async_Task_0_10ms, RteBswUsedOsAlarmRef=Os/Rte_Al_TE2_Default_BSW_Async_Task_0_10ms:
          Can_MainFunction_BusOffTimingEvent0
          Can_MainFunction_ModeTimingEvent0
          Can_MainFunction_WakeupTimingEvent0
      CanIf
      CanNm
        CanNm_MainFunctionTimingEvent0 (RteBswEventToTaskMapping): RteBswUsedOsEventRef=Rte_Ev_Cyclic2_Default_BSW_Async_Task_0_5ms, RteBswUsedOsAlarmRef=Os/Rte_Al_TE2_Default_BSW_Async_Task_0_5ms
      CanSM
        CanSM_MainFunctionTimingEvent0 (RteBswEventToTaskMapping): RteBswUsedOsEventRef=Rte_Ev_Cyclic2_Default_BSW_Async_Task_0_10ms, RteBswUsedOsAlarmRef=Os/Rte_Al_TE2_Default_BSW_Async_Task_0_10ms
      CanTp
        CanTp_MainFunctionTimingEvent0 (RteBswEventToTaskMapping): RteBswUsedOsEventRef=Rte_Ev_Cyclic2_Default_BSW_Async_Task_0_5ms, RteBswUsedOsAlarmRef=Os/Rte_Al_TE2_Default_BSW_Async_Task_0_5ms
      Com
        3 x RteBswEventToTaskMapping:
          Com_MainFunctionRouteSignalsTimingEvent0: RteBswUsedOsEventRef=Rte_Ev_Cyclic2_Default_BSW_Async_Task_0_10ms, RteBswUsedOsAlarmRef=Os/Rte_Al_TE2_Default_BSW_Async_Task_0_10ms
          Com_MainFunctionRxTimingEvent0: RteBswUsedOsEventRef=Rte_Ev_Cyclic2_Default_BSW_Async_Task_0_10ms, RteBswUsedOsAlarmRef=Os/Rte_Al_TE2_Default_BSW_Async_Task_0_10ms
          Com_MainFunctionTxTimingEvent0: RteBswUsedOsEventRef=Rte_Ev_Cyclic2_Default_BSW_Async_Task_0_5ms, RteBswUsedOsAlarmRef=Os/Rte_Al_TE2_Default_BSW_Async_Task_0_5ms
      ComM
        10 x RteBswEventToTaskMapping, all with RteBswUsedOsEventRef=Rte_Ev_Cyclic2_Default_BSW_Async_Task_0_20ms, RteBswUsedOsAlarmRef=Os/Rte_Al_TE2_Default_BSW_Async_Task_0_20ms:
          ComM_MainFunction_{0..9}TimingEvent0
      Dcm
        Dcm_MainFunctionTimingEvent0 (RteBswEventToTaskMapping): RteBswUsedOsEventRef=Rte_Ev_Cyclic2_Default_BSW_Async_Task_0_10ms, RteBswUsedOsAlarmRef=Os/Rte_Al_TE2_Default_BSW_Async_Task_0_10ms
      Dem
        Dem_MasterMainFunctionTimingEvent0 (RteBswEventToTaskMapping): RteBswUsedOsEventRef=Rte_Ev_Cyclic2_Default_BSW_Async_Task_0_100ms, RteBswUsedOsAlarmRef=Os/Rte_Al_TE2_Default_BSW_Async_Task_0_100ms
        Dem_SatelliteMainFunctionTimingEvent0 (RteBswEventToTaskMapping): RteBswUsedOsEventRef=Rte_Ev_Cyclic2_Default_BSW_Async_Task_0_100ms, RteBswUsedOsAlarmRef=Os/Rte_Al_TE2_Default_BSW_Async_Task_0_100ms
      Det
      Dio
      EcuM
        EcuM_MainFunctionTimingEvent0 (RteBswEventToTaskMapping): RteBswUsedOsEventRef=Rte_Ev_Cyclic2_Default_BSW_Async_Task_0_100ms, RteBswUsedOsAlarmRef=Os/Rte_Al_TE2_Default_BSW_Async_Task_0_100ms
      Fee
        Fee_MainFunctionTimingEvent0 (RteBswEventToTaskMapping): RteBswUsedOsEventRef=Rte_Ev_Cyclic2_Default_BSW_Async_Task_0_5ms, RteBswUsedOsAlarmRef=Os/Rte_Al_TE2_Default_BSW_Async_Task_0_5ms
      Fls
        Fls_MainFunctionTimingEvent0 (RteBswEventToTaskMapping): RteBswUsedOsEventRef=Rte_Ev_Cyclic2_Default_BSW_Async_Task_0_10ms, RteBswUsedOsAlarmRef=Os/Rte_Al_TE2_Default_BSW_Async_Task_0_10ms
      Gpt
      Icu
      IoHwAb
      Issm
        Issm_MainFunctionTimingEvent0 (RteBswEventToTaskMapping): RteBswUsedOsEventRef=Rte_Ev_Cyclic2_Default_BSW_Async_Task_0_10ms, RteBswUsedOsAlarmRef=Os/Rte_Al_TE2_Default_BSW_Async_Task_0_10ms
      J1939Nm
        J1939Nm_MainFunctionTimingEvent0 (RteBswEventToTaskMapping): RteBswUsedOsEventRef=Rte_Ev_Cyclic2_Default_BSW_Async_Task_0_10ms, RteBswUsedOsAlarmRef=Os/Rte_Al_TE2_Default_BSW_Async_Task_0_10ms
      J1939Rm
        J1939Rm_MainFunctionTimingEvent0 (RteBswEventToTaskMapping): RteBswUsedOsEventRef=Rte_Ev_Cyclic2_Default_BSW_Async_Task_0_10ms, RteBswUsedOsAlarmRef=Os/Rte_Al_TE2_Default_BSW_Async_Task_0_10ms
      J1939Tp
        J1939Tp_MainFunctionTimingEvent0 (RteBswEventToTaskMapping): RteBswUsedOsEventRef=Rte_Ev_Cyclic2_Default_BSW_Async_Task_0_10ms, RteBswUsedOsAlarmRef=Os/Rte_Al_TE2_Default_BSW_Async_Task_0_10ms
      Lin
      LinIf
        LinIf_MainFunctionTimingEvent0 (RteBswEventToTaskMapping): RteBswUsedOsEventRef=Rte_Ev_Cyclic2_Default_BSW_Async_Task_0_5ms, RteBswUsedOsAlarmRef=Os/Rte_Al_TE2_Default_BSW_Async_Task_0_5ms
      LinSM
        LinSM_MainFunctionTimingEvent0 (RteBswEventToTaskMapping): RteBswUsedOsEventRef=Rte_Ev_Cyclic2_Default_BSW_Async_Task_0_10ms, RteBswUsedOsAlarmRef=Os/Rte_Al_TE2_Default_BSW_Async_Task_0_10ms
      LinTp
      Mcl
      Mcu
      Nm
      NvM
        NvM_MainFunctionTimingEvent0 (RteBswEventToTaskMapping): RteBswUsedOsEventRef=Rte_Ev_Cyclic2_Default_BSW_Async_Task_0_10ms, RteBswUsedOsAlarmRef=Os/Rte_Al_TE2_Default_BSW_Async_Task_0_10ms
      PduR
      Port
      Pwm
      Spi
        Spi_MainFunction_HandlingTimingEvent0 (RteBswEventToTaskMapping)
      Wdg
    25 x RteSwComponentInstance:
      BswM_EcuSwComposition
        6 x RteEventToTaskMapping:
          Timer_BswM_MainFunction: RteUsedOsEventRef=Rte_Ev_Cyclic2_Default_BSW_Async_Task_0_10ms, RteUsedOsAlarmRef=Os/Rte_Al_TE2_Default_BSW_Async_Task_0_10ms
          DataReceivedEvent_BswM_Read_LIN{1..5}_ScheduleTableRequestMode_Request_LIN{1..5}_ScheduleTableRequestMode_requestedMode: RteUsedOsEventRef=Rte_Ev_Run_BswM_BswM_Read_LIN{1..5}_ScheduleTableRequestMode
      CDD_LFIC_EcuSwComposition
      CDD_RFIC_EcuSwComposition
        OIT_RE_rfic_init_RficInit_P_CS (RteEventToTaskMapping): RteUsedOsEventRef=Rte_Ev_Run_CDD_RFIC_RE_rfic_init
      ComM_EcuSwComposition
        30 x RteEventToTaskMapping:
          Timer_ComM_MainFunction_{0..9}: RteUsedOsEventRef=Rte_Ev_Cyclic2_Default_BSW_Async_Task_0_20ms, RteUsedOsAlarmRef=Os/Rte_Al_TE2_Default_BSW_Async_Task_0_20ms
          OpEventGetCurrentComMode_GetCurrentComMode_UR_CN_Backbone1J1939_2a22de3d: RteUsedOsEventRef=Rte_Ev_Run_ComM_GetCurrentComMode
          OpEventGetCurrentComMode_GetCurrentComMode_UR_CN_Backbone2_3f947ba3: RteUsedOsEventRef=Rte_Ev_Run_ComM_GetCurrentComMode
          OpEventGetCurrentComMode_GetCurrentComMode_UR_CN_CabSubnet_aa77b0b0: RteUsedOsEventRef=Rte_Ev_Run_ComM_GetCurrentComMode
          OpEventGetCurrentComMode_GetCurrentComMode_UR_CN_FMSNet_05490e3d: RteUsedOsEventRef=Rte_Ev_Run_ComM_GetCurrentComMode
          OpEventGetCurrentComMode_GetCurrentComMode_UR_CN_LIN00_ace1a6ba: RteUsedOsEventRef=Rte_Ev_Run_ComM_GetCurrentComMode
          OpEventGetCurrentComMode_GetCurrentComMode_UR_CN_LIN01_4323cd84: RteUsedOsEventRef=Rte_Ev_Run_ComM_GetCurrentComMode
          OpEventGetCurrentComMode_GetCurrentComMode_UR_CN_LIN02_a8147687: RteUsedOsEventRef=Rte_Ev_Run_ComM_GetCurrentComMode
          OpEventGetCurrentComMode_GetCurrentComMode_UR_CN_LIN03_47d61db9: RteUsedOsEventRef=Rte_Ev_Run_ComM_GetCurrentComMode
          OpEventGetCurrentComMode_GetCurrentComMode_UR_CN_LIN04_a50a06c0: RteUsedOsEventRef=Rte_Ev_Run_ComM_GetCurrentComMode
          OpEventGetCurrentComMode_GetCurrentComMode_UR_CN_SecuritySubnet_7cec9a61: RteUsedOsEventRef=Rte_Ev_Run_ComM_GetCurrentComMode
          OpEventRequestComMode_RequestComMode_UR_CN_Backbone1J1939_2a22de3d: RteUsedOsEventRef=Rte_Ev_Run_ComM_RequestComMode
          OpEventRequestComMode_RequestComMode_UR_CN_Backbone2_3f947ba3: RteUsedOsEventRef=Rte_Ev_Run_ComM_RequestComMode
          OpEventRequestComMode_RequestComMode_UR_CN_CabSubnet_aa77b0b0: RteUsedOsEventRef=Rte_Ev_Run_ComM_RequestComMode
          OpEventRequestComMode_RequestComMode_UR_CN_FMSNet_05490e3d: RteUsedOsEventRef=Rte_Ev_Run_ComM_RequestComMode
          OpEventRequestComMode_RequestComMode_UR_CN_LIN00_ace1a6ba: RteUsedOsEventRef=Rte_Ev_Run_ComM_RequestComMode
          OpEventRequestComMode_RequestComMode_UR_CN_LIN01_4323cd84: RteUsedOsEventRef=Rte_Ev_Run_ComM_RequestComMode
          OpEventRequestComMode_RequestComMode_UR_CN_LIN02_a8147687: RteUsedOsEventRef=Rte_Ev_Run_ComM_RequestComMode
          OpEventRequestComMode_RequestComMode_UR_CN_LIN03_47d61db9: RteUsedOsEventRef=Rte_Ev_Run_ComM_RequestComMode
          OpEventRequestComMode_RequestComMode_UR_CN_LIN04_a50a06c0: RteUsedOsEventRef=Rte_Ev_Run_ComM_RequestComMode
          OpEventRequestComMode_RequestComMode_UR_CN_SecuritySubnet_7cec9a61: RteUsedOsEventRef=Rte_Ev_Run_ComM_RequestComMode
      Dcm_EcuSwComposition
        Timer_Dcm_MainFunction (RteEventToTaskMapping): RteUsedOsEventRef=Rte_Ev_Cyclic2_Default_BSW_Async_Task_0_10ms, RteUsedOsAlarmRef=Os/Rte_Al_TE2_Default_BSW_Async_Task_0_10ms
      DemMaster_OsApplication_Untrusted_Core0_EcuSwComposition
        Timer_Dem_MasterMainFunction (RteEventToTaskMapping): RteUsedOsEventRef=Rte_Ev_Cyclic2_Default_BSW_Async_Task_0_100ms, RteUsedOsAlarmRef=Os/Rte_Al_TE2_Default_BSW_Async_Task_0_100ms
        OpEventSetOperationCycleState_SetOperationCycleState_OpCycle_DemOperationCycle_0 (RteEventToTaskMapping): RteUsedOsEventRef=Rte_Ev_Run_DemMaster_OsApplication_Untrusted_Core0_SetOperationCycleState
      DemSatellite_OsApplication_Untrusted_Core0_EcuSwComposition
        Timer_Dem_SatelliteMainFunction (RteEventToTaskMapping): RteUsedOsEventRef=Rte_Ev_Cyclic2_Default_BSW_Async_Task_0_100ms, RteUsedOsAlarmRef=Os/Rte_Al_TE2_Default_BSW_Async_Task_0_100ms
      Det_EcuSwComposition
      EcuM_EcuSwComposition
        Timer_EcuM_MainFunction (RteEventToTaskMapping): RteUsedOsEventRef=Rte_Ev_Cyclic2_Default_BSW_Async_Task_0_100ms, RteUsedOsAlarmRef=Os/Rte_Al_TE2_Default_BSW_Async_Task_0_100ms
        OpEventSelectShutdownTarget_SelectShutdownTarget_EcuM_ShutdownTarget (RteEventToTaskMapping): RteUsedOsEventRef=Rte_Ev_Run_EcuM_SelectShutdownTarget
      IOHWAB_EcuSwComposition
        Timer_IoHwAb_REIoHwAb_10ms (RteEventToTaskMapping): RteUsedOsEventRef=Rte_Ev_Cyclic_StartApplication_Trusted_Task_0_10ms, RteUsedOsAlarmRef=Os/Rte_Al_TE_StartApplication_Trusted_Task_0_10ms
        OpEventIoHwAb_RficNRESDio_P_Read_Read_RficNRESDio_P (RteEventToTaskMapping): RteUsedOsEventRef=Rte_Ev_Run_IOHWAB_IoHwAb_RficNRESDio_P_Read
      Issm_EcuSwComposition
        Timer_Issm_MainFunction (RteEventToTaskMapping): RteUsedOsEventRef=Rte_Ev_Cyclic2_Default_BSW_Async_Task_0_10ms, RteUsedOsAlarmRef=Os/Rte_Al_TE2_Default_BSW_Async_Task_0_10ms
      J1939Rm_EcuSwComposition
        Timer_J1939Rm_MainFunction (RteEventToTaskMapping): RteUsedOsEventRef=Rte_Ev_Cyclic2_Default_BSW_Async_Task_0_10ms, RteUsedOsAlarmRef=Os/Rte_Al_TE2_Default_BSW_Async_Task_0_10ms
      NvM_EcuSwComposition
        Timer_NvM_MainFunction (RteEventToTaskMapping): RteUsedOsEventRef=Rte_Ev_Cyclic2_Default_BSW_Async_Task_0_10ms, RteUsedOsAlarmRef=Os/Rte_Al_TE2_Default_BSW_Async_Task_0_10ms
      Os_OsCore0_swc_EcuSwComposition
      PVTApp_AdiInterfaces_EcuSwComposition
        TMT_Re_PvtAdInterfaces (RteEventToTaskMapping): RteUsedOsEventRef=Rte_Ev_Cyclic_StartApplication_Trusted_Task_0_10ms, RteUsedOsAlarmRef=Os/Rte_Al_TE_StartApplication_Trusted_Task_0_10ms
      PVTApp_Do12VInterface_EcuSwComposition
        TMT_Re_PvtDo12VInterface (RteEventToTaskMapping): RteUsedOsEventRef=Rte_Ev_Cyclic_PvtTask_0_10ms, RteUsedOsAlarmRef=Os/Rte_Al_TE_PvtTask_0_10ms
      PVTApp_DobhsCtrlInterface_EcuSwComposition
        TMT_Re_PvtDobhsInterface (RteEventToTaskMapping): RteUsedOsEventRef=Rte_Ev_Cyclic_StartApplication_Trusted_Task_0_10ms, RteUsedOsAlarmRef=Os/Rte_Al_TE_StartApplication_Trusted_Task_0_10ms
      PVTApp_DowhsDowlsInterface_EcuSwComposition
        TMT_Re_PvtDowhsDowlsInterface (RteEventToTaskMapping): RteUsedOsEventRef=Rte_Ev_Cyclic_StartApplication_Trusted_Task_0_10ms, RteUsedOsAlarmRef=Os/Rte_Al_TE_StartApplication_Trusted_Task_0_10ms
      StartApplication_EcuSwComposition
        7 x RteEventToTaskMapping:
          Timer_StartApplication_Cyclic1000ms: RteUsedOsEventRef=Rte_Ev_Run_StartApplication_StartApplication_Cyclic1000ms, RteUsedOsAlarmRef=Os/Rte_Al_TE_StartApplication_StartApplication_Cyclic1000ms
          Timer_StartApplication_Cyclic10ms: RteUsedOsEventRef=Rte_Ev_Run_StartApplication_StartApplication_Cyclic10ms, RteUsedOsAlarmRef=Os/Rte_Al_TE_StartApplication_StartApplication_Cyclic10ms
          Timer_StartApplication_Cyclic1ms: RteUsedOsEventRef=Rte_Ev_Run_StartApplication_StartApplication_Cyclic1ms, RteUsedOsAlarmRef=Os/Rte_Al_TE_StartApplication_StartApplication_Cyclic1ms
          Timer_StartApplication_Cyclic250ms: RteUsedOsEventRef=Rte_Ev_Run_StartApplication_StartApplication_Cyclic250ms, RteUsedOsAlarmRef=Os/Rte_Al_TE_StartApplication_StartApplication_Cyclic250ms
          Timer_StartApplication_MEMORYPROTECTION_Cyclic10ms: RteUsedOsEventRef=Rte_Ev_Run_StartApplication_StartApplication_MEMORYPROTECTION_Cyclic10ms, RteUsedOsAlarmRef=Os/Rte_Al_TE_StartApplication_StartApplication_MEMORYPROTECTION_Cyclic10ms
          DataReceivedEvent_StartApplication_OnDataRec_RxCtrl_PpTrailer3CalibratedTotalLoad_ISig_4_oHMIIOM_BB2_15P_oBackbone2_a94_8da52e5b: RteUsedOsEventRef=Rte_Ev_Run_StartApplication_StartApplication_OnDataRec_RxCtrl
          DataReceivedEvent_StartApplication_OnDataRec_RxData_PpEngineGasRate_oEMS_BB2_05P_oBackbone2_96ec243f_Rx_DeEngineGasRate_000974b3: RteUsedOsEventRef=Rte_Ev_Run_StartApplication_StartApplication_OnDataRec_RxData
      StartApplicationMemoryAccessState_EcuSwComposition
      StartApplicationTrusted_EcuSwComposition
        DataReceivedEvent_StartApplicationTrusted_OnDataRec_TrustedData_PpTrustedData_DeValue (RteEventToTaskMapping): RteUsedOsEventRef=Rte_Ev_Run_StartApplicationTrusted_StartApplicationTrusted_OnDataRec_TrustedData
      TP_EcuSwComposition
        TMT_RE_SMK_TP (RteEventToTaskMapping): RteUsedOsEventRef=Rte_Ev_Run_TP_RE_SMK_TP, RteUsedOsAlarmRef=Os/Rte_Al_TE_TP_RE_SMK_TP
      Telegram_EcuSwComposition
        TMT_RE_SMK_Telegram (RteEventToTaskMapping): RteUsedOsEventRef=Rte_Ev_Cyclic_PvtTask_0_10ms, RteUsedOsAlarmRef=Os/Rte_Al_TE_PvtTask_0_10ms
      TestLin_EcuSwComposition
        27 x RteEventToTaskMapping:
          TMT_ReTestLin: RteUsedOsEventRef=Rte_Ev_Cyclic_PvtTask_0_10ms, RteUsedOsAlarmRef=Os/Rte_Al_TE_PvtTask_0_10ms
          DRT_Re_LIN0_FSP1_L1_FSP1DiagInfoL1_RXCbk_FSP1DiagInfoL1_FSP1DiagInfoL1: RteUsedOsEventRef=Rte_Ev_Run_TestLin_Re_LIN0_FSP1_L1_FSP1DiagInfoL1_RXCbk
          DRET_Re_LIN0_FSP1_RxTimeout_FSP1DiagInfoL1_FSP1DiagInfoL1: RteUsedOsEventRef=Rte_Ev_Run_TestLin_Re_LIN0_FSP1_L1_FSP1DiagInfoL1_RxTimeout
          DRT_Re_LIN0_FSP1_L1_FSP1ResponseErrorL1_RXCbk_FSP1ResponseErrorL1_FSP1ResponseErrorL1: RteUsedOsEventRef=Rte_Ev_Run_TestLin_Re_LIN0_FSP1_L1_FSP1ResponseErrorL1_RXCbk
          DRET_Re_LIN0_FSP1_L1_FSP1ResponseErrorL1_RxTimeout_FSP1ResponseErrorL1_FSP1ResponseErrorL1: RteUsedOsEventRef=Rte_Ev_Run_TestLin_Re_LIN0_FSP1_L1_FSP1ResponseErrorL1_RxTimeout
          DRT_Re_LIN0_FSP1_L1_SwitchDetectionNeeded1L1_RXCbk_SwitchDetectionNeeded1L1_SwitchDetectionNeeded1L1: RteUsedOsEventRef=Rte_Ev_Run_TestLin_Re_LIN0_FSP1_L1_SwitchDetectionNeeded1L1_RXCbk
          DRET_Re_LIN0_FSP1_L1_SwitchDetectionNeeded1L1_RxTimeout_SwitchDetectionNeeded1L1_SwitchDetectionNeeded1L1: RteUsedOsEventRef=Rte_Ev_Run_TestLin_Re_LIN0_FSP1_L1_SwitchDetectionNeeded1L1_RxTimeout
          DRT_Re_LIN0_FSP2_L1_FSP2DiagInfoL1_RXCbk_FSP2DiagInfoL1_FSP2DiagInfoL1: RteUsedOsEventRef=Rte_Ev_Run_TestLin_Re_LIN0_FSP2_L1_FSP2DiagInfoL1_RXCbk
          DRET_Re_LIN0_FSP2_L1_RxTimeout_FSP2DiagInfoL1_FSP2DiagInfoL1: RteUsedOsEventRef=Rte_Ev_Run_TestLin_Re_LIN0_FSP2_L1_FSP2DiagInfoL1_RxTimeout
          DRT_Re_LIN0_FSP2_L1_FSP2ResponseErrorL1_RXCbk_FSP2ResponseErrorL1_FSP2ResponseErrorL1: RteUsedOsEventRef=Rte_Ev_Run_TestLin_Re_LIN0_FSP2_L1_FSP2ResponseErrorL1_RXCbk
          DRET_Re_LIN0_FSP2_L1_RxTimeout_1_FSP2ResponseErrorL1_FSP2ResponseErrorL1: RteUsedOsEventRef=Rte_Ev_Run_TestLin_Re_LIN0_FSP2_L1_FSP2ResponseErrorL1_RxTimeout
          DRT_Re_LIN0_FSP2_L1_FSP2SwitchStatusL1_RXCbk_FSP2SwitchStatusL1_FSP2SwitchStatusL1: RteUsedOsEventRef=Rte_Ev_Run_TestLin_Re_LIN0_FSP2_L1_FSP2SwitchStatusL1_RXCbk
          DRET_Re_LIN0_FSP2_L1_RxTimeout_1_1_FSP2SwitchStatusL1_FSP2SwitchStatusL1: RteUsedOsEventRef=Rte_Ev_Run_TestLin_Re_LIN0_FSP2_L1_FSP2SwitchStatusL1_RxTimeout
          DRT_Re_LIN0_FSP2_L1_SwitchDetectionNeeded2L1_RXCbk_SwitchDetectionNeeded2L1_SwitchDetectionNeeded2L1: RteUsedOsEventRef=Rte_Ev_Run_TestLin_Re_LIN0_FSP2_L1_SwitchDetectionNeeded2L1_RXCbk
          DRET_Re_LIN0_FSP2_L1_RxTimeout_1_1_1_SwitchDetectionNeeded2L1_SwitchDetectionNeeded2L1: RteUsedOsEventRef=Rte_Ev_Run_TestLin_Re_LIN0_FSP2_L1_SwitchDetectionNeeded2L1_RxTimeout
          DRT_Re_LIN0_ILCP1_DiagInfoILCP1_RXCbk_DiagInfoILCP1_DiagInfoILCP1: RteUsedOsEventRef=Rte_Ev_Run_TestLin_Re_LIN0_ILCP1_DiagInfoILCP1_RXCbk
          DRET_Re_LIN0_ILCP1_RxTimeout_DiagInfoILCP1_DiagInfoILCP1: RteUsedOsEventRef=Rte_Ev_Run_TestLin_Re_LIN0_ILCP1_DiagInfoILCP1_RxTimeout
          DRT_Re_LIN0_ILCP1_LIN_DoorAutoFuncBtn_stat_RXCbk_LIN_DoorAutoFuncBtn_stat_LIN_DoorAutoFuncBtn_stat: RteUsedOsEventRef=Rte_Ev_Run_TestLin_Re_LIN0_ILCP1_LIN_DoorAutoFuncBtn_stat_RXCbk
          DRET_Re_LIN0_ILCP1_RxTimeout_1_LIN_DoorAutoFuncBtn_stat_LIN_DoorAutoFuncBtn_stat: RteUsedOsEventRef=Rte_Ev_Run_TestLin_Re_LIN0_ILCP1_LIN_DoorAutoFuncBtn_stat_RxTimeout
          DRT_Re_LIN0_ILCP1_LIN_IntLghtDimmingLvlDecBtn_s_RXCbk_LIN_IntLghtDimmingLvlDecBtn_s_LIN_IntLghtDimmingLvlDecBtn_s: RteUsedOsEventRef=Rte_Ev_Run_TestLin_Re_LIN0_ILCP1_LIN_IntLghtDimmingLvlDecBtn_s_RXCbk
          DRET_Re_LIN0_ILCP1_RxTimeout_1_1_LIN_IntLghtDimmingLvlDecBtn_s_LIN_IntLghtDimmingLvlDecBtn_s: RteUsedOsEventRef=Rte_Ev_Run_TestLin_Re_LIN0_ILCP1_LIN_IntLghtDimmingLvlDecBtn_s_RxTimeout
          DRT_Re_LIN0_ILCP1_LIN_IntLghtDimmingLvlIncBtn_s_RXCbk_LIN_IntLghtDimmingLvlIncBtn_s_LIN_IntLghtDimmingLvlIncBtn_s: RteUsedOsEventRef=Rte_Ev_Run_TestLin_Re_LIN0_ILCP1_LIN_IntLghtDimmingLvlIncBtn_s_RXCbk
          DRET_Re_LIN0_ILCP1_RxTimeout_1_1_1_LIN_IntLghtDimmingLvlIncBtn_s_LIN_IntLghtDimmingLvlIncBtn_s: RteUsedOsEventRef=Rte_Ev_Run_TestLin_Re_LIN0_ILCP1_LIN_IntLghtDimmingLvlIncBtn_s_RxTimeout
          DRT_Re_LIN0_ILCP1_LIN_IntLghtModeSelrFreeWheel_s_RXCbk_LIN_IntLghtModeSelrFreeWheel_s_LIN_IntLghtModeSelrFreeWheel_s: RteUsedOsEventRef=Rte_Ev_Run_TestLin_Re_LIN0_ILCP1_LIN_IntLghtModeSelrFreeWheel_s_RXCbk
          DRET_Re_LIN0_ILCP1_RxTimeout_1_1_1_1_LIN_IntLghtModeSelrFreeWheel_s_LIN_IntLghtModeSelrFreeWheel_s: RteUsedOsEventRef=Rte_Ev_Run_TestLin_Re_LIN0_ILCP1_LIN_IntLghtModeSelrFreeWheel_s_RxTimeout
          DRT_Re_LIN0_ILCP1_ResponseErrorILCP1_RXCbk_ResponseErrorILCP1_ResponseErrorILCP1: RteUsedOsEventRef=Rte_Ev_Run_TestLin_Re_LIN0_ILCP1_ResponseErrorILCP1_RXCbk
          DRET_Re_LIN0_ILCP1_RxTimeout_1_1_1_1_1_ResponseErrorILCP1_ResponseErrorILCP1: RteUsedOsEventRef=Rte_Ev_Run_TestLin_Re_LIN0_ILCP1_ResponseErrorILCP1_RxTimeout
      vDem42_EcuSwComposition
    RteOsInteraction
      12 x RteUsedOsActivation, all with RteExpectedActivationOffset=0:
        Rte_Al_TE_StartApplication_StartApplication_Cyclic1000ms: RteActivationOsAlarmRef=Os/Rte_Al_TE_StartApplication_StartApplication_Cyclic1000ms, RteActivationOsTaskRef=Default_Appl_Task
        Rte_Al_TE_StartApplication_StartApplication_Cyclic10ms: RteActivationOsAlarmRef=Os/Rte_Al_TE_StartApplication_StartApplication_Cyclic10ms, RteActivationOsTaskRef=Default_Appl_Task
        Rte_Al_TE_StartApplication_StartApplication_Cyclic1ms: RteActivationOsAlarmRef=Os/Rte_Al_TE_StartApplication_StartApplication_Cyclic1ms, RteActivationOsTaskRef=Default_Appl_Task
        Rte_Al_TE_StartApplication_StartApplication_Cyclic250ms: RteActivationOsAlarmRef=Os/Rte_Al_TE_StartApplication_StartApplication_Cyclic250ms, RteActivationOsTaskRef=Default_Appl_Task
        Rte_Al_TE2_Default_BSW_Async_Task_0_100ms: RteActivationOsAlarmRef=Os/Rte_Al_TE2_Default_BSW_Async_Task_0_100ms, RteActivationOsTaskRef=Default_BSW_Async_Task
        Rte_Al_TE2_Default_BSW_Async_Task_0_10ms: RteActivationOsAlarmRef=Os/Rte_Al_TE2_Default_BSW_Async_Task_0_10ms, RteActivationOsTaskRef=Default_BSW_Async_Task
        Rte_Al_TE2_Default_BSW_Async_Task_0_20ms: RteActivationOsAlarmRef=Os/Rte_Al_TE2_Default_BSW_Async_Task_0_20ms, RteActivationOsTaskRef=Default_BSW_Async_Task
        Rte_Al_TE2_Default_BSW_Async_Task_0_5ms: RteActivationOsAlarmRef=Os/Rte_Al_TE2_Default_BSW_Async_Task_0_5ms, RteActivationOsTaskRef=Default_BSW_Async_Task
        Rte_Al_TE_PvtTask_0_10ms: RteActivationOsAlarmRef=Os/Rte_Al_TE_PvtTask_0_10ms, RteActivationOsTaskRef=PvtTask
        Rte_Al_TE_TP_RE_SMK_TP: RteActivationOsAlarmRef=Os/Rte_Al_TE_TP_RE_SMK_TP, RteActivationOsTaskRef=PvtTask
        Rte_Al_TE_StartApplication_StartApplication_MEMORYPROTECTION_Cyclic10ms: RteActivationOsAlarmRef=Os/Rte_Al_TE_StartApplication_StartApplication_MEMORYPROTECTION_Cyclic10ms, RteActivationOsTaskRef=StartApplication_MemoryViolation_Task
        Rte_Al_TE_StartApplication_Trusted_Task_0_10ms: RteActivationOsAlarmRef=Os/Rte_Al_TE_StartApplication_Trusted_Task_0_10ms, RteActivationOsTaskRef=StartApplication_Trusted_Task
  module config NvM
  module config Os
    Default_Appl_Task (OsTask):
      OsTaskActivation = 1
      OsTaskPriority = 5
      OsTaskSchedule = FULL
      OsTaskEventRef = Rte_Ev_Run_StartApplication_StartApplication_Cyclic1000ms
      OsTaskEventRef = Rte_Ev_Run_StartApplication_StartApplication_Cyclic10ms
      OsTaskEventRef = Rte_Ev_Run_StartApplication_StartApplication_Cyclic1ms
      OsTaskEventRef = Rte_Ev_Run_StartApplication_StartApplication_Cyclic250ms
      OsTaskEventRef = Rte_Ev_Run_StartApplication_StartApplication_OnDataRec_RxCtrl
      OsTaskEventRef = Rte_Ev_Run_StartApplication_StartApplication_OnDataRec_RxData
      OsTaskAccessingApplication = OsApplication_Trusted_Core0
    4 x OsAlarm, all with OsAlarmCounterRef=SystemTimer:
      Rte_Al_TE_StartApplication_StartApplication_Cyclic1000ms
        OsAlarmAction
          OsAlarmSetEvent: OsAlarmSetEventRef=Rte_Ev_Run_StartApplication_StartApplication_Cyclic1000ms, OsAlarmSetEventTaskRef=Default_Appl_Task
      Rte_Al_TE_StartApplication_StartApplication_Cyclic10ms
        OsAlarmAction
          OsAlarmSetEvent: OsAlarmSetEventRef=Rte_Ev_Run_StartApplication_StartApplication_Cyclic10ms, OsAlarmSetEventTaskRef=Default_Appl_Task
      Rte_Al_TE_StartApplication_StartApplication_Cyclic1ms
        OsAlarmAction
          OsAlarmSetEvent: OsAlarmSetEventRef=Rte_Ev_Run_StartApplication_StartApplication_Cyclic1ms, OsAlarmSetEventTaskRef=Default_Appl_Task
      Rte_Al_TE_StartApplication_StartApplication_Cyclic250ms
        OsAlarmAction
          OsAlarmSetEvent: OsAlarmSetEventRef=Rte_Ev_Run_StartApplication_StartApplication_Cyclic250ms, OsAlarmSetEventTaskRef=Default_Appl_Task
    Default_BSW_Async_Task (OsTask):
      OsTaskActivation = 1
      OsTaskPriority = 30
      OsTaskSchedule = FULL
      OsTaskEventRef = Rte_Ev_Cyclic2_Default_BSW_Async_Task_0_100ms
      OsTaskEventRef = Rte_Ev_Cyclic2_Default_BSW_Async_Task_0_10ms
      OsTaskEventRef = Rte_Ev_Cyclic2_Default_BSW_Async_Task_0_20ms
      OsTaskEventRef = Rte_Ev_Cyclic2_Default_BSW_Async_Task_0_5ms
      OsTaskEventRef = Rte_Ev_Run_BswM_BswM_Read_LIN{1..5}_ScheduleTableRequestMode
      OsTaskEventRef = Rte_Ev_Run_ComM_GetCurrentComMode
      OsTaskEventRef = Rte_Ev_Run_ComM_RequestComMode
      OsTaskEventRef = Rte_Ev_Run_DemMaster_OsApplication_Untrusted_Core0_SetOperationCycleState
      OsTaskEventRef = Rte_Ev_Run_EcuM_SelectShutdownTarget
      OsTaskAccessingApplication = OsApplication_Trusted_Core0
    4 x OsAlarm, all with OsAlarmCounterRef=SystemTimer:
      Rte_Al_TE2_Default_BSW_Async_Task_0_100ms
        OsAlarmAction
          OsAlarmSetEvent: OsAlarmSetEventRef=Rte_Ev_Cyclic2_Default_BSW_Async_Task_0_100ms, OsAlarmSetEventTaskRef=Default_BSW_Async_Task
      Rte_Al_TE2_Default_BSW_Async_Task_0_10ms
        OsAlarmAction
          OsAlarmSetEvent: OsAlarmSetEventRef=Rte_Ev_Cyclic2_Default_BSW_Async_Task_0_10ms, OsAlarmSetEventTaskRef=Default_BSW_Async_Task
      Rte_Al_TE2_Default_BSW_Async_Task_0_20ms
        OsAlarmAction
          OsAlarmSetEvent: OsAlarmSetEventRef=Rte_Ev_Cyclic2_Default_BSW_Async_Task_0_20ms, OsAlarmSetEventTaskRef=Default_BSW_Async_Task
      Rte_Al_TE2_Default_BSW_Async_Task_0_5ms
        OsAlarmAction
          OsAlarmSetEvent: OsAlarmSetEventRef=Rte_Ev_Cyclic2_Default_BSW_Async_Task_0_5ms, OsAlarmSetEventTaskRef=Default_BSW_Async_Task
    PvtTask (OsTask):
      OsTaskActivation = 1
      OsTaskPriority = 42
      OsTaskSchedule = FULL
      OsTaskEventRef = Rte_Ev_Cyclic_PvtTask_0_10ms
      OsTaskEventRef = Rte_Ev_Run_CDD_RFIC_RE_rfic_init
      OsTaskEventRef = Rte_Ev_Run_TP_RE_SMK_TP
      OsTaskEventRef = Rte_Ev_Run_TestLin_Re_LIN0_FSP1_L1_FSP1DiagInfoL1_RXCbk
      OsTaskEventRef = Rte_Ev_Run_TestLin_Re_LIN0_FSP1_L1_FSP1DiagInfoL1_RxTimeout
      OsTaskEventRef = Rte_Ev_Run_TestLin_Re_LIN0_FSP1_L1_FSP1ResponseErrorL1_RXCbk
      OsTaskEventRef = Rte_Ev_Run_TestLin_Re_LIN0_FSP1_L1_FSP1ResponseErrorL1_RxTimeout
      OsTaskEventRef = Rte_Ev_Run_TestLin_Re_LIN0_FSP1_L1_SwitchDetectionNeeded1L1_RXCbk
      OsTaskEventRef = Rte_Ev_Run_TestLin_Re_LIN0_FSP1_L1_SwitchDetectionNeeded1L1_RxTimeout
      OsTaskEventRef = Rte_Ev_Run_TestLin_Re_LIN0_FSP2_L1_FSP2DiagInfoL1_RXCbk
      OsTaskEventRef = Rte_Ev_Run_TestLin_Re_LIN0_FSP2_L1_FSP2DiagInfoL1_RxTimeout
      OsTaskEventRef = Rte_Ev_Run_TestLin_Re_LIN0_FSP2_L1_FSP2ResponseErrorL1_RXCbk
      OsTaskEventRef = Rte_Ev_Run_TestLin_Re_LIN0_FSP2_L1_FSP2ResponseErrorL1_RxTimeout
      OsTaskEventRef = Rte_Ev_Run_TestLin_Re_LIN0_FSP2_L1_FSP2SwitchStatusL1_RXCbk
      OsTaskEventRef = Rte_Ev_Run_TestLin_Re_LIN0_FSP2_L1_FSP2SwitchStatusL1_RxTimeout
      OsTaskEventRef = Rte_Ev_Run_TestLin_Re_LIN0_FSP2_L1_SwitchDetectionNeeded2L1_RXCbk
      OsTaskEventRef = Rte_Ev_Run_TestLin_Re_LIN0_FSP2_L1_SwitchDetectionNeeded2L1_RxTimeout
      OsTaskEventRef = Rte_Ev_Run_TestLin_Re_LIN0_ILCP1_DiagInfoILCP1_RXCbk
      OsTaskEventRef = Rte_Ev_Run_TestLin_Re_LIN0_ILCP1_DiagInfoILCP1_RxTimeout
      OsTaskEventRef = Rte_Ev_Run_TestLin_Re_LIN0_ILCP1_LIN_DoorAutoFuncBtn_stat_RXCbk
      OsTaskEventRef = Rte_Ev_Run_TestLin_Re_LIN0_ILCP1_LIN_DoorAutoFuncBtn_stat_RxTimeout
      OsTaskEventRef = Rte_Ev_Run_TestLin_Re_LIN0_ILCP1_LIN_IntLghtDimmingLvlDecBtn_s_RXCbk
      OsTaskEventRef = Rte_Ev_Run_TestLin_Re_LIN0_ILCP1_LIN_IntLghtDimmingLvlDecBtn_s_RxTimeout
      OsTaskEventRef = Rte_Ev_Run_TestLin_Re_LIN0_ILCP1_LIN_IntLghtDimmingLvlIncBtn_s_RXCbk
      OsTaskEventRef = Rte_Ev_Run_TestLin_Re_LIN0_ILCP1_LIN_IntLghtDimmingLvlIncBtn_s_RxTimeout
      OsTaskEventRef = Rte_Ev_Run_TestLin_Re_LIN0_ILCP1_LIN_IntLghtModeSelrFreeWheel_s_RXCbk
      OsTaskEventRef = Rte_Ev_Run_TestLin_Re_LIN0_ILCP1_LIN_IntLghtModeSelrFreeWheel_s_RxTimeout
      OsTaskEventRef = Rte_Ev_Run_TestLin_Re_LIN0_ILCP1_ResponseErrorILCP1_RXCbk
      OsTaskEventRef = Rte_Ev_Run_TestLin_Re_LIN0_ILCP1_ResponseErrorILCP1_RxTimeout
      OsTaskAccessingApplication = OsApplication_Untrusted_Core0
    Rte_Al_TE_PvtTask_0_10ms (OsAlarm): OsAlarmCounterRef=SystemTimer, OsAlarmAccessingApplication=OsApplication_Untrusted_Core0
      OsAlarmAction
        OsAlarmSetEvent: OsAlarmSetEventRef=Rte_Ev_Cyclic_PvtTask_0_10ms, OsAlarmSetEventTaskRef=PvtTask
    Rte_Al_TE_TP_RE_SMK_TP (OsAlarm): OsAlarmCounterRef=SystemTimer, OsAlarmAccessingApplication=OsApplication_Untrusted_Core0
      OsAlarmAction
        OsAlarmSetEvent: OsAlarmSetEventRef=Rte_Ev_Run_TP_RE_SMK_TP, OsAlarmSetEventTaskRef=PvtTask
    StartApplication_MemoryViolation_Task (OsTask):
      OsTaskActivation = 1
      OsTaskPriority = 40
      OsTaskSchedule = FULL
      OsTaskEventRef = Rte_Ev_Run_StartApplication_StartApplication_MEMORYPROTECTION_Cyclic10ms
      OsTaskAccessingApplication = OsApplication_Trusted_Core0
    Rte_Al_TE_StartApplication_StartApplication_MEMORYPROTECTION_Cyclic10ms (OsAlarm): OsAlarmCounterRef=SystemTimer
      OsAlarmAction
        OsAlarmSetEvent:
          OsAlarmSetEventRef = Rte_Ev_Run_StartApplication_StartApplication_MEMORYPROTECTION_Cyclic10ms
          OsAlarmSetEventTaskRef = StartApplication_MemoryViolation_Task
    StartApplication_Trusted_Task (OsTask):
      OsTaskActivation = 1
      OsTaskPriority = 41
      OsTaskSchedule = FULL
      OsTaskEventRef = Rte_Ev_Cyclic_StartApplication_Trusted_Task_0_10ms
      OsTaskEventRef = Rte_Ev_Run_IOHWAB_IoHwAb_RficNRESDio_P_Read
      OsTaskEventRef = Rte_Ev_Run_StartApplicationTrusted_StartApplicationTrusted_OnDataRec_TrustedData
      OsTaskAccessingApplication = OsApplication_Untrusted_Core0
    Rte_Al_TE_StartApplication_Trusted_Task_0_10ms (OsAlarm): OsAlarmCounterRef=SystemTimer, OsAlarmAccessingApplication=OsApplication_Untrusted_Core0
      OsAlarmAction
        OsAlarmSetEvent: OsAlarmSetEventRef=Rte_Ev_Cyclic_StartApplication_Trusted_Task_0_10ms, OsAlarmSetEventTaskRef=StartApplication_Trusted_Task
    52 x OsEvent:
      Rte_Ev_Cyclic2_Default_BSW_Async_Task_0_100ms
      Rte_Ev_Cyclic2_Default_BSW_Async_Task_0_10ms
      Rte_Ev_Cyclic2_Default_BSW_Async_Task_0_20ms
      Rte_Ev_Cyclic2_Default_BSW_Async_Task_0_5ms
      Rte_Ev_Cyclic_PvtTask_0_10ms
      Rte_Ev_Cyclic_StartApplication_Trusted_Task_0_10ms
      Rte_Ev_Run_BswM_BswM_Read_LIN{1..5}_ScheduleTableRequestMode
      Rte_Ev_Run_CDD_RFIC_RE_rfic_init
      Rte_Ev_Run_ComM_GetCurrentComMode
      Rte_Ev_Run_ComM_RequestComMode
      Rte_Ev_Run_DemMaster_OsApplication_Untrusted_Core0_SetOperationCycleState
      Rte_Ev_Run_EcuM_SelectShutdownTarget
      Rte_Ev_Run_IOHWAB_IoHwAb_RficNRESDio_P_Read
      Rte_Ev_Run_StartApplicationTrusted_StartApplicationTrusted_OnDataRec_TrustedData
      Rte_Ev_Run_StartApplication_StartApplication_Cyclic1000ms
      Rte_Ev_Run_StartApplication_StartApplication_Cyclic10ms
      Rte_Ev_Run_StartApplication_StartApplication_Cyclic1ms
      Rte_Ev_Run_StartApplication_StartApplication_Cyclic250ms
      Rte_Ev_Run_StartApplication_StartApplication_MEMORYPROTECTION_Cyclic10ms
      Rte_Ev_Run_StartApplication_StartApplication_OnDataRec_RxCtrl
      Rte_Ev_Run_StartApplication_StartApplication_OnDataRec_RxData
      Rte_Ev_Run_TP_RE_SMK_TP
      Rte_Ev_Run_TestLin_Re_LIN0_FSP1_L1_FSP1DiagInfoL1_RXCbk
      Rte_Ev_Run_TestLin_Re_LIN0_FSP1_L1_FSP1DiagInfoL1_RxTimeout
      Rte_Ev_Run_TestLin_Re_LIN0_FSP1_L1_FSP1ResponseErrorL1_RXCbk
      Rte_Ev_Run_TestLin_Re_LIN0_FSP1_L1_FSP1ResponseErrorL1_RxTimeout
      Rte_Ev_Run_TestLin_Re_LIN0_FSP1_L1_SwitchDetectionNeeded1L1_RXCbk
      Rte_Ev_Run_TestLin_Re_LIN0_FSP1_L1_SwitchDetectionNeeded1L1_RxTimeout
      Rte_Ev_Run_TestLin_Re_LIN0_FSP2_L1_FSP2DiagInfoL1_RXCbk
      Rte_Ev_Run_TestLin_Re_LIN0_FSP2_L1_FSP2DiagInfoL1_RxTimeout
      Rte_Ev_Run_TestLin_Re_LIN0_FSP2_L1_FSP2ResponseErrorL1_RXCbk
      Rte_Ev_Run_TestLin_Re_LIN0_FSP2_L1_FSP2ResponseErrorL1_RxTimeout
      Rte_Ev_Run_TestLin_Re_LIN0_FSP2_L1_FSP2SwitchStatusL1_RXCbk
      Rte_Ev_Run_TestLin_Re_LIN0_FSP2_L1_FSP2SwitchStatusL1_RxTimeout
      Rte_Ev_Run_TestLin_Re_LIN0_FSP2_L1_SwitchDetectionNeeded2L1_RXCbk
      Rte_Ev_Run_TestLin_Re_LIN0_FSP2_L1_SwitchDetectionNeeded2L1_RxTimeout
      Rte_Ev_Run_TestLin_Re_LIN0_ILCP1_DiagInfoILCP1_RXCbk
      Rte_Ev_Run_TestLin_Re_LIN0_ILCP1_DiagInfoILCP1_RxTimeout
      Rte_Ev_Run_TestLin_Re_LIN0_ILCP1_LIN_DoorAutoFuncBtn_stat_RXCbk
      Rte_Ev_Run_TestLin_Re_LIN0_ILCP1_LIN_DoorAutoFuncBtn_stat_RxTimeout
      Rte_Ev_Run_TestLin_Re_LIN0_ILCP1_LIN_IntLghtDimmingLvlDecBtn_s_RXCbk
      Rte_Ev_Run_TestLin_Re_LIN0_ILCP1_LIN_IntLghtDimmingLvlDecBtn_s_RxTimeout
      Rte_Ev_Run_TestLin_Re_LIN0_ILCP1_LIN_IntLghtDimmingLvlIncBtn_s_RXCbk
      Rte_Ev_Run_TestLin_Re_LIN0_ILCP1_LIN_IntLghtDimmingLvlIncBtn_s_RxTimeout
      Rte_Ev_Run_TestLin_Re_LIN0_ILCP1_LIN_IntLghtModeSelrFreeWheel_s_RXCbk
      Rte_Ev_Run_TestLin_Re_LIN0_ILCP1_LIN_IntLghtModeSelrFreeWheel_s_RxTimeout
      Rte_Ev_Run_TestLin_Re_LIN0_ILCP1_ResponseErrorILCP1_RXCbk
      Rte_Ev_Run_TestLin_Re_LIN0_ILCP1_ResponseErrorILCP1_RxTimeout
    OsApplication_Trusted_Core0 (OsApplication):
      OsTrusted = true
      OsAppTaskRef = PvtTask
      OsAppAlarmRef = Os/Rte_Al_TE_PvtTask_0_10ms
      OsAppAlarmRef = Os/Rte_Al_TE_TP_RE_SMK_TP
      OsAppTaskRef = StartApplication_Trusted_Task
      OsAppAlarmRef = Os/Rte_Al_TE_StartApplication_Trusted_Task_0_10ms
    OsApplication_Untrusted_Core0 (OsApplication):
      OsTrusted = false
      OsAppTaskRef = Default_Appl_Task
      OsAppAlarmRef = Os/Rte_Al_TE_StartApplication_StartApplication_Cyclic1000ms
      OsAppAlarmRef = Os/Rte_Al_TE_StartApplication_StartApplication_Cyclic10ms
      OsAppAlarmRef = Os/Rte_Al_TE_StartApplication_StartApplication_Cyclic1ms
      OsAppAlarmRef = Os/Rte_Al_TE_StartApplication_StartApplication_Cyclic250ms
      OsAppTaskRef = Default_BSW_Async_Task
      OsAppAlarmRef = Os/Rte_Al_TE2_Default_BSW_Async_Task_0_100ms
      OsAppAlarmRef = Os/Rte_Al_TE2_Default_BSW_Async_Task_0_10ms
      OsAppAlarmRef = Os/Rte_Al_TE2_Default_BSW_Async_Task_0_20ms
      OsAppAlarmRef = Os/Rte_Al_TE2_Default_BSW_Async_Task_0_5ms
      OsAppTaskRef = StartApplication_MemoryViolation_Task
      OsAppAlarmRef = Os/Rte_Al_TE_StartApplication_StartApplication_MEMORYPROTECTION_Cyclic10ms
  module config EcuC
  ecuc value collection DaVinci_Project: ecuc-values=[Com, Rte, Os, EcuC, NvM]
