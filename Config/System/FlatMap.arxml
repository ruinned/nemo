AUTOSAR XML (schema 4-2-1)
package /COM/VECTOR/CFG/WORKFLOW/SYSDESC/SYNC
  flat map FLATMAP
    549 x flat instance descriptor:
      SwitchDetectionNeeded2L3: upstream-reference=EcuSwComposition.SwitchDetectionNeeded2L3.SwitchDetectionNeeded2L3, ecu-extract-reference=COMPOSITIONTYPE.SwitchDetectionNeeded2L3.SwitchDetectionNeeded2L3
      SwitchDetectionNeeded2L3_001: upstream-reference=EcuSwComposition.SwitchDetectionNeeded2L3, ecu-extract-reference=COMPOSITIONTYPE.SwitchDetectionNeeded2L3
      FSP1SwitchStatusL3: upstream-reference=EcuSwComposition.FSP1SwitchStatusL3.FSP1SwitchStatusL3, ecu-extract-reference=COMPOSITIONTYPE.FSP1SwitchStatusL3.FSP1SwitchStatusL3
      FSP1SwitchStatusL3_001: upstream-reference=EcuSwComposition.FSP1SwitchStatusL3, ecu-extract-reference=COMPOSITIONTYPE.FSP1SwitchStatusL3
      FSP2SwitchStatusL3: upstream-reference=EcuSwComposition.FSP2SwitchStatusL3.FSP2SwitchStatusL3, ecu-extract-reference=COMPOSITIONTYPE.FSP2SwitchStatusL3.FSP2SwitchStatusL3
      FSP2SwitchStatusL3_001: upstream-reference=EcuSwComposition.FSP2SwitchStatusL3, ecu-extract-reference=COMPOSITIONTYPE.FSP2SwitchStatusL3
      FSP2DiagInfoL3: upstream-reference=EcuSwComposition.FSP2DiagInfoL3.FSP2DiagInfoL3, ecu-extract-reference=COMPOSITIONTYPE.FSP2DiagInfoL3.FSP2DiagInfoL3
      FSP2DiagInfoL3_001: upstream-reference=EcuSwComposition.FSP2DiagInfoL3, ecu-extract-reference=COMPOSITIONTYPE.FSP2DiagInfoL3
      FSP1ResponseErrorL3: upstream-reference=EcuSwComposition.FSP1ResponseErrorL3.FSP1ResponseErrorL3, ecu-extract-reference=COMPOSITIONTYPE.FSP1ResponseErrorL3.FSP1ResponseErrorL3
      FSP1ResponseErrorL3_001: upstream-reference=EcuSwComposition.FSP1ResponseErrorL3, ecu-extract-reference=COMPOSITIONTYPE.FSP1ResponseErrorL3
      LIN_TCP_KnobPostionStatus: upstream-reference=EcuSwComposition.LIN_TCP_KnobPostionStatus.LIN_TCP_KnobPostionStatus, ecu-extract-reference=COMPOSITIONTYPE.LIN_TCP_KnobPostionStatus.LIN_TCP_KnobPostionStatus
      LIN_TCP_KnobPostionStatus_001: upstream-reference=EcuSwComposition.LIN_TCP_KnobPostionStatus, ecu-extract-reference=COMPOSITIONTYPE.LIN_TCP_KnobPostionStatus
      SwitchDetectionNeeded1L3: upstream-reference=EcuSwComposition.SwitchDetectionNeeded1L3.SwitchDetectionNeeded1L3, ecu-extract-reference=COMPOSITIONTYPE.SwitchDetectionNeeded1L3.SwitchDetectionNeeded1L3
      SwitchDetectionNeeded1L3_001: upstream-reference=EcuSwComposition.SwitchDetectionNeeded1L3, ecu-extract-reference=COMPOSITIONTYPE.SwitchDetectionNeeded1L3
      FSP1DiagInfoL3: upstream-reference=EcuSwComposition.FSP1DiagInfoL3.FSP1DiagInfoL3, ecu-extract-reference=COMPOSITIONTYPE.FSP1DiagInfoL3.FSP1DiagInfoL3
      FSP1DiagInfoL3_001: upstream-reference=EcuSwComposition.FSP1DiagInfoL3, ecu-extract-reference=COMPOSITIONTYPE.FSP1DiagInfoL3
      SwitchDetectionResp2L3: upstream-reference=EcuSwComposition.SwitchDetectionResp2L3.SwitchDetectionResp2L3, ecu-extract-reference=COMPOSITIONTYPE.SwitchDetectionResp2L3.SwitchDetectionResp2L3
      SwitchDetectionResp2L3_001: upstream-reference=EcuSwComposition.SwitchDetectionResp2L3, ecu-extract-reference=COMPOSITIONTYPE.SwitchDetectionResp2L3
      SwitchDetectionResp1L3: upstream-reference=EcuSwComposition.SwitchDetectionResp1L3.SwitchDetectionResp1L3, ecu-extract-reference=COMPOSITIONTYPE.SwitchDetectionResp1L3.SwitchDetectionResp1L3
      SwitchDetectionResp1L3_001: upstream-reference=EcuSwComposition.SwitchDetectionResp1L3, ecu-extract-reference=COMPOSITIONTYPE.SwitchDetectionResp1L3
      ResponseErrorTCP: upstream-reference=EcuSwComposition.ResponseErrorTCP.ResponseErrorTCP, ecu-extract-reference=COMPOSITIONTYPE.ResponseErrorTCP.ResponseErrorTCP
      ResponseErrorTCP_001: upstream-reference=EcuSwComposition.ResponseErrorTCP, ecu-extract-reference=COMPOSITIONTYPE.ResponseErrorTCP
      LIN_TCP_ABS_ButtonStatus: upstream-reference=EcuSwComposition.LIN_TCP_ABS_ButtonStatus.LIN_TCP_ABS_ButtonStatus, ecu-extract-reference=COMPOSITIONTYPE.LIN_TCP_ABS_ButtonStatus.LIN_TCP_ABS_ButtonStatus
      LIN_TCP_ABS_ButtonStatus_001: upstream-reference=EcuSwComposition.LIN_TCP_ABS_ButtonStatus, ecu-extract-reference=COMPOSITIONTYPE.LIN_TCP_ABS_ButtonStatus
      LIN_TCP_TCS_ButtonStatus: upstream-reference=EcuSwComposition.LIN_TCP_TCS_ButtonStatus.LIN_TCP_TCS_ButtonStatus, ecu-extract-reference=COMPOSITIONTYPE.LIN_TCP_TCS_ButtonStatus.LIN_TCP_TCS_ButtonStatus
      LIN_TCP_TCS_ButtonStatus_001: upstream-reference=EcuSwComposition.LIN_TCP_TCS_ButtonStatus, ecu-extract-reference=COMPOSITIONTYPE.LIN_TCP_TCS_ButtonStatus
      FSP2ResponseErrorL3: upstream-reference=EcuSwComposition.FSP2ResponseErrorL3.FSP2ResponseErrorL3, ecu-extract-reference=COMPOSITIONTYPE.FSP2ResponseErrorL3.FSP2ResponseErrorL3
      FSP2ResponseErrorL3_001: upstream-reference=EcuSwComposition.FSP2ResponseErrorL3, ecu-extract-reference=COMPOSITIONTYPE.FSP2ResponseErrorL3
      DiagInfoTCP: upstream-reference=EcuSwComposition.DiagInfoTCP.DiagInfoTCP, ecu-extract-reference=COMPOSITIONTYPE.DiagInfoTCP.DiagInfoTCP
      DiagInfoTCP_001: upstream-reference=EcuSwComposition.DiagInfoTCP, ecu-extract-reference=COMPOSITIONTYPE.DiagInfoTCP
      LIN_TCP_ATC_ButtonStatus: upstream-reference=EcuSwComposition.LIN_TCP_ATC_ButtonStatus.LIN_TCP_ATC_ButtonStatus, ecu-extract-reference=COMPOSITIONTYPE.LIN_TCP_ATC_ButtonStatus.LIN_TCP_ATC_ButtonStatus
      LIN_TCP_ATC_ButtonStatus_001: upstream-reference=EcuSwComposition.LIN_TCP_ATC_ButtonStatus, ecu-extract-reference=COMPOSITIONTYPE.LIN_TCP_ATC_ButtonStatus
      LIN_TCP_ESC_ButtonStatus: upstream-reference=EcuSwComposition.LIN_TCP_ESC_ButtonStatus.LIN_TCP_ESC_ButtonStatus, ecu-extract-reference=COMPOSITIONTYPE.LIN_TCP_ESC_ButtonStatus.LIN_TCP_ESC_ButtonStatus
      LIN_TCP_ESC_ButtonStatus_001: upstream-reference=EcuSwComposition.LIN_TCP_ESC_ButtonStatus, ecu-extract-reference=COMPOSITIONTYPE.LIN_TCP_ESC_ButtonStatus
      ATC_Indication: upstream-reference=EcuSwComposition.ATC_Indication.ATC_Indication, ecu-extract-reference=COMPOSITIONTYPE.ATC_Indication.ATC_Indication
      ATC_Indication_001: upstream-reference=EcuSwComposition.ATC_Indication, ecu-extract-reference=COMPOSITIONTYPE.ATC_Indication
      ABS_Indication: upstream-reference=EcuSwComposition.ABS_Indication.ABS_Indication, ecu-extract-reference=COMPOSITIONTYPE.ABS_Indication.ABS_Indication
      ABS_Indication_001: upstream-reference=EcuSwComposition.ABS_Indication, ecu-extract-reference=COMPOSITIONTYPE.ABS_Indication
      ESC_Indication: upstream-reference=EcuSwComposition.ESC_Indication.ESC_Indication, ecu-extract-reference=COMPOSITIONTYPE.ESC_Indication.ESC_Indication
      ESC_Indication_001: upstream-reference=EcuSwComposition.ESC_Indication, ecu-extract-reference=COMPOSITIONTYPE.ESC_Indication
      FSP1IndicationCmdL3: upstream-reference=EcuSwComposition.FSP1IndicationCmdL3.FSP1IndicationCmdL3, ecu-extract-reference=COMPOSITIONTYPE.FSP1IndicationCmdL3.FSP1IndicationCmdL3
      FSP1IndicationCmdL3_001: upstream-reference=EcuSwComposition.FSP1IndicationCmdL3, ecu-extract-reference=COMPOSITIONTYPE.FSP1IndicationCmdL3
      TCS_Indication: upstream-reference=EcuSwComposition.TCS_Indication.TCS_Indication, ecu-extract-reference=COMPOSITIONTYPE.TCS_Indication.TCS_Indication
      TCS_Indication_001: upstream-reference=EcuSwComposition.TCS_Indication, ecu-extract-reference=COMPOSITIONTYPE.TCS_Indication
      FSP2IndicationCmdL3: upstream-reference=EcuSwComposition.FSP2IndicationCmdL3.FSP2IndicationCmdL3, ecu-extract-reference=COMPOSITIONTYPE.FSP2IndicationCmdL3.FSP2IndicationCmdL3
      FSP2IndicationCmdL3_001: upstream-reference=EcuSwComposition.FSP2IndicationCmdL3, ecu-extract-reference=COMPOSITIONTYPE.FSP2IndicationCmdL3
      TestLin: upstream-reference=EcuSwComposition.TestLin, ecu-extract-reference=COMPOSITIONTYPE.TestLin
      PVTApp_Do12VInterface: upstream-reference=EcuSwComposition.PVTApp_Do12VInterface, ecu-extract-reference=COMPOSITIONTYPE.PVTApp_Do12VInterface
      PVTApp_AdiInterfaces: upstream-reference=EcuSwComposition.PVTApp_AdiInterfaces, ecu-extract-reference=COMPOSITIONTYPE.PVTApp_AdiInterfaces
      Debug_PVT_SCIM_Ctrl_BHS3: upstream-reference=EcuSwComposition.Debug_PVT_SCIM_Ctrl_BHS3.Debug_PVT_SCIM_Ctrl_BHS3, ecu-extract-reference=COMPOSITIONTYPE.Debug_PVT_SCIM_Ctrl_BHS3.Debug_PVT_SCIM_Ctrl_BHS3
      Debug_PVT_SCIM_Ctrl_BHS3_001: upstream-reference=EcuSwComposition.Debug_PVT_SCIM_Ctrl_BHS3, ecu-extract-reference=COMPOSITIONTYPE.Debug_PVT_SCIM_Ctrl_BHS3
      Debug_PVT_SCIM_Ctrl_BHS2: upstream-reference=EcuSwComposition.Debug_PVT_SCIM_Ctrl_BHS2.Debug_PVT_SCIM_Ctrl_BHS2, ecu-extract-reference=COMPOSITIONTYPE.Debug_PVT_SCIM_Ctrl_BHS2.Debug_PVT_SCIM_Ctrl_BHS2
      Debug_PVT_SCIM_Ctrl_BHS2_001: upstream-reference=EcuSwComposition.Debug_PVT_SCIM_Ctrl_BHS2, ecu-extract-reference=COMPOSITIONTYPE.Debug_PVT_SCIM_Ctrl_BHS2
      Debug_PVT_SCIM_Ctrl_BHS1: upstream-reference=EcuSwComposition.Debug_PVT_SCIM_Ctrl_BHS1.Debug_PVT_SCIM_Ctrl_BHS1, ecu-extract-reference=COMPOSITIONTYPE.Debug_PVT_SCIM_Ctrl_BHS1.Debug_PVT_SCIM_Ctrl_BHS1
      Debug_PVT_SCIM_Ctrl_BHS1_001: upstream-reference=EcuSwComposition.Debug_PVT_SCIM_Ctrl_BHS1, ecu-extract-reference=COMPOSITIONTYPE.Debug_PVT_SCIM_Ctrl_BHS1
      Debug_PVT_SCIM_Ctrl_BHS4: upstream-reference=EcuSwComposition.Debug_PVT_SCIM_Ctrl_BHS4.Debug_PVT_SCIM_Ctrl_BHS4, ecu-extract-reference=COMPOSITIONTYPE.Debug_PVT_SCIM_Ctrl_BHS4.Debug_PVT_SCIM_Ctrl_BHS4
      Debug_PVT_SCIM_Ctrl_BHS4_001: upstream-reference=EcuSwComposition.Debug_PVT_SCIM_Ctrl_BHS4, ecu-extract-reference=COMPOSITIONTYPE.Debug_PVT_SCIM_Ctrl_BHS4
      Debug_PVT_SCIM_RD_BHS3_Volt: upstream-reference=EcuSwComposition.Debug_PVT_SCIM_RD_BHS3_Volt.Debug_PVT_SCIM_RD_BHS3_Volt, ecu-extract-reference=COMPOSITIONTYPE.Debug_PVT_SCIM_RD_BHS3_Volt.Debug_PVT_SCIM_RD_BHS3_Volt
      Debug_PVT_SCIM_RD_BHS3_Volt_001: upstream-reference=EcuSwComposition.Debug_PVT_SCIM_RD_BHS3_Volt, ecu-extract-reference=COMPOSITIONTYPE.Debug_PVT_SCIM_RD_BHS3_Volt
      Debug_PVT_SCIM_RD_BHS1_Volt: upstream-reference=EcuSwComposition.Debug_PVT_SCIM_RD_BHS1_Volt.Debug_PVT_SCIM_RD_BHS1_Volt, ecu-extract-reference=COMPOSITIONTYPE.Debug_PVT_SCIM_RD_BHS1_Volt.Debug_PVT_SCIM_RD_BHS1_Volt
      Debug_PVT_SCIM_RD_BHS1_Volt_001: upstream-reference=EcuSwComposition.Debug_PVT_SCIM_RD_BHS1_Volt, ecu-extract-reference=COMPOSITIONTYPE.Debug_PVT_SCIM_RD_BHS1_Volt
      Debug_PVT_SCIM_RD_BHS3_Fault: upstream-reference=EcuSwComposition.Debug_PVT_SCIM_RD_BHS3_Fault.Debug_PVT_SCIM_RD_BHS3_Fault, ecu-extract-reference=COMPOSITIONTYPE.Debug_PVT_SCIM_RD_BHS3_Fault.Debug_PVT_SCIM_RD_BHS3_Fault
      Debug_PVT_SCIM_RD_BHS3_Fault_001: upstream-reference=EcuSwComposition.Debug_PVT_SCIM_RD_BHS3_Fault, ecu-extract-reference=COMPOSITIONTYPE.Debug_PVT_SCIM_RD_BHS3_Fault
      Debug_PVT_SCIM_RD_BHS1_Fault: upstream-reference=EcuSwComposition.Debug_PVT_SCIM_RD_BHS1_Fault.Debug_PVT_SCIM_RD_BHS1_Fault, ecu-extract-reference=COMPOSITIONTYPE.Debug_PVT_SCIM_RD_BHS1_Fault.Debug_PVT_SCIM_RD_BHS1_Fault
      Debug_PVT_SCIM_RD_BHS1_Fault_001: upstream-reference=EcuSwComposition.Debug_PVT_SCIM_RD_BHS1_Fault, ecu-extract-reference=COMPOSITIONTYPE.Debug_PVT_SCIM_RD_BHS1_Fault
      Debug_PVT_SCIM_RD_BHS2_Fault: upstream-reference=EcuSwComposition.Debug_PVT_SCIM_RD_BHS2_Fault.Debug_PVT_SCIM_RD_BHS2_Fault, ecu-extract-reference=COMPOSITIONTYPE.Debug_PVT_SCIM_RD_BHS2_Fault.Debug_PVT_SCIM_RD_BHS2_Fault
      Debug_PVT_SCIM_RD_BHS2_Fault_001: upstream-reference=EcuSwComposition.Debug_PVT_SCIM_RD_BHS2_Fault, ecu-extract-reference=COMPOSITIONTYPE.Debug_PVT_SCIM_RD_BHS2_Fault
      Debug_PVT_SCIM_RD_BHS2_Volt: upstream-reference=EcuSwComposition.Debug_PVT_SCIM_RD_BHS2_Volt.Debug_PVT_SCIM_RD_BHS2_Volt, ecu-extract-reference=COMPOSITIONTYPE.Debug_PVT_SCIM_RD_BHS2_Volt.Debug_PVT_SCIM_RD_BHS2_Volt
      Debug_PVT_SCIM_RD_BHS2_Volt_001: upstream-reference=EcuSwComposition.Debug_PVT_SCIM_RD_BHS2_Volt, ecu-extract-reference=COMPOSITIONTYPE.Debug_PVT_SCIM_RD_BHS2_Volt
      Debug_PVT_SCIM_RD_BHS4_Fault: upstream-reference=EcuSwComposition.Debug_PVT_SCIM_RD_BHS4_Fault.Debug_PVT_SCIM_RD_BHS4_Fault, ecu-extract-reference=COMPOSITIONTYPE.Debug_PVT_SCIM_RD_BHS4_Fault.Debug_PVT_SCIM_RD_BHS4_Fault
      Debug_PVT_SCIM_RD_BHS4_Fault_001: upstream-reference=EcuSwComposition.Debug_PVT_SCIM_RD_BHS4_Fault, ecu-extract-reference=COMPOSITIONTYPE.Debug_PVT_SCIM_RD_BHS4_Fault
      Debug_PVT_SCIM_RD_BHS4_Volt: upstream-reference=EcuSwComposition.Debug_PVT_SCIM_RD_BHS4_Volt.Debug_PVT_SCIM_RD_BHS4_Volt, ecu-extract-reference=COMPOSITIONTYPE.Debug_PVT_SCIM_RD_BHS4_Volt.Debug_PVT_SCIM_RD_BHS4_Volt
      Debug_PVT_SCIM_RD_BHS4_Volt_001: upstream-reference=EcuSwComposition.Debug_PVT_SCIM_RD_BHS4_Volt, ecu-extract-reference=COMPOSITIONTYPE.Debug_PVT_SCIM_RD_BHS4_Volt
      PVTApp_DobhsCtrlInterface: upstream-reference=EcuSwComposition.PVTApp_DobhsCtrlInterface, ecu-extract-reference=COMPOSITIONTYPE.PVTApp_DobhsCtrlInterface
      Debug_PVT_SCIM_Ctrl_DaiPullUp: upstream-reference=EcuSwComposition.Debug_PVT_SCIM_Ctrl_DaiPullUp, ecu-extract-reference=COMPOSITIONTYPE.Debug_PVT_SCIM_Ctrl_DaiPullUp
      Debug_PVT_SCIM_RD_ADI09: upstream-reference=EcuSwComposition.Debug_PVT_SCIM_RD_ADI09.Debug_PVT_SCIM_RD_ADI09, ecu-extract-reference=COMPOSITIONTYPE.Debug_PVT_SCIM_RD_ADI09.Debug_PVT_SCIM_RD_ADI09
      Debug_PVT_SCIM_RD_ADI09_001: upstream-reference=EcuSwComposition.Debug_PVT_SCIM_RD_ADI09, ecu-extract-reference=COMPOSITIONTYPE.Debug_PVT_SCIM_RD_ADI09
      Debug_PVT_SCIM_RD_ADI16: upstream-reference=EcuSwComposition.Debug_PVT_SCIM_RD_ADI16.Debug_PVT_SCIM_RD_ADI16, ecu-extract-reference=COMPOSITIONTYPE.Debug_PVT_SCIM_RD_ADI16.Debug_PVT_SCIM_RD_ADI16
      Debug_PVT_SCIM_RD_ADI16_001: upstream-reference=EcuSwComposition.Debug_PVT_SCIM_RD_ADI16, ecu-extract-reference=COMPOSITIONTYPE.Debug_PVT_SCIM_RD_ADI16
      Debug_PVT_SCIM_RD_ADI07: upstream-reference=EcuSwComposition.Debug_PVT_SCIM_RD_ADI07.Debug_PVT_SCIM_RD_ADI07, ecu-extract-reference=COMPOSITIONTYPE.Debug_PVT_SCIM_RD_ADI07.Debug_PVT_SCIM_RD_ADI07
      Debug_PVT_SCIM_RD_ADI07_001: upstream-reference=EcuSwComposition.Debug_PVT_SCIM_RD_ADI07, ecu-extract-reference=COMPOSITIONTYPE.Debug_PVT_SCIM_RD_ADI07
      Debug_PVT_SCIM_RD_ADI02: upstream-reference=EcuSwComposition.Debug_PVT_SCIM_RD_ADI02.Debug_PVT_SCIM_RD_ADI02, ecu-extract-reference=COMPOSITIONTYPE.Debug_PVT_SCIM_RD_ADI02.Debug_PVT_SCIM_RD_ADI02
      Debug_PVT_SCIM_RD_ADI02_001: upstream-reference=EcuSwComposition.Debug_PVT_SCIM_RD_ADI02, ecu-extract-reference=COMPOSITIONTYPE.Debug_PVT_SCIM_RD_ADI02
      Debug_PVT_SCIM_RD_DAI1: upstream-reference=EcuSwComposition.Debug_PVT_SCIM_RD_DAI1.Debug_PVT_SCIM_RD_DAI1, ecu-extract-reference=COMPOSITIONTYPE.Debug_PVT_SCIM_RD_DAI1.Debug_PVT_SCIM_RD_DAI1
      Debug_PVT_SCIM_RD_DAI1_001: upstream-reference=EcuSwComposition.Debug_PVT_SCIM_RD_DAI1, ecu-extract-reference=COMPOSITIONTYPE.Debug_PVT_SCIM_RD_DAI1
      Debug_PVT_SCIM_RD_ADI10: upstream-reference=EcuSwComposition.Debug_PVT_SCIM_RD_ADI10.Debug_PVT_SCIM_RD_ADI10, ecu-extract-reference=COMPOSITIONTYPE.Debug_PVT_SCIM_RD_ADI10.Debug_PVT_SCIM_RD_ADI10
      Debug_PVT_SCIM_RD_ADI10_001: upstream-reference=EcuSwComposition.Debug_PVT_SCIM_RD_ADI10, ecu-extract-reference=COMPOSITIONTYPE.Debug_PVT_SCIM_RD_ADI10
      Debug_PVT_SCIM_RD_ADI06: upstream-reference=EcuSwComposition.Debug_PVT_SCIM_RD_ADI06.Debug_PVT_SCIM_RD_ADI06, ecu-extract-reference=COMPOSITIONTYPE.Debug_PVT_SCIM_RD_ADI06.Debug_PVT_SCIM_RD_ADI06
      Debug_PVT_SCIM_RD_ADI06_001: upstream-reference=EcuSwComposition.Debug_PVT_SCIM_RD_ADI06, ecu-extract-reference=COMPOSITIONTYPE.Debug_PVT_SCIM_RD_ADI06
      Debug_PVT_SCIM_RD_ADI01: upstream-reference=EcuSwComposition.Debug_PVT_SCIM_RD_ADI01.Debug_PVT_SCIM_RD_ADI01, ecu-extract-reference=COMPOSITIONTYPE.Debug_PVT_SCIM_RD_ADI01.Debug_PVT_SCIM_RD_ADI01
      Debug_PVT_SCIM_RD_ADI01_001: upstream-reference=EcuSwComposition.Debug_PVT_SCIM_RD_ADI01, ecu-extract-reference=COMPOSITIONTYPE.Debug_PVT_SCIM_RD_ADI01
      Debug_PVT_SCIM_RD_ADI03: upstream-reference=EcuSwComposition.Debug_PVT_SCIM_RD_ADI03.Debug_PVT_SCIM_RD_ADI03, ecu-extract-reference=COMPOSITIONTYPE.Debug_PVT_SCIM_RD_ADI03.Debug_PVT_SCIM_RD_ADI03
      Debug_PVT_SCIM_RD_ADI03_001: upstream-reference=EcuSwComposition.Debug_PVT_SCIM_RD_ADI03, ecu-extract-reference=COMPOSITIONTYPE.Debug_PVT_SCIM_RD_ADI03
      Debug_PVT_SCIM_RD_ADI11: upstream-reference=EcuSwComposition.Debug_PVT_SCIM_RD_ADI11.Debug_PVT_SCIM_RD_ADI11, ecu-extract-reference=COMPOSITIONTYPE.Debug_PVT_SCIM_RD_ADI11.Debug_PVT_SCIM_RD_ADI11
      Debug_PVT_SCIM_RD_ADI11_001: upstream-reference=EcuSwComposition.Debug_PVT_SCIM_RD_ADI11, ecu-extract-reference=COMPOSITIONTYPE.Debug_PVT_SCIM_RD_ADI11
      Debug_PVT_SCIM_RD_ADI14: upstream-reference=EcuSwComposition.Debug_PVT_SCIM_RD_ADI14.Debug_PVT_SCIM_RD_ADI14, ecu-extract-reference=COMPOSITIONTYPE.Debug_PVT_SCIM_RD_ADI14.Debug_PVT_SCIM_RD_ADI14
      Debug_PVT_SCIM_RD_ADI14_001: upstream-reference=EcuSwComposition.Debug_PVT_SCIM_RD_ADI14, ecu-extract-reference=COMPOSITIONTYPE.Debug_PVT_SCIM_RD_ADI14
      Debug_PVT_SCIM_RD_ADI13: upstream-reference=EcuSwComposition.Debug_PVT_SCIM_RD_ADI13.Debug_PVT_SCIM_RD_ADI13, ecu-extract-reference=COMPOSITIONTYPE.Debug_PVT_SCIM_RD_ADI13.Debug_PVT_SCIM_RD_ADI13
      Debug_PVT_SCIM_RD_ADI13_001: upstream-reference=EcuSwComposition.Debug_PVT_SCIM_RD_ADI13, ecu-extract-reference=COMPOSITIONTYPE.Debug_PVT_SCIM_RD_ADI13
      Debug_PVT_SCIM_RD_ADI04: upstream-reference=EcuSwComposition.Debug_PVT_SCIM_RD_ADI04.Debug_PVT_SCIM_RD_ADI04, ecu-extract-reference=COMPOSITIONTYPE.Debug_PVT_SCIM_RD_ADI04.Debug_PVT_SCIM_RD_ADI04
      Debug_PVT_SCIM_RD_ADI04_001: upstream-reference=EcuSwComposition.Debug_PVT_SCIM_RD_ADI04, ecu-extract-reference=COMPOSITIONTYPE.Debug_PVT_SCIM_RD_ADI04
      Debug_PVT_SCIM_RD_ADI12: upstream-reference=EcuSwComposition.Debug_PVT_SCIM_RD_ADI12.Debug_PVT_SCIM_RD_ADI12, ecu-extract-reference=COMPOSITIONTYPE.Debug_PVT_SCIM_RD_ADI12.Debug_PVT_SCIM_RD_ADI12
      Debug_PVT_SCIM_RD_ADI12_001: upstream-reference=EcuSwComposition.Debug_PVT_SCIM_RD_ADI12, ecu-extract-reference=COMPOSITIONTYPE.Debug_PVT_SCIM_RD_ADI12
      Debug_PVT_SCIM_RD_ADI15: upstream-reference=EcuSwComposition.Debug_PVT_SCIM_RD_ADI15.Debug_PVT_SCIM_RD_ADI15, ecu-extract-reference=COMPOSITIONTYPE.Debug_PVT_SCIM_RD_ADI15.Debug_PVT_SCIM_RD_ADI15
      Debug_PVT_SCIM_RD_ADI15_001: upstream-reference=EcuSwComposition.Debug_PVT_SCIM_RD_ADI15, ecu-extract-reference=COMPOSITIONTYPE.Debug_PVT_SCIM_RD_ADI15
      Debug_PVT_SCIM_RD_ADI05: upstream-reference=EcuSwComposition.Debug_PVT_SCIM_RD_ADI05.Debug_PVT_SCIM_RD_ADI05, ecu-extract-reference=COMPOSITIONTYPE.Debug_PVT_SCIM_RD_ADI05.Debug_PVT_SCIM_RD_ADI05
      Debug_PVT_SCIM_RD_ADI05_001: upstream-reference=EcuSwComposition.Debug_PVT_SCIM_RD_ADI05, ecu-extract-reference=COMPOSITIONTYPE.Debug_PVT_SCIM_RD_ADI05
      Debug_PVT_SCIM_RD_DAI2: upstream-reference=EcuSwComposition.Debug_PVT_SCIM_RD_DAI2.Debug_PVT_SCIM_RD_DAI2, ecu-extract-reference=COMPOSITIONTYPE.Debug_PVT_SCIM_RD_DAI2.Debug_PVT_SCIM_RD_DAI2
      Debug_PVT_SCIM_RD_DAI2_001: upstream-reference=EcuSwComposition.Debug_PVT_SCIM_RD_DAI2, ecu-extract-reference=COMPOSITIONTYPE.Debug_PVT_SCIM_RD_DAI2
      Debug_PVT_SCIM_RD_ADI08: upstream-reference=EcuSwComposition.Debug_PVT_SCIM_RD_ADI08.Debug_PVT_SCIM_RD_ADI08, ecu-extract-reference=COMPOSITIONTYPE.Debug_PVT_SCIM_RD_ADI08.Debug_PVT_SCIM_RD_ADI08
      Debug_PVT_SCIM_RD_ADI08_001: upstream-reference=EcuSwComposition.Debug_PVT_SCIM_RD_ADI08, ecu-extract-reference=COMPOSITIONTYPE.Debug_PVT_SCIM_RD_ADI08
      LIN_BunkH2RoofhatchCloseBtn_St: upstream-reference=EcuSwComposition.LIN_BunkH2RoofhatchCloseBtn_St.LIN_BunkH2RoofhatchCloseBtn_St, ecu-extract-reference=COMPOSITIONTYPE.LIN_BunkH2RoofhatchCloseBtn_St.LIN_BunkH2RoofhatchCloseBtn_St
      LIN_BunkH2RoofhatchCloseBtn_St_001: upstream-reference=EcuSwComposition.LIN_BunkH2RoofhatchCloseBtn_St, ecu-extract-reference=COMPOSITIONTYPE.LIN_BunkH2RoofhatchCloseBtn_St
      LIN_BunkH2LockButtonStatus: upstream-reference=EcuSwComposition.LIN_BunkH2LockButtonStatus.LIN_BunkH2LockButtonStatus, ecu-extract-reference=COMPOSITIONTYPE.LIN_BunkH2LockButtonStatus.LIN_BunkH2LockButtonStatus
      LIN_BunkH2LockButtonStatus_001: upstream-reference=EcuSwComposition.LIN_BunkH2LockButtonStatus, ecu-extract-reference=COMPOSITIONTYPE.LIN_BunkH2LockButtonStatus
      LIN_AlmClkSetCurAlm_rqst_sg: upstream-reference=EcuSwComposition.LIN_AlmClkSetCurAlm_rqst_sg.LIN_AlmClkSetCurAlm_rqst_sg, ecu-extract-reference=COMPOSITIONTYPE.LIN_AlmClkSetCurAlm_rqst_sg.LIN_AlmClkSetCurAlm_rqst_sg
      LIN_AlmClkSetCurAlm_rqst_sg_001: upstream-reference=EcuSwComposition.LIN_AlmClkSetCurAlm_rqst_sg, ecu-extract-reference=COMPOSITIONTYPE.LIN_AlmClkSetCurAlm_rqst_sg
      LIN_BunkH2IntLightIncBtn_stat: upstream-reference=EcuSwComposition.LIN_BunkH2IntLightIncBtn_stat.LIN_BunkH2IntLightIncBtn_stat, ecu-extract-reference=COMPOSITIONTYPE.LIN_BunkH2IntLightIncBtn_stat.LIN_BunkH2IntLightIncBtn_stat
      LIN_BunkH2IntLightIncBtn_stat_001: upstream-reference=EcuSwComposition.LIN_BunkH2IntLightIncBtn_stat, ecu-extract-reference=COMPOSITIONTYPE.LIN_BunkH2IntLightIncBtn_stat
      LIN_BunkH2Fade_ButtonStatus: upstream-reference=EcuSwComposition.LIN_BunkH2Fade_ButtonStatus.LIN_BunkH2Fade_ButtonStatus, ecu-extract-reference=COMPOSITIONTYPE.LIN_BunkH2Fade_ButtonStatus.LIN_BunkH2Fade_ButtonStatus
      LIN_BunkH2Fade_ButtonStatus_001: upstream-reference=EcuSwComposition.LIN_BunkH2Fade_ButtonStatus, ecu-extract-reference=COMPOSITIONTYPE.LIN_BunkH2Fade_ButtonStatus
      SwitchDetectionNeeded1L1: upstream-reference=EcuSwComposition.SwitchDetectionNeeded1L1.SwitchDetectionNeeded1L1, ecu-extract-reference=COMPOSITIONTYPE.SwitchDetectionNeeded1L1.SwitchDetectionNeeded1L1
      SwitchDetectionNeeded1L1_001: upstream-reference=EcuSwComposition.SwitchDetectionNeeded1L1, ecu-extract-reference=COMPOSITIONTYPE.SwitchDetectionNeeded1L1
      LIN_BunkH2PowerWinOpenPSBtn_st: upstream-reference=EcuSwComposition.LIN_BunkH2PowerWinOpenPSBtn_st.LIN_BunkH2PowerWinOpenPSBtn_st, ecu-extract-reference=COMPOSITIONTYPE.LIN_BunkH2PowerWinOpenPSBtn_st.LIN_BunkH2PowerWinOpenPSBtn_st
      LIN_BunkH2PowerWinOpenPSBtn_st_001: upstream-reference=EcuSwComposition.LIN_BunkH2PowerWinOpenPSBtn_st, ecu-extract-reference=COMPOSITIONTYPE.LIN_BunkH2PowerWinOpenPSBtn_st
      LIN_IntLghtDimmingLvlDecBtn_s: upstream-reference=EcuSwComposition.LIN_IntLghtDimmingLvlDecBtn_s.LIN_IntLghtDimmingLvlDecBtn_s, ecu-extract-reference=COMPOSITIONTYPE.LIN_IntLghtDimmingLvlDecBtn_s.LIN_IntLghtDimmingLvlDecBtn_s
      LIN_IntLghtDimmingLvlDecBtn_s_001: upstream-reference=EcuSwComposition.LIN_IntLghtDimmingLvlDecBtn_s, ecu-extract-reference=COMPOSITIONTYPE.LIN_IntLghtDimmingLvlDecBtn_s
      LIN_IntLghtDimmingLvlIncBtn_s: upstream-reference=EcuSwComposition.LIN_IntLghtDimmingLvlIncBtn_s.LIN_IntLghtDimmingLvlIncBtn_s, ecu-extract-reference=COMPOSITIONTYPE.LIN_IntLghtDimmingLvlIncBtn_s.LIN_IntLghtDimmingLvlIncBtn_s
      LIN_IntLghtDimmingLvlIncBtn_s_001: upstream-reference=EcuSwComposition.LIN_IntLghtDimmingLvlIncBtn_s, ecu-extract-reference=COMPOSITIONTYPE.LIN_IntLghtDimmingLvlIncBtn_s
      ResponseErrorLECM2: upstream-reference=EcuSwComposition.ResponseErrorLECM2.ResponseErrorLECM2, ecu-extract-reference=COMPOSITIONTYPE.ResponseErrorLECM2.ResponseErrorLECM2
      ResponseErrorLECM2_001: upstream-reference=EcuSwComposition.ResponseErrorLECM2, ecu-extract-reference=COMPOSITIONTYPE.ResponseErrorLECM2
      LIN_BunkH2PHTi_rqs_sg: upstream-reference=EcuSwComposition.LIN_BunkH2PHTi_rqs_sg.LIN_BunkH2PHTi_rqs_sg, ecu-extract-reference=COMPOSITIONTYPE.LIN_BunkH2PHTi_rqs_sg.LIN_BunkH2PHTi_rqs_sg
      LIN_BunkH2PHTi_rqs_sg_001: upstream-reference=EcuSwComposition.LIN_BunkH2PHTi_rqs_sg, ecu-extract-reference=COMPOSITIONTYPE.LIN_BunkH2PHTi_rqs_sg
      ResponseErrorLECMBasic: upstream-reference=EcuSwComposition.ResponseErrorLECMBasic.ResponseErrorLECMBasic, ecu-extract-reference=COMPOSITIONTYPE.ResponseErrorLECMBasic.ResponseErrorLECMBasic
      ResponseErrorLECMBasic_001: upstream-reference=EcuSwComposition.ResponseErrorLECMBasic, ecu-extract-reference=COMPOSITIONTYPE.ResponseErrorLECMBasic
      LIN_BunkH2VolumeDown_ButtonSta: upstream-reference=EcuSwComposition.LIN_BunkH2VolumeDown_ButtonSta.LIN_BunkH2VolumeDown_ButtonSta, ecu-extract-reference=COMPOSITIONTYPE.LIN_BunkH2VolumeDown_ButtonSta.LIN_BunkH2VolumeDown_ButtonSta
      LIN_BunkH2VolumeDown_ButtonSta_001: upstream-reference=EcuSwComposition.LIN_BunkH2VolumeDown_ButtonSta, ecu-extract-reference=COMPOSITIONTYPE.LIN_BunkH2VolumeDown_ButtonSta
      LIN_BunkH2IntLightDecBtn_stat: upstream-reference=EcuSwComposition.LIN_BunkH2IntLightDecBtn_stat.LIN_BunkH2IntLightDecBtn_stat, ecu-extract-reference=COMPOSITIONTYPE.LIN_BunkH2IntLightDecBtn_stat.LIN_BunkH2IntLightDecBtn_stat
      LIN_BunkH2IntLightDecBtn_stat_001: upstream-reference=EcuSwComposition.LIN_BunkH2IntLightDecBtn_stat, ecu-extract-reference=COMPOSITIONTYPE.LIN_BunkH2IntLightDecBtn_stat
      FSP2DiagInfoL1: upstream-reference=EcuSwComposition.FSP2DiagInfoL1.FSP2DiagInfoL1, ecu-extract-reference=COMPOSITIONTYPE.FSP2DiagInfoL1.FSP2DiagInfoL1
      FSP2DiagInfoL1_001: upstream-reference=EcuSwComposition.FSP2DiagInfoL1, ecu-extract-reference=COMPOSITIONTYPE.FSP2DiagInfoL1
      LIN_BunkBAudioOnOff_ButtonStat: upstream-reference=EcuSwComposition.LIN_BunkBAudioOnOff_ButtonStat.LIN_BunkBAudioOnOff_ButtonStat, ecu-extract-reference=COMPOSITIONTYPE.LIN_BunkBAudioOnOff_ButtonStat.LIN_BunkBAudioOnOff_ButtonStat
      LIN_BunkBAudioOnOff_ButtonStat_001: upstream-reference=EcuSwComposition.LIN_BunkBAudioOnOff_ButtonStat, ecu-extract-reference=COMPOSITIONTYPE.LIN_BunkBAudioOnOff_ButtonStat
      DiagInfoLECM2: upstream-reference=EcuSwComposition.DiagInfoLECM2.DiagInfoLECM2, ecu-extract-reference=COMPOSITIONTYPE.DiagInfoLECM2.DiagInfoLECM2
      DiagInfoLECM2_001: upstream-reference=EcuSwComposition.DiagInfoLECM2, ecu-extract-reference=COMPOSITIONTYPE.DiagInfoLECM2
      SwitchDetectionNeeded2L1: upstream-reference=EcuSwComposition.SwitchDetectionNeeded2L1.SwitchDetectionNeeded2L1, ecu-extract-reference=COMPOSITIONTYPE.SwitchDetectionNeeded2L1.SwitchDetectionNeeded2L1
      SwitchDetectionNeeded2L1_001: upstream-reference=EcuSwComposition.SwitchDetectionNeeded2L1, ecu-extract-reference=COMPOSITIONTYPE.SwitchDetectionNeeded2L1
      DiagInfoLECMBasic: upstream-reference=EcuSwComposition.DiagInfoLECMBasic.DiagInfoLECMBasic, ecu-extract-reference=COMPOSITIONTYPE.DiagInfoLECMBasic.DiagInfoLECMBasic
      DiagInfoLECMBasic_001: upstream-reference=EcuSwComposition.DiagInfoLECMBasic, ecu-extract-reference=COMPOSITIONTYPE.DiagInfoLECMBasic
      LIN_BunkBVolumeDown_ButtonStat: upstream-reference=EcuSwComposition.LIN_BunkBVolumeDown_ButtonStat.LIN_BunkBVolumeDown_ButtonStat, ecu-extract-reference=COMPOSITIONTYPE.LIN_BunkBVolumeDown_ButtonStat.LIN_BunkBVolumeDown_ButtonStat
      LIN_BunkBVolumeDown_ButtonStat_001: upstream-reference=EcuSwComposition.LIN_BunkBVolumeDown_ButtonStat, ecu-extract-reference=COMPOSITIONTYPE.LIN_BunkBVolumeDown_ButtonStat
      LIN_IntLghtModeSelrFreeWheel_s: upstream-reference=EcuSwComposition.LIN_IntLghtModeSelrFreeWheel_s.LIN_IntLghtModeSelrFreeWheel_s, ecu-extract-reference=COMPOSITIONTYPE.LIN_IntLghtModeSelrFreeWheel_s.LIN_IntLghtModeSelrFreeWheel_s
      LIN_IntLghtModeSelrFreeWheel_s_001: upstream-reference=EcuSwComposition.LIN_IntLghtModeSelrFreeWheel_s, ecu-extract-reference=COMPOSITIONTYPE.LIN_IntLghtModeSelrFreeWheel_s
      LIN_BunkH2OnOFF_ButtonStatus: upstream-reference=EcuSwComposition.LIN_BunkH2OnOFF_ButtonStatus.LIN_BunkH2OnOFF_ButtonStatus, ecu-extract-reference=COMPOSITIONTYPE.LIN_BunkH2OnOFF_ButtonStatus.LIN_BunkH2OnOFF_ButtonStatus
      LIN_BunkH2OnOFF_ButtonStatus_001: upstream-reference=EcuSwComposition.LIN_BunkH2OnOFF_ButtonStatus, ecu-extract-reference=COMPOSITIONTYPE.LIN_BunkH2OnOFF_ButtonStatus
      FSP1ResponseErrorL1: upstream-reference=EcuSwComposition.FSP1ResponseErrorL1.FSP1ResponseErrorL1, ecu-extract-reference=COMPOSITIONTYPE.FSP1ResponseErrorL1.FSP1ResponseErrorL1
      FSP1ResponseErrorL1_001: upstream-reference=EcuSwComposition.FSP1ResponseErrorL1, ecu-extract-reference=COMPOSITIONTYPE.FSP1ResponseErrorL1
      LIN_BunkH2VolumeUp_ButtonStatu: upstream-reference=EcuSwComposition.LIN_BunkH2VolumeUp_ButtonStatu.LIN_BunkH2VolumeUp_ButtonStatu, ecu-extract-reference=COMPOSITIONTYPE.LIN_BunkH2VolumeUp_ButtonStatu.LIN_BunkH2VolumeUp_ButtonStatu
      LIN_BunkH2VolumeUp_ButtonStatu_001: upstream-reference=EcuSwComposition.LIN_BunkH2VolumeUp_ButtonStatu, ecu-extract-reference=COMPOSITIONTYPE.LIN_BunkH2VolumeUp_ButtonStatu
      ResponseErrorILCP1: upstream-reference=EcuSwComposition.ResponseErrorILCP1.ResponseErrorILCP1, ecu-extract-reference=COMPOSITIONTYPE.ResponseErrorILCP1.ResponseErrorILCP1
      ResponseErrorILCP1_001: upstream-reference=EcuSwComposition.ResponseErrorILCP1, ecu-extract-reference=COMPOSITIONTYPE.ResponseErrorILCP1
      LIN_BunkH2Phone_ButtonStatus: upstream-reference=EcuSwComposition.LIN_BunkH2Phone_ButtonStatus.LIN_BunkH2Phone_ButtonStatus, ecu-extract-reference=COMPOSITIONTYPE.LIN_BunkH2Phone_ButtonStatus.LIN_BunkH2Phone_ButtonStatus
      LIN_BunkH2Phone_ButtonStatus_001: upstream-reference=EcuSwComposition.LIN_BunkH2Phone_ButtonStatus, ecu-extract-reference=COMPOSITIONTYPE.LIN_BunkH2Phone_ButtonStatus
      FSP2ResponseErrorL1: upstream-reference=EcuSwComposition.FSP2ResponseErrorL1.FSP2ResponseErrorL1, ecu-extract-reference=COMPOSITIONTYPE.FSP2ResponseErrorL1.FSP2ResponseErrorL1
      FSP2ResponseErrorL1_001: upstream-reference=EcuSwComposition.FSP2ResponseErrorL1, ecu-extract-reference=COMPOSITIONTYPE.FSP2ResponseErrorL1
      LIN_BunkH2PowerWinCloseDSBtn_s: upstream-reference=EcuSwComposition.LIN_BunkH2PowerWinCloseDSBtn_s.LIN_BunkH2PowerWinCloseDSBtn_s, ecu-extract-reference=COMPOSITIONTYPE.LIN_BunkH2PowerWinCloseDSBtn_s.LIN_BunkH2PowerWinCloseDSBtn_s
      LIN_BunkH2PowerWinCloseDSBtn_s_001: upstream-reference=EcuSwComposition.LIN_BunkH2PowerWinCloseDSBtn_s, ecu-extract-reference=COMPOSITIONTYPE.LIN_BunkH2PowerWinCloseDSBtn_s
      LIN_BunkH2PowerWinOpenDSBtn_st: upstream-reference=EcuSwComposition.LIN_BunkH2PowerWinOpenDSBtn_st.LIN_BunkH2PowerWinOpenDSBtn_st, ecu-extract-reference=COMPOSITIONTYPE.LIN_BunkH2PowerWinOpenDSBtn_st.LIN_BunkH2PowerWinOpenDSBtn_st
      LIN_BunkH2PowerWinOpenDSBtn_st_001: upstream-reference=EcuSwComposition.LIN_BunkH2PowerWinOpenDSBtn_st, ecu-extract-reference=COMPOSITIONTYPE.LIN_BunkH2PowerWinOpenDSBtn_st
      LIN_DoorAutoFuncBtn_stat: upstream-reference=EcuSwComposition.LIN_DoorAutoFuncBtn_stat.LIN_DoorAutoFuncBtn_stat, ecu-extract-reference=COMPOSITIONTYPE.LIN_DoorAutoFuncBtn_stat.LIN_DoorAutoFuncBtn_stat
      LIN_DoorAutoFuncBtn_stat_001: upstream-reference=EcuSwComposition.LIN_DoorAutoFuncBtn_stat, ecu-extract-reference=COMPOSITIONTYPE.LIN_DoorAutoFuncBtn_stat
      LIN_BunkH2TempDec_ButtonStatus: upstream-reference=EcuSwComposition.LIN_BunkH2TempDec_ButtonStatus.LIN_BunkH2TempDec_ButtonStatus, ecu-extract-reference=COMPOSITIONTYPE.LIN_BunkH2TempDec_ButtonStatus.LIN_BunkH2TempDec_ButtonStatus
      LIN_BunkH2TempDec_ButtonStatus_001: upstream-reference=EcuSwComposition.LIN_BunkH2TempDec_ButtonStatus, ecu-extract-reference=COMPOSITIONTYPE.LIN_BunkH2TempDec_ButtonStatus
      LIN_BunkBVolumeUp_ButtonStat: upstream-reference=EcuSwComposition.LIN_BunkBVolumeUp_ButtonStat.LIN_BunkBVolumeUp_ButtonStat, ecu-extract-reference=COMPOSITIONTYPE.LIN_BunkBVolumeUp_ButtonStat.LIN_BunkBVolumeUp_ButtonStat
      LIN_BunkBVolumeUp_ButtonStat_001: upstream-reference=EcuSwComposition.LIN_BunkBVolumeUp_ButtonStat, ecu-extract-reference=COMPOSITIONTYPE.LIN_BunkBVolumeUp_ButtonStat
      LIN_BunkBIntLightActvnBtn_stat: upstream-reference=EcuSwComposition.LIN_BunkBIntLightActvnBtn_stat.LIN_BunkBIntLightActvnBtn_stat, ecu-extract-reference=COMPOSITIONTYPE.LIN_BunkBIntLightActvnBtn_stat.LIN_BunkBIntLightActvnBtn_stat
      LIN_BunkBIntLightActvnBtn_stat_001: upstream-reference=EcuSwComposition.LIN_BunkBIntLightActvnBtn_stat, ecu-extract-reference=COMPOSITIONTYPE.LIN_BunkBIntLightActvnBtn_stat
      LIN_BunkH2PowerWinClosePSBtn_s: upstream-reference=EcuSwComposition.LIN_BunkH2PowerWinClosePSBtn_s.LIN_BunkH2PowerWinClosePSBtn_s, ecu-extract-reference=COMPOSITIONTYPE.LIN_BunkH2PowerWinClosePSBtn_s.LIN_BunkH2PowerWinClosePSBtn_s
      LIN_BunkH2PowerWinClosePSBtn_s_001: upstream-reference=EcuSwComposition.LIN_BunkH2PowerWinClosePSBtn_s, ecu-extract-reference=COMPOSITIONTYPE.LIN_BunkH2PowerWinClosePSBtn_s
      LIN_BunkBParkHeater_ButtonStat: upstream-reference=EcuSwComposition.LIN_BunkBParkHeater_ButtonStat.LIN_BunkBParkHeater_ButtonStat, ecu-extract-reference=COMPOSITIONTYPE.LIN_BunkBParkHeater_ButtonStat.LIN_BunkBParkHeater_ButtonStat
      LIN_BunkBParkHeater_ButtonStat_001: upstream-reference=EcuSwComposition.LIN_BunkBParkHeater_ButtonStat, ecu-extract-reference=COMPOSITIONTYPE.LIN_BunkBParkHeater_ButtonStat
      LIN_BunkH2ParkHeater_ButtonSta: upstream-reference=EcuSwComposition.LIN_BunkH2ParkHeater_ButtonSta.LIN_BunkH2ParkHeater_ButtonSta, ecu-extract-reference=COMPOSITIONTYPE.LIN_BunkH2ParkHeater_ButtonSta.LIN_BunkH2ParkHeater_ButtonSta
      LIN_BunkH2ParkHeater_ButtonSta_001: upstream-reference=EcuSwComposition.LIN_BunkH2ParkHeater_ButtonSta, ecu-extract-reference=COMPOSITIONTYPE.LIN_BunkH2ParkHeater_ButtonSta
      LIN_BunkBTempInc_ButtonStat: upstream-reference=EcuSwComposition.LIN_BunkBTempInc_ButtonStat.LIN_BunkBTempInc_ButtonStat, ecu-extract-reference=COMPOSITIONTYPE.LIN_BunkBTempInc_ButtonStat.LIN_BunkBTempInc_ButtonStat
      LIN_BunkBTempInc_ButtonStat_001: upstream-reference=EcuSwComposition.LIN_BunkBTempInc_ButtonStat, ecu-extract-reference=COMPOSITIONTYPE.LIN_BunkBTempInc_ButtonStat
      LIN_BunkH2AudioOnOff_ButtonSta: upstream-reference=EcuSwComposition.LIN_BunkH2AudioOnOff_ButtonSta.LIN_BunkH2AudioOnOff_ButtonSta, ecu-extract-reference=COMPOSITIONTYPE.LIN_BunkH2AudioOnOff_ButtonSta.LIN_BunkH2AudioOnOff_ButtonSta
      LIN_BunkH2AudioOnOff_ButtonSta_001: upstream-reference=EcuSwComposition.LIN_BunkH2AudioOnOff_ButtonSta, ecu-extract-reference=COMPOSITIONTYPE.LIN_BunkH2AudioOnOff_ButtonSta
      SwitchDetectionResp2L1: upstream-reference=EcuSwComposition.SwitchDetectionResp2L1.SwitchDetectionResp2L1, ecu-extract-reference=COMPOSITIONTYPE.SwitchDetectionResp2L1.SwitchDetectionResp2L1
      SwitchDetectionResp2L1_001: upstream-reference=EcuSwComposition.SwitchDetectionResp2L1, ecu-extract-reference=COMPOSITIONTYPE.SwitchDetectionResp2L1
      LIN_BunkH2IntLightActvnBtn_sta: upstream-reference=EcuSwComposition.LIN_BunkH2IntLightActvnBtn_sta.LIN_BunkH2IntLightActvnBtn_sta, ecu-extract-reference=COMPOSITIONTYPE.LIN_BunkH2IntLightActvnBtn_sta.LIN_BunkH2IntLightActvnBtn_sta
      LIN_BunkH2IntLightActvnBtn_sta_001: upstream-reference=EcuSwComposition.LIN_BunkH2IntLightActvnBtn_sta, ecu-extract-reference=COMPOSITIONTYPE.LIN_BunkH2IntLightActvnBtn_sta
      LIN_BunkH2RoofhatchOpenBtn_Sta: upstream-reference=EcuSwComposition.LIN_BunkH2RoofhatchOpenBtn_Sta.LIN_BunkH2RoofhatchOpenBtn_Sta, ecu-extract-reference=COMPOSITIONTYPE.LIN_BunkH2RoofhatchOpenBtn_Sta.LIN_BunkH2RoofhatchOpenBtn_Sta
      LIN_BunkH2RoofhatchOpenBtn_Sta_001: upstream-reference=EcuSwComposition.LIN_BunkH2RoofhatchOpenBtn_Sta, ecu-extract-reference=COMPOSITIONTYPE.LIN_BunkH2RoofhatchOpenBtn_Sta
      SwitchDetectionResp1L1: upstream-reference=EcuSwComposition.SwitchDetectionResp1L1.SwitchDetectionResp1L1, ecu-extract-reference=COMPOSITIONTYPE.SwitchDetectionResp1L1.SwitchDetectionResp1L1
      SwitchDetectionResp1L1_001: upstream-reference=EcuSwComposition.SwitchDetectionResp1L1, ecu-extract-reference=COMPOSITIONTYPE.SwitchDetectionResp1L1
      FSP1DiagInfoL1: upstream-reference=EcuSwComposition.FSP1DiagInfoL1.FSP1DiagInfoL1, ecu-extract-reference=COMPOSITIONTYPE.FSP1DiagInfoL1.FSP1DiagInfoL1
      FSP1DiagInfoL1_001: upstream-reference=EcuSwComposition.FSP1DiagInfoL1, ecu-extract-reference=COMPOSITIONTYPE.FSP1DiagInfoL1
      DiagInfoILCP1: upstream-reference=EcuSwComposition.DiagInfoILCP1.DiagInfoILCP1, ecu-extract-reference=COMPOSITIONTYPE.DiagInfoILCP1.DiagInfoILCP1
      DiagInfoILCP1_001: upstream-reference=EcuSwComposition.DiagInfoILCP1, ecu-extract-reference=COMPOSITIONTYPE.DiagInfoILCP1
      LIN_BunkBTempDec_ButtonStat: upstream-reference=EcuSwComposition.LIN_BunkBTempDec_ButtonStat.LIN_BunkBTempDec_ButtonStat, ecu-extract-reference=COMPOSITIONTYPE.LIN_BunkBTempDec_ButtonStat.LIN_BunkBTempDec_ButtonStat
      LIN_BunkBTempDec_ButtonStat_001: upstream-reference=EcuSwComposition.LIN_BunkBTempDec_ButtonStat, ecu-extract-reference=COMPOSITIONTYPE.LIN_BunkBTempDec_ButtonStat
      LIN_BunkH2TempInc_ButtonStatus: upstream-reference=EcuSwComposition.LIN_BunkH2TempInc_ButtonStatus.LIN_BunkH2TempInc_ButtonStatus, ecu-extract-reference=COMPOSITIONTYPE.LIN_BunkH2TempInc_ButtonStatus.LIN_BunkH2TempInc_ButtonStatus
      LIN_BunkH2TempInc_ButtonStatus_001: upstream-reference=EcuSwComposition.LIN_BunkH2TempInc_ButtonStatus, ecu-extract-reference=COMPOSITIONTYPE.LIN_BunkH2TempInc_ButtonStatus
      LIN_IntLightMaxModeInd_cmd: upstream-reference=EcuSwComposition.LIN_IntLightMaxModeInd_cmd.LIN_IntLightMaxModeInd_cmd, ecu-extract-reference=COMPOSITIONTYPE.LIN_IntLightMaxModeInd_cmd.LIN_IntLightMaxModeInd_cmd
      LIN_IntLightMaxModeInd_cmd_001: upstream-reference=EcuSwComposition.LIN_IntLightMaxModeInd_cmd, ecu-extract-reference=COMPOSITIONTYPE.LIN_IntLightMaxModeInd_cmd
      LIN_AlmClkCurAlarm_stat_sg: upstream-reference=EcuSwComposition.LIN_AlmClkCurAlarm_stat_sg.LIN_AlmClkCurAlarm_stat_sg, ecu-extract-reference=COMPOSITIONTYPE.LIN_AlmClkCurAlarm_stat_sg.LIN_AlmClkCurAlarm_stat_sg
      LIN_AlmClkCurAlarm_stat_sg_001: upstream-reference=EcuSwComposition.LIN_AlmClkCurAlarm_stat_sg, ecu-extract-reference=COMPOSITIONTYPE.LIN_AlmClkCurAlarm_stat_sg
      LIN_DoorAutoFuncInd_cmd: upstream-reference=EcuSwComposition.LIN_DoorAutoFuncInd_cmd.LIN_DoorAutoFuncInd_cmd, ecu-extract-reference=COMPOSITIONTYPE.LIN_DoorAutoFuncInd_cmd.LIN_DoorAutoFuncInd_cmd
      LIN_DoorAutoFuncInd_cmd_001: upstream-reference=EcuSwComposition.LIN_DoorAutoFuncInd_cmd, ecu-extract-reference=COMPOSITIONTYPE.LIN_DoorAutoFuncInd_cmd
      LIN_IntLightNightModeInd_cmd: upstream-reference=EcuSwComposition.LIN_IntLightNightModeInd_cmd.LIN_IntLightNightModeInd_cmd, ecu-extract-reference=COMPOSITIONTYPE.LIN_IntLightNightModeInd_cmd.LIN_IntLightNightModeInd_cmd
      LIN_IntLightNightModeInd_cmd_001: upstream-reference=EcuSwComposition.LIN_IntLightNightModeInd_cmd, ecu-extract-reference=COMPOSITIONTYPE.LIN_IntLightNightModeInd_cmd
      LIN_IntLightRestingModeInd_cmd: upstream-reference=EcuSwComposition.LIN_IntLightRestingModeInd_cmd.LIN_IntLightRestingModeInd_cmd, ecu-extract-reference=COMPOSITIONTYPE.LIN_IntLightRestingModeInd_cmd.LIN_IntLightRestingModeInd_cmd
      LIN_IntLightRestingModeInd_cmd_001: upstream-reference=EcuSwComposition.LIN_IntLightRestingModeInd_cmd, ecu-extract-reference=COMPOSITIONTYPE.LIN_IntLightRestingModeInd_cmd
      LIN_AudioVolumeIndicationCmd: upstream-reference=EcuSwComposition.LIN_AudioVolumeIndicationCmd.LIN_AudioVolumeIndicationCmd, ecu-extract-reference=COMPOSITIONTYPE.LIN_AudioVolumeIndicationCmd.LIN_AudioVolumeIndicationCmd
      LIN_AudioVolumeIndicationCmd_001: upstream-reference=EcuSwComposition.LIN_AudioVolumeIndicationCmd, ecu-extract-reference=COMPOSITIONTYPE.LIN_AudioVolumeIndicationCmd
      LIN_IntLghtOffModeInd_cmd: upstream-reference=EcuSwComposition.LIN_IntLghtOffModeInd_cmd.LIN_IntLghtOffModeInd_cmd, ecu-extract-reference=COMPOSITIONTYPE.LIN_IntLghtOffModeInd_cmd.LIN_IntLghtOffModeInd_cmd
      LIN_IntLghtOffModeInd_cmd_001: upstream-reference=EcuSwComposition.LIN_IntLghtOffModeInd_cmd, ecu-extract-reference=COMPOSITIONTYPE.LIN_IntLghtOffModeInd_cmd
      FSP2IndicationCmdL1: upstream-reference=EcuSwComposition.FSP2IndicationCmdL1.FSP2IndicationCmdL1, ecu-extract-reference=COMPOSITIONTYPE.FSP2IndicationCmdL1.FSP2IndicationCmdL1
      FSP2IndicationCmdL1_001: upstream-reference=EcuSwComposition.FSP2IndicationCmdL1, ecu-extract-reference=COMPOSITIONTYPE.FSP2IndicationCmdL1
      LIN_PhoneButtonIndication_cmd: upstream-reference=EcuSwComposition.LIN_PhoneButtonIndication_cmd.LIN_PhoneButtonIndication_cmd, ecu-extract-reference=COMPOSITIONTYPE.LIN_PhoneButtonIndication_cmd.LIN_PhoneButtonIndication_cmd
      LIN_PhoneButtonIndication_cmd_001: upstream-reference=EcuSwComposition.LIN_PhoneButtonIndication_cmd, ecu-extract-reference=COMPOSITIONTYPE.LIN_PhoneButtonIndication_cmd
      LIN_AudioSystemStatus: upstream-reference=EcuSwComposition.LIN_AudioSystemStatus.LIN_AudioSystemStatus, ecu-extract-reference=COMPOSITIONTYPE.LIN_AudioSystemStatus.LIN_AudioSystemStatus
      LIN_AudioSystemStatus_001: upstream-reference=EcuSwComposition.LIN_AudioSystemStatus, ecu-extract-reference=COMPOSITIONTYPE.LIN_AudioSystemStatus
      LIN_BTStatus: upstream-reference=EcuSwComposition.LIN_BTStatus.LIN_BTStatus, ecu-extract-reference=COMPOSITIONTYPE.LIN_BTStatus.LIN_BTStatus
      LIN_BTStatus_001: upstream-reference=EcuSwComposition.LIN_BTStatus, ecu-extract-reference=COMPOSITIONTYPE.LIN_BTStatus
      DoorLock_stat: upstream-reference=EcuSwComposition.DoorLock_stat.DoorLock_stat, ecu-extract-reference=COMPOSITIONTYPE.DoorLock_stat.DoorLock_stat
      DoorLock_stat_001: upstream-reference=EcuSwComposition.DoorLock_stat, ecu-extract-reference=COMPOSITIONTYPE.DoorLock_stat
      LIN_IntLghtLvlIndScaled_cmd: upstream-reference=EcuSwComposition.LIN_IntLghtLvlIndScaled_cmd.LIN_IntLghtLvlIndScaled_cmd, ecu-extract-reference=COMPOSITIONTYPE.LIN_IntLghtLvlIndScaled_cmd.LIN_IntLghtLvlIndScaled_cmd
      LIN_IntLghtLvlIndScaled_cmd_001: upstream-reference=EcuSwComposition.LIN_IntLghtLvlIndScaled_cmd, ecu-extract-reference=COMPOSITIONTYPE.LIN_IntLghtLvlIndScaled_cmd
      LIN_IntLghtModeInd_cmd_sg: upstream-reference=EcuSwComposition.LIN_IntLghtModeInd_cmd_sg.LIN_IntLghtModeInd_cmd_sg, ecu-extract-reference=COMPOSITIONTYPE.LIN_IntLghtModeInd_cmd_sg.LIN_IntLghtModeInd_cmd_sg
      LIN_IntLghtModeInd_cmd_sg_001: upstream-reference=EcuSwComposition.LIN_IntLghtModeInd_cmd_sg, ecu-extract-reference=COMPOSITIONTYPE.LIN_IntLghtModeInd_cmd_sg
      FSP3ResponseErrorL2: upstream-reference=EcuSwComposition.FSP3ResponseErrorL2.FSP3ResponseErrorL2, ecu-extract-reference=COMPOSITIONTYPE.FSP3ResponseErrorL2.FSP3ResponseErrorL2
      FSP3ResponseErrorL2_001: upstream-reference=EcuSwComposition.FSP3ResponseErrorL2, ecu-extract-reference=COMPOSITIONTYPE.FSP3ResponseErrorL2
      FSP1SwitchStatusL2: upstream-reference=EcuSwComposition.FSP1SwitchStatusL2.FSP1SwitchStatusL2, ecu-extract-reference=COMPOSITIONTYPE.FSP1SwitchStatusL2.FSP1SwitchStatusL2
      FSP1SwitchStatusL2_001: upstream-reference=EcuSwComposition.FSP1SwitchStatusL2, ecu-extract-reference=COMPOSITIONTYPE.FSP1SwitchStatusL2
      SwitchDetectionResp1L2: upstream-reference=EcuSwComposition.SwitchDetectionResp1L2.SwitchDetectionResp1L2, ecu-extract-reference=COMPOSITIONTYPE.SwitchDetectionResp1L2.SwitchDetectionResp1L2
      SwitchDetectionResp1L2_001: upstream-reference=EcuSwComposition.SwitchDetectionResp1L2, ecu-extract-reference=COMPOSITIONTYPE.SwitchDetectionResp1L2
      SwitchDetectionNeeded2L2: upstream-reference=EcuSwComposition.SwitchDetectionNeeded2L2.SwitchDetectionNeeded2L2, ecu-extract-reference=COMPOSITIONTYPE.SwitchDetectionNeeded2L2.SwitchDetectionNeeded2L2
      SwitchDetectionNeeded2L2_001: upstream-reference=EcuSwComposition.SwitchDetectionNeeded2L2, ecu-extract-reference=COMPOSITIONTYPE.SwitchDetectionNeeded2L2
      FSP3SwitchStatusL2: upstream-reference=EcuSwComposition.FSP3SwitchStatusL2.FSP3SwitchStatusL2, ecu-extract-reference=COMPOSITIONTYPE.FSP3SwitchStatusL2.FSP3SwitchStatusL2
      FSP3SwitchStatusL2_001: upstream-reference=EcuSwComposition.FSP3SwitchStatusL2, ecu-extract-reference=COMPOSITIONTYPE.FSP3SwitchStatusL2
      FSP3DiagInfoL2: upstream-reference=EcuSwComposition.FSP3DiagInfoL2.FSP3DiagInfoL2, ecu-extract-reference=COMPOSITIONTYPE.FSP3DiagInfoL2.FSP3DiagInfoL2
      FSP3DiagInfoL2_001: upstream-reference=EcuSwComposition.FSP3DiagInfoL2, ecu-extract-reference=COMPOSITIONTYPE.FSP3DiagInfoL2
      FSP1DiagInfoL2: upstream-reference=EcuSwComposition.FSP1DiagInfoL2.FSP1DiagInfoL2, ecu-extract-reference=COMPOSITIONTYPE.FSP1DiagInfoL2.FSP1DiagInfoL2
      FSP1DiagInfoL2_001: upstream-reference=EcuSwComposition.FSP1DiagInfoL2, ecu-extract-reference=COMPOSITIONTYPE.FSP1DiagInfoL2
      FSP4ResponseErrorL2: upstream-reference=EcuSwComposition.FSP4ResponseErrorL2.FSP4ResponseErrorL2, ecu-extract-reference=COMPOSITIONTYPE.FSP4ResponseErrorL2.FSP4ResponseErrorL2
      FSP4ResponseErrorL2_001: upstream-reference=EcuSwComposition.FSP4ResponseErrorL2, ecu-extract-reference=COMPOSITIONTYPE.FSP4ResponseErrorL2
      FSP4DiagInfoL2: upstream-reference=EcuSwComposition.FSP4DiagInfoL2.FSP4DiagInfoL2, ecu-extract-reference=COMPOSITIONTYPE.FSP4DiagInfoL2.FSP4DiagInfoL2
      FSP4DiagInfoL2_001: upstream-reference=EcuSwComposition.FSP4DiagInfoL2, ecu-extract-reference=COMPOSITIONTYPE.FSP4DiagInfoL2
      FSP2DiagInfoL2: upstream-reference=EcuSwComposition.FSP2DiagInfoL2.FSP2DiagInfoL2, ecu-extract-reference=COMPOSITIONTYPE.FSP2DiagInfoL2.FSP2DiagInfoL2
      FSP2DiagInfoL2_001: upstream-reference=EcuSwComposition.FSP2DiagInfoL2, ecu-extract-reference=COMPOSITIONTYPE.FSP2DiagInfoL2
      SwitchDetectionResp4L2: upstream-reference=EcuSwComposition.SwitchDetectionResp4L2.SwitchDetectionResp4L2, ecu-extract-reference=COMPOSITIONTYPE.SwitchDetectionResp4L2.SwitchDetectionResp4L2
      SwitchDetectionResp4L2_001: upstream-reference=EcuSwComposition.SwitchDetectionResp4L2, ecu-extract-reference=COMPOSITIONTYPE.SwitchDetectionResp4L2
      FSP4SwitchStatusL2: upstream-reference=EcuSwComposition.FSP4SwitchStatusL2.FSP4SwitchStatusL2, ecu-extract-reference=COMPOSITIONTYPE.FSP4SwitchStatusL2.FSP4SwitchStatusL2
      FSP4SwitchStatusL2_001: upstream-reference=EcuSwComposition.FSP4SwitchStatusL2, ecu-extract-reference=COMPOSITIONTYPE.FSP4SwitchStatusL2
      FSP1ResponseErrorL2: upstream-reference=EcuSwComposition.FSP1ResponseErrorL2.FSP1ResponseErrorL2, ecu-extract-reference=COMPOSITIONTYPE.FSP1ResponseErrorL2.FSP1ResponseErrorL2
      FSP1ResponseErrorL2_001: upstream-reference=EcuSwComposition.FSP1ResponseErrorL2, ecu-extract-reference=COMPOSITIONTYPE.FSP1ResponseErrorL2
      SwitchDetectionResp2L2: upstream-reference=EcuSwComposition.SwitchDetectionResp2L2.SwitchDetectionResp2L2, ecu-extract-reference=COMPOSITIONTYPE.SwitchDetectionResp2L2.SwitchDetectionResp2L2
      SwitchDetectionResp2L2_001: upstream-reference=EcuSwComposition.SwitchDetectionResp2L2, ecu-extract-reference=COMPOSITIONTYPE.SwitchDetectionResp2L2
      FSP2SwitchStatusL2: upstream-reference=EcuSwComposition.FSP2SwitchStatusL2.FSP2SwitchStatusL2, ecu-extract-reference=COMPOSITIONTYPE.FSP2SwitchStatusL2.FSP2SwitchStatusL2
      FSP2SwitchStatusL2_001: upstream-reference=EcuSwComposition.FSP2SwitchStatusL2, ecu-extract-reference=COMPOSITIONTYPE.FSP2SwitchStatusL2
      SwitchDetectionNeeded1L2: upstream-reference=EcuSwComposition.SwitchDetectionNeeded1L2.SwitchDetectionNeeded1L2, ecu-extract-reference=COMPOSITIONTYPE.SwitchDetectionNeeded1L2.SwitchDetectionNeeded1L2
      SwitchDetectionNeeded1L2_001: upstream-reference=EcuSwComposition.SwitchDetectionNeeded1L2, ecu-extract-reference=COMPOSITIONTYPE.SwitchDetectionNeeded1L2
      FSP2ResponseErrorL2: upstream-reference=EcuSwComposition.FSP2ResponseErrorL2.FSP2ResponseErrorL2, ecu-extract-reference=COMPOSITIONTYPE.FSP2ResponseErrorL2.FSP2ResponseErrorL2
      FSP2ResponseErrorL2_001: upstream-reference=EcuSwComposition.FSP2ResponseErrorL2, ecu-extract-reference=COMPOSITIONTYPE.FSP2ResponseErrorL2
      SwitchDetectionNeeded3L2: upstream-reference=EcuSwComposition.SwitchDetectionNeeded3L2.SwitchDetectionNeeded3L2, ecu-extract-reference=COMPOSITIONTYPE.SwitchDetectionNeeded3L2.SwitchDetectionNeeded3L2
      SwitchDetectionNeeded3L2_001: upstream-reference=EcuSwComposition.SwitchDetectionNeeded3L2, ecu-extract-reference=COMPOSITIONTYPE.SwitchDetectionNeeded3L2
      SwitchDetectionResp3L2: upstream-reference=EcuSwComposition.SwitchDetectionResp3L2.SwitchDetectionResp3L2, ecu-extract-reference=COMPOSITIONTYPE.SwitchDetectionResp3L2.SwitchDetectionResp3L2
      SwitchDetectionResp3L2_001: upstream-reference=EcuSwComposition.SwitchDetectionResp3L2, ecu-extract-reference=COMPOSITIONTYPE.SwitchDetectionResp3L2
      SwitchDetectionNeeded4L2: upstream-reference=EcuSwComposition.SwitchDetectionNeeded4L2.SwitchDetectionNeeded4L2, ecu-extract-reference=COMPOSITIONTYPE.SwitchDetectionNeeded4L2.SwitchDetectionNeeded4L2
      SwitchDetectionNeeded4L2_001: upstream-reference=EcuSwComposition.SwitchDetectionNeeded4L2, ecu-extract-reference=COMPOSITIONTYPE.SwitchDetectionNeeded4L2
      FSP3IndicationCmdL2: upstream-reference=EcuSwComposition.FSP3IndicationCmdL2.FSP3IndicationCmdL2, ecu-extract-reference=COMPOSITIONTYPE.FSP3IndicationCmdL2.FSP3IndicationCmdL2
      FSP3IndicationCmdL2_001: upstream-reference=EcuSwComposition.FSP3IndicationCmdL2, ecu-extract-reference=COMPOSITIONTYPE.FSP3IndicationCmdL2
      FSP1IndicationCmdL2: upstream-reference=EcuSwComposition.FSP1IndicationCmdL2.FSP1IndicationCmdL2, ecu-extract-reference=COMPOSITIONTYPE.FSP1IndicationCmdL2.FSP1IndicationCmdL2
      FSP1IndicationCmdL2_001: upstream-reference=EcuSwComposition.FSP1IndicationCmdL2, ecu-extract-reference=COMPOSITIONTYPE.FSP1IndicationCmdL2
      FSP4IndicationCmdL2: upstream-reference=EcuSwComposition.FSP4IndicationCmdL2.FSP4IndicationCmdL2, ecu-extract-reference=COMPOSITIONTYPE.FSP4IndicationCmdL2.FSP4IndicationCmdL2
      FSP4IndicationCmdL2_001: upstream-reference=EcuSwComposition.FSP4IndicationCmdL2, ecu-extract-reference=COMPOSITIONTYPE.FSP4IndicationCmdL2
      FSP2IndicationCmdL2: upstream-reference=EcuSwComposition.FSP2IndicationCmdL2.FSP2IndicationCmdL2, ecu-extract-reference=COMPOSITIONTYPE.FSP2IndicationCmdL2.FSP2IndicationCmdL2
      FSP2IndicationCmdL2_001: upstream-reference=EcuSwComposition.FSP2IndicationCmdL2, ecu-extract-reference=COMPOSITIONTYPE.FSP2IndicationCmdL2
      ResponseErrorELCP1: upstream-reference=EcuSwComposition.ResponseErrorELCP1.ResponseErrorELCP1, ecu-extract-reference=COMPOSITIONTYPE.ResponseErrorELCP1.ResponseErrorELCP1
      ResponseErrorELCP1_001: upstream-reference=EcuSwComposition.ResponseErrorELCP1, ecu-extract-reference=COMPOSITIONTYPE.ResponseErrorELCP1
      SwitchDetectionNeeded1L5: upstream-reference=EcuSwComposition.SwitchDetectionNeeded1L5.SwitchDetectionNeeded1L5, ecu-extract-reference=COMPOSITIONTYPE.SwitchDetectionNeeded1L5.SwitchDetectionNeeded1L5
      SwitchDetectionNeeded1L5_001: upstream-reference=EcuSwComposition.SwitchDetectionNeeded1L5, ecu-extract-reference=COMPOSITIONTYPE.SwitchDetectionNeeded1L5
      LIN_WRDownButtonStatus: upstream-reference=EcuSwComposition.LIN_WRDownButtonStatus.LIN_WRDownButtonStatus, ecu-extract-reference=COMPOSITIONTYPE.LIN_WRDownButtonStatus.LIN_WRDownButtonStatus
      LIN_WRDownButtonStatus_001: upstream-reference=EcuSwComposition.LIN_WRDownButtonStatus, ecu-extract-reference=COMPOSITIONTYPE.LIN_WRDownButtonStatus
      FSP1SwitchStatusL4: upstream-reference=EcuSwComposition.FSP1SwitchStatusL4.FSP1SwitchStatusL4, ecu-extract-reference=COMPOSITIONTYPE.FSP1SwitchStatusL4.FSP1SwitchStatusL4
      FSP1SwitchStatusL4_001: upstream-reference=EcuSwComposition.FSP1SwitchStatusL4, ecu-extract-reference=COMPOSITIONTYPE.FSP1SwitchStatusL4
      LIN_IntLghtNightModeBt2_s: upstream-reference=EcuSwComposition.LIN_IntLghtNightModeBt2_s.LIN_IntLghtNightModeBt2_s, ecu-extract-reference=COMPOSITIONTYPE.LIN_IntLghtNightModeBt2_s.LIN_IntLghtNightModeBt2_s
      LIN_IntLghtNightModeBt2_s_001: upstream-reference=EcuSwComposition.LIN_IntLghtNightModeBt2_s, ecu-extract-reference=COMPOSITIONTYPE.LIN_IntLghtNightModeBt2_s
      ResponseErrorILCP2: upstream-reference=EcuSwComposition.ResponseErrorILCP2.ResponseErrorILCP2, ecu-extract-reference=COMPOSITIONTYPE.ResponseErrorILCP2.ResponseErrorILCP2
      ResponseErrorILCP2_001: upstream-reference=EcuSwComposition.ResponseErrorILCP2, ecu-extract-reference=COMPOSITIONTYPE.ResponseErrorILCP2
      FSP1ResponseErrorL4: upstream-reference=EcuSwComposition.FSP1ResponseErrorL4.FSP1ResponseErrorL4, ecu-extract-reference=COMPOSITIONTYPE.FSP1ResponseErrorL4.FSP1ResponseErrorL4
      FSP1ResponseErrorL4_001: upstream-reference=EcuSwComposition.FSP1ResponseErrorL4, ecu-extract-reference=COMPOSITIONTYPE.FSP1ResponseErrorL4
      LIN_DifflockMode_Wheelstatus: upstream-reference=EcuSwComposition.LIN_DifflockMode_Wheelstatus.LIN_DifflockMode_Wheelstatus, ecu-extract-reference=COMPOSITIONTYPE.LIN_DifflockMode_Wheelstatus.LIN_DifflockMode_Wheelstatus
      LIN_DifflockMode_Wheelstatus_001: upstream-reference=EcuSwComposition.LIN_DifflockMode_Wheelstatus, ecu-extract-reference=COMPOSITIONTYPE.LIN_DifflockMode_Wheelstatus
      LIN_LKSPushButton: upstream-reference=EcuSwComposition.LIN_LKSPushButton.LIN_LKSPushButton, ecu-extract-reference=COMPOSITIONTYPE.LIN_LKSPushButton.LIN_LKSPushButton
      LIN_LKSPushButton_001: upstream-reference=EcuSwComposition.LIN_LKSPushButton, ecu-extract-reference=COMPOSITIONTYPE.LIN_LKSPushButton
      LIN_LightMode_Status_2: upstream-reference=EcuSwComposition.LIN_LightMode_Status_2.LIN_LightMode_Status_2, ecu-extract-reference=COMPOSITIONTYPE.LIN_LightMode_Status_2.LIN_LightMode_Status_2
      LIN_LightMode_Status_3: upstream-reference=EcuSwComposition.LIN_LightMode_Status_2, ecu-extract-reference=COMPOSITIONTYPE.LIN_LightMode_Status_2
      LIN_SpeedControlModeWheelStat: upstream-reference=EcuSwComposition.LIN_SpeedControlModeWheelStat.LIN_SpeedControlModeWheelStat, ecu-extract-reference=COMPOSITIONTYPE.LIN_SpeedControlModeWheelStat.LIN_SpeedControlModeWheelStat
      LIN_SpeedControlModeWheelStat_001: upstream-reference=EcuSwComposition.LIN_SpeedControlModeWheelStat, ecu-extract-reference=COMPOSITIONTYPE.LIN_SpeedControlModeWheelStat
      LIN_BackButtonStatus: upstream-reference=EcuSwComposition.LIN_BackButtonStatus.LIN_BackButtonStatus, ecu-extract-reference=COMPOSITIONTYPE.LIN_BackButtonStatus.LIN_BackButtonStatus
      LIN_BackButtonStatus_001: upstream-reference=EcuSwComposition.LIN_BackButtonStatus, ecu-extract-reference=COMPOSITIONTYPE.LIN_BackButtonStatus
      LIN_MemButtonStatus: upstream-reference=EcuSwComposition.LIN_MemButtonStatus.LIN_MemButtonStatus, ecu-extract-reference=COMPOSITIONTYPE.LIN_MemButtonStatus.LIN_MemButtonStatus
      LIN_MemButtonStatus_001: upstream-reference=EcuSwComposition.LIN_MemButtonStatus, ecu-extract-reference=COMPOSITIONTYPE.LIN_MemButtonStatus
      SwitchDetectionResp1L4: upstream-reference=EcuSwComposition.SwitchDetectionResp1L4.SwitchDetectionResp1L4, ecu-extract-reference=COMPOSITIONTYPE.SwitchDetectionResp1L4.SwitchDetectionResp1L4
      SwitchDetectionResp1L4_001: upstream-reference=EcuSwComposition.SwitchDetectionResp1L4, ecu-extract-reference=COMPOSITIONTYPE.SwitchDetectionResp1L4
      LIN_SelectButtonStatus: upstream-reference=EcuSwComposition.LIN_SelectButtonStatus.LIN_SelectButtonStatus, ecu-extract-reference=COMPOSITIONTYPE.LIN_SelectButtonStatus.LIN_SelectButtonStatus
      LIN_SelectButtonStatus_001: upstream-reference=EcuSwComposition.LIN_SelectButtonStatus, ecu-extract-reference=COMPOSITIONTYPE.LIN_SelectButtonStatus
      LIN_IntLghtDimmingLvlFreeWhl_s: upstream-reference=EcuSwComposition.LIN_IntLghtDimmingLvlFreeWhl_s.LIN_IntLghtDimmingLvlFreeWhl_s, ecu-extract-reference=COMPOSITIONTYPE.LIN_IntLghtDimmingLvlFreeWhl_s.LIN_IntLghtDimmingLvlFreeWhl_s
      LIN_IntLghtDimmingLvlFreeWhl_s_001: upstream-reference=EcuSwComposition.LIN_IntLghtDimmingLvlFreeWhl_s, ecu-extract-reference=COMPOSITIONTYPE.LIN_IntLghtDimmingLvlFreeWhl_s
      LIN_FogLightRear_ButtonStat_1: upstream-reference=EcuSwComposition.LIN_FogLightRear_ButtonStat_1.LIN_FogLightRear_ButtonStat_1, ecu-extract-reference=COMPOSITIONTYPE.LIN_FogLightRear_ButtonStat_1.LIN_FogLightRear_ButtonStat_1
      LIN_FogLightRear_ButtonStat_2: upstream-reference=EcuSwComposition.LIN_FogLightRear_ButtonStat_1, ecu-extract-reference=COMPOSITIONTYPE.LIN_FogLightRear_ButtonStat_1
      LIN_SpeedControlModeButtonStat: upstream-reference=EcuSwComposition.LIN_SpeedControlModeButtonStat.LIN_SpeedControlModeButtonStat, ecu-extract-reference=COMPOSITIONTYPE.LIN_SpeedControlModeButtonStat.LIN_SpeedControlModeButtonStat
      LIN_SpeedControlModeButtonStat_001: upstream-reference=EcuSwComposition.LIN_SpeedControlModeButtonStat, ecu-extract-reference=COMPOSITIONTYPE.LIN_SpeedControlModeButtonStat
      DiagInfoDLFW: upstream-reference=EcuSwComposition.DiagInfoDLFW.DiagInfoDLFW, ecu-extract-reference=COMPOSITIONTYPE.DiagInfoDLFW.DiagInfoDLFW
      DiagInfoDLFW_001: upstream-reference=EcuSwComposition.DiagInfoDLFW, ecu-extract-reference=COMPOSITIONTYPE.DiagInfoDLFW
      LIN_FogLightRear_ButtonStat_3: upstream-reference=EcuSwComposition.LIN_FogLightRear_ButtonStat_2.LIN_FogLightRear_ButtonStat_2, ecu-extract-reference=COMPOSITIONTYPE.LIN_FogLightRear_ButtonStat_2.LIN_FogLightRear_ButtonStat_2
      LIN_FogLightRear_ButtonStat_4: upstream-reference=EcuSwComposition.LIN_FogLightRear_ButtonStat_2, ecu-extract-reference=COMPOSITIONTYPE.LIN_FogLightRear_ButtonStat_2
      LIN_StopButtonStatus: upstream-reference=EcuSwComposition.LIN_StopButtonStatus.LIN_StopButtonStatus, ecu-extract-reference=COMPOSITIONTYPE.LIN_StopButtonStatus.LIN_StopButtonStatus
      LIN_StopButtonStatus_001: upstream-reference=EcuSwComposition.LIN_StopButtonStatus, ecu-extract-reference=COMPOSITIONTYPE.LIN_StopButtonStatus
      DiagInfoRCECS: upstream-reference=EcuSwComposition.DiagInfoRCECS.DiagInfoRCECS, ecu-extract-reference=COMPOSITIONTYPE.DiagInfoRCECS.DiagInfoRCECS
      DiagInfoRCECS_001: upstream-reference=EcuSwComposition.DiagInfoRCECS, ecu-extract-reference=COMPOSITIONTYPE.DiagInfoRCECS
      LIN_LightMode_Status_1: upstream-reference=EcuSwComposition.LIN_LightMode_Status_1.LIN_LightMode_Status_1, ecu-extract-reference=COMPOSITIONTYPE.LIN_LightMode_Status_1.LIN_LightMode_Status_1
      LIN_LightMode_Status_4: upstream-reference=EcuSwComposition.LIN_LightMode_Status_1, ecu-extract-reference=COMPOSITIONTYPE.LIN_LightMode_Status_1
      LIN_WRUpButtonStatus: upstream-reference=EcuSwComposition.LIN_WRUpButtonStatus.LIN_WRUpButtonStatus, ecu-extract-reference=COMPOSITIONTYPE.LIN_WRUpButtonStatus.LIN_WRUpButtonStatus
      LIN_WRUpButtonStatus_001: upstream-reference=EcuSwComposition.LIN_WRUpButtonStatus, ecu-extract-reference=COMPOSITIONTYPE.LIN_WRUpButtonStatus
      LIN_DifflockDeactivationBtn_st: upstream-reference=EcuSwComposition.LIN_DifflockDeactivationBtn_st.LIN_DifflockDeactivationBtn_st, ecu-extract-reference=COMPOSITIONTYPE.LIN_DifflockDeactivationBtn_st.LIN_DifflockDeactivationBtn_st
      LIN_DifflockDeactivationBtn_st_001: upstream-reference=EcuSwComposition.LIN_DifflockDeactivationBtn_st, ecu-extract-reference=COMPOSITIONTYPE.LIN_DifflockDeactivationBtn_st
      LIN_IntLghtCenterBtnFreeWhl_s: upstream-reference=EcuSwComposition.LIN_IntLghtCenterBtnFreeWhl_s.LIN_IntLghtCenterBtnFreeWhl_s, ecu-extract-reference=COMPOSITIONTYPE.LIN_IntLghtCenterBtnFreeWhl_s.LIN_IntLghtCenterBtnFreeWhl_s
      LIN_IntLghtCenterBtnFreeWhl_s_001: upstream-reference=EcuSwComposition.LIN_IntLghtCenterBtnFreeWhl_s, ecu-extract-reference=COMPOSITIONTYPE.LIN_IntLghtCenterBtnFreeWhl_s
      SwitchDetectionResp1L5: upstream-reference=EcuSwComposition.SwitchDetectionResp1L5.SwitchDetectionResp1L5, ecu-extract-reference=COMPOSITIONTYPE.SwitchDetectionResp1L5.SwitchDetectionResp1L5
      SwitchDetectionResp1L5_001: upstream-reference=EcuSwComposition.SwitchDetectionResp1L5, ecu-extract-reference=COMPOSITIONTYPE.SwitchDetectionResp1L5
      FSP1DiagInfoL5: upstream-reference=EcuSwComposition.FSP1DiagInfoL5.FSP1DiagInfoL5, ecu-extract-reference=COMPOSITIONTYPE.FSP1DiagInfoL5.FSP1DiagInfoL5
      FSP1DiagInfoL5_001: upstream-reference=EcuSwComposition.FSP1DiagInfoL5, ecu-extract-reference=COMPOSITIONTYPE.FSP1DiagInfoL5
      LIN_EscButtonMuddySiteStatus: upstream-reference=EcuSwComposition.LIN_EscButtonMuddySiteStatus.LIN_EscButtonMuddySiteStatus, ecu-extract-reference=COMPOSITIONTYPE.LIN_EscButtonMuddySiteStatus.LIN_EscButtonMuddySiteStatus
      LIN_EscButtonMuddySiteStatus_001: upstream-reference=EcuSwComposition.LIN_EscButtonMuddySiteStatus, ecu-extract-reference=COMPOSITIONTYPE.LIN_EscButtonMuddySiteStatus
      FSP1SwitchStatusL5: upstream-reference=EcuSwComposition.FSP1SwitchStatusL5.FSP1SwitchStatusL5, ecu-extract-reference=COMPOSITIONTYPE.FSP1SwitchStatusL5.FSP1SwitchStatusL5
      FSP1SwitchStatusL5_001: upstream-reference=EcuSwComposition.FSP1SwitchStatusL5, ecu-extract-reference=COMPOSITIONTYPE.FSP1SwitchStatusL5
      SwitchDetectionNeeded1L4: upstream-reference=EcuSwComposition.SwitchDetectionNeeded1L4.SwitchDetectionNeeded1L4, ecu-extract-reference=COMPOSITIONTYPE.SwitchDetectionNeeded1L4.SwitchDetectionNeeded1L4
      SwitchDetectionNeeded1L4_001: upstream-reference=EcuSwComposition.SwitchDetectionNeeded1L4, ecu-extract-reference=COMPOSITIONTYPE.SwitchDetectionNeeded1L4
      LIN_AdjustButtonStatus: upstream-reference=EcuSwComposition.LIN_AdjustButtonStatus.LIN_AdjustButtonStatus, ecu-extract-reference=COMPOSITIONTYPE.LIN_AdjustButtonStatus.LIN_AdjustButtonStatus
      LIN_AdjustButtonStatus_001: upstream-reference=EcuSwComposition.LIN_AdjustButtonStatus, ecu-extract-reference=COMPOSITIONTYPE.LIN_AdjustButtonStatus
      ResponseErrorDLFW: upstream-reference=EcuSwComposition.ResponseErrorDLFW.ResponseErrorDLFW, ecu-extract-reference=COMPOSITIONTYPE.ResponseErrorDLFW.ResponseErrorDLFW
      ResponseErrorDLFW_001: upstream-reference=EcuSwComposition.ResponseErrorDLFW, ecu-extract-reference=COMPOSITIONTYPE.ResponseErrorDLFW
      LIN_BlackPanelMode_ButtonStat: upstream-reference=EcuSwComposition.LIN_BlackPanelMode_ButtonStat.LIN_BlackPanelMode_ButtonStat, ecu-extract-reference=COMPOSITIONTYPE.LIN_BlackPanelMode_ButtonStat.LIN_BlackPanelMode_ButtonStat
      LIN_BlackPanelMode_ButtonStat_001: upstream-reference=EcuSwComposition.LIN_BlackPanelMode_ButtonStat, ecu-extract-reference=COMPOSITIONTYPE.LIN_BlackPanelMode_ButtonStat
      FSP1DiagInfoL4: upstream-reference=EcuSwComposition.FSP1DiagInfoL4.FSP1DiagInfoL4, ecu-extract-reference=COMPOSITIONTYPE.FSP1DiagInfoL4.FSP1DiagInfoL4
      FSP1DiagInfoL4_001: upstream-reference=EcuSwComposition.FSP1DiagInfoL4, ecu-extract-reference=COMPOSITIONTYPE.FSP1DiagInfoL4
      LIN_FCWPushButton: upstream-reference=EcuSwComposition.LIN_FCWPushButton.LIN_FCWPushButton, ecu-extract-reference=COMPOSITIONTYPE.LIN_FCWPushButton.LIN_FCWPushButton
      LIN_FCWPushButton_001: upstream-reference=EcuSwComposition.LIN_FCWPushButton, ecu-extract-reference=COMPOSITIONTYPE.LIN_FCWPushButton
      ResponseErrorRCECS: upstream-reference=EcuSwComposition.ResponseErrorRCECS.ResponseErrorRCECS, ecu-extract-reference=COMPOSITIONTYPE.ResponseErrorRCECS.ResponseErrorRCECS
      ResponseErrorRCECS_001: upstream-reference=EcuSwComposition.ResponseErrorRCECS, ecu-extract-reference=COMPOSITIONTYPE.ResponseErrorRCECS
      DiagInfoELCP2: upstream-reference=EcuSwComposition.DiagInfoELCP2.DiagInfoELCP2, ecu-extract-reference=COMPOSITIONTYPE.DiagInfoELCP2.DiagInfoELCP2
      DiagInfoELCP2_001: upstream-reference=EcuSwComposition.DiagInfoELCP2, ecu-extract-reference=COMPOSITIONTYPE.DiagInfoELCP2
      DiagInfoCCFW: upstream-reference=EcuSwComposition.DiagInfoCCFW.DiagInfoCCFW, ecu-extract-reference=COMPOSITIONTYPE.DiagInfoCCFW.DiagInfoCCFW
      DiagInfoCCFW_001: upstream-reference=EcuSwComposition.DiagInfoCCFW, ecu-extract-reference=COMPOSITIONTYPE.DiagInfoCCFW
      DiagInfoILCP2: upstream-reference=EcuSwComposition.DiagInfoILCP2.DiagInfoILCP2, ecu-extract-reference=COMPOSITIONTYPE.DiagInfoILCP2.DiagInfoILCP2
      DiagInfoILCP2_001: upstream-reference=EcuSwComposition.DiagInfoILCP2, ecu-extract-reference=COMPOSITIONTYPE.DiagInfoILCP2
      DiagInfoELCP1: upstream-reference=EcuSwComposition.DiagInfoELCP1.DiagInfoELCP1, ecu-extract-reference=COMPOSITIONTYPE.DiagInfoELCP1.DiagInfoELCP1
      DiagInfoELCP1_001: upstream-reference=EcuSwComposition.DiagInfoELCP1, ecu-extract-reference=COMPOSITIONTYPE.DiagInfoELCP1
      LIN_BackLightDimming_Status: upstream-reference=EcuSwComposition.LIN_BackLightDimming_Status.LIN_BackLightDimming_Status, ecu-extract-reference=COMPOSITIONTYPE.LIN_BackLightDimming_Status.LIN_BackLightDimming_Status
      LIN_BackLightDimming_Status_001: upstream-reference=EcuSwComposition.LIN_BackLightDimming_Status, ecu-extract-reference=COMPOSITIONTYPE.LIN_BackLightDimming_Status
      FSP1ResponseErrorL5: upstream-reference=EcuSwComposition.FSP1ResponseErrorL5.FSP1ResponseErrorL5, ecu-extract-reference=COMPOSITIONTYPE.FSP1ResponseErrorL5.FSP1ResponseErrorL5
      FSP1ResponseErrorL5_001: upstream-reference=EcuSwComposition.FSP1ResponseErrorL5, ecu-extract-reference=COMPOSITIONTYPE.FSP1ResponseErrorL5
      LIN_DRL_ButtonStatus: upstream-reference=EcuSwComposition.LIN_DRL_ButtonStatus.LIN_DRL_ButtonStatus, ecu-extract-reference=COMPOSITIONTYPE.LIN_DRL_ButtonStatus.LIN_DRL_ButtonStatus
      LIN_DRL_ButtonStatus_001: upstream-reference=EcuSwComposition.LIN_DRL_ButtonStatus, ecu-extract-reference=COMPOSITIONTYPE.LIN_DRL_ButtonStatus
      ResponseErrorELCP2: upstream-reference=EcuSwComposition.ResponseErrorELCP2.ResponseErrorELCP2, ecu-extract-reference=COMPOSITIONTYPE.ResponseErrorELCP2.ResponseErrorELCP2
      ResponseErrorELCP2_001: upstream-reference=EcuSwComposition.ResponseErrorELCP2, ecu-extract-reference=COMPOSITIONTYPE.ResponseErrorELCP2
      ResponseErrorCCFW: upstream-reference=EcuSwComposition.ResponseErrorCCFW.ResponseErrorCCFW, ecu-extract-reference=COMPOSITIONTYPE.ResponseErrorCCFW.ResponseErrorCCFW
      ResponseErrorCCFW_001: upstream-reference=EcuSwComposition.ResponseErrorCCFW, ecu-extract-reference=COMPOSITIONTYPE.ResponseErrorCCFW
      LIN_LevelingThumbwheel_stat: upstream-reference=EcuSwComposition.LIN_LevelingThumbwheel_stat.LIN_LevelingThumbwheel_stat, ecu-extract-reference=COMPOSITIONTYPE.LIN_LevelingThumbwheel_stat.LIN_LevelingThumbwheel_stat
      LIN_LevelingThumbwheel_stat_001: upstream-reference=EcuSwComposition.LIN_LevelingThumbwheel_stat, ecu-extract-reference=COMPOSITIONTYPE.LIN_LevelingThumbwheel_stat
      LIN_Offroad_ButtonStatus: upstream-reference=EcuSwComposition.LIN_Offroad_ButtonStatus.LIN_Offroad_ButtonStatus, ecu-extract-reference=COMPOSITIONTYPE.LIN_Offroad_ButtonStatus.LIN_Offroad_ButtonStatus
      LIN_Offroad_ButtonStatus_001: upstream-reference=EcuSwComposition.LIN_Offroad_ButtonStatus, ecu-extract-reference=COMPOSITIONTYPE.LIN_Offroad_ButtonStatus
      LIN_FogLightFront_ButtonStat_2: upstream-reference=EcuSwComposition.LIN_FogLightFront_ButtonStat_2.LIN_FogLightFront_ButtonStat_2, ecu-extract-reference=COMPOSITIONTYPE.LIN_FogLightFront_ButtonStat_2.LIN_FogLightFront_ButtonStat_2
      LIN_FogLightFront_ButtonStat_3: upstream-reference=EcuSwComposition.LIN_FogLightFront_ButtonStat_2, ecu-extract-reference=COMPOSITIONTYPE.LIN_FogLightFront_ButtonStat_2
      LIN_RearWorkProjector_BtnStat: upstream-reference=EcuSwComposition.LIN_RearWorkProjector_BtnStat.LIN_RearWorkProjector_BtnStat, ecu-extract-reference=COMPOSITIONTYPE.LIN_RearWorkProjector_BtnStat.LIN_RearWorkProjector_BtnStat
      LIN_RearWorkProjector_BtnStat_001: upstream-reference=EcuSwComposition.LIN_RearWorkProjector_BtnStat, ecu-extract-reference=COMPOSITIONTYPE.LIN_RearWorkProjector_BtnStat
      LIN_HeadLampUpDown_SwitchStatu: upstream-reference=EcuSwComposition.LIN_HeadLampUpDown_SwitchStatu.LIN_HeadLampUpDown_SwitchStatu, ecu-extract-reference=COMPOSITIONTYPE.LIN_HeadLampUpDown_SwitchStatu.LIN_HeadLampUpDown_SwitchStatu
      LIN_HeadLampUpDown_SwitchStatu_001: upstream-reference=EcuSwComposition.LIN_HeadLampUpDown_SwitchStatu, ecu-extract-reference=COMPOSITIONTYPE.LIN_HeadLampUpDown_SwitchStatu
      LIN_FogLightFront_ButtonStat_1: upstream-reference=EcuSwComposition.LIN_FogLightFront_ButtonStat_1.LIN_FogLightFront_ButtonStat_1, ecu-extract-reference=COMPOSITIONTYPE.LIN_FogLightFront_ButtonStat_1.LIN_FogLightFront_ButtonStat_1
      LIN_FogLightFront_ButtonStat_4: upstream-reference=EcuSwComposition.LIN_FogLightFront_ButtonStat_1, ecu-extract-reference=COMPOSITIONTYPE.LIN_FogLightFront_ButtonStat_1
      LIN_IntLghtMaxModeBtnPnl2_s: upstream-reference=EcuSwComposition.LIN_IntLghtMaxModeBtnPnl2_s.LIN_IntLghtMaxModeBtnPnl2_s, ecu-extract-reference=COMPOSITIONTYPE.LIN_IntLghtMaxModeBtnPnl2_s.LIN_IntLghtMaxModeBtnPnl2_s
      LIN_IntLghtMaxModeBtnPnl2_s_001: upstream-reference=EcuSwComposition.LIN_IntLghtMaxModeBtnPnl2_s, ecu-extract-reference=COMPOSITIONTYPE.LIN_IntLghtMaxModeBtnPnl2_s
      LIN_IntLghtRestModeBtnPnl2_s: upstream-reference=EcuSwComposition.LIN_IntLghtRestModeBtnPnl2_s.LIN_IntLghtRestModeBtnPnl2_s, ecu-extract-reference=COMPOSITIONTYPE.LIN_IntLghtRestModeBtnPnl2_s.LIN_IntLghtRestModeBtnPnl2_s
      LIN_IntLghtRestModeBtnPnl2_s_001: upstream-reference=EcuSwComposition.LIN_IntLghtRestModeBtnPnl2_s, ecu-extract-reference=COMPOSITIONTYPE.LIN_IntLghtRestModeBtnPnl2_s
      LIN_ACCOrCCIndication: upstream-reference=EcuSwComposition.LIN_ACCOrCCIndication.LIN_ACCOrCCIndication, ecu-extract-reference=COMPOSITIONTYPE.LIN_ACCOrCCIndication.LIN_ACCOrCCIndication
      LIN_ACCOrCCIndication_001: upstream-reference=EcuSwComposition.LIN_ACCOrCCIndication, ecu-extract-reference=COMPOSITIONTYPE.LIN_ACCOrCCIndication
      LIN_M3_DeviceIndication: upstream-reference=EcuSwComposition.LIN_M3_DeviceIndication.LIN_M3_DeviceIndication, ecu-extract-reference=COMPOSITIONTYPE.LIN_M3_DeviceIndication.LIN_M3_DeviceIndication
      LIN_M3_DeviceIndication_001: upstream-reference=EcuSwComposition.LIN_M3_DeviceIndication, ecu-extract-reference=COMPOSITIONTYPE.LIN_M3_DeviceIndication
      LIN_EscButtonMuddySiteDeviceIn: upstream-reference=EcuSwComposition.LIN_EscButtonMuddySiteDeviceIn.LIN_EscButtonMuddySiteDeviceIn, ecu-extract-reference=COMPOSITIONTYPE.LIN_EscButtonMuddySiteDeviceIn.LIN_EscButtonMuddySiteDeviceIn
      LIN_EscButtonMuddySiteDeviceIn_001: upstream-reference=EcuSwComposition.LIN_EscButtonMuddySiteDeviceIn, ecu-extract-reference=COMPOSITIONTYPE.LIN_EscButtonMuddySiteDeviceIn
      LIN_M1_DeviceIndication: upstream-reference=EcuSwComposition.LIN_M1_DeviceIndication.LIN_M1_DeviceIndication, ecu-extract-reference=COMPOSITIONTYPE.LIN_M1_DeviceIndication.LIN_M1_DeviceIndication
      LIN_M1_DeviceIndication_001: upstream-reference=EcuSwComposition.LIN_M1_DeviceIndication, ecu-extract-reference=COMPOSITIONTYPE.LIN_M1_DeviceIndication
      LIN_ShortPulseMaxLength: upstream-reference=EcuSwComposition.LIN_ShortPulseMaxLength.LIN_ShortPulseMaxLength, ecu-extract-reference=COMPOSITIONTYPE.LIN_ShortPulseMaxLength.LIN_ShortPulseMaxLength
      LIN_ShortPulseMaxLength_001: upstream-reference=EcuSwComposition.LIN_ShortPulseMaxLength, ecu-extract-reference=COMPOSITIONTYPE.LIN_ShortPulseMaxLength
      LIN_FCW_DeviceIndication: upstream-reference=EcuSwComposition.LIN_FCW_DeviceIndication.LIN_FCW_DeviceIndication, ecu-extract-reference=COMPOSITIONTYPE.LIN_FCW_DeviceIndication.LIN_FCW_DeviceIndication
      LIN_FCW_DeviceIndication_001: upstream-reference=EcuSwComposition.LIN_FCW_DeviceIndication, ecu-extract-reference=COMPOSITIONTYPE.LIN_FCW_DeviceIndication
      LIN_DrivingLightPlus_Indicatio: upstream-reference=EcuSwComposition.LIN_DrivingLightPlus_Indicatio.LIN_DrivingLightPlus_Indicatio, ecu-extract-reference=COMPOSITIONTYPE.LIN_DrivingLightPlus_Indicatio.LIN_DrivingLightPlus_Indicatio
      LIN_DrivingLightPlus_Indicatio_001: upstream-reference=EcuSwComposition.LIN_DrivingLightPlus_Indicatio, ecu-extract-reference=COMPOSITIONTYPE.LIN_DrivingLightPlus_Indicatio
      LIN_RearFog_Indication: upstream-reference=EcuSwComposition.LIN_RearFog_Indication.LIN_RearFog_Indication, ecu-extract-reference=COMPOSITIONTYPE.LIN_RearFog_Indication.LIN_RearFog_Indication
      LIN_RearFog_Indication_001: upstream-reference=EcuSwComposition.LIN_RearFog_Indication, ecu-extract-reference=COMPOSITIONTYPE.LIN_RearFog_Indication
      LIN_Offroad_Indication: upstream-reference=EcuSwComposition.LIN_Offroad_Indication.LIN_Offroad_Indication, ecu-extract-reference=COMPOSITIONTYPE.LIN_Offroad_Indication.LIN_Offroad_Indication
      LIN_Offroad_Indication_001: upstream-reference=EcuSwComposition.LIN_Offroad_Indication, ecu-extract-reference=COMPOSITIONTYPE.LIN_Offroad_Indication
      LIN_LKS_DeviceIndication: upstream-reference=EcuSwComposition.LIN_LKS_DeviceIndication.LIN_LKS_DeviceIndication, ecu-extract-reference=COMPOSITIONTYPE.LIN_LKS_DeviceIndication.LIN_LKS_DeviceIndication
      LIN_LKS_DeviceIndication_001: upstream-reference=EcuSwComposition.LIN_LKS_DeviceIndication, ecu-extract-reference=COMPOSITIONTYPE.LIN_LKS_DeviceIndication
      LIN_Down_DeviceIndication: upstream-reference=EcuSwComposition.LIN_Down_DeviceIndication.LIN_Down_DeviceIndication, ecu-extract-reference=COMPOSITIONTYPE.LIN_Down_DeviceIndication.LIN_Down_DeviceIndication
      LIN_Down_DeviceIndication_001: upstream-reference=EcuSwComposition.LIN_Down_DeviceIndication, ecu-extract-reference=COMPOSITIONTYPE.LIN_Down_DeviceIndication
      LIN_M2_DeviceIndication: upstream-reference=EcuSwComposition.LIN_M2_DeviceIndication.LIN_M2_DeviceIndication, ecu-extract-reference=COMPOSITIONTYPE.LIN_M2_DeviceIndication.LIN_M2_DeviceIndication
      LIN_M2_DeviceIndication_001: upstream-reference=EcuSwComposition.LIN_M2_DeviceIndication, ecu-extract-reference=COMPOSITIONTYPE.LIN_M2_DeviceIndication
      LIN_ParkingLight_Indication: upstream-reference=EcuSwComposition.LIN_ParkingLight_Indication.LIN_ParkingLight_Indication, ecu-extract-reference=COMPOSITIONTYPE.LIN_ParkingLight_Indication.LIN_ParkingLight_Indication
      LIN_ParkingLight_Indication_001: upstream-reference=EcuSwComposition.LIN_ParkingLight_Indication, ecu-extract-reference=COMPOSITIONTYPE.LIN_ParkingLight_Indication
      FSP1IndicationCmdL5: upstream-reference=EcuSwComposition.FSP1IndicationCmdL5.FSP1IndicationCmdL5, ecu-extract-reference=COMPOSITIONTYPE.FSP1IndicationCmdL5.FSP1IndicationCmdL5
      FSP1IndicationCmdL5_001: upstream-reference=EcuSwComposition.FSP1IndicationCmdL5, ecu-extract-reference=COMPOSITIONTYPE.FSP1IndicationCmdL5
      LIN_FrontFog_Indication: upstream-reference=EcuSwComposition.LIN_FrontFog_Indication.LIN_FrontFog_Indication, ecu-extract-reference=COMPOSITIONTYPE.LIN_FrontFog_Indication.LIN_FrontFog_Indication
      LIN_FrontFog_Indication_001: upstream-reference=EcuSwComposition.LIN_FrontFog_Indication, ecu-extract-reference=COMPOSITIONTYPE.LIN_FrontFog_Indication
      LIN_ASLIndication: upstream-reference=EcuSwComposition.LIN_ASLIndication.LIN_ASLIndication, ecu-extract-reference=COMPOSITIONTYPE.LIN_ASLIndication.LIN_ASLIndication
      LIN_ASLIndication_001: upstream-reference=EcuSwComposition.LIN_ASLIndication, ecu-extract-reference=COMPOSITIONTYPE.LIN_ASLIndication
      LIN_DaytimeRunningLight_Indica: upstream-reference=EcuSwComposition.LIN_DaytimeRunningLight_Indica.LIN_DaytimeRunningLight_Indica, ecu-extract-reference=COMPOSITIONTYPE.LIN_DaytimeRunningLight_Indica.LIN_DaytimeRunningLight_Indica
      LIN_DaytimeRunningLight_Indica_001: upstream-reference=EcuSwComposition.LIN_DaytimeRunningLight_Indica, ecu-extract-reference=COMPOSITIONTYPE.LIN_DaytimeRunningLight_Indica
      LIN_DifflockOnOff_Indication: upstream-reference=EcuSwComposition.LIN_DifflockOnOff_Indication.LIN_DifflockOnOff_Indication, ecu-extract-reference=COMPOSITIONTYPE.LIN_DifflockOnOff_Indication.LIN_DifflockOnOff_Indication
      LIN_DifflockOnOff_Indication_001: upstream-reference=EcuSwComposition.LIN_DifflockOnOff_Indication, ecu-extract-reference=COMPOSITIONTYPE.LIN_DifflockOnOff_Indication
      LIN_RearWorkProjector_Indicati: upstream-reference=EcuSwComposition.LIN_RearWorkProjector_Indicati.LIN_RearWorkProjector_Indicati, ecu-extract-reference=COMPOSITIONTYPE.LIN_RearWorkProjector_Indicati.LIN_RearWorkProjector_Indicati
      LIN_RearWorkProjector_Indicati_001: upstream-reference=EcuSwComposition.LIN_RearWorkProjector_Indicati, ecu-extract-reference=COMPOSITIONTYPE.LIN_RearWorkProjector_Indicati
      FSP1IndicationCmdL4: upstream-reference=EcuSwComposition.FSP1IndicationCmdL4.FSP1IndicationCmdL4, ecu-extract-reference=COMPOSITIONTYPE.FSP1IndicationCmdL4.FSP1IndicationCmdL4
      FSP1IndicationCmdL4_001: upstream-reference=EcuSwComposition.FSP1IndicationCmdL4, ecu-extract-reference=COMPOSITIONTYPE.FSP1IndicationCmdL4
      LIN_Adjust_DeviceIndication: upstream-reference=EcuSwComposition.LIN_Adjust_DeviceIndication.LIN_Adjust_DeviceIndication, ecu-extract-reference=COMPOSITIONTYPE.LIN_Adjust_DeviceIndication.LIN_Adjust_DeviceIndication
      LIN_Adjust_DeviceIndication_001: upstream-reference=EcuSwComposition.LIN_Adjust_DeviceIndication, ecu-extract-reference=COMPOSITIONTYPE.LIN_Adjust_DeviceIndication
      LIN_DrivingLight_Indication: upstream-reference=EcuSwComposition.LIN_DrivingLight_Indication.LIN_DrivingLight_Indication, ecu-extract-reference=COMPOSITIONTYPE.LIN_DrivingLight_Indication.LIN_DrivingLight_Indication
      LIN_DrivingLight_Indication_001: upstream-reference=EcuSwComposition.LIN_DrivingLight_Indication, ecu-extract-reference=COMPOSITIONTYPE.LIN_DrivingLight_Indication
      LIN_Up_DeviceIndication: upstream-reference=EcuSwComposition.LIN_Up_DeviceIndication.LIN_Up_DeviceIndication, ecu-extract-reference=COMPOSITIONTYPE.LIN_Up_DeviceIndication.LIN_Up_DeviceIndication
      LIN_Up_DeviceIndication_001: upstream-reference=EcuSwComposition.LIN_Up_DeviceIndication, ecu-extract-reference=COMPOSITIONTYPE.LIN_Up_DeviceIndication
      IOHWAB: upstream-reference=EcuSwComposition.IOHWAB, ecu-extract-reference=COMPOSITIONTYPE.IOHWAB
      Debug_PVT_SCIM_Ctrl_LivingPullUp: upstream-reference=EcuSwComposition.Debug_PVT_SCIM_Ctrl_LivingPullUp.Debug_PVT_SCIM_Ctrl_LivingPullUp, ecu-extract-reference=COMPOSITIONTYPE.Debug_PVT_SCIM_Ctrl_LivingPullUp.Debug_PVT_SCIM_Ctrl_LivingPullUp
      Debug_PVT_SCIM_Ctrl_LivingPullUp_001: upstream-reference=EcuSwComposition.Debug_PVT_SCIM_Ctrl_LivingPullUp, ecu-extract-reference=COMPOSITIONTYPE.Debug_PVT_SCIM_Ctrl_LivingPullUp
      Debug_PVT_SCIM_Ctrl_ParkedPullUp: upstream-reference=EcuSwComposition.Debug_PVT_SCIM_Ctrl_ParkedPullUp.Debug_PVT_SCIM_Ctrl_ParkedPullUp, ecu-extract-reference=COMPOSITIONTYPE.Debug_PVT_SCIM_Ctrl_ParkedPullUp.Debug_PVT_SCIM_Ctrl_ParkedPullUp
      Debug_PVT_SCIM_Ctrl_ParkedPullUp_001: upstream-reference=EcuSwComposition.Debug_PVT_SCIM_Ctrl_ParkedPullUp, ecu-extract-reference=COMPOSITIONTYPE.Debug_PVT_SCIM_Ctrl_ParkedPullUp
      ABSInhibitRqstDenied: upstream-reference=EcuSwComposition.ABSInhibitRqstDenied.ABSInhibitRqstDenied, ecu-extract-reference=COMPOSITIONTYPE.ABSInhibitRqstDenied.ABSInhibitRqstDenied
      ABSInhibitRqstDenied_001: upstream-reference=EcuSwComposition.ABSInhibitRqstDenied, ecu-extract-reference=COMPOSITIONTYPE.ABSInhibitRqstDenied
      Debug_PVT_SCIM_RD_12VLivingVolt: upstream-reference=EcuSwComposition.Debug_PVT_SCIM_RD_12VLivingVolt.Debug_PVT_SCIM_RD_12VLivingVolt, ecu-extract-reference=COMPOSITIONTYPE.Debug_PVT_SCIM_RD_12VLivingVolt.Debug_PVT_SCIM_RD_12VLivingVolt
      Debug_PVT_SCIM_RD_12VLivingVolt_001: upstream-reference=EcuSwComposition.Debug_PVT_SCIM_RD_12VLivingVolt, ecu-extract-reference=COMPOSITIONTYPE.Debug_PVT_SCIM_RD_12VLivingVolt
      Debug_PVT_SCIM_RD_12VParkedVolt: upstream-reference=EcuSwComposition.Debug_PVT_SCIM_RD_12VParkedVolt.Debug_PVT_SCIM_RD_12VParkedVolt, ecu-extract-reference=COMPOSITIONTYPE.Debug_PVT_SCIM_RD_12VParkedVolt.Debug_PVT_SCIM_RD_12VParkedVolt
      Debug_PVT_SCIM_RD_12VParkedVolt_001: upstream-reference=EcuSwComposition.Debug_PVT_SCIM_RD_12VParkedVolt, ecu-extract-reference=COMPOSITIONTYPE.Debug_PVT_SCIM_RD_12VParkedVolt
      Debug_PVT_SCIM_RD_12VDCDCFault: upstream-reference=EcuSwComposition.Debug_PVT_SCIM_RD_12VDCDCFault.Debug_PVT_SCIM_RD_12VDCDCFault, ecu-extract-reference=COMPOSITIONTYPE.Debug_PVT_SCIM_RD_12VDCDCFault.Debug_PVT_SCIM_RD_12VDCDCFault
      Debug_PVT_SCIM_RD_12VDCDCFault_001: upstream-reference=EcuSwComposition.Debug_PVT_SCIM_RD_12VDCDCFault, ecu-extract-reference=COMPOSITIONTYPE.Debug_PVT_SCIM_RD_12VDCDCFault
      Debug_PVT_SCIM_RD_12VDCDCVolt: upstream-reference=EcuSwComposition.Debug_PVT_SCIM_RD_12VDCDCVolt.Debug_PVT_SCIM_RD_12VDCDCVolt, ecu-extract-reference=COMPOSITIONTYPE.Debug_PVT_SCIM_RD_12VDCDCVolt.Debug_PVT_SCIM_RD_12VDCDCVolt
      Debug_PVT_SCIM_RD_12VDCDCVolt_001: upstream-reference=EcuSwComposition.Debug_PVT_SCIM_RD_12VDCDCVolt, ecu-extract-reference=COMPOSITIONTYPE.Debug_PVT_SCIM_RD_12VDCDCVolt
      Debug_PVT_SCIM_RD_VBAT: upstream-reference=EcuSwComposition.Debug_PVT_SCIM_RD_VBAT.Debug_PVT_SCIM_RD_VBAT, ecu-extract-reference=COMPOSITIONTYPE.Debug_PVT_SCIM_RD_VBAT.Debug_PVT_SCIM_RD_VBAT
      Debug_PVT_SCIM_RD_VBAT_001: upstream-reference=EcuSwComposition.Debug_PVT_SCIM_RD_VBAT, ecu-extract-reference=COMPOSITIONTYPE.Debug_PVT_SCIM_RD_VBAT
      Debug_PVT_SCIM_Ctrl_WLS2Freq: upstream-reference=EcuSwComposition.Debug_PVT_SCIM_Ctrl_WLS2Freq.Debug_PVT_SCIM_Ctrl_WLS2Freq, ecu-extract-reference=COMPOSITIONTYPE.Debug_PVT_SCIM_Ctrl_WLS2Freq.Debug_PVT_SCIM_Ctrl_WLS2Freq
      Debug_PVT_SCIM_Ctrl_WLS2Freq_001: upstream-reference=EcuSwComposition.Debug_PVT_SCIM_Ctrl_WLS2Freq, ecu-extract-reference=COMPOSITIONTYPE.Debug_PVT_SCIM_Ctrl_WLS2Freq
      Debug_PVT_SCIM_Ctrl_WLS3: upstream-reference=EcuSwComposition.Debug_PVT_SCIM_Ctrl_WLS3.Debug_PVT_SCIM_Ctrl_WLS3, ecu-extract-reference=COMPOSITIONTYPE.Debug_PVT_SCIM_Ctrl_WLS3.Debug_PVT_SCIM_Ctrl_WLS3
      Debug_PVT_SCIM_Ctrl_WLS3_001: upstream-reference=EcuSwComposition.Debug_PVT_SCIM_Ctrl_WLS3, ecu-extract-reference=COMPOSITIONTYPE.Debug_PVT_SCIM_Ctrl_WLS3
      Debug_PVT_SCIM_Ctrl_WLS2Duty: upstream-reference=EcuSwComposition.Debug_PVT_SCIM_Ctrl_WLS2Duty.Debug_PVT_SCIM_Ctrl_WLS2Duty, ecu-extract-reference=COMPOSITIONTYPE.Debug_PVT_SCIM_Ctrl_WLS2Duty.Debug_PVT_SCIM_Ctrl_WLS2Duty
      Debug_PVT_SCIM_Ctrl_WLS2Duty_001: upstream-reference=EcuSwComposition.Debug_PVT_SCIM_Ctrl_WLS2Duty, ecu-extract-reference=COMPOSITIONTYPE.Debug_PVT_SCIM_Ctrl_WLS2Duty
      Debug_PVT_SCIM_Ctrl_WLS1_Duty: upstream-reference=EcuSwComposition.Debug_PVT_SCIM_Ctrl_WLS1_Duty.Debug_PVT_SCIM_Ctrl_WLS1_Duty, ecu-extract-reference=COMPOSITIONTYPE.Debug_PVT_SCIM_Ctrl_WLS1_Duty.Debug_PVT_SCIM_Ctrl_WLS1_Duty
      Debug_PVT_SCIM_Ctrl_WLS1_Duty_001: upstream-reference=EcuSwComposition.Debug_PVT_SCIM_Ctrl_WLS1_Duty, ecu-extract-reference=COMPOSITIONTYPE.Debug_PVT_SCIM_Ctrl_WLS1_Duty
      Debug_PVT_SCIM_Ctrl_WHS1: upstream-reference=EcuSwComposition.Debug_PVT_SCIM_Ctrl_WHS1.Debug_PVT_SCIM_Ctrl_WHS1, ecu-extract-reference=COMPOSITIONTYPE.Debug_PVT_SCIM_Ctrl_WHS1.Debug_PVT_SCIM_Ctrl_WHS1
      Debug_PVT_SCIM_Ctrl_WHS1_001: upstream-reference=EcuSwComposition.Debug_PVT_SCIM_Ctrl_WHS1, ecu-extract-reference=COMPOSITIONTYPE.Debug_PVT_SCIM_Ctrl_WHS1
      Debug_PVT_SCIM_Ctrl_WHS1_Freq: upstream-reference=EcuSwComposition.Debug_PVT_SCIM_Ctrl_WHS1_Freq.Debug_PVT_SCIM_Ctrl_WHS1_Freq, ecu-extract-reference=COMPOSITIONTYPE.Debug_PVT_SCIM_Ctrl_WHS1_Freq.Debug_PVT_SCIM_Ctrl_WHS1_Freq
      Debug_PVT_SCIM_Ctrl_WHS1_Freq_001: upstream-reference=EcuSwComposition.Debug_PVT_SCIM_Ctrl_WHS1_Freq, ecu-extract-reference=COMPOSITIONTYPE.Debug_PVT_SCIM_Ctrl_WHS1_Freq
      Debug_PVT_SCIM_Ctrl_WLS3Duty: upstream-reference=EcuSwComposition.Debug_PVT_SCIM_Ctrl_WLS3Duty.Debug_PVT_SCIM_Ctrl_WLS3Duty, ecu-extract-reference=COMPOSITIONTYPE.Debug_PVT_SCIM_Ctrl_WLS3Duty.Debug_PVT_SCIM_Ctrl_WLS3Duty
      Debug_PVT_SCIM_Ctrl_WLS3Duty_001: upstream-reference=EcuSwComposition.Debug_PVT_SCIM_Ctrl_WLS3Duty, ecu-extract-reference=COMPOSITIONTYPE.Debug_PVT_SCIM_Ctrl_WLS3Duty
      Debug_PVT_SCIM_Ctrl_WHS1_Duty: upstream-reference=EcuSwComposition.Debug_PVT_SCIM_Ctrl_WHS1_Duty.Debug_PVT_SCIM_Ctrl_WHS1_Duty, ecu-extract-reference=COMPOSITIONTYPE.Debug_PVT_SCIM_Ctrl_WHS1_Duty.Debug_PVT_SCIM_Ctrl_WHS1_Duty
      Debug_PVT_SCIM_Ctrl_WHS1_Duty_001: upstream-reference=EcuSwComposition.Debug_PVT_SCIM_Ctrl_WHS1_Duty, ecu-extract-reference=COMPOSITIONTYPE.Debug_PVT_SCIM_Ctrl_WHS1_Duty
      Debug_PVT_SCIM_Ctrl_WLS1_Freq: upstream-reference=EcuSwComposition.Debug_PVT_SCIM_Ctrl_WLS1_Freq.Debug_PVT_SCIM_Ctrl_WLS1_Freq, ecu-extract-reference=COMPOSITIONTYPE.Debug_PVT_SCIM_Ctrl_WLS1_Freq.Debug_PVT_SCIM_Ctrl_WLS1_Freq
      Debug_PVT_SCIM_Ctrl_WLS1_Freq_001: upstream-reference=EcuSwComposition.Debug_PVT_SCIM_Ctrl_WLS1_Freq, ecu-extract-reference=COMPOSITIONTYPE.Debug_PVT_SCIM_Ctrl_WLS1_Freq
      Debug_PVT_SCIM_Ctrl_WLS3Freq: upstream-reference=EcuSwComposition.Debug_PVT_SCIM_Ctrl_WLS3Freq.Debug_PVT_SCIM_Ctrl_WLS3Freq, ecu-extract-reference=COMPOSITIONTYPE.Debug_PVT_SCIM_Ctrl_WLS3Freq.Debug_PVT_SCIM_Ctrl_WLS3Freq
      Debug_PVT_SCIM_Ctrl_WLS3Freq_001: upstream-reference=EcuSwComposition.Debug_PVT_SCIM_Ctrl_WLS3Freq, ecu-extract-reference=COMPOSITIONTYPE.Debug_PVT_SCIM_Ctrl_WLS3Freq
      Debug_PVT_SCIM_Ctrl_WHS2: upstream-reference=EcuSwComposition.Debug_PVT_SCIM_Ctrl_WHS2.Debug_PVT_SCIM_Ctrl_WHS2, ecu-extract-reference=COMPOSITIONTYPE.Debug_PVT_SCIM_Ctrl_WHS2.Debug_PVT_SCIM_Ctrl_WHS2
      Debug_PVT_SCIM_Ctrl_WHS2_001: upstream-reference=EcuSwComposition.Debug_PVT_SCIM_Ctrl_WHS2, ecu-extract-reference=COMPOSITIONTYPE.Debug_PVT_SCIM_Ctrl_WHS2
      Debug_PVT_SCIM_Ctrl_WLS2: upstream-reference=EcuSwComposition.Debug_PVT_SCIM_Ctrl_WLS2.Debug_PVT_SCIM_Ctrl_WLS2, ecu-extract-reference=COMPOSITIONTYPE.Debug_PVT_SCIM_Ctrl_WLS2.Debug_PVT_SCIM_Ctrl_WLS2
      Debug_PVT_SCIM_Ctrl_WLS2_001: upstream-reference=EcuSwComposition.Debug_PVT_SCIM_Ctrl_WLS2, ecu-extract-reference=COMPOSITIONTYPE.Debug_PVT_SCIM_Ctrl_WLS2
      Debug_PVT_SCIM_Ctrl_WHS2_Freq: upstream-reference=EcuSwComposition.Debug_PVT_SCIM_Ctrl_WHS2_Freq.Debug_PVT_SCIM_Ctrl_WHS2_Freq, ecu-extract-reference=COMPOSITIONTYPE.Debug_PVT_SCIM_Ctrl_WHS2_Freq.Debug_PVT_SCIM_Ctrl_WHS2_Freq
      Debug_PVT_SCIM_Ctrl_WHS2_Freq_001: upstream-reference=EcuSwComposition.Debug_PVT_SCIM_Ctrl_WHS2_Freq, ecu-extract-reference=COMPOSITIONTYPE.Debug_PVT_SCIM_Ctrl_WHS2_Freq
      Debug_PVT_SCIM_Ctrl_WLS1: upstream-reference=EcuSwComposition.Debug_PVT_SCIM_Ctrl_WLS1.Debug_PVT_SCIM_Ctrl_WLS1, ecu-extract-reference=COMPOSITIONTYPE.Debug_PVT_SCIM_Ctrl_WLS1.Debug_PVT_SCIM_Ctrl_WLS1
      Debug_PVT_SCIM_Ctrl_WLS1_001: upstream-reference=EcuSwComposition.Debug_PVT_SCIM_Ctrl_WLS1, ecu-extract-reference=COMPOSITIONTYPE.Debug_PVT_SCIM_Ctrl_WLS1
      Debug_PVT_SCIM_Ctrl_WHS2_Duty: upstream-reference=EcuSwComposition.Debug_PVT_SCIM_Ctrl_WHS2_Duty.Debug_PVT_SCIM_Ctrl_WHS2_Duty, ecu-extract-reference=COMPOSITIONTYPE.Debug_PVT_SCIM_Ctrl_WHS2_Duty.Debug_PVT_SCIM_Ctrl_WHS2_Duty
      Debug_PVT_SCIM_Ctrl_WHS2_Duty_001: upstream-reference=EcuSwComposition.Debug_PVT_SCIM_Ctrl_WHS2_Duty, ecu-extract-reference=COMPOSITIONTYPE.Debug_PVT_SCIM_Ctrl_WHS2_Duty
      Debug_PVT_SCIM_RD_WLS1_Duty: upstream-reference=EcuSwComposition.Debug_PVT_SCIM_RD_WLS1_Duty.Debug_PVT_SCIM_RD_WLS1_Duty, ecu-extract-reference=COMPOSITIONTYPE.Debug_PVT_SCIM_RD_WLS1_Duty.Debug_PVT_SCIM_RD_WLS1_Duty
      Debug_PVT_SCIM_RD_WLS1_Duty_001: upstream-reference=EcuSwComposition.Debug_PVT_SCIM_RD_WLS1_Duty, ecu-extract-reference=COMPOSITIONTYPE.Debug_PVT_SCIM_RD_WLS1_Duty
      Debug_PVT_SCIM_RD_WLS3_Freq: upstream-reference=EcuSwComposition.Debug_PVT_SCIM_RD_WLS3_Freq.Debug_PVT_SCIM_RD_WLS3_Freq, ecu-extract-reference=COMPOSITIONTYPE.Debug_PVT_SCIM_RD_WLS3_Freq.Debug_PVT_SCIM_RD_WLS3_Freq
      Debug_PVT_SCIM_RD_WLS3_Freq_001: upstream-reference=EcuSwComposition.Debug_PVT_SCIM_RD_WLS3_Freq, ecu-extract-reference=COMPOSITIONTYPE.Debug_PVT_SCIM_RD_WLS3_Freq
      Debug_PVT_SCIM_RD_WHS1_Volt: upstream-reference=EcuSwComposition.Debug_PVT_SCIM_RD_WHS1_Volt.Debug_PVT_SCIM_RD_WHS1_Volt, ecu-extract-reference=COMPOSITIONTYPE.Debug_PVT_SCIM_RD_WHS1_Volt.Debug_PVT_SCIM_RD_WHS1_Volt
      Debug_PVT_SCIM_RD_WHS1_Volt_001: upstream-reference=EcuSwComposition.Debug_PVT_SCIM_RD_WHS1_Volt, ecu-extract-reference=COMPOSITIONTYPE.Debug_PVT_SCIM_RD_WHS1_Volt
      Debug_PVT_SCIM_RD_WLS2_Fault: upstream-reference=EcuSwComposition.Debug_PVT_SCIM_RD_WLS2_Fault.Debug_PVT_SCIM_RD_WLS2_Fault, ecu-extract-reference=COMPOSITIONTYPE.Debug_PVT_SCIM_RD_WLS2_Fault.Debug_PVT_SCIM_RD_WLS2_Fault
      Debug_PVT_SCIM_RD_WLS2_Fault_001: upstream-reference=EcuSwComposition.Debug_PVT_SCIM_RD_WLS2_Fault, ecu-extract-reference=COMPOSITIONTYPE.Debug_PVT_SCIM_RD_WLS2_Fault
      Debug_PVT_SCIM_RD_WLS1_Volt: upstream-reference=EcuSwComposition.Debug_PVT_SCIM_RD_WLS1_Volt.Debug_PVT_SCIM_RD_WLS1_Volt, ecu-extract-reference=COMPOSITIONTYPE.Debug_PVT_SCIM_RD_WLS1_Volt.Debug_PVT_SCIM_RD_WLS1_Volt
      Debug_PVT_SCIM_RD_WLS1_Volt_001: upstream-reference=EcuSwComposition.Debug_PVT_SCIM_RD_WLS1_Volt, ecu-extract-reference=COMPOSITIONTYPE.Debug_PVT_SCIM_RD_WLS1_Volt
      Debug_PVT_SCIM_RD_WHS2_Volt: upstream-reference=EcuSwComposition.Debug_PVT_SCIM_RD_WHS2_Volt.Debug_PVT_SCIM_RD_WHS2_Volt, ecu-extract-reference=COMPOSITIONTYPE.Debug_PVT_SCIM_RD_WHS2_Volt.Debug_PVT_SCIM_RD_WHS2_Volt
      Debug_PVT_SCIM_RD_WHS2_Volt_001: upstream-reference=EcuSwComposition.Debug_PVT_SCIM_RD_WHS2_Volt, ecu-extract-reference=COMPOSITIONTYPE.Debug_PVT_SCIM_RD_WHS2_Volt
      Debug_PVT_SCIM_RD_WHS1_Duty: upstream-reference=EcuSwComposition.Debug_PVT_SCIM_RD_WHS1_Duty.Debug_PVT_SCIM_RD_WHS1_Duty, ecu-extract-reference=COMPOSITIONTYPE.Debug_PVT_SCIM_RD_WHS1_Duty.Debug_PVT_SCIM_RD_WHS1_Duty
      Debug_PVT_SCIM_RD_WHS1_Duty_001: upstream-reference=EcuSwComposition.Debug_PVT_SCIM_RD_WHS1_Duty, ecu-extract-reference=COMPOSITIONTYPE.Debug_PVT_SCIM_RD_WHS1_Duty
      Debug_PVT_SCIM_RD_WLS2_Volt: upstream-reference=EcuSwComposition.Debug_PVT_SCIM_RD_WLS2_Volt.Debug_PVT_SCIM_RD_WLS2_Volt, ecu-extract-reference=COMPOSITIONTYPE.Debug_PVT_SCIM_RD_WLS2_Volt.Debug_PVT_SCIM_RD_WLS2_Volt
      Debug_PVT_SCIM_RD_WLS2_Volt_001: upstream-reference=EcuSwComposition.Debug_PVT_SCIM_RD_WLS2_Volt, ecu-extract-reference=COMPOSITIONTYPE.Debug_PVT_SCIM_RD_WLS2_Volt
      Debug_PVT_SCIM_RD_WLS1_Fault: upstream-reference=EcuSwComposition.Debug_PVT_SCIM_RD_WLS1_Fault.Debug_PVT_SCIM_RD_WLS1_Fault, ecu-extract-reference=COMPOSITIONTYPE.Debug_PVT_SCIM_RD_WLS1_Fault.Debug_PVT_SCIM_RD_WLS1_Fault
      Debug_PVT_SCIM_RD_WLS1_Fault_001: upstream-reference=EcuSwComposition.Debug_PVT_SCIM_RD_WLS1_Fault, ecu-extract-reference=COMPOSITIONTYPE.Debug_PVT_SCIM_RD_WLS1_Fault
      Debug_PVT_SCIM_RD_WLS2_Freq: upstream-reference=EcuSwComposition.Debug_PVT_SCIM_RD_WLS2_Freq.Debug_PVT_SCIM_RD_WLS2_Freq, ecu-extract-reference=COMPOSITIONTYPE.Debug_PVT_SCIM_RD_WLS2_Freq.Debug_PVT_SCIM_RD_WLS2_Freq
      Debug_PVT_SCIM_RD_WLS2_Freq_001: upstream-reference=EcuSwComposition.Debug_PVT_SCIM_RD_WLS2_Freq, ecu-extract-reference=COMPOSITIONTYPE.Debug_PVT_SCIM_RD_WLS2_Freq
      Debug_PVT_SCIM_RD_WHS2_Duty: upstream-reference=EcuSwComposition.Debug_PVT_SCIM_RD_WHS2_Duty.Debug_PVT_SCIM_RD_WHS2_Duty, ecu-extract-reference=COMPOSITIONTYPE.Debug_PVT_SCIM_RD_WHS2_Duty.Debug_PVT_SCIM_RD_WHS2_Duty
      Debug_PVT_SCIM_RD_WHS2_Duty_001: upstream-reference=EcuSwComposition.Debug_PVT_SCIM_RD_WHS2_Duty, ecu-extract-reference=COMPOSITIONTYPE.Debug_PVT_SCIM_RD_WHS2_Duty
      Debug_PVT_SCIM_RD_WHS1_Freq: upstream-reference=EcuSwComposition.Debug_PVT_SCIM_RD_WHS1_Freq.Debug_PVT_SCIM_RD_WHS1_Freq, ecu-extract-reference=COMPOSITIONTYPE.Debug_PVT_SCIM_RD_WHS1_Freq.Debug_PVT_SCIM_RD_WHS1_Freq
      Debug_PVT_SCIM_RD_WHS1_Freq_001: upstream-reference=EcuSwComposition.Debug_PVT_SCIM_RD_WHS1_Freq, ecu-extract-reference=COMPOSITIONTYPE.Debug_PVT_SCIM_RD_WHS1_Freq
      Debug_PVT_SCIM_RD_WLS2_Duty: upstream-reference=EcuSwComposition.Debug_PVT_SCIM_RD_WLS2_Duty.Debug_PVT_SCIM_RD_WLS2_Duty, ecu-extract-reference=COMPOSITIONTYPE.Debug_PVT_SCIM_RD_WLS2_Duty.Debug_PVT_SCIM_RD_WLS2_Duty
      Debug_PVT_SCIM_RD_WLS2_Duty_001: upstream-reference=EcuSwComposition.Debug_PVT_SCIM_RD_WLS2_Duty, ecu-extract-reference=COMPOSITIONTYPE.Debug_PVT_SCIM_RD_WLS2_Duty
      Debug_PVT_SCIM_RD_WHS1_Fault: upstream-reference=EcuSwComposition.Debug_PVT_SCIM_RD_WHS1_Fault.Debug_PVT_SCIM_RD_WHS1_Fault, ecu-extract-reference=COMPOSITIONTYPE.Debug_PVT_SCIM_RD_WHS1_Fault.Debug_PVT_SCIM_RD_WHS1_Fault
      Debug_PVT_SCIM_RD_WHS1_Fault_001: upstream-reference=EcuSwComposition.Debug_PVT_SCIM_RD_WHS1_Fault, ecu-extract-reference=COMPOSITIONTYPE.Debug_PVT_SCIM_RD_WHS1_Fault
      Debug_PVT_SCIM_RD_WHS2_Freq: upstream-reference=EcuSwComposition.Debug_PVT_SCIM_RD_WHS2_Freq.Debug_PVT_SCIM_RD_WHS2_Freq, ecu-extract-reference=COMPOSITIONTYPE.Debug_PVT_SCIM_RD_WHS2_Freq.Debug_PVT_SCIM_RD_WHS2_Freq
      Debug_PVT_SCIM_RD_WHS2_Freq_001: upstream-reference=EcuSwComposition.Debug_PVT_SCIM_RD_WHS2_Freq, ecu-extract-reference=COMPOSITIONTYPE.Debug_PVT_SCIM_RD_WHS2_Freq
      Debug_PVT_SCIM_RD_WLS3_Duty: upstream-reference=EcuSwComposition.Debug_PVT_SCIM_RD_WLS3_Duty.Debug_PVT_SCIM_RD_WLS3_Duty, ecu-extract-reference=COMPOSITIONTYPE.Debug_PVT_SCIM_RD_WLS3_Duty.Debug_PVT_SCIM_RD_WLS3_Duty
      Debug_PVT_SCIM_RD_WLS3_Duty_001: upstream-reference=EcuSwComposition.Debug_PVT_SCIM_RD_WLS3_Duty, ecu-extract-reference=COMPOSITIONTYPE.Debug_PVT_SCIM_RD_WLS3_Duty
      Debug_PVT_SCIM_RD_WHS2_Fault: upstream-reference=EcuSwComposition.Debug_PVT_SCIM_RD_WHS2_Fault.Debug_PVT_SCIM_RD_WHS2_Fault, ecu-extract-reference=COMPOSITIONTYPE.Debug_PVT_SCIM_RD_WHS2_Fault.Debug_PVT_SCIM_RD_WHS2_Fault
      Debug_PVT_SCIM_RD_WHS2_Fault_001: upstream-reference=EcuSwComposition.Debug_PVT_SCIM_RD_WHS2_Fault, ecu-extract-reference=COMPOSITIONTYPE.Debug_PVT_SCIM_RD_WHS2_Fault
      Debug_PVT_SCIM_RD_WLS3_Fault: upstream-reference=EcuSwComposition.Debug_PVT_SCIM_RD_WLS3_Fault.Debug_PVT_SCIM_RD_WLS3_Fault, ecu-extract-reference=COMPOSITIONTYPE.Debug_PVT_SCIM_RD_WLS3_Fault.Debug_PVT_SCIM_RD_WLS3_Fault
      Debug_PVT_SCIM_RD_WLS3_Fault_001: upstream-reference=EcuSwComposition.Debug_PVT_SCIM_RD_WLS3_Fault, ecu-extract-reference=COMPOSITIONTYPE.Debug_PVT_SCIM_RD_WLS3_Fault
      Debug_PVT_SCIM_RD_WLS1_Freq: upstream-reference=EcuSwComposition.Debug_PVT_SCIM_RD_WLS1_Freq.Debug_PVT_SCIM_RD_WLS1_Freq, ecu-extract-reference=COMPOSITIONTYPE.Debug_PVT_SCIM_RD_WLS1_Freq.Debug_PVT_SCIM_RD_WLS1_Freq
      Debug_PVT_SCIM_RD_WLS1_Freq_001: upstream-reference=EcuSwComposition.Debug_PVT_SCIM_RD_WLS1_Freq, ecu-extract-reference=COMPOSITIONTYPE.Debug_PVT_SCIM_RD_WLS1_Freq
      Debug_PVT_SCIM_RD_WLS3_Volt: upstream-reference=EcuSwComposition.Debug_PVT_SCIM_RD_WLS3_Volt.Debug_PVT_SCIM_RD_WLS3_Volt, ecu-extract-reference=COMPOSITIONTYPE.Debug_PVT_SCIM_RD_WLS3_Volt.Debug_PVT_SCIM_RD_WLS3_Volt
      Debug_PVT_SCIM_RD_WLS3_Volt_001: upstream-reference=EcuSwComposition.Debug_PVT_SCIM_RD_WLS3_Volt, ecu-extract-reference=COMPOSITIONTYPE.Debug_PVT_SCIM_RD_WLS3_Volt
      Debug_PVT_SCIM_Ctrl_12VDCDC: upstream-reference=EcuSwComposition.Debug_PVT_SCIM_Ctrl_12VDCDC.Debug_PVT_SCIM_Ctrl_12VDCDC, ecu-extract-reference=COMPOSITIONTYPE.Debug_PVT_SCIM_Ctrl_12VDCDC.Debug_PVT_SCIM_Ctrl_12VDCDC
      Debug_PVT_SCIM_Ctrl_12VDCDC_001: upstream-reference=EcuSwComposition.Debug_PVT_SCIM_Ctrl_12VDCDC, ecu-extract-reference=COMPOSITIONTYPE.Debug_PVT_SCIM_Ctrl_12VDCDC
      Debug_PVT_SCIM_Ctrl_12VParked: upstream-reference=EcuSwComposition.Debug_PVT_SCIM_Ctrl_12VParked.Debug_PVT_SCIM_Ctrl_12VParked, ecu-extract-reference=COMPOSITIONTYPE.Debug_PVT_SCIM_Ctrl_12VParked.Debug_PVT_SCIM_Ctrl_12VParked
      Debug_PVT_SCIM_Ctrl_12VParked_001: upstream-reference=EcuSwComposition.Debug_PVT_SCIM_Ctrl_12VParked, ecu-extract-reference=COMPOSITIONTYPE.Debug_PVT_SCIM_Ctrl_12VParked
      Debug_PVT_SCIM_Ctrl_12VLiving: upstream-reference=EcuSwComposition.Debug_PVT_SCIM_Ctrl_12VLiving.Debug_PVT_SCIM_Ctrl_12VLiving, ecu-extract-reference=COMPOSITIONTYPE.Debug_PVT_SCIM_Ctrl_12VLiving.Debug_PVT_SCIM_Ctrl_12VLiving
      Debug_PVT_SCIM_Ctrl_12VLiving_001: upstream-reference=EcuSwComposition.Debug_PVT_SCIM_Ctrl_12VLiving, ecu-extract-reference=COMPOSITIONTYPE.Debug_PVT_SCIM_Ctrl_12VLiving
      PVTApp_DowhsDowlsInterface: upstream-reference=EcuSwComposition.PVTApp_DowhsDowlsInterface, ecu-extract-reference=COMPOSITIONTYPE.PVTApp_DowhsDowlsInterface
      CDD_LFIC: upstream-reference=EcuSwComposition.CDD_LFIC, ecu-extract-reference=COMPOSITIONTYPE.CDD_LFIC
      CDD_RFIC: upstream-reference=EcuSwComposition.CDD_RFIC, ecu-extract-reference=COMPOSITIONTYPE.CDD_RFIC
      Telegram: upstream-reference=EcuSwComposition.PEPS.Telegram, ecu-extract-reference=COMPOSITIONTYPE.Telegram
      Debug_PVT_SCIM_Ctrl_DAIPullUp: upstream-reference=EcuSwComposition.Debug_PVT_SCIM_Ctrl_DaiPullUp.Debug_PVT_SCIM_Ctrl_DaiPullUp, ecu-extract-reference=COMPOSITIONTYPE.Debug_PVT_SCIM_Ctrl_DaiPullUp.Debug_PVT_SCIM_Ctrl_DaiPullUp
      Debug_PVT_PEPS_P1_MaxRSSI_P: upstream-reference=EcuSwComposition.Debug_PVT_PEPS_P1_MaxRSSI_P, ecu-extract-reference=COMPOSITIONTYPE.Debug_PVT_PEPS_P1_MaxRSSI_P
      Debug_PVT_PEPS_GainP3_stat_P: upstream-reference=EcuSwComposition.Debug_PVT_PEPS_GainP3_stat_P, ecu-extract-reference=COMPOSITIONTYPE.Debug_PVT_PEPS_GainP3_stat_P
      Debug_PVT_PEPS_P4_MaxRSSI_P: upstream-reference=EcuSwComposition.Debug_PVT_PEPS_P4_MaxRSSI_P, ecu-extract-reference=COMPOSITIONTYPE.Debug_PVT_PEPS_P4_MaxRSSI_P
      Debug_PVT_PEPS_GainP2_stat_P: upstream-reference=EcuSwComposition.Debug_PVT_PEPS_GainP2_stat_P, ecu-extract-reference=COMPOSITIONTYPE.Debug_PVT_PEPS_GainP2_stat_P
      Debug_PVT_PEPS_P3_MaxRSSI_P: upstream-reference=EcuSwComposition.Debug_PVT_PEPS_P3_MaxRSSI_P, ecu-extract-reference=COMPOSITIONTYPE.Debug_PVT_PEPS_P3_MaxRSSI_P
      Debug_PVT_PEPS_GainP1_stat_P: upstream-reference=EcuSwComposition.Debug_PVT_PEPS_GainP1_stat_P, ecu-extract-reference=COMPOSITIONTYPE.Debug_PVT_PEPS_GainP1_stat_P
      Debug_PVT_PEPS_VDSI_stat_P: upstream-reference=EcuSwComposition.Debug_PVT_PEPS_VDSI_stat_P, ecu-extract-reference=COMPOSITIONTYPE.Debug_PVT_PEPS_VDSI_stat_P
      Debug_PVT_PEPS_P2_MaxRSSI_P: upstream-reference=EcuSwComposition.Debug_PVT_PEPS_P2_MaxRSSI_P, ecu-extract-reference=COMPOSITIONTYPE.Debug_PVT_PEPS_P2_MaxRSSI_P
      Debug_PVT_PEPS_AntCtrl_stat_P: upstream-reference=EcuSwComposition.Debug_PVT_PEPS_AntCtrl_stat_P, ecu-extract-reference=COMPOSITIONTYPE.Debug_PVT_PEPS_AntCtrl_stat_P
      Debug_PVT_PEPS_GainP4_stat_P: upstream-reference=EcuSwComposition.Debug_PVT_PEPS_GainP4_stat_P, ecu-extract-reference=COMPOSITIONTYPE.Debug_PVT_PEPS_GainP4_stat_P
      Debug_PVT_PEPS_Ant_Ctrl_P: upstream-reference=EcuSwComposition.Debug_PVT_PEPS_Ant_Ctrl_P, ecu-extract-reference=COMPOSITIONTYPE.Debug_PVT_PEPS_Ant_Ctrl_P
      Debug_PVT_PEPS_VDSI_Ctrl_P: upstream-reference=EcuSwComposition.Debug_PVT_PEPS_VDSI_Ctrl_P, ecu-extract-reference=COMPOSITIONTYPE.Debug_PVT_PEPS_VDSI_Ctrl_P
      Debug_PVT_PEPS_GainP3_Ctrl_P: upstream-reference=EcuSwComposition.Debug_PVT_PEPS_GainP3_Ctrl_P, ecu-extract-reference=COMPOSITIONTYPE.Debug_PVT_PEPS_GainP3_Ctrl_P
      Debug_PVT_PEPS_GainP1_Ctrl_P: upstream-reference=EcuSwComposition.Debug_PVT_PEPS_GainP1_Ctrl_P, ecu-extract-reference=COMPOSITIONTYPE.Debug_PVT_PEPS_GainP1_Ctrl_P
      Debug_PVT_PEPS_GainP4_Ctrl_P: upstream-reference=EcuSwComposition.Debug_PVT_PEPS_GainP4_Ctrl_P, ecu-extract-reference=COMPOSITIONTYPE.Debug_PVT_PEPS_GainP4_Ctrl_P
      Debug_PVT_PEPS_GainP2_Ctrl_P: upstream-reference=EcuSwComposition.Debug_PVT_PEPS_GainP2_Ctrl_P, ecu-extract-reference=COMPOSITIONTYPE.Debug_PVT_PEPS_GainP2_Ctrl_P
      Debug_PVT_PEPS_Logic_stat_P: upstream-reference=EcuSwComposition.Debug_PVT_PEPS_Logic_stat_P, ecu-extract-reference=COMPOSITIONTYPE.Debug_PVT_PEPS_Logic_stat_P
      TP: upstream-reference=EcuSwComposition.PEPS.TP, ecu-extract-reference=COMPOSITIONTYPE.TP
