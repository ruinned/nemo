[part 1 of 2: package /ActiveEcuC]
AUTOSAR XML (schema 4-2-1)
package /ActiveEcuC
  module config CanIf: implementation-config-variant=VARIANT-PRE-COMPILE, module-description=CanIf_Impl
    CanIfCtrlDrvCfg_7d254554 (CanIfCtrlDrvCfg): CanIfCtrlDrvTxCancellation=false, CanIfCtrlDrvInitHohConfigRef=CanIfInitHohCfg, CanIfCtrlDrvNameRef=CanGeneral
      5 x CanIfCtrlCfg, all with CanIfCtrlWakeupSupport=false, CanIfCtrlJ1939DynAddrSupport=DISABLED:
        CT_Backbone1J1939_198bcf1c: CanIfCtrlId=0, CanIfCtrlCanCtrlRef=CT_Backbone1J1939_198bcf1c
        CT_SecuritySubnet_f5346ae6: CanIfCtrlId=2, CanIfCtrlCanCtrlRef=CT_SecuritySubnet_f5346ae6
        CT_FMSNet_119a8706: CanIfCtrlId=3, CanIfCtrlCanCtrlRef=CT_FMSNet_119a8706
        CT_Backbone2_34cfe263: CanIfCtrlId=4, CanIfCtrlCanCtrlRef=CT_Backbone2_34cfe263
        CT_CabSubnet_d2ff0fbe: CanIfCtrlId=1, CanIfCtrlCanCtrlRef=CT_CabSubnet_d2ff0fbe
    CanIfDispatchCfg:
      CanIfDispatchUserCtrlBusOffName = CanSM_ControllerBusOff
      CanIfDispatchUserCtrlBusOffUL = CAN_SM
      CanIfDispatchUserCtrlModeIndicationName = CanSM_ControllerModeIndication
      CanIfDispatchUserCtrlModeIndicationUL = CAN_SM
      CanIfDispatchUserTrcvModeIndicationUL = CDD
      CanIfDispatchUserTrcvModeIndicationName = NULL_PTR
    CanIfInitCfg
      12 x CanIfRxPduCfg, all with CanIfRxPduCanIdType=EXTENDED_CAN, CanIfRxPduDlc=8, CanIfRxPduReadData=false, CanIfRxPduReadNotifyStatus=false, CanIfRxPduDlcCheck=true, CanIfRxPduHrhIdRef=CN_Backbone1J1939_6e8ec372_Rx:
        ET1_X_EMS_oBackbone1J1939_a6b0a91f_Rx: CanIfRxPduCanId=419360256, CanIfRxPduCanIdMask=67108863, CanIfRxPduUserRxIndicationName=PduR_CanIfRxIndication, CanIfRxPduUserRxIndicationUL=PDUR, CanIfRxPduId=5, CanIfRxPduRef=ET1_X_EMS_oBackbone1J1939_2b7be601_Rx
        EBC5_X_EBS_oBackbone1J1939_a226f3b2_Rx: CanIfRxPduCanId=419283979, CanIfRxPduCanIdMask=67108863, CanIfRxPduUserRxIndicationName=PduR_CanIfRxIndication, CanIfRxPduUserRxIndicationUL=PDUR, CanIfRxPduId=6, CanIfRxPduRef=EBC5_X_EBS_oBackbone1J1939_71f8bf2e_Rx
        VDHR_X_VMCU_oBackbone1J1939_0e2cb4b8_Rx: CanIfRxPduCanId=419348753, CanIfRxPduCanIdMask=67108863, CanIfRxPduUserRxIndicationName=PduR_CanIfRxIndication, CanIfRxPduUserRxIndicationUL=PDUR, CanIfRxPduId=7, CanIfRxPduRef=VDHR_X_VMCU_oBackbone1J1939_27498c2c_Rx
        EEC1_X_EMS_oBackbone1J1939_5b1d5ab3_Rx: CanIfRxPduCanId=217056256, CanIfRxPduCanIdMask=67108863, CanIfRxPduUserRxIndicationName=PduR_CanIfRxIndication, CanIfRxPduUserRxIndicationUL=PDUR, CanIfRxPduId=8, CanIfRxPduRef=EEC1_X_EMS_oBackbone1J1939_cdd2f3bf_Rx
        TD_X_HMIIOM_oBackbone1J1939_49e6bcf2_Rx: CanIfRxPduCanId=419358231, CanIfRxPduCanIdMask=67108863, CanIfRxPduUserRxIndicationName=PduR_CanIfRxIndication, CanIfRxPduUserRxIndicationUL=PDUR, CanIfRxPduId=9, CanIfRxPduRef=TD_X_HMIIOM_oBackbone1J1939_5060289e_Rx
        HRLFC_X_EMS_oBackbone1J1939_5e7f7408_Rx: CanIfRxPduCanId=419236096, CanIfRxPduCanIdMask=67108863, CanIfRxPduUserRxIndicationName=PduR_CanIfRxIndication, CanIfRxPduUserRxIndicationUL=PDUR, CanIfRxPduId=10, CanIfRxPduRef=HRLFC_X_EMS_oBackbone1J1939_04c7cc2f_Rx
        CVW_X_EBS_oBackbone1J1939_2dfa9bbe_Rx: CanIfRxPduCanId=419328011, CanIfRxPduCanIdMask=67108863, CanIfRxPduUserRxIndicationName=PduR_CanIfRxIndication, CanIfRxPduUserRxIndicationUL=PDUR, CanIfRxPduId=11, CanIfRxPduRef=CVW_X_EBS_oBackbone1J1939_7745bc8f_Rx
        TPCM_Tp_oBackbone1J1939_ffabc0bc_Rx: CanIfRxPduCanId=485293822, CanIfRxPduCanIdMask=67043328, CanIfRxPduUserRxIndicationName=J1939Tp_RxIndication, CanIfRxPduUserRxIndicationUL=J1939TP, CanIfRxPduId=0, CanIfRxPduRef=TPCM_Tp_oBackbone1J1939_b357cc8b_Rx
        EBS_BB1_05P_oBackbone1J1939_43953999_Rx: CanIfRxPduCanId=419401995, CanIfRxPduCanIdMask=67108863, CanIfRxPduUserRxIndicationName=PduR_CanIfRxIndication, CanIfRxPduUserRxIndicationUL=PDUR, CanIfRxPduId=12, CanIfRxPduRef=EBS_BB1_05P_oBackbone1J1939_ef101786_Rx
        VMCU_BB1_01P_oBackbone1J1939_c293b9cd_Rx: CanIfRxPduCanId=150945809, CanIfRxPduCanIdMask=67108863, CanIfRxPduUserRxIndicationName=PduR_CanIfRxIndication, CanIfRxPduUserRxIndicationUL=PDUR, CanIfRxPduId=13, CanIfRxPduRef=VMCU_BB1_01P_oBackbone1J1939_73c9d3c7_Rx
        EBS_BB1_01P_oBackbone1J1939_9205779e_Rx: CanIfRxPduCanId=352266763, CanIfRxPduCanIdMask=67108863, CanIfRxPduUserRxIndicationName=PduR_CanIfRxIndication, CanIfRxPduUserRxIndicationUL=PDUR, CanIfRxPduId=14, CanIfRxPduRef=EBS_BB1_01P_oBackbone1J1939_06650efd_Rx
        LFE_X_EMS_oBackbone1J1939_592edea5_Rx: CanIfRxPduCanId=419361280, CanIfRxPduCanIdMask=67108863, CanIfRxPduUserRxIndicationName=PduR_CanIfRxIndication, CanIfRxPduUserRxIndicationUL=PDUR, CanIfRxPduId=15, CanIfRxPduRef=LFE_X_EMS_oBackbone1J1939_8a36c848_Rx
      CIOM_BB1_01P_oBackbone1J1939_55a00301_Tx (CanIfTxPduCfg):
        CanIfTxPduCanId = 352273457
        CanIfTxPduCanIdType = EXTENDED_CAN
        CanIfTxPduDlc = 8
        CanIfTxPduUserTxConfirmationName = NULL_PTR
        CanIfTxPduUserTxConfirmationUL = NONE
        CanIfTxPduId = 1
        CanIfTxPduReadNotifyStatus = false
        CanIfTxPduType = STATIC
        CanIfTxPduBufferRef = CanIfBufferCfg_CIOM_BB1_01P_oBackbone1J1939_55a00301_Tx
        CanIfTxPduRef = CIOM_BB1_01P_oBackbone1J1939_6c85c28e_Tx
      CanIfInitHohCfg: CanIfInitRefCfgSet=CanConfigSet
        CN_Backbone1J1939_6e8ec372_Rx (CanIfHrhCfg): CanIfHrhSoftwareFilter=true, CanIfHrhCanCtrlIdRef=CT_Backbone1J1939_198bcf1c, CanIfHrhIdSymRef=CN_Backbone1J1939_6e8ec372_Rx
        CN_SecuritySubnet_3840872e_Rx (CanIfHrhCfg): CanIfHrhSoftwareFilter=true, CanIfHrhCanCtrlIdRef=CT_SecuritySubnet_f5346ae6, CanIfHrhIdSymRef=CN_SecuritySubnet_3840872e_Rx
        CN_Backbone2_78967e2c_Tx (CanIfHthCfg): CanIfHthCanCtrlIdRef=CT_Backbone2_34cfe263, CanIfHthIdSymRef=CN_Backbone2_78967e2c_Tx
        3 x CanIfHrhCfg, all with CanIfHrhSoftwareFilter=true:
          CN_Backbone2_7b3866ec_Rx: CanIfHrhCanCtrlIdRef=CT_Backbone2_34cfe263, CanIfHrhIdSymRef=CN_Backbone2_7b3866ec_Rx
          CN_CabSubnet_eedbadff_Rx: CanIfHrhCanCtrlIdRef=CT_CabSubnet_d2ff0fbe, CanIfHrhIdSymRef=CN_CabSubnet_eedbadff_Rx
          CN_FMSNet_41e51372_Rx: CanIfHrhCanCtrlIdRef=CT_FMSNet_119a8706, CanIfHrhIdSymRef=CN_FMSNet_41e51372_Rx
        121 x CanIfHthCfg:
          CanIfHthCfg_CIOM_Sec_01P_oSecuritySubnet_de08418d_Tx: CanIfHthCanCtrlIdRef=CT_SecuritySubnet_f5346ae6, CanIfHthIdSymRef=CanHardwareObject_CIOM_Sec_01P_oSecuritySubnet_de08418d_Tx
          CanIfHthCfg_IntTesterTGW2FuncDiagMsg_Sec_Tp_oSecuritySubnet_57d96404_Tx: CanIfHthCanCtrlIdRef=CT_SecuritySubnet_f5346ae6, CanIfHthIdSymRef=CanHardwareObject_IntTesterTGW2FuncDiagMsg_Sec_Tp_oSecuritySubnet_57d96404_Tx
          CanIfHthCfg_DiagReqMsgIntHMIIOM_C0_F3_Sec_Tp_oSecuritySubnet_3aaf1649_Tx: CanIfHthCanCtrlIdRef=CT_SecuritySubnet_f5346ae6, CanIfHthIdSymRef=CanHardwareObject_DiagReqMsgIntHMIIOM_C0_F3_Sec_Tp_oSecuritySubnet_3aaf1649_Tx
          CanIfHthCfg_TesterFuncDiagMsg_Sec_Tp_oSecuritySubnet_7f5a7347_Tx: CanIfHthCanCtrlIdRef=CT_SecuritySubnet_f5346ae6, CanIfHthIdSymRef=CanHardwareObject_TesterFuncDiagMsg_Sec_Tp_oSecuritySubnet_7f5a7347_Tx
          CanIfHthCfg_PhysDiagReqMsg_A1_F2_Sec_Tp_oSecuritySubnet_5d2e792a_Tx: CanIfHthCanCtrlIdRef=CT_SecuritySubnet_f5346ae6, CanIfHthIdSymRef=CanHardwareObject_PhysDiagReqMsg_A1_F2_Sec_Tp_oSecuritySubnet_5d2e792a_Tx
          CanIfHthCfg_DiagReqMsgIntTGW2_A1_F4_Sec_Tp_oSecuritySubnet_eb89cc56_Tx: CanIfHthCanCtrlIdRef=CT_SecuritySubnet_f5346ae6, CanIfHthIdSymRef=CanHardwareObject_DiagReqMsgIntTGW2_A1_F4_Sec_Tp_oSecuritySubnet_eb89cc56_Tx
          CanIfHthCfg_AnmMsg_CIOM_SecuritySubnet_oSecuritySubnet_d0267e59_Tx: CanIfHthCanCtrlIdRef=CT_SecuritySubnet_f5346ae6, CanIfHthIdSymRef=CanHardwareObject_AnmMsg_CIOM_SecuritySubnet_oSecuritySubnet_d0267e59_Tx
          CanIfHthCfg_DiagReqMsgIntHMIIOM_A0_F3_Sec_Tp_oSecuritySubnet_09265670_Tx: CanIfHthCanCtrlIdRef=CT_SecuritySubnet_f5346ae6, CanIfHthIdSymRef=CanHardwareObject_DiagReqMsgIntHMIIOM_A0_F3_Sec_Tp_oSecuritySubnet_09265670_Tx
          CanIfHthCfg_PDM_Sec_04S_FCM_Tp_oSecuritySubnet_90a313cf_Tx: CanIfHthCanCtrlIdRef=CT_SecuritySubnet_f5346ae6, CanIfHthIdSymRef=CanHardwareObject_PDM_Sec_04S_FCM_Tp_oSecuritySubnet_90a313cf_Tx
          CanIfHthCfg_CIOM_Sec_02P_oSecuritySubnet_04f0ad2a_Tx: CanIfHthCanCtrlIdRef=CT_SecuritySubnet_f5346ae6, CanIfHthIdSymRef=CanHardwareObject_CIOM_Sec_02P_oSecuritySubnet_04f0ad2a_Tx
          CanIfHthCfg_Alarm_Sec_07S_FCM_Tp_oSecuritySubnet_94ec21d2_Tx: CanIfHthCanCtrlIdRef=CT_SecuritySubnet_f5346ae6, CanIfHthIdSymRef=CanHardwareObject_Alarm_Sec_07S_FCM_Tp_oSecuritySubnet_94ec21d2_Tx
          CanIfHthCfg_PDM_Sec_03S_FCM_Tp_oSecuritySubnet_2750bd9e_Tx: CanIfHthCanCtrlIdRef=CT_SecuritySubnet_f5346ae6, CanIfHthIdSymRef=CanHardwareObject_PDM_Sec_03S_FCM_Tp_oSecuritySubnet_2750bd9e_Tx
          CanIfHthCfg_CIOM_Sec_12S_Tp_oSecuritySubnet_2d9a0e12_Tx: CanIfHthCanCtrlIdRef=CT_SecuritySubnet_f5346ae6, CanIfHthIdSymRef=CanHardwareObject_CIOM_Sec_12S_Tp_oSecuritySubnet_2d9a0e12_Tx
          CanIfHthCfg_Alarm_Sec_06S_FCM_Tp_oSecuritySubnet_a3ee35ea_Tx: CanIfHthCanCtrlIdRef=CT_SecuritySubnet_f5346ae6, CanIfHthIdSymRef=CanHardwareObject_Alarm_Sec_06S_FCM_Tp_oSecuritySubnet_a3ee35ea_Tx
          CanIfHthCfg_CIOM_Sec_09S_Tp_oSecuritySubnet_ba09ccac_Tx: CanIfHthCanCtrlIdRef=CT_SecuritySubnet_f5346ae6, CanIfHthIdSymRef=CanHardwareObject_CIOM_Sec_09S_Tp_oSecuritySubnet_ba09ccac_Tx
          CanIfHthCfg_CIOM_Sec_04P_oSecuritySubnet_6a707225_Tx: CanIfHthCanCtrlIdRef=CT_SecuritySubnet_f5346ae6, CanIfHthIdSymRef=CanHardwareObject_CIOM_Sec_04P_oSecuritySubnet_6a707225_Tx
          CanIfHthCfg_Alarm_Sec_03S_FCM_Tp_oSecuritySubnet_48e47132_Tx: CanIfHthCanCtrlIdRef=CT_SecuritySubnet_f5346ae6, CanIfHthIdSymRef=CanHardwareObject_Alarm_Sec_03S_FCM_Tp_oSecuritySubnet_48e47132_Tx
          CanIfHthCfg_PhysDiagReqMsg_C0_F2_Sec_Tp_oSecuritySubnet_f27248ff_Tx: CanIfHthCanCtrlIdRef=CT_SecuritySubnet_f5346ae6, CanIfHthIdSymRef=CanHardwareObject_PhysDiagReqMsg_C0_F2_Sec_Tp_oSecuritySubnet_f27248ff_Tx
          CanIfHthCfg_DiagReqMsgIntTGW2_C0_F4_Sec_Tp_oSecuritySubnet_0ba24808_Tx: CanIfHthCanCtrlIdRef=CT_SecuritySubnet_f5346ae6, CanIfHthIdSymRef=CanHardwareObject_DiagReqMsgIntTGW2_C0_F4_Sec_Tp_oSecuritySubnet_0ba24808_Tx
          CanIfHthCfg_DiagReqMsgIntTGW2_A0_F4_Sec_Tp_oSecuritySubnet_8adef0bc_Tx: CanIfHthCanCtrlIdRef=CT_SecuritySubnet_f5346ae6, CanIfHthIdSymRef=CanHardwareObject_DiagReqMsgIntTGW2_A0_F4_Sec_Tp_oSecuritySubnet_8adef0bc_Tx
          CanIfHthCfg_DiagReqMsgIntHMIIOM_A1_F3_Sec_Tp_oSecuritySubnet_a1b03b66_Tx: CanIfHthCanCtrlIdRef=CT_SecuritySubnet_f5346ae6, CanIfHthIdSymRef=CanHardwareObject_DiagReqMsgIntHMIIOM_A1_F3_Sec_Tp_oSecuritySubnet_a1b03b66_Tx
          CanIfHthCfg_NmAsr_CIOM_Sec_oSecuritySubnet_dae88b7d_Tx: CanIfHthCanCtrlIdRef=CT_SecuritySubnet_f5346ae6, CanIfHthIdSymRef=CanHardwareObject_NmAsr_CIOM_Sec_oSecuritySubnet_dae88b7d_Tx
          CanIfHthCfg_PhysDiagReqMsg_A0_F2_Sec_Tp_oSecuritySubnet_cb87d97b_Tx: CanIfHthCanCtrlIdRef=CT_SecuritySubnet_f5346ae6, CanIfHthIdSymRef=CanHardwareObject_PhysDiagReqMsg_A0_F2_Sec_Tp_oSecuritySubnet_cb87d97b_Tx
          CanIfHthCfg_CIOM_Sec_05S_Tp_oSecuritySubnet_c8b553a6_Tx: CanIfHthCanCtrlIdRef=CT_SecuritySubnet_f5346ae6, CanIfHthIdSymRef=CanHardwareObject_CIOM_Sec_05S_Tp_oSecuritySubnet_c8b553a6_Tx
          CanIfHthCfg_CIOM_Sec_03P_oSecuritySubnet_4d58f6b7_Tx: CanIfHthCanCtrlIdRef=CT_SecuritySubnet_f5346ae6, CanIfHthIdSymRef=CanHardwareObject_CIOM_Sec_03P_oSecuritySubnet_4d58f6b7_Tx
          CanIfHthCfg_DDM_Sec_04S_FCM_Tp_oSecuritySubnet_eddd4cee_Tx: CanIfHthCanCtrlIdRef=CT_SecuritySubnet_f5346ae6, CanIfHthIdSymRef=CanHardwareObject_DDM_Sec_04S_FCM_Tp_oSecuritySubnet_eddd4cee_Tx
          CanIfHthCfg_DDM_Sec_05S_FCM_Tp_oSecuritySubnet_d14dc345_Tx: CanIfHthCanCtrlIdRef=CT_SecuritySubnet_f5346ae6, CanIfHthIdSymRef=CanHardwareObject_DDM_Sec_05S_FCM_Tp_oSecuritySubnet_d14dc345_Tx
          CanIfHthCfg_CIOM_Sec_07S_Tp_oSecuritySubnet_69506b1a_Tx: CanIfHthCanCtrlIdRef=CT_SecuritySubnet_f5346ae6, CanIfHthIdSymRef=CanHardwareObject_CIOM_Sec_07S_Tp_oSecuritySubnet_69506b1a_Tx
          CanIfHthCfg_DDM_Sec_03S_FCM_Tp_oSecuritySubnet_5a2ee2bf_Tx: CanIfHthCanCtrlIdRef=CT_SecuritySubnet_f5346ae6, CanIfHthIdSymRef=CanHardwareObject_DDM_Sec_03S_FCM_Tp_oSecuritySubnet_5a2ee2bf_Tx
          CanIfHthCfg_CIOM_Sec_06S_Tp_oSecuritySubnet_39a2f744_Tx: CanIfHthCanCtrlIdRef=CT_SecuritySubnet_f5346ae6, CanIfHthIdSymRef=CanHardwareObject_CIOM_Sec_06S_Tp_oSecuritySubnet_39a2f744_Tx
          CanIfHthCfg_CIOM_Sec_10S_Tp_oSecuritySubnet_8c7f36ae_Tx: CanIfHthCanCtrlIdRef=CT_SecuritySubnet_f5346ae6, CanIfHthIdSymRef=CanHardwareObject_CIOM_Sec_10S_Tp_oSecuritySubnet_8c7f36ae_Tx
          CanIfHthCfg_CIOM_Sec_08S_Tp_oSecuritySubnet_eafb50f2_Tx: CanIfHthCanCtrlIdRef=CT_SecuritySubnet_f5346ae6, CanIfHthIdSymRef=CanHardwareObject_CIOM_Sec_08S_Tp_oSecuritySubnet_eafb50f2_Tx
          CanIfHthCfg_CIOM_Sec_11S_Tp_oSecuritySubnet_dc8daaf0_Tx: CanIfHthCanCtrlIdRef=CT_SecuritySubnet_f5346ae6, CanIfHthIdSymRef=CanHardwareObject_CIOM_Sec_11S_Tp_oSecuritySubnet_dc8daaf0_Tx
          CanIfHthCfg_J1939NmTxPdu_fa509995: CanIfHthCanCtrlIdRef=CT_Backbone1J1939_198bcf1c, CanIfHthIdSymRef=CanHardwareObject_J1939NmTxPdu_fa509995
          CanIfHthCfg_CIOM_BB1_01P_oBackbone1J1939_55a00301_Tx: CanIfHthCanCtrlIdRef=CT_Backbone1J1939_198bcf1c, CanIfHthIdSymRef=CanHardwareObject_CIOM_BB1_01P_oBackbone1J1939_55a00301_Tx
          CanIfHthCfg_FcNPdu_Backbone1J1939_dba64907: CanIfHthCanCtrlIdRef=CT_Backbone1J1939_198bcf1c, CanIfHthIdSymRef=CanHardwareObject_FcNPdu_Backbone1J1939_dba64907
          CanIfHthCfg_AckmTxPdu_Backbone1J1939_54966c1b: CanIfHthCanCtrlIdRef=CT_Backbone1J1939_198bcf1c, CanIfHthIdSymRef=CanHardwareObject_AckmTxPdu_Backbone1J1939_54966c1b
          CanIfHthCfg_PTODE_X_CIOMFMS_oFMSNet_8abc23b8_Tx: CanIfHthCanCtrlIdRef=CT_FMSNet_119a8706, CanIfHthIdSymRef=CanHardwareObject_PTODE_X_CIOMFMS_oFMSNet_8abc23b8_Tx
          CanIfHthCfg_AT1T1I1_X_CIOMFMS_oFMSNet_4f6adf75_Tx: CanIfHthCanCtrlIdRef=CT_FMSNet_119a8706, CanIfHthIdSymRef=CanHardwareObject_AT1T1I1_X_CIOMFMS_oFMSNet_4f6adf75_Tx
          CanIfHthCfg_CVW_X_CIOMFMS_oFMSNet_5e9635e8_Tx: CanIfHthCanCtrlIdRef=CT_FMSNet_119a8706, CanIfHthIdSymRef=CanHardwareObject_CVW_X_CIOMFMS_oFMSNet_5e9635e8_Tx
          CanIfHthCfg_SERV_X_CIOMFMS_oFMSNet_0f3b4ff2_Tx: CanIfHthCanCtrlIdRef=CT_FMSNet_119a8706, CanIfHthIdSymRef=CanHardwareObject_SERV_X_CIOMFMS_oFMSNet_0f3b4ff2_Tx
          CanIfHthCfg_EEC1_X_CIOMFMS_oFMSNet_954d78de_Tx: CanIfHthCanCtrlIdRef=CT_FMSNet_119a8706, CanIfHthIdSymRef=CanHardwareObject_EEC1_X_CIOMFMS_oFMSNet_954d78de_Tx
          CanIfHthCfg_CL_X_CIOMFMS_oFMSNet_fc518547_Tx: CanIfHthCanCtrlIdRef=CT_FMSNet_119a8706, CanIfHthIdSymRef=CanHardwareObject_CL_X_CIOMFMS_oFMSNet_fc518547_Tx
          CanIfHthCfg_ERC1_x_EMSRetFMS_oFMSNet_d863a207_Tx: CanIfHthCanCtrlIdRef=CT_FMSNet_119a8706, CanIfHthIdSymRef=CanHardwareObject_ERC1_x_EMSRetFMS_oFMSNet_d863a207_Tx
          CanIfHthCfg_HRLFC_X_CIOMFMS_oFMSNet_c55a7a2b_Tx: CanIfHthCanCtrlIdRef=CT_FMSNet_119a8706, CanIfHthIdSymRef=CanHardwareObject_HRLFC_X_CIOMFMS_oFMSNet_c55a7a2b_Tx
          CanIfHthCfg_DD_X_CIOMFMS_oFMSNet_95f62c09_Tx: CanIfHthCanCtrlIdRef=CT_FMSNet_119a8706, CanIfHthIdSymRef=CanHardwareObject_DD_X_CIOMFMS_oFMSNet_95f62c09_Tx
          CanIfHthCfg_TPDT_Tp_oFMSNet_3018618a_Tx: CanIfHthCanCtrlIdRef=CT_FMSNet_119a8706, CanIfHthIdSymRef=CanHardwareObject_TPDT_Tp_oFMSNet_3018618a_Tx
          CanIfHthCfg_FMS_X_CIOMFMS_oFMSNet_68f86b37_Tx: CanIfHthCanCtrlIdRef=CT_FMSNet_119a8706, CanIfHthIdSymRef=CanHardwareObject_FMS_X_CIOMFMS_oFMSNet_68f86b37_Tx
          CanIfHthCfg_AckmTxPdu_FMSNet_J1939_44d89c3b: CanIfHthCanCtrlIdRef=CT_FMSNet_119a8706, CanIfHthIdSymRef=CanHardwareObject_AckmTxPdu_FMSNet_J1939_44d89c3b
          CanIfHthCfg_VDHR_X_CIOMFMS_oFMSNet_67a02fb8_Tx: CanIfHthCanCtrlIdRef=CT_FMSNet_119a8706, CanIfHthIdSymRef=CanHardwareObject_VDHR_X_CIOMFMS_oFMSNet_67a02fb8_Tx
          CanIfHthCfg_LFC_X_CIOMFMS_oFMSNet_16e703d3_Tx: CanIfHthCanCtrlIdRef=CT_FMSNet_119a8706, CanIfHthIdSymRef=CanHardwareObject_LFC_X_CIOMFMS_oFMSNet_16e703d3_Tx
          CanIfHthCfg_ET1_X_CIOMFMS_oFMSNet_ff39068f_Tx: CanIfHthCanCtrlIdRef=CT_FMSNet_119a8706, CanIfHthIdSymRef=CanHardwareObject_ET1_X_CIOMFMS_oFMSNet_ff39068f_Tx
          CanIfHthCfg_LFE_X_CIOMFMS_oFMSNet_adac24c8_Tx: CanIfHthCanCtrlIdRef=CT_FMSNet_119a8706, CanIfHthIdSymRef=CanHardwareObject_LFE_X_CIOMFMS_oFMSNet_adac24c8_Tx
          CanIfHthCfg_FMS1_X_CIOMFMS_oFMSNet_fb3c9fbd_Tx: CanIfHthCanCtrlIdRef=CT_FMSNet_119a8706, CanIfHthIdSymRef=CanHardwareObject_FMS1_X_CIOMFMS_oFMSNet_fb3c9fbd_Tx
          CanIfHthCfg_EEC14_X_CIOMFMS_oFMSNet_3551b912_Tx: CanIfHthCanCtrlIdRef=CT_FMSNet_119a8706, CanIfHthIdSymRef=CanHardwareObject_EEC14_X_CIOMFMS_oFMSNet_3551b912_Tx
          CanIfHthCfg_TPDirect_0FE6B_Tp_oFMSNet_5c137171_Tx: CanIfHthCanCtrlIdRef=CT_FMSNet_119a8706, CanIfHthIdSymRef=CanHardwareObject_TPDirect_0FE6B_Tp_oFMSNet_5c137171_Tx
          CanIfHthCfg_AIR1_X_CIOMFMS_oFMSNet_9b1ec537_Tx: CanIfHthCanCtrlIdRef=CT_FMSNet_119a8706, CanIfHthIdSymRef=CanHardwareObject_AIR1_X_CIOMFMS_oFMSNet_9b1ec537_Tx
          CanIfHthCfg_EEC2_X_CIOMFMS_oFMSNet_d3e60e6a_Tx: CanIfHthCanCtrlIdRef=CT_FMSNet_119a8706, CanIfHthIdSymRef=CanHardwareObject_EEC2_X_CIOMFMS_oFMSNet_d3e60e6a_Tx
          CanIfHthCfg_TCO1_X_CIOMFMS_oFMSNet_567baf3d_Tx: CanIfHthCanCtrlIdRef=CT_FMSNet_119a8706, CanIfHthIdSymRef=CanHardwareObject_TCO1_X_CIOMFMS_oFMSNet_567baf3d_Tx
          CanIfHthCfg_J1939NmTxPdu_2068bfea: CanIfHthCanCtrlIdRef=CT_FMSNet_119a8706, CanIfHthIdSymRef=CanHardwareObject_J1939NmTxPdu_2068bfea
          CanIfHthCfg_ERC1_x_RECUFMS_oFMSNet_338e7918_Tx: CanIfHthCanCtrlIdRef=CT_FMSNet_119a8706, CanIfHthIdSymRef=CanHardwareObject_ERC1_x_RECUFMS_oFMSNet_338e7918_Tx
          CanIfHthCfg_VP236_X_CIOMFMS_oFMSNet_524bf569_Tx: CanIfHthCanCtrlIdRef=CT_FMSNet_119a8706, CanIfHthIdSymRef=CanHardwareObject_VP236_X_CIOMFMS_oFMSNet_524bf569_Tx
          CanIfHthCfg_TPCM_Tp_oFMSNet_55e2f930_Tx: CanIfHthCanCtrlIdRef=CT_FMSNet_119a8706, CanIfHthIdSymRef=CanHardwareObject_TPCM_Tp_oFMSNet_55e2f930_Tx
          CanIfHthCfg_HOURS_X_CIOMFMS_oFMSNet_bfc991fc_Tx: CanIfHthCanCtrlIdRef=CT_FMSNet_119a8706, CanIfHthIdSymRef=CanHardwareObject_HOURS_X_CIOMFMS_oFMSNet_bfc991fc_Tx
          CanIfHthCfg_VW_X_CIOMFMS_oFMSNet_06d77621_Tx: CanIfHthCanCtrlIdRef=CT_FMSNet_119a8706, CanIfHthIdSymRef=CanHardwareObject_VW_X_CIOMFMS_oFMSNet_06d77621_Tx
          CanIfHthCfg_CCVS_X_CIOMFMS_oFMSNet_1dbcfa70_Tx: CanIfHthCanCtrlIdRef=CT_FMSNet_119a8706, CanIfHthIdSymRef=CanHardwareObject_CCVS_X_CIOMFMS_oFMSNet_1dbcfa70_Tx
          CanIfHthCfg_AMB_X_CIOMFMS_oFMSNet_f6109b97_Tx: CanIfHthCanCtrlIdRef=CT_FMSNet_119a8706, CanIfHthIdSymRef=CanHardwareObject_AMB_X_CIOMFMS_oFMSNet_f6109b97_Tx
          CanIfHthCfg_CIOM_Cab_22P_oCabSubnet_698a9fe8_Tx: CanIfHthCanCtrlIdRef=CT_CabSubnet_d2ff0fbe, CanIfHthIdSymRef=CanHardwareObject_CIOM_Cab_22P_oCabSubnet_698a9fe8_Tx
          CanIfHthCfg_IntTesterTGW2FuncDiagMsg_Cab_Tp_oCabSubnet_96ec8334_Tx: CanIfHthCanCtrlIdRef=CT_CabSubnet_d2ff0fbe, CanIfHthIdSymRef=CanHardwareObject_IntTesterTGW2FuncDiagMsg_Cab_Tp_oCabSubnet_96ec8334_Tx
          CanIfHthCfg_CIOM_Cab_26P_oCabSubnet_2df59da9_Tx: CanIfHthCanCtrlIdRef=CT_CabSubnet_d2ff0fbe, CanIfHthIdSymRef=CanHardwareObject_CIOM_Cab_26P_oCabSubnet_2df59da9_Tx
          CanIfHthCfg_PhysDiagReqMsg_A2_F2_Cab_Tp_oCabSubnet_6d74e481_Tx: CanIfHthCanCtrlIdRef=CT_CabSubnet_d2ff0fbe, CanIfHthIdSymRef=CanHardwareObject_PhysDiagReqMsg_A2_F2_Cab_Tp_oCabSubnet_6d74e481_Tx
          CanIfHthCfg_CIOM_Cab_15P_oCabSubnet_85195a2a_Tx: CanIfHthCanCtrlIdRef=CT_CabSubnet_d2ff0fbe, CanIfHthIdSymRef=CanHardwareObject_CIOM_Cab_15P_oCabSubnet_85195a2a_Tx
          CanIfHthCfg_CIOM_Cab_11S_Tp_oCabSubnet_ec1435f4_Tx: CanIfHthCanCtrlIdRef=CT_CabSubnet_d2ff0fbe, CanIfHthIdSymRef=CanHardwareObject_CIOM_Cab_11S_Tp_oCabSubnet_ec1435f4_Tx
          CanIfHthCfg_CIOM_Cab_28S_oCabSubnet_0dafccc7_Tx: CanIfHthCanCtrlIdRef=CT_CabSubnet_d2ff0fbe, CanIfHthIdSymRef=CanHardwareObject_CIOM_Cab_28S_oCabSubnet_0dafccc7_Tx
          CanIfHthCfg_CIOM_Cab_21P_oCabSubnet_c1ce1ce8_Tx: CanIfHthCanCtrlIdRef=CT_CabSubnet_d2ff0fbe, CanIfHthIdSymRef=CanHardwareObject_CIOM_Cab_21P_oCabSubnet_c1ce1ce8_Tx
          CanIfHthCfg_CIOM_Cab_17P_oCabSubnet_4a9e582a_Tx: CanIfHthCanCtrlIdRef=CT_CabSubnet_d2ff0fbe, CanIfHthIdSymRef=CanHardwareObject_CIOM_Cab_17P_oCabSubnet_4a9e582a_Tx
          CanIfHthCfg_CIOM_Cab_33P_oCabSubnet_0e2edd69_Tx: CanIfHthCanCtrlIdRef=CT_CabSubnet_d2ff0fbe, CanIfHthIdSymRef=CanHardwareObject_CIOM_Cab_33P_oCabSubnet_0e2edd69_Tx
          CanIfHthCfg_DiagReqMsgIntTGW2_53_F4_Cab_Tp_oCabSubnet_75ef26c1_Tx: CanIfHthCanCtrlIdRef=CT_CabSubnet_d2ff0fbe, CanIfHthIdSymRef=CanHardwareObject_DiagReqMsgIntTGW2_53_F4_Cab_Tp_oCabSubnet_75ef26c1_Tx
          CanIfHthCfg_CIOM_Cab_04S_Tp_oCabSubnet_e3ca2569_Tx: CanIfHthCanCtrlIdRef=CT_CabSubnet_d2ff0fbe, CanIfHthIdSymRef=CanHardwareObject_CIOM_Cab_04S_Tp_oCabSubnet_e3ca2569_Tx
          CanIfHthCfg_DiagReqMsgIntHMIIOM_26_F3_Cab_Tp_oCabSubnet_2e1f9ada_Tx: CanIfHthCanCtrlIdRef=CT_CabSubnet_d2ff0fbe, CanIfHthIdSymRef=CanHardwareObject_DiagReqMsgIntHMIIOM_26_F3_Cab_Tp_oCabSubnet_2e1f9ada_Tx
          CanIfHthCfg_CIOM_Cab_07P_oCabSubnet_4af99bab_Tx: CanIfHthCanCtrlIdRef=CT_CabSubnet_d2ff0fbe, CanIfHthIdSymRef=CanHardwareObject_CIOM_Cab_07P_oCabSubnet_4af99bab_Tx
          CanIfHthCfg_DiagReqMsgIntHMIIOM_A2_F3_Cab_Tp_oCabSubnet_fcbc8d7d_Tx: CanIfHthCanCtrlIdRef=CT_CabSubnet_d2ff0fbe, CanIfHthIdSymRef=CanHardwareObject_DiagReqMsgIntHMIIOM_A2_F3_Cab_Tp_oCabSubnet_fcbc8d7d_Tx
          CanIfHthCfg_CIOM_Cab_10P_oCabSubnet_a6a5d96b_Tx: CanIfHthCanCtrlIdRef=CT_CabSubnet_d2ff0fbe, CanIfHthIdSymRef=CanHardwareObject_CIOM_Cab_10P_oCabSubnet_a6a5d96b_Tx
          CanIfHthCfg_CIOM_Cab_25S_Tp_oCabSubnet_d5957759_Tx: CanIfHthCanCtrlIdRef=CT_CabSubnet_d2ff0fbe, CanIfHthIdSymRef=CanHardwareObject_CIOM_Cab_25S_Tp_oCabSubnet_d5957759_Tx
          CanIfHthCfg_CIOM_Cab_12P_oCabSubnet_6922db6b_Tx: CanIfHthCanCtrlIdRef=CT_CabSubnet_d2ff0fbe, CanIfHthIdSymRef=CanHardwareObject_CIOM_Cab_12P_oCabSubnet_6922db6b_Tx
          CanIfHthCfg_NmAsr_CIOM_Cab_oCabSubnet_153d3c7d_Tx: CanIfHthCanCtrlIdRef=CT_CabSubnet_d2ff0fbe, CanIfHthIdSymRef=CanHardwareObject_NmAsr_CIOM_Cab_oCabSubnet_153d3c7d_Tx
          CanIfHthCfg_CIOM_Cab_32P_oCabSubnet_69ed5c69_Tx: CanIfHthCanCtrlIdRef=CT_CabSubnet_d2ff0fbe, CanIfHthIdSymRef=CanHardwareObject_CIOM_Cab_32P_oCabSubnet_69ed5c69_Tx
          CanIfHthCfg_CIOM_Cab_18P_oCabSubnet_2e5bdde9_Tx: CanIfHthCanCtrlIdRef=CT_CabSubnet_d2ff0fbe, CanIfHthIdSymRef=CanHardwareObject_CIOM_Cab_18P_oCabSubnet_2e5bdde9_Tx
          CanIfHthCfg_PhysDiagReqMsg_98_F2_Cab_Tp_oCabSubnet_4c51814f_Tx: CanIfHthCanCtrlIdRef=CT_CabSubnet_d2ff0fbe, CanIfHthIdSymRef=CanHardwareObject_PhysDiagReqMsg_98_F2_Cab_Tp_oCabSubnet_4c51814f_Tx
          CanIfHthCfg_CIOM_Cab_09P_oCabSubnet_49ff9f68_Tx: CanIfHthCanCtrlIdRef=CT_CabSubnet_d2ff0fbe, CanIfHthIdSymRef=CanHardwareObject_CIOM_Cab_09P_oCabSubnet_49ff9f68_Tx
          CanIfHthCfg_DiagReqMsgIntTGW2_26_F4_Cab_Tp_oCabSubnet_b42402a4_Tx: CanIfHthCanCtrlIdRef=CT_CabSubnet_d2ff0fbe, CanIfHthIdSymRef=CanHardwareObject_DiagReqMsgIntTGW2_26_F4_Cab_Tp_oCabSubnet_b42402a4_Tx
          CanIfHthCfg_CIOM_Cab_05S_Tp_oCabSubnet_e74407ff_Tx: CanIfHthCanCtrlIdRef=CT_CabSubnet_d2ff0fbe, CanIfHthIdSymRef=CanHardwareObject_CIOM_Cab_05S_Tp_oCabSubnet_e74407ff_Tx
          CanIfHthCfg_DiagReqMsgIntTGW2_A2_F4_Cab_Tp_oCabSubnet_fc611706_Tx: CanIfHthCanCtrlIdRef=CT_CabSubnet_d2ff0fbe, CanIfHthIdSymRef=CanHardwareObject_DiagReqMsgIntTGW2_A2_F4_Cab_Tp_oCabSubnet_fc611706_Tx
          CanIfHthCfg_CIOM_Cab_08P_oCabSubnet_2e3c1e68_Tx: CanIfHthCanCtrlIdRef=CT_CabSubnet_d2ff0fbe, CanIfHthIdSymRef=CanHardwareObject_CIOM_Cab_08P_oCabSubnet_2e3c1e68_Tx
          CanIfHthCfg_DiagReqMsgIntHMIIOM_98_F3_Cab_Tp_oCabSubnet_2daafb4e_Tx: CanIfHthCanCtrlIdRef=CT_CabSubnet_d2ff0fbe, CanIfHthIdSymRef=CanHardwareObject_DiagReqMsgIntHMIIOM_98_F3_Cab_Tp_oCabSubnet_2daafb4e_Tx
          CanIfHthCfg_CIOM_Cab_24P_oCabSubnet_e2729fa9_Tx: CanIfHthCanCtrlIdRef=CT_CabSubnet_d2ff0fbe, CanIfHthIdSymRef=CanHardwareObject_CIOM_Cab_24P_oCabSubnet_e2729fa9_Tx
          CanIfHthCfg_CIOM_Cab_30S_Tp_oCabSubnet_da4b67c4_Tx: CanIfHthCanCtrlIdRef=CT_CabSubnet_d2ff0fbe, CanIfHthIdSymRef=CanHardwareObject_CIOM_Cab_30S_Tp_oCabSubnet_da4b67c4_Tx
          CanIfHthCfg_CIOM_Cab_13S_Tp_oCabSubnet_e50870d8_Tx: CanIfHthCanCtrlIdRef=CT_CabSubnet_d2ff0fbe, CanIfHthIdSymRef=CanHardwareObject_CIOM_Cab_13S_Tp_oCabSubnet_e50870d8_Tx
          CanIfHthCfg_CIOM_Cab_19P_oCabSubnet_49985ce9_Tx: CanIfHthCanCtrlIdRef=CT_CabSubnet_d2ff0fbe, CanIfHthIdSymRef=CanHardwareObject_CIOM_Cab_19P_oCabSubnet_49985ce9_Tx
          CanIfHthCfg_CIOM_Cab_01P_oCabSubnet_c1019bea_Tx: CanIfHthCanCtrlIdRef=CT_CabSubnet_d2ff0fbe, CanIfHthIdSymRef=CanHardwareObject_CIOM_Cab_01P_oCabSubnet_c1019bea_Tx
          CanIfHthCfg_CIOM_Cab_34P_Tp_oCabSubnet_377e6916_Tx: CanIfHthCanCtrlIdRef=CT_CabSubnet_d2ff0fbe, CanIfHthIdSymRef=CanHardwareObject_CIOM_Cab_34P_Tp_oCabSubnet_377e6916_Tx
          CanIfHthCfg_CIOM_Cab_02P_oCabSubnet_694518ea_Tx: CanIfHthCanCtrlIdRef=CT_CabSubnet_d2ff0fbe, CanIfHthIdSymRef=CanHardwareObject_CIOM_Cab_02P_oCabSubnet_694518ea_Tx
          CanIfHthCfg_PhysDiagReqMsg_53_F2_Cab_Tp_oCabSubnet_9abe6f67_Tx: CanIfHthCanCtrlIdRef=CT_CabSubnet_d2ff0fbe, CanIfHthIdSymRef=CanHardwareObject_PhysDiagReqMsg_53_F2_Cab_Tp_oCabSubnet_9abe6f67_Tx
          CanIfHthCfg_CIOM_Cab_27P_oCabSubnet_4a361ca9_Tx: CanIfHthCanCtrlIdRef=CT_CabSubnet_d2ff0fbe, CanIfHthIdSymRef=CanHardwareObject_CIOM_Cab_27P_oCabSubnet_4a361ca9_Tx
          CanIfHthCfg_AnmMsg_CIOM_CabSubnet_oCabSubnet_e295c8bd_Tx: CanIfHthCanCtrlIdRef=CT_CabSubnet_d2ff0fbe, CanIfHthIdSymRef=CanHardwareObject_AnmMsg_CIOM_CabSubnet_oCabSubnet_e295c8bd_Tx
          CanIfHthCfg_CIOM_Cab_06P_oCabSubnet_2d3a1aab_Tx: CanIfHthCanCtrlIdRef=CT_CabSubnet_d2ff0fbe, CanIfHthIdSymRef=CanHardwareObject_CIOM_Cab_06P_oCabSubnet_2d3a1aab_Tx
          CanIfHthCfg_TesterFuncDiagMsg_Cab_Tp_oCabSubnet_d293ecaa_Tx: CanIfHthCanCtrlIdRef=CT_CabSubnet_d2ff0fbe, CanIfHthIdSymRef=CanHardwareObject_TesterFuncDiagMsg_Cab_Tp_oCabSubnet_d293ecaa_Tx
          CanIfHthCfg_CIOM_Cab_31P_oCabSubnet_c1a9df69_Tx: CanIfHthCanCtrlIdRef=CT_CabSubnet_d2ff0fbe, CanIfHthIdSymRef=CanHardwareObject_CIOM_Cab_31P_oCabSubnet_c1a9df69_Tx
          CanIfHthCfg_DiagReqMsgIntTGW2_98_F4_Cab_Tp_oCabSubnet_2e8c3543_Tx: CanIfHthCanCtrlIdRef=CT_CabSubnet_d2ff0fbe, CanIfHthIdSymRef=CanHardwareObject_DiagReqMsgIntTGW2_98_F4_Cab_Tp_oCabSubnet_2e8c3543_Tx
          CanIfHthCfg_CIOM_Cab_23P_oCabSubnet_0e491ee8_Tx: CanIfHthCanCtrlIdRef=CT_CabSubnet_d2ff0fbe, CanIfHthIdSymRef=CanHardwareObject_CIOM_Cab_23P_oCabSubnet_0e491ee8_Tx
          CanIfHthCfg_CIOM_Cab_14P_oCabSubnet_e2dadb2a_Tx: CanIfHthCanCtrlIdRef=CT_CabSubnet_d2ff0fbe, CanIfHthIdSymRef=CanHardwareObject_CIOM_Cab_14P_oCabSubnet_e2dadb2a_Tx
          CanIfHthCfg_PhysDiagReqMsg_53_F1_Cab_Tp_oCabSubnet_682570ce_Tx: CanIfHthCanCtrlIdRef=CT_CabSubnet_d2ff0fbe, CanIfHthIdSymRef=CanHardwareObject_PhysDiagReqMsg_53_F1_Cab_Tp_oCabSubnet_682570ce_Tx
          CanIfHthCfg_CIOM_Cab_20S_Tp_oCabSubnet_c323df97_Tx: CanIfHthCanCtrlIdRef=CT_CabSubnet_d2ff0fbe, CanIfHthIdSymRef=CanHardwareObject_CIOM_Cab_20S_Tp_oCabSubnet_c323df97_Tx
          CanIfHthCfg_CCM_Cab_03P_FCM_Tp_oCabSubnet_af75b436_Tx: CanIfHthCanCtrlIdRef=CT_CabSubnet_d2ff0fbe, CanIfHthIdSymRef=CanHardwareObject_CCM_Cab_03P_FCM_Tp_oCabSubnet_af75b436_Tx
          CanIfHthCfg_CIOM_Cab_16P_oCabSubnet_2d5dd92a_Tx: CanIfHthCanCtrlIdRef=CT_CabSubnet_d2ff0fbe, CanIfHthIdSymRef=CanHardwareObject_CIOM_Cab_16P_oCabSubnet_2d5dd92a_Tx
          CanIfHthCfg_DiagReqMsgIntHMIIOM_53_F3_Cab_Tp_oCabSubnet_e9059d48_Tx: CanIfHthCanCtrlIdRef=CT_CabSubnet_d2ff0fbe, CanIfHthIdSymRef=CanHardwareObject_DiagReqMsgIntHMIIOM_53_F3_Cab_Tp_oCabSubnet_e9059d48_Tx
          CanIfHthCfg_CIOM_Cab_29S_Tp_oCabSubnet_e3dce9b1_Tx: CanIfHthCanCtrlIdRef=CT_CabSubnet_d2ff0fbe, CanIfHthIdSymRef=CanHardwareObject_CIOM_Cab_29S_Tp_oCabSubnet_e3dce9b1_Tx
          CanIfHthCfg_PhysDiagReqMsg_26_F2_Cab_Tp_oCabSubnet_e2a6386f_Tx: CanIfHthCanCtrlIdRef=CT_CabSubnet_d2ff0fbe, CanIfHthIdSymRef=CanHardwareObject_PhysDiagReqMsg_26_F2_Cab_Tp_oCabSubnet_e2a6386f_Tx
          CanIfHthCfg_CIOM_Cab_03P_oCabSubnet_0e8699ea_Tx: CanIfHthCanCtrlIdRef=CT_CabSubnet_d2ff0fbe, CanIfHthIdSymRef=CanHardwareObject_CIOM_Cab_03P_oCabSubnet_0e8699ea_Tx
          CanIfHthCfg_NmAsr_CIOM_BB2_oBackbone2_9b0338b4_Tx: CanIfHthCanCtrlIdRef=CT_Backbone2_34cfe263, CanIfHthIdSymRef=CanHardwareObject_NmAsr_CIOM_BB2_oBackbone2_9b0338b4_Tx
          CanIfHthCfg_CIOM_BB2_29P_oBackbone2_bfae97b8_Tx: CanIfHthCanCtrlIdRef=CT_Backbone2_34cfe263, CanIfHthIdSymRef=CanHardwareObject_CIOM_BB2_29P_oBackbone2_bfae97b8_Tx
        CanIfHrhCfg_DebugCtrl2_SCIM_BB2_oBackbone2_57e784a1_Rx (CanIfHrhCfg):
          CanIfHrhSoftwareFilter = false
          CanIfHrhCanCtrlIdRef = CT_Backbone2_34cfe263
          CanIfHrhIdSymRef = CanHardwareObject_DebugCtrl2_SCIM_BB2_oBackbone2_57e784a1_Rx
        CanIfHrhCfg_DebugCtrl1_SCIM_BB2_oBackbone2_139697c4_Rx (CanIfHrhCfg):
          CanIfHrhSoftwareFilter = false
          CanIfHrhCanCtrlIdRef = CT_Backbone2_34cfe263
          CanIfHrhIdSymRef = CanHardwareObject_DebugCtrl1_SCIM_BB2_oBackbone2_139697c4_Rx
        4 x CanIfHthCfg:
          CN_CabSubnet_9ea693f1_Tx: CanIfHthCanCtrlIdRef=CT_CabSubnet_d2ff0fbe, CanIfHthIdSymRef=CN_CabSubnet_9ea693f1_Tx
          CN_FMSNet_fce1aae5_Tx: CanIfHthCanCtrlIdRef=CT_FMSNet_119a8706, CanIfHthIdSymRef=CN_FMSNet_fce1aae5_Tx
          CN_Backbone1J1939_0b1f4bae_Tx: CanIfHthCanCtrlIdRef=CT_Backbone1J1939_198bcf1c, CanIfHthIdSymRef=CN_Backbone1J1939_0b1f4bae_Tx
          CN_SecuritySubnet_e7a0ee54_Tx: CanIfHthCanCtrlIdRef=CT_SecuritySubnet_f5346ae6, CanIfHthIdSymRef=CN_SecuritySubnet_e7a0ee54_Tx
        7 x CanIfHrhCfg, all with CanIfHrhSoftwareFilter=false, CanIfHrhCanCtrlIdRef=CT_Backbone2_34cfe263:
          CanIfHrhCfg_DebugCtrl3_SCIM_BB2_oBackbone2_dd1877bd_Rx: CanIfHrhIdSymRef=CanHardwareObject_DebugCtrl3_SCIM_BB2_oBackbone2_dd1877bd_Rx
          CanIfHrhCfg_DebugCtrl4_SCIM_BB2_oBackbone2_df05a26b_Rx: CanIfHrhIdSymRef=CanHardwareObject_DebugCtrl4_SCIM_BB2_oBackbone2_df05a26b_Rx
          CanIfHrhCfg_DebugCtrl5_SCIM_BB2_oBackbone2_55fa5177_Rx: CanIfHrhIdSymRef=CanHardwareObject_DebugCtrl5_SCIM_BB2_oBackbone2_55fa5177_Rx
          CanIfHrhCfg_DebugCtrl6_SCIM_BB2_oBackbone2_118b4212_Rx: CanIfHrhIdSymRef=CanHardwareObject_DebugCtrl6_SCIM_BB2_oBackbone2_118b4212_Rx
          CanIfHrhCfg_DebugCtrl7_SCIM_BB2_oBackbone2_9b74b10e_Rx: CanIfHrhIdSymRef=CanHardwareObject_DebugCtrl7_SCIM_BB2_oBackbone2_9b74b10e_Rx
          CanIfHrhCfg_DebugCtrl8_SCIM_BB2_oBackbone2_15b0e9be_Rx: CanIfHrhIdSymRef=CanHardwareObject_DebugCtrl8_SCIM_BB2_oBackbone2_15b0e9be_Rx
          CanIfHrhCfg_DebugCtrl9_SCIM_BB2_oBackbone2_9f4f1aa2_Rx: CanIfHrhIdSymRef=CanHardwareObject_DebugCtrl9_SCIM_BB2_oBackbone2_9f4f1aa2_Rx
      18 x CanIfRxPduCfg, all with CanIfRxPduCanIdType=EXTENDED_CAN, CanIfRxPduReadData=false, CanIfRxPduReadNotifyStatus=false, CanIfRxPduDlcCheck=true, CanIfRxPduHrhIdRef=CN_Backbone1J1939_6e8ec372_Rx:
        VMCU_BB1_03P_oBackbone1J1939_51c30ef7_Rx: CanIfRxPduCanId=419413777, CanIfRxPduCanIdMask=67108863, CanIfRxPduDlc=8, CanIfRxPduUserRxIndicationName=PduR_CanIfRxIndication, CanIfRxPduUserRxIndicationUL=PDUR, CanIfRxPduId=16, CanIfRxPduRef=VMCU_BB1_03P_oBackbone1J1939_eacbdc5a_Rx
        TPDirect_0FE6B_Tp_oBackbone1J1939_e14130fb_Rx: CanIfRxPduCanId=419326974, CanIfRxPduCanIdMask=67108608, CanIfRxPduDlc=8, CanIfRxPduUserRxIndicationName=J1939Tp_RxIndication, CanIfRxPduUserRxIndicationUL=J1939TP, CanIfRxPduId=3, CanIfRxPduRef=TPDirect_0FE6B_Tp_oBackbone1J1939_71559532_Rx
        ACM_BB1_01P_oBackbone1J1939_9e50bfac_Rx: CanIfRxPduCanId=419408445, CanIfRxPduCanIdMask=67108863, CanIfRxPduDlc=8, CanIfRxPduUserRxIndicationName=PduR_CanIfRxIndication, CanIfRxPduUserRxIndicationUL=PDUR, CanIfRxPduId=17, CanIfRxPduRef=ACM_BB1_01P_oBackbone1J1939_b0278a49_Rx
        TCO1_X_TACHO_oBackbone1J1939_884a7499_Rx: CanIfRxPduCanId=218000622, CanIfRxPduCanIdMask=67108863, CanIfRxPduDlc=8, CanIfRxPduUserRxIndicationName=PduR_CanIfRxIndication, CanIfRxPduUserRxIndicationUL=PDUR, CanIfRxPduId=18, CanIfRxPduRef=TCO1_X_TACHO_oBackbone1J1939_3f1c366d_Rx
        VDC1_X_EBS_oBackbone1J1939_09820bff_Rx: CanIfRxPduCanId=419319563, CanIfRxPduCanIdMask=67108863, CanIfRxPduDlc=8, CanIfRxPduUserRxIndicationName=PduR_CanIfRxIndication, CanIfRxPduUserRxIndicationUL=PDUR, CanIfRxPduId=19, CanIfRxPduRef=VDC1_X_EBS_oBackbone1J1939_e351e41c_Rx
        ERC1_X_RECU_oBackbone1J1939_3104dca7_Rx: CanIfRxPduCanId=418381840, CanIfRxPduCanIdMask=67108863, CanIfRxPduDlc=8, CanIfRxPduUserRxIndicationName=PduR_CanIfRxIndication, CanIfRxPduUserRxIndicationUL=PDUR, CanIfRxPduId=20, CanIfRxPduRef=ERC1_X_RECU_oBackbone1J1939_d09c878a_Rx
        VDC2_X_EBS_oBackbone1J1939_e250e643_Rx: CanIfRxPduCanId=217057547, CanIfRxPduCanIdMask=67108863, CanIfRxPduDlc=8, CanIfRxPduUserRxIndicationName=PduR_CanIfRxIndication, CanIfRxPduUserRxIndicationUL=PDUR, CanIfRxPduId=21, CanIfRxPduRef=VDC2_X_EBS_oBackbone1J1939_58daf9b3_Rx
        ERC1_X_EMSRet_oBackbone1J1939_35cada34_Rx: CanIfRxPduCanId=418381839, CanIfRxPduCanIdMask=67108863, CanIfRxPduDlc=8, CanIfRxPduUserRxIndicationName=PduR_CanIfRxIndication, CanIfRxPduUserRxIndicationUL=PDUR, CanIfRxPduId=22, CanIfRxPduRef=ERC1_X_EMSRet_oBackbone1J1939_63f95975_Rx
        EBS_BB1_02P_oBackbone1J1939_b875028c_Rx: CanIfRxPduCanId=352278027, CanIfRxPduCanIdMask=67108863, CanIfRxPduDlc=8, CanIfRxPduUserRxIndicationName=PduR_CanIfRxIndication, CanIfRxPduUserRxIndicationUL=PDUR, CanIfRxPduId=23, CanIfRxPduRef=EBS_BB1_02P_oBackbone1J1939_3e5e858e_Rx
        EEC2_X_EMS_oBackbone1J1939_b0cfb70f_Rx: CanIfRxPduCanId=217056000, CanIfRxPduCanIdMask=67108863, CanIfRxPduDlc=8, CanIfRxPduUserRxIndicationName=PduR_CanIfRxIndication, CanIfRxPduUserRxIndicationUL=PDUR, CanIfRxPduId=24, CanIfRxPduRef=EEC2_X_EMS_oBackbone1J1939_7659ee10_Rx
        EBC1_X_EBS_oBackbone1J1939_aabe659c_Rx: CanIfRxPduCanId=418382091, CanIfRxPduCanIdMask=67108863, CanIfRxPduDlc=8, CanIfRxPduUserRxIndicationName=PduR_CanIfRxIndication, CanIfRxPduUserRxIndicationUL=PDUR, CanIfRxPduId=25, CanIfRxPduRef=EBC1_X_EBS_oBackbone1J1939_0f6d94fb_Rx
        AMB_X_VMCU_oBackbone1J1939_d5496e9a_Rx: CanIfRxPduCanId=419362065, CanIfRxPduCanIdMask=67108863, CanIfRxPduDlc=8, CanIfRxPduUserRxIndicationName=PduR_CanIfRxIndication, CanIfRxPduUserRxIndicationUL=PDUR, CanIfRxPduId=26, CanIfRxPduRef=AMB_X_VMCU_oBackbone1J1939_52549913_Rx
        AIR1_X_VMCU_oBackbone1J1939_30174316_Rx: CanIfRxPduCanId=419343889, CanIfRxPduCanIdMask=67108863, CanIfRxPduDlc=8, CanIfRxPduUserRxIndicationName=PduR_CanIfRxIndication, CanIfRxPduUserRxIndicationUL=PDUR, CanIfRxPduId=27, CanIfRxPduRef=AIR1_X_VMCU_oBackbone1J1939_276eaeb8_Rx
        FMS1_X_HMIIOM_oBackbone1J1939_f8c70f73_Rx: CanIfRxPduCanId=419265815, CanIfRxPduCanIdMask=67108863, CanIfRxPduDlc=8, CanIfRxPduUserRxIndicationName=PduR_CanIfRxIndication, CanIfRxPduUserRxIndicationUL=PDUR, CanIfRxPduId=28, CanIfRxPduRef=FMS1_X_HMIIOM_oBackbone1J1939_496422f1_Rx
        TPDT_Tp_oBackbone1J1939_7785b746_Rx: CanIfRxPduCanId=485228286, CanIfRxPduCanIdMask=67043328, CanIfRxPduDlc=8, CanIfRxPduUserRxIndicationName=J1939Tp_RxIndication, CanIfRxPduUserRxIndicationUL=J1939TP, CanIfRxPduId=1, CanIfRxPduRef=TPDT_Tp_oBackbone1J1939_005f683d_Rx
        EBC2_X_EBS_oBackbone1J1939_416c8820_Rx: CanIfRxPduCanId=419348235, CanIfRxPduCanIdMask=67108863, CanIfRxPduDlc=8, CanIfRxPduUserRxIndicationName=PduR_CanIfRxIndication, CanIfRxPduUserRxIndicationUL=PDUR, CanIfRxPduId=29, CanIfRxPduRef=EBC2_X_EBS_oBackbone1J1939_b4e68954_Rx
        CCVS_X_VMCU_oBackbone1J1939_d16316a3_Rx: CanIfRxPduCanId=419361041, CanIfRxPduCanIdMask=67108863, CanIfRxPduDlc=8, CanIfRxPduUserRxIndicationName=PduR_CanIfRxIndication, CanIfRxPduUserRxIndicationUL=PDUR, CanIfRxPduId=30, CanIfRxPduRef=CCVS_X_VMCU_oBackbone1J1939_dd344e88_Rx
        RqstRxPdu_Backbone1J1939_54966c1b: CanIfRxPduDlc=3, CanIfRxPduId=2, CanIfRxPduUserRxIndicationName=PduR_CanIfRxIndication, CanIfRxPduUserRxIndicationUL=PDUR, CanIfRxPduCanId=15335424, CanIfRxPduCanIdMask=67043328, CanIfRxPduRef=RqstRxPdu_Backbone1J1939_54966c1b
      AckmTxPdu_Backbone1J1939_54966c1b (CanIfTxPduCfg):
        CanIfTxPduCanId = 15204352
        CanIfTxPduCanIdType = EXTENDED_CAN
        CanIfTxPduDlc = 8
        CanIfTxPduId = 3
        CanIfTxPduReadNotifyStatus = false
        CanIfTxPduType = STATIC
        CanIfTxPduUserTxConfirmationUL = PDUR
        CanIfTxPduUserTxConfirmationName = PduR_CanIfTxConfirmation
        CanIfTxPduCanIdMask = 3825139712
        CanIfTxPduBufferRef = CanIfBufferCfg_AckmTxPdu_Backbone1J1939_54966c1b
        CanIfTxPduRef = AckmTxPdu_Backbone1J1939_54966c1b
      J1939NmRxPdu_fa509995 (CanIfRxPduCfg):
        CanIfRxPduDlc = 8
        CanIfRxPduCanIdType = EXTENDED_CAN
        CanIfRxPduCanIdMask = 67108608
        CanIfRxPduCanId = 15662848
        CanIfRxPduDlcCheck = true
        CanIfRxPduReadData = false
        CanIfRxPduReadNotifyStatus = false
        CanIfRxPduUserRxIndicationUL = J1939NM
        CanIfRxPduId = 4
        CanIfRxPduUserRxIndicationName = J1939Nm_RxIndication
        CanIfRxPduRef = J1939NmRxPdu_fa509995
        CanIfRxPduHrhIdRef = CN_Backbone1J1939_6e8ec372_Rx
      J1939NmTxPdu_fa509995 (CanIfTxPduCfg):
        CanIfTxPduDlc = 8
        CanIfTxPduCanIdType = EXTENDED_CAN
        CanIfTxPduCanId = 418316032
        CanIfTxPduCanIdMask = 4294967040
        CanIfTxPduId = 0
        CanIfTxPduReadNotifyStatus = false
        CanIfTxPduType = STATIC
        CanIfTxPduUserTxConfirmationUL = J1939NM
        CanIfTxPduUserTxConfirmationName = J1939Nm_TxConfirmation
        CanIfTxPduRef = J1939NmTxPdu_fa509995
        CanIfTxPduBufferRef = CanIfBufferCfg_J1939NmTxPdu_fa509995
      FcNPdu_Backbone1J1939_dba64907 (CanIfTxPduCfg):
        CanIfTxPduCanId = 15466496
        CanIfTxPduCanIdType = EXTENDED_CAN
        CanIfTxPduDlc = 8
        CanIfTxPduId = 2
        CanIfTxPduReadNotifyStatus = false
        CanIfTxPduType = STATIC
        CanIfTxPduUserTxConfirmationUL = J1939TP
        CanIfTxPduCanIdMask = 3825139712
        CanIfTxPduUserTxConfirmationName = J1939Tp_TxConfirmation
        CanIfTxPduBufferRef = CanIfBufferCfg_FcNPdu_Backbone1J1939_dba64907
        CanIfTxPduRef = FcNPdu_Backbone1J1939_dba64907_Tx
      3 x CanIfRxPduCfg, all with CanIfRxPduCanIdType=EXTENDED_CAN, CanIfRxPduDlc=8, CanIfRxPduReadData=false, CanIfRxPduReadNotifyStatus=false, CanIfRxPduDlcCheck=true:
        VMCU_BB2_02P_oBackbone2_4ec96099_Rx: CanIfRxPduCanId=532, CanIfRxPduUserRxIndicationName=PduR_CanIfRxIndication, CanIfRxPduUserRxIndicationUL=PDUR, CanIfRxPduId=239, CanIfRxPduHrhIdRef=CN_Backbone2_7b3866ec_Rx, CanIfRxPduRef=VMCU_BB2_02P_oBackbone2_16b17746_Rx
        Alarm_Sec_07S_Tp_oSecuritySubnet_bf7e0710_Rx: CanIfRxPduCanId=352304959, CanIfRxPduUserRxIndicationName=CanTp_RxIndication, CanIfRxPduUserRxIndicationType=PDUID_PDUINFOPTR, CanIfRxPduUserRxIndicationUL=CAN_TP, CanIfRxPduId=109, CanIfRxPduHrhIdRef=CN_SecuritySubnet_3840872e_Rx, CanIfRxPduRef=Alarm_Sec_07S_Tp_oSecuritySubnet_4f378649_Rx
        Alarm_Sec_03S_Tp_oSecuritySubnet_838659b7_Rx: CanIfRxPduCanId=352261439, CanIfRxPduUserRxIndicationName=CanTp_RxIndication, CanIfRxPduUserRxIndicationType=PDUID_PDUINFOPTR, CanIfRxPduUserRxIndicationUL=CAN_TP, CanIfRxPduId=119, CanIfRxPduHrhIdRef=CN_SecuritySubnet_3840872e_Rx, CanIfRxPduRef=Alarm_Sec_03S_Tp_oSecuritySubnet_acfc2dba_Rx
      VW_X_CIOMFMS_oFMSNet_06d77621_Tx (CanIfTxPduCfg):
        CanIfTxPduCanId = 419359281
        CanIfTxPduCanIdType = EXTENDED_CAN
        CanIfTxPduDlc = 8
        CanIfTxPduUserTxConfirmationName = NULL_PTR
        CanIfTxPduUserTxConfirmationUL = NONE
        CanIfTxPduId = 98
        CanIfTxPduReadNotifyStatus = false
        CanIfTxPduType = STATIC
        CanIfTxPduBufferRef = CanIfBufferCfg_VW_X_CIOMFMS_oFMSNet_06d77621_Tx
        CanIfTxPduRef = VW_X_CIOMFMS_oFMSNet_1c90cc30_Tx
      DiagReqMsgIntTGW2_A0_F4_BB2_Tp_oBackbone2_9c9945bf_Rx (CanIfRxPduCfg):
        CanIfRxPduCanId = 524329204
        CanIfRxPduCanIdType = EXTENDED_CAN
        CanIfRxPduDlc = 8
        CanIfRxPduUserRxIndicationName = CanTp_RxIndication
        CanIfRxPduUserRxIndicationType = PDUID_PDUINFOPTR
        CanIfRxPduUserRxIndicationUL = CAN_TP
        CanIfRxPduId = 140
        CanIfRxPduReadData = false
        CanIfRxPduReadNotifyStatus = false
        CanIfRxPduDlcCheck = true
        CanIfRxPduHrhIdRef = CN_Backbone2_7b3866ec_Rx
        CanIfRxPduRef = DiagReqMsgIntTGW2_A0_F4_BB2_Tp_oBackbone2_d0d92195_Rx
      DiagFaultStat_DDM_BB2_oBackbone2_c5068234_Tx (CanIfTxPduCfg):
        CanIfTxPduCanId = 1510
        CanIfTxPduCanIdType = EXTENDED_CAN
        CanIfTxPduDlc = 8
        CanIfTxPduUserTxConfirmationName = PduR_CanIfTxConfirmation
        CanIfTxPduUserTxConfirmationUL = PDUR
        CanIfTxPduId = 204
        CanIfTxPduReadNotifyStatus = false
        CanIfTxPduType = STATIC
        CanIfTxPduBufferRef = CHNL_a6b6a922
        CanIfTxPduRef = DiagFaultStat_DDM_BB2_oBackbone2_f2c6a79a_Tx
      CIOM_Sec_09S_FCM_Tp_oSecuritySubnet_094e790d_Rx (CanIfRxPduCfg):
        CanIfRxPduCanId = 352265793
        CanIfRxPduCanIdType = EXTENDED_CAN
        CanIfRxPduDlc = 8
        CanIfRxPduUserRxIndicationName = CanTp_RxIndication
        CanIfRxPduUserRxIndicationUL = CAN_TP
        CanIfRxPduId = 117
        CanIfRxPduReadData = false
        CanIfRxPduReadNotifyStatus = false
        CanIfRxPduDlcCheck = true
        CanIfRxPduHrhIdRef = CN_SecuritySubnet_3840872e_Rx
        CanIfRxPduRef = CIOM_Sec_09S_FCM_Tp_oSecuritySubnet_2f785b12_Rx
      SRS_Cab_01P_oCabSubnet_3796a617_Rx (CanIfRxPduCfg):
        CanIfRxPduCanId = 285205843
        CanIfRxPduCanIdType = EXTENDED_CAN
        CanIfRxPduDlc = 8
        CanIfRxPduUserRxIndicationName = PduR_CanIfRxIndication
        CanIfRxPduUserRxIndicationUL = PDUR
        CanIfRxPduId = 73
        CanIfRxPduReadData = false
        CanIfRxPduReadNotifyStatus = false
        CanIfRxPduDlcCheck = true
        CanIfRxPduHrhIdRef = CN_CabSubnet_eedbadff_Rx
        CanIfRxPduRef = SRS_Cab_01P_oCabSubnet_81a51028_Rx
      CIOM_BB2_04P_oBackbone2_14239779_Tx (CanIfTxPduCfg):
        CanIfTxPduCanId = 218048576
        CanIfTxPduCanIdType = EXTENDED_CAN
        CanIfTxPduDlc = 8
        CanIfTxPduUserTxConfirmationName = NULL_PTR
        CanIfTxPduUserTxConfirmationUL = NONE
        CanIfTxPduId = 198
        CanIfTxPduReadNotifyStatus = false
        CanIfTxPduType = STATIC
        CanIfTxPduBufferRef = CHNL_a6b6a922
        CanIfTxPduRef = CIOM_BB2_04P_oBackbone2_92a7e039_Tx
      DiagRespMsgIntTGW2_F4_26_BB2_Tp_oBackbone2_5b036461_Tx (CanIfTxPduCfg):
        CanIfTxPduCanId = 524350502
        CanIfTxPduCanIdType = EXTENDED_CAN
        CanIfTxPduDlc = 8
        CanIfTxPduUserTxConfirmationName = CanTp_TxConfirmation
        CanIfTxPduUserTxConfirmationUL = CAN_TP
        CanIfTxPduId = 155
        CanIfTxPduReadNotifyStatus = false
        CanIfTxPduType = STATIC
        CanIfTxPduBufferRef = CHNL_a6b6a922
        CanIfTxPduRef = DiagRespMsgIntTGW2_F4_26_BB2_Tp_oBackbone2_b16af2d2_Tx
      3 x CanIfRxPduCfg, all with CanIfRxPduCanIdType=EXTENDED_CAN, CanIfRxPduDlc=8, CanIfRxPduUserRxIndicationName=PduR_CanIfRxIndication, CanIfRxPduUserRxIndicationUL=PDUR, CanIfRxPduReadData=false, CanIfRxPduReadNotifyStatus=false, CanIfRxPduDlcCheck=true:
        BBM_BB2_02P_oBackbone2_912f6fea_Rx: CanIfRxPduCanId=318756070, CanIfRxPduId=168, CanIfRxPduHrhIdRef=CN_Backbone2_7b3866ec_Rx, CanIfRxPduRef=BBM_BB2_02P_oBackbone2_ae84b87e_Rx
        LECM1_Cab_02P_oCabSubnet_e0d2bc45_Rx: CanIfRxPduCanId=285209506, CanIfRxPduId=72, CanIfRxPduHrhIdRef=CN_CabSubnet_eedbadff_Rx, CanIfRxPduRef=LECM1_Cab_02P_oCabSubnet_7b05953d_Rx
        VMCU_BB2_58P_oBackbone2_0848ab9e_Rx: CanIfRxPduCanId=1243, CanIfRxPduId=204, CanIfRxPduHrhIdRef=CN_Backbone2_7b3866ec_Rx, CanIfRxPduRef=VMCU_BB2_58P_oBackbone2_20589d38_Rx
      3 x CanIfTxPduCfg, all with CanIfTxPduCanIdType=EXTENDED_CAN, CanIfTxPduDlc=8, CanIfTxPduReadNotifyStatus=false, CanIfTxPduType=STATIC, CanIfTxPduBufferRef=CHNL_a6b6a922:
        TECU_BB2_06S_FCM_Tp_oBackbone2_a56e8b10_Tx: CanIfTxPduCanId=1446, CanIfTxPduUserTxConfirmationName=CanTp_TxConfirmation, CanIfTxPduUserTxConfirmationUL=CAN_TP, CanIfTxPduId=208, CanIfTxPduRef=TECU_BB2_06S_FCM_Tp_oBackbone2_dca81527_Tx
        DiagUUDTRespMsg1_F2_A1_BB2_oBackbone2_26f22879_Tx: CanIfTxPduCanId=524481185, CanIfTxPduUserTxConfirmationName=NULL_PTR, CanIfTxPduUserTxConfirmationUL=NONE, CanIfTxPduId=142, CanIfTxPduRef=DiagUUDTRespMsg1_F2_A1_BB2_oBackbone2_41dd0943_Tx
        PhysDiagRespMsg_F2_A2_BB2_Tp_oBackbone2_2addb983_Tx: CanIfTxPduCanId=524350114, CanIfTxPduUserTxConfirmationName=CanTp_TxConfirmation, CanIfTxPduUserTxConfirmationUL=CAN_TP, CanIfTxPduId=165, CanIfTxPduRef=PhysDiagRespMsg_F2_A2_BB2_Tp_oBackbone2_d557ba67_Tx
      HMIIOM_BB2_19P_CIOM_Tp_oBackbone2_470ca910_Rx (CanIfRxPduCfg):
        CanIfRxPduCanId = 1386
        CanIfRxPduCanIdType = EXTENDED_CAN
        CanIfRxPduDlc = 8
        CanIfRxPduUserRxIndicationName = CanTp_RxIndication
        CanIfRxPduUserRxIndicationType = PDUID_PDUINFOPTR
        CanIfRxPduUserRxIndicationUL = CAN_TP
        CanIfRxPduId = 179
        CanIfRxPduReadData = false
        CanIfRxPduReadNotifyStatus = false
        CanIfRxPduDlcCheck = true
        CanIfRxPduHrhIdRef = CN_Backbone2_7b3866ec_Rx
        CanIfRxPduRef = HMIIOM_BB2_19P_CIOM_Tp_oBackbone2_530a79b0_Rx
      CIOM_BB2_07P_oBackbone2_bc671479_Tx (CanIfTxPduCfg):
        CanIfTxPduCanId = 368096064
        CanIfTxPduCanIdType = EXTENDED_CAN
        CanIfTxPduDlc = 8
        CanIfTxPduUserTxConfirmationName = NULL_PTR
        CanIfTxPduUserTxConfirmationUL = NONE
        CanIfTxPduId = 182
        CanIfTxPduReadNotifyStatus = false
        CanIfTxPduType = STATIC
        CanIfTxPduBufferRef = CHNL_a6b6a922
        CanIfTxPduRef = CIOM_BB2_07P_oBackbone2_5bb8e886_Tx
      DiagReqMsgIntTGW2_26_F4_Cab_Tp_oCabSubnet_b42402a4_Tx (CanIfTxPduCfg):
        CanIfTxPduCanId = 524297972
        CanIfTxPduCanIdType = EXTENDED_CAN
        CanIfTxPduDlc = 8
        CanIfTxPduUserTxConfirmationName = CanTp_TxConfirmation
        CanIfTxPduUserTxConfirmationUL = CAN_TP
        CanIfTxPduId = 15
        CanIfTxPduReadNotifyStatus = false
        CanIfTxPduType = STATIC
        CanIfTxPduBufferRef = CanIfBufferCfg_DiagReqMsgIntTGW2_26_F4_Cab_Tp_oCabSubnet_b42402a4_Tx
        CanIfTxPduRef = DiagReqMsgIntTGW2_26_F4_Cab_Tp_oCabSubnet_1e2ef166_Tx
      CCM_Cab_07P_oCabSubnet_de415578_Rx (CanIfRxPduCfg):
        CanIfRxPduCanId = 285161112
        CanIfRxPduCanIdType = EXTENDED_CAN
        CanIfRxPduDlc = 8
        CanIfRxPduUserRxIndicationName = PduR_CanIfRxIndication
        CanIfRxPduUserRxIndicationUL = PDUR
        CanIfRxPduId = 79
        CanIfRxPduReadData = false
        CanIfRxPduReadNotifyStatus = false
        CanIfRxPduDlcCheck = true
        CanIfRxPduHrhIdRef = CN_CabSubnet_eedbadff_Rx
        CanIfRxPduRef = CCM_Cab_07P_oCabSubnet_9f92699c_Rx
      PhysDiagReqMsg_A0_F2_BB2_Tp_oBackbone2_b0139fa8_Rx (CanIfRxPduCfg):
        CanIfRxPduCanId = 524329202
        CanIfRxPduCanIdType = EXTENDED_CAN
        CanIfRxPduDlc = 8
        CanIfRxPduUserRxIndicationName = CanTp_RxIndication
        CanIfRxPduUserRxIndicationType = PDUID_PDUINFOPTR
        CanIfRxPduUserRxIndicationUL = CAN_TP
        CanIfRxPduId = 142
        CanIfRxPduReadData = false
        CanIfRxPduReadNotifyStatus = false
        CanIfRxPduDlcCheck = true
        CanIfRxPduHrhIdRef = CN_Backbone2_7b3866ec_Rx
        CanIfRxPduRef = PhysDiagReqMsg_A0_F2_BB2_Tp_oBackbone2_c6a2dc0a_Rx
      AnmMsg_CIOM_Backbone2_oBackbone2_d362d40e_Tx (CanIfTxPduCfg):
        CanIfTxPduCanId = 486510593
        CanIfTxPduCanIdType = EXTENDED_CAN
        CanIfTxPduDlc = 4
        CanIfTxPduUserTxConfirmationName = NULL_PTR
        CanIfTxPduUserTxConfirmationUL = NONE
        CanIfTxPduId = 177
        CanIfTxPduReadNotifyStatus = false
        CanIfTxPduType = STATIC
        CanIfTxPduBufferRef = CHNL_a6b6a922
        CanIfTxPduRef = AnmMsg_CIOM_Backbone2_oBackbone2_cf5ab87f_Tx
      PhysDiagReqMsg_C0_F2_BB2_Tp_oBackbone2_bd293e55_Rx (CanIfRxPduCfg):
        CanIfRxPduCanId = 524337394
        CanIfRxPduCanIdType = EXTENDED_CAN
        CanIfRxPduDlc = 8
        CanIfRxPduUserRxIndicationName = CanTp_RxIndication
        CanIfRxPduUserRxIndicationType = PDUID_PDUINFOPTR
        CanIfRxPduUserRxIndicationUL = CAN_TP
        CanIfRxPduId = 133
        CanIfRxPduReadData = false
        CanIfRxPduReadNotifyStatus = false
        CanIfRxPduDlcCheck = true
        CanIfRxPduHrhIdRef = CN_Backbone2_7b3866ec_Rx
        CanIfRxPduRef = PhysDiagReqMsg_C0_F2_BB2_Tp_oBackbone2_5fa0d397_Rx
      CIOM_Sec_10S_FCM_Tp_oSecuritySubnet_c49c166b_Rx (CanIfRxPduCfg):
        CanIfRxPduCanId = 352272193
        CanIfRxPduCanIdType = EXTENDED_CAN
        CanIfRxPduDlc = 8
        CanIfRxPduUserRxIndicationName = CanTp_RxIndication
        CanIfRxPduUserRxIndicationUL = CAN_TP
        CanIfRxPduId = 116
        CanIfRxPduReadData = false
        CanIfRxPduReadNotifyStatus = false
        CanIfRxPduDlcCheck = true
        CanIfRxPduHrhIdRef = CN_SecuritySubnet_3840872e_Rx
        CanIfRxPduRef = CIOM_Sec_10S_FCM_Tp_oSecuritySubnet_85f600ee_Rx
      6 x CanIfTxPduCfg, all with CanIfTxPduCanIdType=EXTENDED_CAN, CanIfTxPduDlc=8, CanIfTxPduReadNotifyStatus=false, CanIfTxPduType=STATIC:
        VMCU_BB2_31S_FCM_Tp_oBackbone2_46c44850_Tx: CanIfTxPduCanId=1373, CanIfTxPduUserTxConfirmationName=CanTp_TxConfirmation, CanIfTxPduUserTxConfirmationUL=CAN_TP, CanIfTxPduId=212, CanIfTxPduBufferRef=CHNL_a6b6a922, CanIfTxPduRef=VMCU_BB2_31S_FCM_Tp_oBackbone2_37e5a977_Tx
        DiagRespMsgIntTGW2_F4_53_BB2_Tp_oBackbone2_280e15fa_Tx: CanIfTxPduCanId=524350547, CanIfTxPduUserTxConfirmationName=CanTp_TxConfirmation, CanIfTxPduUserTxConfirmationUL=CAN_TP, CanIfTxPduId=153, CanIfTxPduBufferRef=CHNL_a6b6a922, CanIfTxPduRef=DiagRespMsgIntTGW2_F4_53_BB2_Tp_oBackbone2_559cc665_Tx
        DiagUUDTRespMsg1_F2_40_BB2_oBackbone2_187336ef_Tx: CanIfTxPduCanId=524481088, CanIfTxPduUserTxConfirmationName=PduR_CanIfTxConfirmation, CanIfTxPduUserTxConfirmationUL=PDUR, CanIfTxPduId=146, CanIfTxPduBufferRef=CHNL_a6b6a922, CanIfTxPduRef=DiagUUDTRespMsg1_F2_40_BB2_oBackbone2_e836b7de_Tx
        CIOM_BB2_26S_oBackbone2_f83747d6_Tx: CanIfTxPduCanId=352297202, CanIfTxPduUserTxConfirmationName=PduR_CanIfTxConfirmation, CanIfTxPduUserTxConfirmationUL=PDUR, CanIfTxPduId=185, CanIfTxPduBufferRef=CHNL_a6b6a922, CanIfTxPduRef=CIOM_BB2_26S_oBackbone2_d4aff5b9_Tx
        CIOM_BB2_02P_oBackbone2_9fdb9738_Tx: CanIfTxPduCanId=285157184, CanIfTxPduUserTxConfirmationName=NULL_PTR, CanIfTxPduUserTxConfirmationUL=NONE, CanIfTxPduId=196, CanIfTxPduBufferRef=CHNL_a6b6a922, CanIfTxPduRef=CIOM_BB2_02P_oBackbone2_dbe8f706_Tx
        DiagReqMsgIntHMIIOM_A0_F3_Sec_Tp_oSecuritySubnet_09265670_Tx: CanIfTxPduCanId=524329203, CanIfTxPduUserTxConfirmationName=CanTp_TxConfirmation, CanIfTxPduUserTxConfirmationUL=CAN_TP, CanIfTxPduId=65, CanIfTxPduBufferRef=CanIfBufferCfg_DiagReqMsgIntHMIIOM_A0_F3_Sec_Tp_oSecuritySubnet_09265670_Tx, CanIfTxPduRef=DiagReqMsgIntHMIIOM_A0_F3_Sec_Tp_oSecuritySubnet_f969f34f_Tx
      VMCU_BB2_57P_Tp_oBackbone2_925193df_Rx (CanIfRxPduCfg):
        CanIfRxPduCanId = 1398
        CanIfRxPduCanIdType = EXTENDED_CAN
        CanIfRxPduDlc = 8
        CanIfRxPduUserRxIndicationName = CanTp_RxIndication
        CanIfRxPduUserRxIndicationType = PDUID_PDUINFOPTR
        CanIfRxPduUserRxIndicationUL = CAN_TP
        CanIfRxPduId = 175
        CanIfRxPduReadData = false
        CanIfRxPduReadNotifyStatus = false
        CanIfRxPduDlcCheck = true
        CanIfRxPduHrhIdRef = CN_Backbone2_7b3866ec_Rx
        CanIfRxPduRef = VMCU_BB2_57P_Tp_oBackbone2_48b0754a_Rx
      DiagReqMsgIntTGW2_40_F4_BB2_Tp_oBackbone2_f28a299a_Rx (CanIfRxPduCfg):
        CanIfRxPduCanId = 524304628
        CanIfRxPduCanIdType = EXTENDED_CAN
        CanIfRxPduDlc = 8
        CanIfRxPduUserRxIndicationName = CanTp_RxIndication
        CanIfRxPduUserRxIndicationType = PDUID_PDUINFOPTR
        CanIfRxPduUserRxIndicationUL = CAN_TP
        CanIfRxPduId = 149
        CanIfRxPduReadData = false
        CanIfRxPduReadNotifyStatus = false
        CanIfRxPduDlcCheck = true
        CanIfRxPduHrhIdRef = CN_Backbone2_7b3866ec_Rx
        CanIfRxPduRef = DiagReqMsgIntTGW2_40_F4_BB2_Tp_oBackbone2_e116a20a_Rx
      3 x CanIfTxPduCfg, all with CanIfTxPduCanIdType=EXTENDED_CAN, CanIfTxPduDlc=8, CanIfTxPduReadNotifyStatus=false, CanIfTxPduType=STATIC:
        CIOM_Cab_14P_oCabSubnet_e2dadb2a_Tx: CanIfTxPduCanId=418629631, CanIfTxPduUserTxConfirmationName=NULL_PTR, CanIfTxPduUserTxConfirmationUL=NONE, CanIfTxPduId=30, CanIfTxPduBufferRef=CanIfBufferCfg_CIOM_Cab_14P_oCabSubnet_e2dadb2a_Tx, CanIfTxPduRef=CIOM_Cab_14P_oCabSubnet_5240bc4e_Tx
        DiagRespMsgIntTGW2_F4_40_BB2_Tp_oBackbone2_f5224357_Tx: CanIfTxPduCanId=524350528, CanIfTxPduUserTxConfirmationName=CanTp_TxConfirmation, CanIfTxPduUserTxConfirmationUL=CAN_TP, CanIfTxPduId=154, CanIfTxPduBufferRef=CHNL_a6b6a922, CanIfTxPduRef=DiagRespMsgIntTGW2_F4_40_BB2_Tp_oBackbone2_56fdcdab_Tx
        DiagUUDTRespMsg1_F2_98_BB2_oBackbone2_5178e6a4_Tx: CanIfTxPduCanId=524481176, CanIfTxPduUserTxConfirmationName=NULL_PTR, CanIfTxPduUserTxConfirmationUL=NONE, CanIfTxPduId=144, CanIfTxPduBufferRef=CHNL_a6b6a922, CanIfTxPduRef=DiagUUDTRespMsg1_F2_98_BB2_oBackbone2_fff32bf7_Tx
      PhysDiagReqMsg_53_F1_BB2_Tp_oBackbone2_e289c86d_Rx (CanIfRxPduCfg):
        CanIfRxPduCanId = 416961521
        CanIfRxPduCanIdType = EXTENDED_CAN
        CanIfRxPduDlc = 8
        CanIfRxPduUserRxIndicationName = CanTp_RxIndication
        CanIfRxPduUserRxIndicationType = PDUID_PDUINFOPTR
        CanIfRxPduUserRxIndicationUL = CAN_TP
        CanIfRxPduId = 163
        CanIfRxPduReadData = false
        CanIfRxPduReadNotifyStatus = false
        CanIfRxPduDlcCheck = true
        CanIfRxPduHrhIdRef = CN_Backbone2_7b3866ec_Rx
        CanIfRxPduRef = PhysDiagReqMsg_53_F1_BB2_Tp_oBackbone2_f8f56cbe_Rx
      3 x CanIfTxPduCfg, all with CanIfTxPduCanIdType=EXTENDED_CAN, CanIfTxPduDlc=8, CanIfTxPduReadNotifyStatus=false, CanIfTxPduType=STATIC:
        CIOM_Cab_12P_oCabSubnet_6922db6b_Tx: CanIfTxPduCanId=418420735, CanIfTxPduUserTxConfirmationName=NULL_PTR, CanIfTxPduUserTxConfirmationUL=NONE, CanIfTxPduId=32, CanIfTxPduBufferRef=CanIfBufferCfg_CIOM_Cab_12P_oCabSubnet_6922db6b_Tx, CanIfTxPduRef=CIOM_Cab_12P_oCabSubnet_1b0fab71_Tx
        CIOM_Cab_32P_oCabSubnet_69ed5c69_Tx: CanIfTxPduCanId=285163584, CanIfTxPduUserTxConfirmationName=NULL_PTR, CanIfTxPduUserTxConfirmationUL=NONE, CanIfTxPduId=52, CanIfTxPduBufferRef=CanIfBufferCfg_CIOM_Cab_32P_oCabSubnet_69ed5c69_Tx, CanIfTxPduRef=CIOM_Cab_32P_oCabSubnet_76ea8a97_Tx
        TECU_BB2_05S_FCM_Tp_oBackbone2_69d48940_Tx: CanIfTxPduCanId=939, CanIfTxPduUserTxConfirmationName=CanTp_TxConfirmation, CanIfTxPduUserTxConfirmationUL=CAN_TP, CanIfTxPduId=219, CanIfTxPduBufferRef=CHNL_a6b6a922, CanIfTxPduRef=TECU_BB2_05S_FCM_Tp_oBackbone2_0f3309dc_Tx
      CIOM_Cab_25S_FCM_Tp_oCabSubnet_063a8d48_Rx (CanIfRxPduCfg):
        CanIfRxPduCanId = 418873153
        CanIfRxPduCanIdType = EXTENDED_CAN
        CanIfRxPduDlc = 8
        CanIfRxPduUserRxIndicationName = CanTp_RxIndication
        CanIfRxPduUserRxIndicationUL = CAN_TP
        CanIfRxPduId = 62
        CanIfRxPduReadData = false
        CanIfRxPduReadNotifyStatus = false
        CanIfRxPduDlcCheck = true
        CanIfRxPduHrhIdRef = CN_CabSubnet_eedbadff_Rx
        CanIfRxPduRef = CIOM_Cab_25S_FCM_Tp_oCabSubnet_014fc53b_Rx
      EMS_BB2_06P_oBackbone2_148edfe1_Rx (CanIfRxPduCfg):
        CanIfRxPduCanId = 1391
        CanIfRxPduCanIdType = EXTENDED_CAN
        CanIfRxPduDlc = 8
        CanIfRxPduUserRxIndicationName = PduR_CanIfRxIndication
        CanIfRxPduUserRxIndicationUL = PDUR
        CanIfRxPduId = 178
        CanIfRxPduReadData = false
        CanIfRxPduReadNotifyStatus = false
        CanIfRxPduDlcCheck = true
        CanIfRxPduHrhIdRef = CN_Backbone2_7b3866ec_Rx
        CanIfRxPduRef = EMS_BB2_06P_oBackbone2_fc9fee72_Rx
      CIOM_BB2_01P_oBackbone2_379f1438_Tx (CanIfTxPduCfg):
        CanIfTxPduCanId = 285177664
        CanIfTxPduCanIdType = EXTENDED_CAN
        CanIfTxPduDlc = 8
        CanIfTxPduUserTxConfirmationName = NULL_PTR
        CanIfTxPduUserTxConfirmationUL = NONE
        CanIfTxPduId = 194
        CanIfTxPduReadNotifyStatus = false
        CanIfTxPduType = STATIC
        CanIfTxPduBufferRef = CHNL_a6b6a922
        CanIfTxPduRef = CIOM_BB2_01P_oBackbone2_12f7ffb9_Tx
      CIOM_Sec_01P_oSecuritySubnet_de08418d_Tx (CanIfTxPduCfg):
        CanIfTxPduCanId = 285159232
        CanIfTxPduCanIdType = EXTENDED_CAN
        CanIfTxPduDlc = 8
        CanIfTxPduUserTxConfirmationName = NULL_PTR
        CanIfTxPduUserTxConfirmationUL = NONE
        CanIfTxPduId = 88
        CanIfTxPduReadNotifyStatus = false
        CanIfTxPduType = STATIC
        CanIfTxPduBufferRef = CanIfBufferCfg_CIOM_Sec_01P_oSecuritySubnet_de08418d_Tx
        CanIfTxPduRef = CIOM_Sec_01P_oSecuritySubnet_703c4de6_Tx
      HMIIOM_BB2_23P_oBackbone2_45e8e602_Rx (CanIfRxPduCfg):
        CanIfRxPduCanId = 1056
        CanIfRxPduCanIdType = EXTENDED_CAN
        CanIfRxPduDlc = 8
        CanIfRxPduUserRxIndicationName = PduR_CanIfRxIndication
        CanIfRxPduUserRxIndicationUL = PDUR
        CanIfRxPduId = 208
        CanIfRxPduReadData = false
        CanIfRxPduReadNotifyStatus = false
        CanIfRxPduDlcCheck = true
        CanIfRxPduHrhIdRef = CN_Backbone2_7b3866ec_Rx
        CanIfRxPduRef = HMIIOM_BB2_23P_oBackbone2_5fa1555e_Rx
      DiagUUDTRespMsg1_F2_26_BB2_oBackbone2_fc487bda_Tx (CanIfTxPduCfg):
        CanIfTxPduCanId = 524481062
        CanIfTxPduCanIdType = EXTENDED_CAN
        CanIfTxPduDlc = 8
        CanIfTxPduUserTxConfirmationName = NULL_PTR
        CanIfTxPduUserTxConfirmationUL = NONE
        CanIfTxPduId = 147
        CanIfTxPduReadNotifyStatus = false
        CanIfTxPduType = STATIC
        CanIfTxPduBufferRef = CHNL_a6b6a922
        CanIfTxPduRef = DiagUUDTRespMsg1_F2_26_BB2_oBackbone2_ed213a51_Tx
      4 x CanIfRxPduCfg, all with CanIfRxPduCanIdType=EXTENDED_CAN, CanIfRxPduDlc=8, CanIfRxPduReadData=false, CanIfRxPduReadNotifyStatus=false, CanIfRxPduDlcCheck=true:
        PDM_Sec_03S_Tp_oSecuritySubnet_225f8534_Rx: CanIfRxPduCanId=352311457, CanIfRxPduUserRxIndicationName=CanTp_RxIndication, CanIfRxPduUserRxIndicationType=PDUID_PDUINFOPTR, CanIfRxPduUserRxIndicationUL=CAN_TP, CanIfRxPduId=107, CanIfRxPduHrhIdRef=CN_SecuritySubnet_3840872e_Rx, CanIfRxPduRef=PDM_Sec_03S_Tp_oSecuritySubnet_6b4c7bf0_Rx
        PhysDiagReqMsg_A1_F2_BB2_Tp_oBackbone2_9bf67e6d_Rx: CanIfRxPduCanId=524329458, CanIfRxPduUserRxIndicationName=CanTp_RxIndication, CanIfRxPduUserRxIndicationType=PDUID_PDUINFOPTR, CanIfRxPduUserRxIndicationUL=CAN_TP, CanIfRxPduId=139, CanIfRxPduHrhIdRef=CN_Backbone2_7b3866ec_Rx, CanIfRxPduRef=PhysDiagReqMsg_A1_F2_BB2_Tp_oBackbone2_2eb54cab_Rx
        HMIIOM_BB2_03P_oBackbone2_7d4615c2_Rx: CanIfRxPduCanId=739, CanIfRxPduUserRxIndicationName=PduR_CanIfRxIndication, CanIfRxPduUserRxIndicationUL=PDUR, CanIfRxPduId=230, CanIfRxPduHrhIdRef=CN_Backbone2_7b3866ec_Rx, CanIfRxPduRef=HMIIOM_BB2_03P_oBackbone2_324474b8_Rx
        VMCU_BB2_01P_oBackbone2_e68de399_Rx: CanIfRxPduCanId=520, CanIfRxPduUserRxIndicationName=PduR_CanIfRxIndication, CanIfRxPduUserRxIndicationUL=PDUR, CanIfRxPduId=240, CanIfRxPduHrhIdRef=CN_Backbone2_7b3866ec_Rx, CanIfRxPduRef=VMCU_BB2_01P_oBackbone2_dfae7ff9_Rx
      AnmMsg_CIOM_CabSubnet_oCabSubnet_e295c8bd_Tx (CanIfTxPduCfg):
        CanIfTxPduCanId = 486510630
        CanIfTxPduCanIdType = EXTENDED_CAN
        CanIfTxPduDlc = 4
        CanIfTxPduUserTxConfirmationName = NULL_PTR
        CanIfTxPduUserTxConfirmationUL = NONE
        CanIfTxPduId = 18
        CanIfTxPduReadNotifyStatus = false
        CanIfTxPduType = STATIC
        CanIfTxPduBufferRef = CanIfBufferCfg_AnmMsg_CIOM_CabSubnet_oCabSubnet_e295c8bd_Tx
        CanIfTxPduRef = AnmMsg_CIOM_CabSubnet_oCabSubnet_05b67d33_Tx
      5 x CanIfRxPduCfg, all with CanIfRxPduCanIdType=EXTENDED_CAN, CanIfRxPduDlc=8, CanIfRxPduReadData=false, CanIfRxPduReadNotifyStatus=false, CanIfRxPduDlcCheck=true:
        HMIIOM_BB2_22P_oBackbone2_7ef06453_Rx: CanIfRxPduCanId=1334, CanIfRxPduUserRxIndicationName=PduR_CanIfRxIndication, CanIfRxPduUserRxIndicationUL=PDUR, CanIfRxPduId=187, CanIfRxPduHrhIdRef=CN_Backbone2_7b3866ec_Rx, CanIfRxPduRef=HMIIOM_BB2_22P_oBackbone2_ae7b50f4_Rx
        DiagReqMsgIntHMIIOM_A2_F3_BB2_Tp_oBackbone2_e882bd41_Rx: CanIfRxPduCanId=524329715, CanIfRxPduUserRxIndicationName=CanTp_RxIndication, CanIfRxPduUserRxIndicationType=PDUID_PDUINFOPTR, CanIfRxPduUserRxIndicationUL=CAN_TP, CanIfRxPduId=135, CanIfRxPduHrhIdRef=CN_Backbone2_7b3866ec_Rx, CanIfRxPduRef=DiagReqMsgIntHMIIOM_A2_F3_BB2_Tp_oBackbone2_7715c5ab_Rx
        LECM1_Cab_03S_oCabSubnet_e20ca5cb_Rx: CanIfRxPduCanId=418559999, CanIfRxPduUserRxIndicationName=PduR_CanIfRxIndication, CanIfRxPduUserRxIndicationUL=PDUR, CanIfRxPduId=63, CanIfRxPduHrhIdRef=CN_CabSubnet_eedbadff_Rx, CanIfRxPduRef=LECM1_Cab_03S_oCabSubnet_99f7a9e4_Rx
        LECM1_Cab_05S_oCabSubnet_b18bf7f9_Rx: CanIfRxPduCanId=352288674, CanIfRxPduUserRxIndicationName=PduR_CanIfRxIndication, CanIfRxPduUserRxIndicationUL=PDUR, CanIfRxPduId=69, CanIfRxPduHrhIdRef=CN_CabSubnet_eedbadff_Rx, CanIfRxPduRef=LECM1_Cab_05S_oCabSubnet_d0b8bedb_Rx
        WRCS_Cab_02P_oCabSubnet_506736c4_Rx: CanIfRxPduCanId=285196095, CanIfRxPduUserRxIndicationName=PduR_CanIfRxIndication, CanIfRxPduUserRxIndicationUL=PDUR, CanIfRxPduId=75, CanIfRxPduHrhIdRef=CN_CabSubnet_eedbadff_Rx, CanIfRxPduRef=WRCS_Cab_02P_oCabSubnet_bfa65d2b_Rx
      5 x CanIfTxPduCfg, all with CanIfTxPduCanIdType=EXTENDED_CAN, CanIfTxPduDlc=8, CanIfTxPduReadNotifyStatus=false, CanIfTxPduType=STATIC:
        CIOM_Cab_01P_oCabSubnet_c1019bea_Tx: CanIfTxPduCanId=285166656, CanIfTxPduUserTxConfirmationName=NULL_PTR, CanIfTxPduUserTxConfirmationUL=NONE, CanIfTxPduId=51, CanIfTxPduBufferRef=CanIfBufferCfg_CIOM_Cab_01P_oCabSubnet_c1019bea_Tx, CanIfTxPduRef=CIOM_Cab_01P_oCabSubnet_e4e2333d_Tx
        CIOM_Cab_34P_Tp_oCabSubnet_377e6916_Tx: CanIfTxPduCanId=418873664, CanIfTxPduUserTxConfirmationName=CanTp_TxConfirmation, CanIfTxPduUserTxConfirmationUL=CAN_TP, CanIfTxPduId=26, CanIfTxPduBufferRef=CanIfBufferCfg_CIOM_Cab_34P_Tp_oCabSubnet_377e6916_Tx, CanIfTxPduRef=CIOM_Cab_34P_Tp_oCabSubnet_e6c19589_Tx
        CIOM_Cab_07P_oCabSubnet_4af99bab_Tx: CanIfTxPduCanId=402632000, CanIfTxPduUserTxConfirmationName=NULL_PTR, CanIfTxPduUserTxConfirmationUL=NONE, CanIfTxPduId=36, CanIfTxPduBufferRef=CanIfBufferCfg_CIOM_Cab_07P_oCabSubnet_4af99bab_Tx, CanIfTxPduRef=CIOM_Cab_07P_oCabSubnet_adad2402_Tx
        CIOM_BB2_12S_Tp_oBackbone2_b9170acc_Tx: CanIfTxPduCanId=352264000, CanIfTxPduUserTxConfirmationUL=CAN_TP, CanIfTxPduId=187, CanIfTxPduUserTxConfirmationName=CanTp_TxConfirmation, CanIfTxPduBufferRef=CHNL_a6b6a922, CanIfTxPduRef=CIOM_BB2_12S_Tp_oBackbone2_03cc66fb_Tx
        CCVS_X_CIOMFMS_oFMSNet_1dbcfa70_Tx: CanIfTxPduCanId=419361073, CanIfTxPduUserTxConfirmationName=NULL_PTR, CanIfTxPduUserTxConfirmationUL=NONE, CanIfTxPduId=96, CanIfTxPduBufferRef=CanIfBufferCfg_CCVS_X_CIOMFMS_oFMSNet_1dbcfa70_Tx, CanIfTxPduRef=CCVS_X_CIOMFMS_oFMSNet_559ff1c7_Tx
      VMCU_BB2_73P_oBackbone2_283dab1e_Rx (CanIfRxPduCfg):
        CanIfRxPduCanId = 1032
        CanIfRxPduCanIdType = EXTENDED_CAN
        CanIfRxPduDlc = 8
        CanIfRxPduUserRxIndicationName = PduR_CanIfRxIndication
        CanIfRxPduUserRxIndicationUL = PDUR
        CanIfRxPduId = 212
        CanIfRxPduReadData = false
        CanIfRxPduReadNotifyStatus = false
        CanIfRxPduDlcCheck = true
        CanIfRxPduHrhIdRef = CN_Backbone2_7b3866ec_Rx
        CanIfRxPduRef = VMCU_BB2_73P_oBackbone2_67b68035_Rx
      CIOM_Sec_10S_Tp_oSecuritySubnet_8c7f36ae_Tx (CanIfTxPduCfg):
        CanIfTxPduCanId = 352272192
        CanIfTxPduCanIdType = EXTENDED_CAN
        CanIfTxPduDlc = 8
        CanIfTxPduUserTxConfirmationName = CanTp_TxConfirmation
        CanIfTxPduUserTxConfirmationUL = CAN_TP
        CanIfTxPduId = 82
        CanIfTxPduReadNotifyStatus = false
        CanIfTxPduType = STATIC
        CanIfTxPduBufferRef = CanIfBufferCfg_CIOM_Sec_10S_Tp_oSecuritySubnet_8c7f36ae_Tx
        CanIfTxPduRef = CIOM_Sec_10S_Tp_oSecuritySubnet_07533c76_Tx
      VMCU_BB2_57P_FCM_Tp_oBackbone2_65fb58e9_Tx (CanIfTxPduCfg):
        CanIfTxPduCanId = 1399
        CanIfTxPduCanIdType = EXTENDED_CAN
        CanIfTxPduDlc = 8
        CanIfTxPduUserTxConfirmationName = CanTp_TxConfirmation
        CanIfTxPduUserTxConfirmationUL = CAN_TP
        CanIfTxPduId = 209
        CanIfTxPduReadNotifyStatus = false
        CanIfTxPduType = STATIC
        CanIfTxPduBufferRef = CHNL_a6b6a922
        CanIfTxPduRef = VMCU_BB2_57P_FCM_Tp_oBackbone2_5333f7b7_Tx
      AnmMsg_EMS_Backbone2_oBackbone2_5f08a43f_Rx (CanIfRxPduCfg):
        CanIfRxPduCanId = 486510595
        CanIfRxPduCanIdType = EXTENDED_CAN
        CanIfRxPduDlc = 4
        CanIfRxPduUserRxIndicationName = PduR_CanIfRxIndication
        CanIfRxPduUserRxIndicationUL = PDUR
        CanIfRxPduId = 159
        CanIfRxPduReadData = false
        CanIfRxPduReadNotifyStatus = false
        CanIfRxPduDlcCheck = true
        CanIfRxPduHrhIdRef = CN_Backbone2_7b3866ec_Rx
        CanIfRxPduRef = AnmMsg_EMS_Backbone2_oBackbone2_bf0abd7e_Rx
      CIOM_Sec_06S_Tp_oSecuritySubnet_39a2f744_Tx (CanIfTxPduCfg):
        CanIfTxPduCanId = 352264159
        CanIfTxPduCanIdType = EXTENDED_CAN
        CanIfTxPduDlc = 8
        CanIfTxPduUserTxConfirmationName = CanTp_TxConfirmation
        CanIfTxPduUserTxConfirmationUL = CAN_TP
        CanIfTxPduId = 84
        CanIfTxPduReadNotifyStatus = false
        CanIfTxPduType = STATIC
        CanIfTxPduBufferRef = CanIfBufferCfg_CIOM_Sec_06S_Tp_oSecuritySubnet_39a2f744_Tx
        CanIfTxPduRef = CIOM_Sec_06S_Tp_oSecuritySubnet_070c5acf_Tx
      PhysDiagReqMsg_40_F2_BB2_Tp_oBackbone2_87192655_Rx (CanIfRxPduCfg):
        CanIfRxPduCanId = 524304626
        CanIfRxPduCanIdType = EXTENDED_CAN
        CanIfRxPduDlc = 8
        CanIfRxPduUserRxIndicationName = CanTp_RxIndication
        CanIfRxPduUserRxIndicationType = PDUID_PDUINFOPTR
        CanIfRxPduUserRxIndicationUL = CAN_TP
        CanIfRxPduId = 151
        CanIfRxPduReadData = false
        CanIfRxPduReadNotifyStatus = false
        CanIfRxPduDlcCheck = true
        CanIfRxPduHrhIdRef = CN_Backbone2_7b3866ec_Rx
        CanIfRxPduRef = PhysDiagReqMsg_40_F2_BB2_Tp_oBackbone2_f76d5f95_Rx
      AnmMsg_VMCU_Backbone2_oBackbone2_e6fd44da_Rx (CanIfRxPduCfg):
        CanIfRxPduCanId = 486510599
        CanIfRxPduCanIdType = EXTENDED_CAN
        CanIfRxPduDlc = 4
        CanIfRxPduUserRxIndicationName = PduR_CanIfRxIndication
        CanIfRxPduUserRxIndicationUL = PDUR
        CanIfRxPduId = 157
        CanIfRxPduReadData = false
        CanIfRxPduReadNotifyStatus = false
        CanIfRxPduDlcCheck = true
        CanIfRxPduHrhIdRef = CN_Backbone2_7b3866ec_Rx
        CanIfRxPduRef = AnmMsg_VMCU_Backbone2_oBackbone2_d29bb903_Rx
      3 x CanIfTxPduCfg, all with CanIfTxPduCanIdType=EXTENDED_CAN, CanIfTxPduDlc=8, CanIfTxPduReadNotifyStatus=false, CanIfTxPduType=STATIC:
        IntTesterTGW2FuncDiagMsg_Sec_Tp_oSecuritySubnet_57d96404_Tx: CanIfTxPduCanId=524419060, CanIfTxPduUserTxConfirmationName=CanTp_TxConfirmation, CanIfTxPduUserTxConfirmationUL=CAN_TP, CanIfTxPduId=56, CanIfTxPduBufferRef=CanIfBufferCfg_IntTesterTGW2FuncDiagMsg_Sec_Tp_oSecuritySubnet_57d96404_Tx, CanIfTxPduRef=IntTesterTGW2FuncDiagMsg_Sec_Tp_oSecuritySubnet_e36a9851_Tx
        CIOM_Sec_05S_Tp_oSecuritySubnet_c8b553a6_Tx: CanIfTxPduCanId=352315839, CanIfTxPduUserTxConfirmationName=CanTp_TxConfirmation, CanIfTxPduUserTxConfirmationUL=CAN_TP, CanIfTxPduId=72, CanIfTxPduBufferRef=CanIfBufferCfg_CIOM_Sec_05S_Tp_oSecuritySubnet_c8b553a6_Tx, CanIfTxPduRef=CIOM_Sec_05S_Tp_oSecuritySubnet_38c7245a_Tx
        CIOM_BB2_03P_oBackbone2_f8181638_Tx: CanIfTxPduCanId=285159488, CanIfTxPduUserTxConfirmationName=NULL_PTR, CanIfTxPduUserTxConfirmationUL=NONE, CanIfTxPduId=195, CanIfTxPduBufferRef=CHNL_a6b6a922, CanIfTxPduRef=CIOM_BB2_03P_oBackbone2_2a32f2ac_Tx
      DiagRespMsgIntHMIIOM_F3_A1_Sec_Tp_oSecuritySubnet_052f8796_Rx (CanIfRxPduCfg):
        CanIfRxPduCanId = 524350369
        CanIfRxPduCanIdType = EXTENDED_CAN
        CanIfRxPduDlc = 8
        CanIfRxPduUserRxIndicationName = CanTp_RxIndication
        CanIfRxPduUserRxIndicationType = PDUID_PDUINFOPTR
        CanIfRxPduUserRxIndicationUL = CAN_TP
        CanIfRxPduId = 93
        CanIfRxPduReadData = false
        CanIfRxPduReadNotifyStatus = false
        CanIfRxPduDlcCheck = true
        CanIfRxPduHrhIdRef = CN_SecuritySubnet_3840872e_Rx
        CanIfRxPduRef = DiagRespMsgIntHMIIOM_F3_A1_Sec_Tp_oSecuritySubnet_27771749_Rx
      CIOM_Cab_26P_oCabSubnet_2df59da9_Tx (CanIfTxPduCfg):
        CanIfTxPduCanId = 352270912
        CanIfTxPduCanIdType = EXTENDED_CAN
        CanIfTxPduDlc = 8
        CanIfTxPduUserTxConfirmationName = NULL_PTR
        CanIfTxPduUserTxConfirmationUL = NONE
        CanIfTxPduId = 41
        CanIfTxPduReadNotifyStatus = false
        CanIfTxPduType = STATIC
        CanIfTxPduBufferRef = CanIfBufferCfg_CIOM_Cab_26P_oCabSubnet_2df59da9_Tx
        CanIfTxPduRef = CIOM_Cab_26P_oCabSubnet_3192004e_Tx
      HMIIOM_BB2_07P_oBackbone2_91241c86_Rx (CanIfRxPduCfg):
        CanIfRxPduCanId = 851
        CanIfRxPduCanIdType = EXTENDED_CAN
        CanIfRxPduDlc = 8
        CanIfRxPduUserRxIndicationName = PduR_CanIfRxIndication
        CanIfRxPduUserRxIndicationUL = PDUR
        CanIfRxPduId = 222
        CanIfRxPduReadData = false
        CanIfRxPduReadNotifyStatus = false
        CanIfRxPduDlcCheck = true
        CanIfRxPduHrhIdRef = CN_Backbone2_7b3866ec_Rx
        CanIfRxPduRef = HMIIOM_BB2_07P_oBackbone2_43ce6e92_Rx
      VMCU_BB2_55P_oBackbone2_a30a2c5d_Rx (CanIfRxPduCfg):
        CanIfRxPduCanId = 1059
        CanIfRxPduCanIdType = EXTENDED_CAN
        CanIfRxPduDlc = 8
        CanIfRxPduUserRxIndicationName = PduR_CanIfRxIndication
        CanIfRxPduUserRxIndicationUL = PDUR
        CanIfRxPduId = 207
        CanIfRxPduReadData = false
        CanIfRxPduReadNotifyStatus = false
        CanIfRxPduDlcCheck = true
        CanIfRxPduHrhIdRef = CN_Backbone2_7b3866ec_Rx
        CanIfRxPduRef = VMCU_BB2_55P_oBackbone2_431cb6ec_Rx
      Alarm_Sec_03S_FCM_Tp_oSecuritySubnet_48e47132_Tx (CanIfTxPduCfg):
        CanIfTxPduCanId = 352261440
        CanIfTxPduCanIdType = EXTENDED_CAN
        CanIfTxPduDlc = 8
        CanIfTxPduUserTxConfirmationName = CanTp_TxConfirmation
        CanIfTxPduUserTxConfirmationUL = CAN_TP
        CanIfTxPduId = 85
        CanIfTxPduReadNotifyStatus = false
        CanIfTxPduType = STATIC
        CanIfTxPduBufferRef = CanIfBufferCfg_Alarm_Sec_03S_FCM_Tp_oSecuritySubnet_48e47132_Tx
        CanIfTxPduRef = Alarm_Sec_03S_FCM_Tp_oSecuritySubnet_cc124251_Tx
      5 x CanIfRxPduCfg, all with CanIfRxPduCanIdType=EXTENDED_CAN, CanIfRxPduDlc=8, CanIfRxPduReadData=false, CanIfRxPduReadNotifyStatus=false, CanIfRxPduDlcCheck=true:
        PhysDiagReqMsg_A2_F2_BB2_Tp_oBackbone2_e7d85c22_Rx: CanIfRxPduCanId=524329714, CanIfRxPduUserRxIndicationName=CanTp_RxIndication, CanIfRxPduUserRxIndicationType=PDUID_PDUINFOPTR, CanIfRxPduUserRxIndicationUL=CAN_TP, CanIfRxPduId=136, CanIfRxPduHrhIdRef=CN_Backbone2_7b3866ec_Rx, CanIfRxPduRef=PhysDiagReqMsg_A2_F2_BB2_Tp_oBackbone2_cdfcfb09_Rx
        DACU_BB2_02P_oBackbone2_0b8371c6_Rx: CanIfRxPduCanId=285206864, CanIfRxPduUserRxIndicationName=PduR_CanIfRxIndication, CanIfRxPduUserRxIndicationUL=PDUR, CanIfRxPduId=170, CanIfRxPduHrhIdRef=CN_Backbone2_7b3866ec_Rx, CanIfRxPduRef=DACU_BB2_02P_oBackbone2_a741c3bf_Rx
        DiagRespMsgIntTGW2_F4_A0_Sec_Tp_oSecuritySubnet_d9469eac_Rx: CanIfRxPduCanId=524350624, CanIfRxPduUserRxIndicationName=CanTp_RxIndication, CanIfRxPduUserRxIndicationType=PDUID_PDUINFOPTR, CanIfRxPduUserRxIndicationUL=CAN_TP, CanIfRxPduId=91, CanIfRxPduHrhIdRef=CN_SecuritySubnet_3840872e_Rx, CanIfRxPduRef=DiagRespMsgIntTGW2_F4_A0_Sec_Tp_oSecuritySubnet_96343ca1_Rx
        VMCU_BB2_29P_oBackbone2_6ebc6019_Rx: CanIfRxPduCanId=1240, CanIfRxPduUserRxIndicationName=PduR_CanIfRxIndication, CanIfRxPduUserRxIndicationUL=PDUR, CanIfRxPduId=205, CanIfRxPduHrhIdRef=CN_Backbone2_7b3866ec_Rx, CanIfRxPduRef=VMCU_BB2_29P_oBackbone2_515f6a4b_Rx
        CIOM_Cab_20S_FCM_Tp_oCabSubnet_88858df9_Rx: CanIfRxPduCanId=419381184, CanIfRxPduUserRxIndicationName=CanTp_RxIndication, CanIfRxPduUserRxIndicationUL=CAN_TP, CanIfRxPduId=57, CanIfRxPduHrhIdRef=CN_CabSubnet_eedbadff_Rx, CanIfRxPduRef=CIOM_Cab_20S_FCM_Tp_oCabSubnet_ae93e677_Rx
      HMIIOM_BB2_35S_FCM_Tp_oBackbone2_e32a38c7_Tx (CanIfTxPduCfg):
        CanIfTxPduCanId = 952
        CanIfTxPduCanIdType = EXTENDED_CAN
        CanIfTxPduDlc = 8
        CanIfTxPduUserTxConfirmationName = CanTp_TxConfirmation
        CanIfTxPduUserTxConfirmationUL = CAN_TP
        CanIfTxPduId = 218
        CanIfTxPduReadNotifyStatus = false
        CanIfTxPduType = STATIC
        CanIfTxPduBufferRef = CHNL_a6b6a922
        CanIfTxPduRef = HMIIOM_BB2_35S_FCM_Tp_oBackbone2_85685e55_Tx
      VP236_X_CIOMFMS_oFMSNet_524bf569_Tx (CanIfTxPduCfg):
        CanIfTxPduCanId = 419425329
        CanIfTxPduCanIdType = EXTENDED_CAN
        CanIfTxPduDlc = 8
        CanIfTxPduUserTxConfirmationName = NULL_PTR
        CanIfTxPduUserTxConfirmationUL = NONE
        CanIfTxPduId = 92
        CanIfTxPduReadNotifyStatus = false
        CanIfTxPduType = STATIC
        CanIfTxPduBufferRef = CanIfBufferCfg_VP236_X_CIOMFMS_oFMSNet_524bf569_Tx
        CanIfTxPduRef = VP236_X_CIOMFMS_oFMSNet_634950b3_Tx
      IntTesterTGW2FuncDiagMsg_BB2_Tp_oBackbone2_c6fcfce9_Rx (CanIfRxPduCfg):
        CanIfRxPduCanId = 524419060
        CanIfRxPduCanIdType = EXTENDED_CAN
        CanIfRxPduDlc = 8
        CanIfRxPduUserRxIndicationName = CanTp_RxIndication
        CanIfRxPduUserRxIndicationType = PDUID_PDUINFOPTR
        CanIfRxPduUserRxIndicationUL = CAN_TP
        CanIfRxPduId = 129
        CanIfRxPduReadData = false
        CanIfRxPduReadNotifyStatus = false
        CanIfRxPduDlcCheck = true
        CanIfRxPduHrhIdRef = CN_Backbone2_7b3866ec_Rx
        CanIfRxPduRef = IntTesterTGW2FuncDiagMsg_BB2_Tp_oBackbone2_57c672ca_Rx
      PDM_Sec_03S_FCM_Tp_oSecuritySubnet_2750bd9e_Tx (CanIfTxPduCfg):
        CanIfTxPduCanId = 352311458
        CanIfTxPduCanIdType = EXTENDED_CAN
        CanIfTxPduDlc = 8
        CanIfTxPduUserTxConfirmationName = CanTp_TxConfirmation
        CanIfTxPduUserTxConfirmationUL = CAN_TP
        CanIfTxPduId = 73
        CanIfTxPduReadNotifyStatus = false
        CanIfTxPduType = STATIC
        CanIfTxPduBufferRef = CanIfBufferCfg_PDM_Sec_03S_FCM_Tp_oSecuritySubnet_2750bd9e_Tx
        CanIfTxPduRef = PDM_Sec_03S_FCM_Tp_oSecuritySubnet_b14f51a1_Tx
      CIOM_BB2_27S_oBackbone2_9ff4c6d6_Tx (CanIfTxPduCfg):
        CanIfTxPduCanId = 343162688
        CanIfTxPduCanIdType = EXTENDED_CAN
        CanIfTxPduDlc = 8
        CanIfTxPduUserTxConfirmationName = PduR_CanIfTxConfirmation
        CanIfTxPduUserTxConfirmationUL = PDUR
        CanIfTxPduId = 189
        CanIfTxPduReadNotifyStatus = false
        CanIfTxPduType = STATIC
        CanIfTxPduBufferRef = CHNL_a6b6a922
        CanIfTxPduRef = CIOM_BB2_27S_oBackbone2_2575f013_Tx
      DiagUUDTRespMsg1_F2_98_Cab_oCabSubnet_2175e3c9_Rx (CanIfRxPduCfg):
        CanIfRxPduCanId = 524481176
        CanIfRxPduCanIdType = EXTENDED_CAN
        CanIfRxPduDlc = 8
        CanIfRxPduUserRxIndicationUL = PDUR
        CanIfRxPduId = 33
        CanIfRxPduReadData = false
        CanIfRxPduReadNotifyStatus = false
        CanIfRxPduUserRxIndicationName = PduR_CanIfRxIndication
        CanIfRxPduDlcCheck = true
        CanIfRxPduHrhIdRef = CN_CabSubnet_eedbadff_Rx
        CanIfRxPduRef = DiagUUDTRespMsg1_F2_98_Cab_oCabSubnet_7b5eea01_Rx
      PhysDiagRespMsg_F2_98_BB2_Tp_oBackbone2_0c1730ea_Tx (CanIfTxPduCfg):
        CanIfTxPduCanId = 524350104
        CanIfTxPduCanIdType = EXTENDED_CAN
        CanIfTxPduDlc = 8
        CanIfTxPduUserTxConfirmationName = CanTp_TxConfirmation
        CanIfTxPduUserTxConfirmationUL = CAN_TP
        CanIfTxPduId = 168
        CanIfTxPduReadNotifyStatus = false
        CanIfTxPduType = STATIC
        CanIfTxPduBufferRef = CHNL_a6b6a922
        CanIfTxPduRef = PhysDiagRespMsg_F2_98_BB2_Tp_oBackbone2_218ca79d_Tx
      4 x CanIfRxPduCfg, all with CanIfRxPduCanIdType=EXTENDED_CAN, CanIfRxPduDlc=8, CanIfRxPduReadData=false, CanIfRxPduReadNotifyStatus=false, CanIfRxPduDlcCheck=true:
        DiagUUDTRespMsg1_F2_A0_Sec_oSecuritySubnet_46825d6a_Rx: CanIfRxPduCanId=524481184, CanIfRxPduUserRxIndicationUL=PDUR, CanIfRxPduId=88, CanIfRxPduUserRxIndicationName=PduR_CanIfRxIndication, CanIfRxPduHrhIdRef=CN_SecuritySubnet_3840872e_Rx, CanIfRxPduRef=DiagUUDTRespMsg1_F2_A0_Sec_oSecuritySubnet_3b2bea04_Rx
        DDM_Sec_01P_oSecuritySubnet_09e2b30b_Rx: CanIfRxPduCanId=285196192, CanIfRxPduUserRxIndicationName=PduR_CanIfRxIndication, CanIfRxPduUserRxIndicationUL=PDUR, CanIfRxPduId=122, CanIfRxPduHrhIdRef=CN_SecuritySubnet_3840872e_Rx, CanIfRxPduRef=DDM_Sec_01P_oSecuritySubnet_d2cc7529_Rx
        CIOM_Sec_05S_FCM_Tp_oSecuritySubnet_02ea2344_Rx: CanIfRxPduCanId=352315840, CanIfRxPduUserRxIndicationName=CanTp_RxIndication, CanIfRxPduUserRxIndicationUL=CAN_TP, CanIfRxPduId=106, CanIfRxPduHrhIdRef=CN_SecuritySubnet_3840872e_Rx, CanIfRxPduRef=CIOM_Sec_05S_FCM_Tp_oSecuritySubnet_de6c8083_Rx
        HMIIOM_BB2_38P_oBackbone2_17230dd8_Rx: CanIfRxPduCanId=1421, CanIfRxPduUserRxIndicationName=PduR_CanIfRxIndication, CanIfRxPduUserRxIndicationUL=PDUR, CanIfRxPduId=174, CanIfRxPduHrhIdRef=CN_Backbone2_7b3866ec_Rx, CanIfRxPduRef=HMIIOM_BB2_38P_oBackbone2_4358f946_Rx
      DiagReqMsgIntTGW2_98_F4_Cab_Tp_oCabSubnet_2e8c3543_Tx (CanIfTxPduCfg):
        CanIfTxPduCanId = 524327156
        CanIfTxPduCanIdType = EXTENDED_CAN
        CanIfTxPduDlc = 8
        CanIfTxPduUserTxConfirmationName = CanTp_TxConfirmation
        CanIfTxPduUserTxConfirmationUL = CAN_TP
        CanIfTxPduId = 9
        CanIfTxPduReadNotifyStatus = false
        CanIfTxPduType = STATIC
        CanIfTxPduBufferRef = CanIfBufferCfg_DiagReqMsgIntTGW2_98_F4_Cab_Tp_oCabSubnet_2e8c3543_Tx
        CanIfTxPduRef = DiagReqMsgIntTGW2_98_F4_Cab_Tp_oCabSubnet_1f14bbab_Tx
      HMIIOM_BB2_35S_Tp_oBackbone2_61dbf5f7_Rx (CanIfRxPduCfg):
        CanIfRxPduCanId = 949
        CanIfRxPduCanIdType = EXTENDED_CAN
        CanIfRxPduDlc = 8
        CanIfRxPduUserRxIndicationName = CanTp_RxIndication
        CanIfRxPduUserRxIndicationType = PDUID_PDUINFOPTR
        CanIfRxPduUserRxIndicationUL = CAN_TP
        CanIfRxPduId = 218
        CanIfRxPduReadData = false
        CanIfRxPduReadNotifyStatus = false
        CanIfRxPduDlcCheck = true
        CanIfRxPduHrhIdRef = CN_Backbone2_7b3866ec_Rx
        CanIfRxPduRef = HMIIOM_BB2_35S_Tp_oBackbone2_3e85445b_Rx
      CIOM_BB2_10P_oBackbone2_503b56b9_Tx (CanIfTxPduCfg):
        CanIfTxPduCanId = 335540288
        CanIfTxPduCanIdType = EXTENDED_CAN
        CanIfTxPduDlc = 8
        CanIfTxPduUserTxConfirmationName = NULL_PTR
        CanIfTxPduUserTxConfirmationUL = NONE
        CanIfTxPduId = 190
        CanIfTxPduReadNotifyStatus = false
        CanIfTxPduType = STATIC
        CanIfTxPduBufferRef = CHNL_a6b6a922
        CanIfTxPduRef = CIOM_BB2_10P_oBackbone2_d5df6ae0_Tx
      DiagRespMsgIntTGW2_F4_98_Cab_Tp_oCabSubnet_d506a20a_Rx (CanIfRxPduCfg):
        CanIfRxPduCanId = 524350616
        CanIfRxPduCanIdType = EXTENDED_CAN
        CanIfRxPduDlc = 8
        CanIfRxPduUserRxIndicationName = CanTp_RxIndication
        CanIfRxPduUserRxIndicationType = PDUID_PDUINFOPTR
        CanIfRxPduUserRxIndicationUL = CAN_TP
        CanIfRxPduId = 37
        CanIfRxPduReadData = false
        CanIfRxPduReadNotifyStatus = false
        CanIfRxPduDlcCheck = true
        CanIfRxPduHrhIdRef = CN_CabSubnet_eedbadff_Rx
        CanIfRxPduRef = DiagRespMsgIntTGW2_F4_98_Cab_Tp_oCabSubnet_c5366f75_Rx
      DiagFaultStat_Alarm_BB2_oBackbone2_7b6d0a04_Tx (CanIfTxPduCfg):
        CanIfTxPduCanId = 1504
        CanIfTxPduCanIdType = EXTENDED_CAN
        CanIfTxPduDlc = 8
        CanIfTxPduUserTxConfirmationName = PduR_CanIfTxConfirmation
        CanIfTxPduUserTxConfirmationUL = PDUR
        CanIfTxPduId = 207
        CanIfTxPduReadNotifyStatus = false
        CanIfTxPduType = STATIC
        CanIfTxPduBufferRef = CHNL_a6b6a922
        CanIfTxPduRef = DiagFaultStat_Alarm_BB2_oBackbone2_8c5e38cc_Tx
      AnmMsg_CCM_CabSubnet_oCabSubnet_7e592096_Rx (CanIfRxPduCfg):
        CanIfRxPduCanId = 486510629
        CanIfRxPduCanIdType = EXTENDED_CAN
        CanIfRxPduDlc = 4
        CanIfRxPduUserRxIndicationName = PduR_CanIfRxIndication
        CanIfRxPduUserRxIndicationUL = PDUR
        CanIfRxPduId = 52
        CanIfRxPduReadData = false
        CanIfRxPduReadNotifyStatus = false
        CanIfRxPduDlcCheck = true
        CanIfRxPduHrhIdRef = CN_CabSubnet_eedbadff_Rx
        CanIfRxPduRef = AnmMsg_CCM_CabSubnet_oCabSubnet_2f78a729_Rx
      PhysDiagRespMsg_F2_40_BB2_Tp_oBackbone2_bd4d3e52_Tx (CanIfTxPduCfg):
        CanIfTxPduCanId = 524350016
        CanIfTxPduCanIdType = EXTENDED_CAN
        CanIfTxPduDlc = 8
        CanIfTxPduUserTxConfirmationName = CanTp_TxConfirmation
        CanIfTxPduUserTxConfirmationUL = CAN_TP
        CanIfTxPduId = 170
        CanIfTxPduReadNotifyStatus = false
        CanIfTxPduType = STATIC
        CanIfTxPduBufferRef = CHNL_a6b6a922
        CanIfTxPduRef = PhysDiagRespMsg_F2_40_BB2_Tp_oBackbone2_20ea29cc_Tx
      DiagFaultStat_WRCS_BB2_oBackbone2_dad83051_Tx (CanIfTxPduCfg):
        CanIfTxPduCanId = 1520
        CanIfTxPduCanIdType = EXTENDED_CAN
        CanIfTxPduDlc = 8
        CanIfTxPduUserTxConfirmationName = PduR_CanIfTxConfirmation
        CanIfTxPduUserTxConfirmationUL = PDUR
        CanIfTxPduId = 200
        CanIfTxPduReadNotifyStatus = false
        CanIfTxPduType = STATIC
        CanIfTxPduBufferRef = CHNL_a6b6a922
        CanIfTxPduRef = DiagFaultStat_WRCS_BB2_oBackbone2_e82bcc3e_Tx
      VMCU_BB2_51P_oBackbone2_e7752e1c_Rx (CanIfRxPduCfg):
        CanIfRxPduCanId = 729
        CanIfRxPduCanIdType = EXTENDED_CAN
        CanIfRxPduDlc = 8
        CanIfRxPduUserRxIndicationName = PduR_CanIfRxIndication
        CanIfRxPduUserRxIndicationUL = PDUR
        CanIfRxPduId = 232
        CanIfRxPduReadData = false
        CanIfRxPduReadNotifyStatus = false
        CanIfRxPduDlcCheck = true
        CanIfRxPduHrhIdRef = CN_Backbone2_7b3866ec_Rx
        CanIfRxPduRef = VMCU_BB2_51P_oBackbone2_3296acc6_Rx
      SRS_Cab_06P_oCabSubnet_bec0c2b2_Rx (CanIfRxPduCfg):
        CanIfRxPduCanId = 419342675
        CanIfRxPduCanIdType = EXTENDED_CAN
        CanIfRxPduDlc = 8
        CanIfRxPduUserRxIndicationName = PduR_CanIfRxIndication
        CanIfRxPduUserRxIndicationUL = PDUR
        CanIfRxPduId = 58
        CanIfRxPduReadData = false
        CanIfRxPduReadNotifyStatus = false
        CanIfRxPduDlcCheck = true
        CanIfRxPduHrhIdRef = CN_CabSubnet_eedbadff_Rx
        CanIfRxPduRef = SRS_Cab_06P_oCabSubnet_393002bd_Rx
      4 x CanIfTxPduCfg, all with CanIfTxPduCanIdType=EXTENDED_CAN, CanIfTxPduDlc=8, CanIfTxPduReadNotifyStatus=false, CanIfTxPduType=STATIC:
        CIOM_Cab_22P_oCabSubnet_698a9fe8_Tx: CanIfTxPduCanId=401702725, CanIfTxPduUserTxConfirmationName=NULL_PTR, CanIfTxPduUserTxConfirmationUL=NONE, CanIfTxPduId=37, CanIfTxPduBufferRef=CanIfBufferCfg_CIOM_Cab_22P_oCabSubnet_698a9fe8_Tx, CanIfTxPduRef=CIOM_Cab_22P_oCabSubnet_40181a64_Tx
        CIOM_Cab_29S_Tp_oCabSubnet_e3dce9b1_Tx: CanIfTxPduCanId=285196096, CanIfTxPduUserTxConfirmationName=CanTp_TxConfirmation, CanIfTxPduUserTxConfirmationUL=CAN_TP, CanIfTxPduId=46, CanIfTxPduBufferRef=CanIfBufferCfg_CIOM_Cab_29S_Tp_oCabSubnet_e3dce9b1_Tx, CanIfTxPduRef=CIOM_Cab_29S_Tp_oCabSubnet_93765729_Tx
        DiagRespMsgIntTGW2_F4_98_BB2_Tp_oBackbone2_8516ddd7_Tx: CanIfTxPduCanId=524350616, CanIfTxPduUserTxConfirmationName=CanTp_TxConfirmation, CanIfTxPduUserTxConfirmationUL=CAN_TP, CanIfTxPduId=152, CanIfTxPduBufferRef=CHNL_a6b6a922, CanIfTxPduRef=DiagRespMsgIntTGW2_F4_98_BB2_Tp_oBackbone2_579b43fa_Tx
        EEC2_X_CIOMFMS_oFMSNet_d3e60e6a_Tx: CanIfTxPduCanId=217056049, CanIfTxPduUserTxConfirmationName=NULL_PTR, CanIfTxPduUserTxConfirmationUL=NONE, CanIfTxPduId=117, CanIfTxPduBufferRef=CanIfBufferCfg_EEC2_X_CIOMFMS_oFMSNet_d3e60e6a_Tx, CanIfTxPduRef=EEC2_X_CIOMFMS_oFMSNet_821ee9a4_Tx
      EMS_BB2_11S_Tp_oBackbone2_f0eef471_Rx (CanIfRxPduCfg):
        CanIfRxPduCanId = 958
        CanIfRxPduCanIdType = EXTENDED_CAN
        CanIfRxPduDlc = 8
        CanIfRxPduUserRxIndicationName = CanTp_RxIndication
        CanIfRxPduUserRxIndicationType = PDUID_PDUINFOPTR
        CanIfRxPduUserRxIndicationUL = CAN_TP
        CanIfRxPduId = 217
        CanIfRxPduReadData = false
        CanIfRxPduReadNotifyStatus = false
        CanIfRxPduDlcCheck = true
        CanIfRxPduHrhIdRef = CN_Backbone2_7b3866ec_Rx
        CanIfRxPduRef = EMS_BB2_11S_Tp_oBackbone2_061c866c_Rx
      PhysDiagRespMsg_F2_26_Cab_Tp_oCabSubnet_48eedf32_Rx (CanIfRxPduCfg):
        CanIfRxPduCanId = 524349990
        CanIfRxPduCanIdType = EXTENDED_CAN
        CanIfRxPduDlc = 8
        CanIfRxPduUserRxIndicationName = CanTp_RxIndication
        CanIfRxPduUserRxIndicationType = PDUID_PDUINFOPTR
        CanIfRxPduUserRxIndicationUL = CAN_TP
        CanIfRxPduId = 47
        CanIfRxPduReadData = false
        CanIfRxPduReadNotifyStatus = false
        CanIfRxPduDlcCheck = true
        CanIfRxPduHrhIdRef = CN_CabSubnet_eedbadff_Rx
        CanIfRxPduRef = PhysDiagRespMsg_F2_26_Cab_Tp_oCabSubnet_55d03a3a_Rx
      7 x CanIfTxPduCfg, all with CanIfTxPduCanIdType=EXTENDED_CAN, CanIfTxPduDlc=8, CanIfTxPduUserTxConfirmationName=CanTp_TxConfirmation, CanIfTxPduUserTxConfirmationUL=CAN_TP, CanIfTxPduReadNotifyStatus=false, CanIfTxPduType=STATIC:
        DiagRespMsgIntTGW2_F4_A2_BB2_Tp_oBackbone2_249acffa_Tx: CanIfTxPduCanId=524350626, CanIfTxPduId=149, CanIfTxPduBufferRef=CHNL_a6b6a922, CanIfTxPduRef=DiagRespMsgIntTGW2_F4_A2_BB2_Tp_oBackbone2_a3405e00_Tx
        DiagRespMsgIntTGW2_F4_A0_BB2_Tp_oBackbone2_7d9615e1_Tx: CanIfTxPduCanId=524350624, CanIfTxPduId=151, CanIfTxPduBufferRef=CHNL_a6b6a922, CanIfTxPduRef=DiagRespMsgIntTGW2_F4_A0_BB2_Tp_oBackbone2_6320a385_Tx
        DiagRespMsgIntHMIIOM_F3_A2_BB2_Tp_oBackbone2_d6b4927e_Tx: CanIfTxPduCanId=524350370, CanIfTxPduId=157, CanIfTxPduBufferRef=CHNL_a6b6a922, CanIfTxPduRef=DiagRespMsgIntHMIIOM_F3_A2_BB2_Tp_oBackbone2_8cec83a2_Tx
        CIOM_Cab_11S_Tp_oCabSubnet_ec1435f4_Tx: CanIfTxPduCanId=418351103, CanIfTxPduId=33, CanIfTxPduBufferRef=CanIfBufferCfg_CIOM_Cab_11S_Tp_oCabSubnet_ec1435f4_Tx, CanIfTxPduRef=CIOM_Cab_11S_Tp_oCabSubnet_3dd38dd2_Tx
        CIOM_Sec_08S_Tp_oSecuritySubnet_eafb50f2_Tx: CanIfTxPduCanId=352259136, CanIfTxPduId=86, CanIfTxPduBufferRef=CanIfBufferCfg_CIOM_Sec_08S_Tp_oSecuritySubnet_eafb50f2_Tx, CanIfTxPduRef=CIOM_Sec_08S_Tp_oSecuritySubnet_647cf642_Tx
        HMIIOM_BB2_19P_CIOM_FCM_Tp_oBackbone2_1a616940_Tx: CanIfTxPduCanId=1387, CanIfTxPduId=211, CanIfTxPduBufferRef=CHNL_a6b6a922, CanIfTxPduRef=HMIIOM_BB2_19P_CIOM_FCM_Tp_oBackbone2_27bd77ce_Tx
        DDM_Sec_04S_FCM_Tp_oSecuritySubnet_eddd4cee_Tx: CanIfTxPduCanId=352298401, CanIfTxPduId=76, CanIfTxPduBufferRef=CanIfBufferCfg_DDM_Sec_04S_FCM_Tp_oSecuritySubnet_eddd4cee_Tx, CanIfTxPduRef=DDM_Sec_04S_FCM_Tp_oSecuritySubnet_2c1e44e1_Tx
      LECM1_Cab_04P_oCabSubnet_b355ee77_Rx (CanIfRxPduCfg):
        CanIfRxPduCanId = 342246562
        CanIfRxPduCanIdType = EXTENDED_CAN
        CanIfRxPduDlc = 8
        CanIfRxPduUserRxIndicationName = PduR_CanIfRxIndication
        CanIfRxPduUserRxIndicationUL = PDUR
        CanIfRxPduId = 71
        CanIfRxPduReadData = false
        CanIfRxPduReadNotifyStatus = false
        CanIfRxPduDlcCheck = true
        CanIfRxPduHrhIdRef = CN_CabSubnet_eedbadff_Rx
        CanIfRxPduRef = LECM1_Cab_04P_oCabSubnet_324a8202_Rx
      CIOM_Cab_06P_oCabSubnet_2d3a1aab_Tx (CanIfTxPduCfg):
        CanIfTxPduCanId = 285185600
        CanIfTxPduCanIdType = EXTENDED_CAN
        CanIfTxPduDlc = 8
        CanIfTxPduUserTxConfirmationName = NULL_PTR
        CanIfTxPduUserTxConfirmationUL = NONE
        CanIfTxPduId = 47
        CanIfTxPduReadNotifyStatus = false
        CanIfTxPduType = STATIC
        CanIfTxPduBufferRef = CanIfBufferCfg_CIOM_Cab_06P_oCabSubnet_2d3a1aab_Tx
        CanIfTxPduRef = CIOM_Cab_06P_oCabSubnet_5c7721a8_Tx
      DiagRespMsgIntHMIIOM_F3_53_Cab_Tp_oCabSubnet_507b9b04_Rx (CanIfRxPduCfg):
        CanIfRxPduCanId = 524350291
        CanIfRxPduCanIdType = EXTENDED_CAN
        CanIfRxPduDlc = 8
        CanIfRxPduUserRxIndicationName = CanTp_RxIndication
        CanIfRxPduUserRxIndicationType = PDUID_PDUINFOPTR
        CanIfRxPduUserRxIndicationUL = CAN_TP
        CanIfRxPduId = 42
        CanIfRxPduReadData = false
        CanIfRxPduReadNotifyStatus = false
        CanIfRxPduDlcCheck = true
        CanIfRxPduHrhIdRef = CN_CabSubnet_eedbadff_Rx
        CanIfRxPduRef = DiagRespMsgIntHMIIOM_F3_53_Cab_Tp_oCabSubnet_e89d3748_Rx
      HMIIOM_BB2_36S_FCM_Tp_oBackbone2_bf84bd48_Tx (CanIfTxPduCfg):
        CanIfTxPduCanId = 1397
        CanIfTxPduCanIdType = EXTENDED_CAN
        CanIfTxPduDlc = 8
        CanIfTxPduUserTxConfirmationName = CanTp_TxConfirmation
        CanIfTxPduUserTxConfirmationUL = CAN_TP
        CanIfTxPduId = 210
        CanIfTxPduReadNotifyStatus = false
        CanIfTxPduType = STATIC
        CanIfTxPduBufferRef = CHNL_a6b6a922
        CanIfTxPduRef = HMIIOM_BB2_36S_FCM_Tp_oBackbone2_56f342ae_Tx
      CCM_Cab_06P_oCabSubnet_ae969834_Rx (CanIfRxPduCfg):
        CanIfRxPduCanId = 285161848
        CanIfRxPduCanIdType = EXTENDED_CAN
        CanIfRxPduDlc = 8
        CanIfRxPduUserRxIndicationName = PduR_CanIfRxIndication
        CanIfRxPduUserRxIndicationUL = PDUR
        CanIfRxPduId = 78
        CanIfRxPduReadData = false
        CanIfRxPduReadNotifyStatus = false
        CanIfRxPduDlcCheck = true
        CanIfRxPduHrhIdRef = CN_CabSubnet_eedbadff_Rx
        CanIfRxPduRef = CCM_Cab_06P_oCabSubnet_6e486c36_Rx
      HMIIOM_BB2_08P_oBackbone2_33da87f8_Rx (CanIfRxPduCfg):
        CanIfRxPduCanId = 970
        CanIfRxPduCanIdType = EXTENDED_CAN
        CanIfRxPduDlc = 8
        CanIfRxPduUserRxIndicationName = PduR_CanIfRxIndication
        CanIfRxPduUserRxIndicationUL = PDUR
        CanIfRxPduId = 215
        CanIfRxPduReadData = false
        CanIfRxPduReadNotifyStatus = false
        CanIfRxPduDlcCheck = true
        CanIfRxPduHrhIdRef = CN_Backbone2_7b3866ec_Rx
        CanIfRxPduRef = HMIIOM_BB2_08P_oBackbone2_184f4853_Rx
      DiagFaultStat_PDM_BB2_oBackbone2_b720c987_Tx (CanIfTxPduCfg):
        CanIfTxPduCanId = 1515
        CanIfTxPduCanIdType = EXTENDED_CAN
        CanIfTxPduDlc = 8
        CanIfTxPduUserTxConfirmationName = PduR_CanIfTxConfirmation
        CanIfTxPduUserTxConfirmationUL = PDUR
        CanIfTxPduId = 202
        CanIfTxPduReadNotifyStatus = false
        CanIfTxPduType = STATIC
        CanIfTxPduBufferRef = CHNL_a6b6a922
        CanIfTxPduRef = DiagFaultStat_PDM_BB2_oBackbone2_fea9ad98_Tx
      CIOM_Cab_30S_Tp_oCabSubnet_da4b67c4_Tx (CanIfTxPduCfg):
        CanIfTxPduCanId = 418873408
        CanIfTxPduCanIdType = EXTENDED_CAN
        CanIfTxPduDlc = 8
        CanIfTxPduUserTxConfirmationName = CanTp_TxConfirmation
        CanIfTxPduUserTxConfirmationUL = CAN_TP
        CanIfTxPduId = 27
        CanIfTxPduReadNotifyStatus = false
        CanIfTxPduType = STATIC
        CanIfTxPduBufferRef = CanIfBufferCfg_CIOM_Cab_30S_Tp_oCabSubnet_da4b67c4_Tx
        CanIfTxPduRef = CIOM_Cab_30S_Tp_oCabSubnet_03dd3571_Tx
      3 x CanIfRxPduCfg, all with CanIfRxPduCanIdType=EXTENDED_CAN, CanIfRxPduReadData=false, CanIfRxPduReadNotifyStatus=false, CanIfRxPduDlcCheck=true:
        AnmMsg_LECM1_CabSubnet_oCabSubnet_ba3b1140_Rx: CanIfRxPduCanId=486510632, CanIfRxPduDlc=4, CanIfRxPduUserRxIndicationName=PduR_CanIfRxIndication, CanIfRxPduUserRxIndicationUL=PDUR, CanIfRxPduId=51, CanIfRxPduHrhIdRef=CN_CabSubnet_eedbadff_Rx, CanIfRxPduRef=AnmMsg_LECM1_CabSubnet_oCabSubnet_aef1a94e_Rx
        DiagReqMsgIntHMIIOM_A1_F3_BB2_Tp_oBackbone2_ba062351_Rx: CanIfRxPduCanId=524329459, CanIfRxPduDlc=8, CanIfRxPduUserRxIndicationName=CanTp_RxIndication, CanIfRxPduUserRxIndicationType=PDUID_PDUINFOPTR, CanIfRxPduUserRxIndicationUL=CAN_TP, CanIfRxPduId=138, CanIfRxPduHrhIdRef=CN_Backbone2_7b3866ec_Rx, CanIfRxPduRef=DiagReqMsgIntHMIIOM_A1_F3_BB2_Tp_oBackbone2_945c7209_Rx
        PhysDiagRespMsg_F1_53_Cab_Tp_oCabSubnet_1d55a011_Rx: CanIfRxPduCanId=417001811, CanIfRxPduDlc=8, CanIfRxPduUserRxIndicationName=CanTp_RxIndication, CanIfRxPduUserRxIndicationType=PDUID_PDUINFOPTR, CanIfRxPduUserRxIndicationUL=CAN_TP, CanIfRxPduId=66, CanIfRxPduHrhIdRef=CN_CabSubnet_eedbadff_Rx, CanIfRxPduRef=PhysDiagRespMsg_F1_53_Cab_Tp_oCabSubnet_526fb92f_Rx
      DiagRespMsgIntHMIIOM_F3_98_BB2_Tp_oBackbone2_73235a33_Tx (CanIfTxPduCfg):
        CanIfTxPduCanId = 524350360
        CanIfTxPduCanIdType = EXTENDED_CAN
        CanIfTxPduDlc = 8
        CanIfTxPduUserTxConfirmationName = CanTp_TxConfirmation
        CanIfTxPduUserTxConfirmationUL = CAN_TP
        CanIfTxPduId = 160
        CanIfTxPduReadNotifyStatus = false
        CanIfTxPduType = STATIC
        CanIfTxPduBufferRef = CHNL_a6b6a922
        CanIfTxPduRef = DiagRespMsgIntHMIIOM_F3_98_BB2_Tp_oBackbone2_78379e58_Tx
      DiagUUDTRespMsg1_F2_A0_BB2_oBackbone2_42f439a2_Tx (CanIfTxPduCfg):
        CanIfTxPduCanId = 524481184
        CanIfTxPduCanIdType = EXTENDED_CAN
        CanIfTxPduDlc = 8
        CanIfTxPduUserTxConfirmationName = NULL_PTR
        CanIfTxPduUserTxConfirmationUL = NONE
        CanIfTxPduId = 143
        CanIfTxPduReadNotifyStatus = false
        CanIfTxPduType = STATIC
        CanIfTxPduBufferRef = CHNL_a6b6a922
        CanIfTxPduRef = DiagUUDTRespMsg1_F2_A0_BB2_oBackbone2_8e431e8b_Tx
      CHNL_a6b6a922 (CanIfBufferCfg):
        CanIfBufferSize = 101
        CanIfTxBufferHandlingType = PRIO_BY_CANID
        CanIfTxBufferMappedTxPdus = 101
        CanIfTxBufferMaxPduLength = 8
        CanIfBufferHthRef = CN_Backbone2_78967e2c_Tx
      PhysDiagReqMsg_53_F2_Cab_Tp_oCabSubnet_9abe6f67_Tx (CanIfTxPduCfg):
        CanIfTxPduCanId = 524309490
        CanIfTxPduCanIdType = EXTENDED_CAN
        CanIfTxPduDlc = 8
        CanIfTxPduUserTxConfirmationName = CanTp_TxConfirmation
        CanIfTxPduUserTxConfirmationUL = CAN_TP
        CanIfTxPduId = 14
        CanIfTxPduReadNotifyStatus = false
        CanIfTxPduType = STATIC
        CanIfTxPduBufferRef = CanIfBufferCfg_PhysDiagReqMsg_53_F2_Cab_Tp_oCabSubnet_9abe6f67_Tx
        CanIfTxPduRef = PhysDiagReqMsg_53_F2_Cab_Tp_oCabSubnet_27b04056_Tx
      3 x CanIfRxPduCfg, all with CanIfRxPduCanIdType=EXTENDED_CAN, CanIfRxPduReadData=false, CanIfRxPduReadNotifyStatus=false, CanIfRxPduDlcCheck=true:
        EMS_BB2_08P_oBackbone2_dd5310ea_Rx: CanIfRxPduCanId=1392, CanIfRxPduDlc=8, CanIfRxPduUserRxIndicationName=PduR_CanIfRxIndication, CanIfRxPduUserRxIndicationUL=PDUR, CanIfRxPduId=177, CanIfRxPduHrhIdRef=CN_Backbone2_7b3866ec_Rx, CanIfRxPduRef=EMS_BB2_08P_oBackbone2_56c4cd19_Rx
        AnmMsg_ECUspare1_Backbone2_oBackbone2_c849277d_Rx: CanIfRxPduCanId=486510661, CanIfRxPduDlc=4, CanIfRxPduUserRxIndicationName=PduR_CanIfRxIndication, CanIfRxPduUserRxIndicationUL=PDUR, CanIfRxPduId=156, CanIfRxPduHrhIdRef=CN_Backbone2_7b3866ec_Rx, CanIfRxPduRef=AnmMsg_ECUspare1_Backbone2_oBackbone2_00fe11e7_Rx
        DDM_Sec_03S_Tp_oSecuritySubnet_b8db9c2b_Rx: CanIfRxPduCanId=352292000, CanIfRxPduDlc=8, CanIfRxPduUserRxIndicationName=CanTp_RxIndication, CanIfRxPduUserRxIndicationType=PDUID_PDUINFOPTR, CanIfRxPduUserRxIndicationUL=CAN_TP, CanIfRxPduId=112, CanIfRxPduHrhIdRef=CN_SecuritySubnet_3840872e_Rx, CanIfRxPduRef=DDM_Sec_03S_Tp_oSecuritySubnet_77804648_Rx
      CIOM_Cab_15P_oCabSubnet_85195a2a_Tx (CanIfTxPduCfg):
        CanIfTxPduCanId = 418768895
        CanIfTxPduCanIdType = EXTENDED_CAN
        CanIfTxPduDlc = 8
        CanIfTxPduUserTxConfirmationName = NULL_PTR
        CanIfTxPduUserTxConfirmationUL = NONE
        CanIfTxPduId = 29
        CanIfTxPduReadNotifyStatus = false
        CanIfTxPduType = STATIC
        CanIfTxPduBufferRef = CanIfBufferCfg_CIOM_Cab_15P_oCabSubnet_85195a2a_Tx
        CanIfTxPduRef = CIOM_Cab_15P_oCabSubnet_a39ab9e4_Tx
      VMCU_BB2_34S_Tp_oBackbone2_37bde105_Rx (CanIfRxPduCfg):
        CanIfRxPduCanId = 973
        CanIfRxPduCanIdType = EXTENDED_CAN
        CanIfRxPduDlc = 8
        CanIfRxPduUserRxIndicationName = CanTp_RxIndication
        CanIfRxPduUserRxIndicationType = PDUID_PDUINFOPTR
        CanIfRxPduUserRxIndicationUL = CAN_TP
        CanIfRxPduId = 214
        CanIfRxPduReadData = false
        CanIfRxPduReadNotifyStatus = false
        CanIfRxPduDlcCheck = true
        CanIfRxPduHrhIdRef = CN_Backbone2_7b3866ec_Rx
        CanIfRxPduRef = VMCU_BB2_34S_Tp_oBackbone2_67254ff5_Rx
      3 x CanIfTxPduCfg, all with CanIfTxPduCanIdType=EXTENDED_CAN, CanIfTxPduDlc=8, CanIfTxPduReadNotifyStatus=false, CanIfTxPduType=STATIC:
        CIOM_BB2_13S_Tp_oBackbone2_bd99285a_Tx: CanIfTxPduCanId=352280384, CanIfTxPduUserTxConfirmationUL=CAN_TP, CanIfTxPduId=186, CanIfTxPduUserTxConfirmationName=CanTp_TxConfirmation, CanIfTxPduBufferRef=CHNL_a6b6a922, CanIfTxPduRef=CIOM_BB2_13S_Tp_oBackbone2_cc527133_Tx
        CIOM_Cab_31P_oCabSubnet_c1a9df69_Tx: CanIfTxPduCanId=368709952, CanIfTxPduUserTxConfirmationName=NULL_PTR, CanIfTxPduUserTxConfirmationUL=NONE, CanIfTxPduId=38, CanIfTxPduBufferRef=CanIfBufferCfg_CIOM_Cab_31P_oCabSubnet_c1a9df69_Tx, CanIfTxPduRef=CIOM_Cab_31P_oCabSubnet_bff58228_Tx
        CIOM_Cab_20S_Tp_oCabSubnet_c323df97_Tx: CanIfTxPduCanId=419381183, CanIfTxPduUserTxConfirmationName=CanTp_TxConfirmation, CanIfTxPduUserTxConfirmationUL=CAN_TP, CanIfTxPduId=21, CanIfTxPduBufferRef=CanIfBufferCfg_CIOM_Cab_20S_Tp_oCabSubnet_c323df97_Tx, CanIfTxPduRef=CIOM_Cab_20S_Tp_oCabSubnet_96ade1e4_Tx
      VMCU_BB2_32S_Tp_oBackbone2_2c992e71_Rx (CanIfRxPduCfg):
        CanIfRxPduCanId = 1345
        CanIfRxPduCanIdType = EXTENDED_CAN
        CanIfRxPduDlc = 8
        CanIfRxPduUserRxIndicationName = CanTp_RxIndication
        CanIfRxPduUserRxIndicationType = PDUID_PDUINFOPTR
        CanIfRxPduUserRxIndicationUL = CAN_TP
        CanIfRxPduId = 184
        CanIfRxPduReadData = false
        CanIfRxPduReadNotifyStatus = false
        CanIfRxPduDlcCheck = true
        CanIfRxPduHrhIdRef = CN_Backbone2_7b3866ec_Rx
        CanIfRxPduRef = VMCU_BB2_32S_Tp_oBackbone2_abf23586_Rx
      WRCS_Cab_01P_oCabSubnet_f823b5c4_Rx (CanIfRxPduCfg):
        CanIfRxPduCanId = 218070911
        CanIfRxPduCanIdType = EXTENDED_CAN
        CanIfRxPduDlc = 8
        CanIfRxPduUserRxIndicationName = PduR_CanIfRxIndication
        CanIfRxPduUserRxIndicationUL = PDUR
        CanIfRxPduId = 84
        CanIfRxPduReadData = false
        CanIfRxPduReadNotifyStatus = false
        CanIfRxPduDlcCheck = true
        CanIfRxPduHrhIdRef = CN_CabSubnet_eedbadff_Rx
        CanIfRxPduRef = WRCS_Cab_01P_oCabSubnet_76b95594_Rx
      3 x CanIfTxPduCfg, all with CanIfTxPduCanIdType=EXTENDED_CAN, CanIfTxPduDlc=8, CanIfTxPduReadNotifyStatus=false, CanIfTxPduType=STATIC:
        DiagRespMsgIntHMIIOM_F3_53_BB2_Tp_oBackbone2_930c5799_Tx: CanIfTxPduCanId=524350291, CanIfTxPduUserTxConfirmationName=CanTp_TxConfirmation, CanIfTxPduUserTxConfirmationUL=CAN_TP, CanIfTxPduId=161, CanIfTxPduBufferRef=CHNL_a6b6a922, CanIfTxPduRef=DiagRespMsgIntHMIIOM_F3_53_BB2_Tp_oBackbone2_7a301bc7_Tx
        VMCU_BB2_34S_FCM_Tp_oBackbone2_c87b48e1_Tx: CanIfTxPduCanId=976, CanIfTxPduUserTxConfirmationName=CanTp_TxConfirmation, CanIfTxPduUserTxConfirmationUL=CAN_TP, CanIfTxPduId=216, CanIfTxPduBufferRef=CHNL_a6b6a922, CanIfTxPduRef=VMCU_BB2_34S_FCM_Tp_oBackbone2_98398a3b_Tx
        EEC14_X_CIOMFMS_oFMSNet_3551b912_Tx: CanIfTxPduCanId=419283505, CanIfTxPduUserTxConfirmationName=NULL_PTR, CanIfTxPduUserTxConfirmationUL=NONE, CanIfTxPduId=107, CanIfTxPduBufferRef=CanIfBufferCfg_EEC14_X_CIOMFMS_oFMSNet_3551b912_Tx, CanIfTxPduRef=EEC14_X_CIOMFMS_oFMSNet_2007104d_Tx
      VMCU_BB2_31S_Tp_oBackbone2_210b49cb_Rx (CanIfRxPduCfg):
        CanIfRxPduCanId = 1372
        CanIfRxPduCanIdType = EXTENDED_CAN
        CanIfRxPduDlc = 8
        CanIfRxPduUserRxIndicationName = CanTp_RxIndication
        CanIfRxPduUserRxIndicationType = PDUID_PDUINFOPTR
        CanIfRxPduUserRxIndicationUL = CAN_TP
        CanIfRxPduId = 183
        CanIfRxPduReadData = false
        CanIfRxPduReadNotifyStatus = false
        CanIfRxPduDlcCheck = true
        CanIfRxPduHrhIdRef = CN_Backbone2_7b3866ec_Rx
        CanIfRxPduRef = VMCU_BB2_31S_Tp_oBackbone2_20210b9f_Rx
      CIOM_Cab_10P_oCabSubnet_a6a5d96b_Tx (CanIfTxPduCfg):
        CanIfTxPduCanId = 352272319
        CanIfTxPduCanIdType = EXTENDED_CAN
        CanIfTxPduDlc = 8
        CanIfTxPduUserTxConfirmationName = NULL_PTR
        CanIfTxPduUserTxConfirmationUL = NONE
        CanIfTxPduId = 40
        CanIfTxPduReadNotifyStatus = false
        CanIfTxPduType = STATIC
        CanIfTxPduBufferRef = CanIfBufferCfg_CIOM_Cab_10P_oCabSubnet_a6a5d96b_Tx
        CanIfTxPduRef = CIOM_Cab_10P_oCabSubnet_23caa664_Tx
      AnmMsg_SRS_CabSubnet_oCabSubnet_690513e9_Rx (CanIfRxPduCfg):
        CanIfRxPduCanId = 486510634
        CanIfRxPduCanIdType = EXTENDED_CAN
        CanIfRxPduDlc = 4
        CanIfRxPduUserRxIndicationName = PduR_CanIfRxIndication
        CanIfRxPduUserRxIndicationUL = PDUR
        CanIfRxPduId = 50
        CanIfRxPduReadData = false
        CanIfRxPduReadNotifyStatus = false
        CanIfRxPduDlcCheck = true
        CanIfRxPduHrhIdRef = CN_CabSubnet_eedbadff_Rx
        CanIfRxPduRef = AnmMsg_SRS_CabSubnet_oCabSubnet_5d05fd8e_Rx
      AT1T1I1_X_CIOMFMS_oFMSNet_4f6adf75_Tx (CanIfTxPduCfg):
        CanIfTxPduCanId = 419321393
        CanIfTxPduCanIdType = EXTENDED_CAN
        CanIfTxPduDlc = 8
        CanIfTxPduUserTxConfirmationName = NULL_PTR
        CanIfTxPduUserTxConfirmationUL = NONE
        CanIfTxPduId = 106
        CanIfTxPduReadNotifyStatus = false
        CanIfTxPduType = STATIC
        CanIfTxPduBufferRef = CanIfBufferCfg_AT1T1I1_X_CIOMFMS_oFMSNet_4f6adf75_Tx
        CanIfTxPduRef = AT1T1I1_X_CIOMFMS_oFMSNet_a4250889_Tx
      AnmMsg_ECUspare2_Backbone2_oBackbone2_181d947f_Rx (CanIfRxPduCfg):
        CanIfRxPduCanId = 486510662
        CanIfRxPduCanIdType = EXTENDED_CAN
        CanIfRxPduDlc = 4
        CanIfRxPduUserRxIndicationName = PduR_CanIfRxIndication
        CanIfRxPduUserRxIndicationUL = PDUR
        CanIfRxPduId = 155
        CanIfRxPduReadData = false
        CanIfRxPduReadNotifyStatus = false
        CanIfRxPduDlcCheck = true
        CanIfRxPduHrhIdRef = CN_Backbone2_7b3866ec_Rx
        CanIfRxPduRef = AnmMsg_ECUspare2_Backbone2_oBackbone2_e3b7a645_Rx
      PhysDiagRespMsg_F2_A2_Cab_Tp_oCabSubnet_89846943_Rx (CanIfRxPduCfg):
        CanIfRxPduCanId = 524350114
        CanIfRxPduCanIdType = EXTENDED_CAN
        CanIfRxPduDlc = 8
        CanIfRxPduUserRxIndicationName = CanTp_RxIndication
        CanIfRxPduUserRxIndicationType = PDUID_PDUINFOPTR
        CanIfRxPduUserRxIndicationUL = CAN_TP
        CanIfRxPduId = 44
        CanIfRxPduReadData = false
        CanIfRxPduReadNotifyStatus = false
        CanIfRxPduDlcCheck = true
        CanIfRxPduHrhIdRef = CN_CabSubnet_eedbadff_Rx
        CanIfRxPduRef = PhysDiagRespMsg_F2_A2_Cab_Tp_oCabSubnet_47fa96e8_Rx
      CVW_X_CIOMFMS_oFMSNet_5e9635e8_Tx (CanIfTxPduCfg):
        CanIfTxPduCanId = 419328049
        CanIfTxPduCanIdType = EXTENDED_CAN
        CanIfTxPduDlc = 8
        CanIfTxPduUserTxConfirmationName = NULL_PTR
        CanIfTxPduUserTxConfirmationUL = NONE
        CanIfTxPduId = 104
        CanIfTxPduReadNotifyStatus = false
        CanIfTxPduType = STATIC
        CanIfTxPduBufferRef = CanIfBufferCfg_CVW_X_CIOMFMS_oFMSNet_5e9635e8_Tx
        CanIfTxPduRef = CVW_X_CIOMFMS_oFMSNet_5a4bdaa1_Tx
      DiagRespMsgIntHMIIOM_F3_A0_Sec_Tp_oSecuritySubnet_95b29252_Rx (CanIfRxPduCfg):
        CanIfRxPduCanId = 524350368
        CanIfRxPduCanIdType = EXTENDED_CAN
        CanIfRxPduDlc = 8
        CanIfRxPduUserRxIndicationName = CanTp_RxIndication
        CanIfRxPduUserRxIndicationType = PDUID_PDUINFOPTR
        CanIfRxPduUserRxIndicationUL = CAN_TP
        CanIfRxPduId = 94
        CanIfRxPduReadData = false
        CanIfRxPduReadNotifyStatus = false
        CanIfRxPduDlcCheck = true
        CanIfRxPduHrhIdRef = CN_SecuritySubnet_3840872e_Rx
        CanIfRxPduRef = DiagRespMsgIntHMIIOM_F3_A0_Sec_Tp_oSecuritySubnet_1ac6fb95_Rx
      DiagReqMsgIntTGW2_A0_F4_Sec_Tp_oSecuritySubnet_8adef0bc_Tx (CanIfTxPduCfg):
        CanIfTxPduCanId = 524329204
        CanIfTxPduCanIdType = EXTENDED_CAN
        CanIfTxPduDlc = 8
        CanIfTxPduUserTxConfirmationName = CanTp_TxConfirmation
        CanIfTxPduUserTxConfirmationUL = CAN_TP
        CanIfTxPduId = 64
        CanIfTxPduReadNotifyStatus = false
        CanIfTxPduType = STATIC
        CanIfTxPduBufferRef = CanIfBufferCfg_DiagReqMsgIntTGW2_A0_F4_Sec_Tp_oSecuritySubnet_8adef0bc_Tx
        CanIfTxPduRef = DiagReqMsgIntTGW2_A0_F4_Sec_Tp_oSecuritySubnet_0880cfdc_Tx
      PhysDiagRespMsg_F2_26_BB2_Tp_oBackbone2_ebb70ff2_Tx (CanIfTxPduCfg):
        CanIfTxPduCanId = 524349990
        CanIfTxPduCanIdType = EXTENDED_CAN
        CanIfTxPduDlc = 8
        CanIfTxPduUserTxConfirmationName = CanTp_TxConfirmation
        CanIfTxPduUserTxConfirmationUL = CAN_TP
        CanIfTxPduId = 171
        CanIfTxPduReadNotifyStatus = false
        CanIfTxPduType = STATIC
        CanIfTxPduBufferRef = CHNL_a6b6a922
        CanIfTxPduRef = PhysDiagRespMsg_F2_26_BB2_Tp_oBackbone2_c77d16b5_Tx
      4 x CanIfRxPduCfg, all with CanIfRxPduCanIdType=EXTENDED_CAN, CanIfRxPduDlc=8, CanIfRxPduReadData=false, CanIfRxPduReadNotifyStatus=false, CanIfRxPduDlcCheck=true:
        SRS_Cab_03P_oCabSubnet_d6393c8f_Rx: CanIfRxPduCanId=352304959, CanIfRxPduUserRxIndicationName=PduR_CanIfRxIndication, CanIfRxPduUserRxIndicationUL=PDUR, CanIfRxPduId=68, CanIfRxPduHrhIdRef=CN_CabSubnet_eedbadff_Rx, CanIfRxPduRef=SRS_Cab_03P_oCabSubnet_b9601d3d_Rx
        CCM_Cab_04P_oCabSubnet_4f3902ac_Rx: CanIfRxPduCanId=285155992, CanIfRxPduUserRxIndicationName=PduR_CanIfRxIndication, CanIfRxPduUserRxIndicationUL=PDUR, CanIfRxPduId=81, CanIfRxPduHrhIdRef=CN_CabSubnet_eedbadff_Rx, CanIfRxPduRef=CCM_Cab_04P_oCabSubnet_568d6123_Rx
        DiagRespMsgIntTGW2_F4_C0_Sec_Tp_oSecuritySubnet_7a975d32_Rx: CanIfRxPduCanId=524350656, CanIfRxPduUserRxIndicationName=CanTp_RxIndication, CanIfRxPduUserRxIndicationType=PDUID_PDUINFOPTR, CanIfRxPduUserRxIndicationUL=CAN_TP, CanIfRxPduId=89, CanIfRxPduHrhIdRef=CN_SecuritySubnet_3840872e_Rx, CanIfRxPduRef=DiagRespMsgIntTGW2_F4_C0_Sec_Tp_oSecuritySubnet_53f564c6_Rx
        DiagRespMsgIntTGW2_F4_53_Cab_Tp_oCabSubnet_781e6a27_Rx: CanIfRxPduCanId=524350547, CanIfRxPduUserRxIndicationName=CanTp_RxIndication, CanIfRxPduUserRxIndicationType=PDUID_PDUINFOPTR, CanIfRxPduUserRxIndicationUL=CAN_TP, CanIfRxPduId=38, CanIfRxPduHrhIdRef=CN_CabSubnet_eedbadff_Rx, CanIfRxPduRef=DiagRespMsgIntTGW2_F4_53_Cab_Tp_oCabSubnet_c731eaea_Rx
      CIOM_BB2_29P_oBackbone2_bfae97b8_Tx (CanIfTxPduCfg):
        CanIfTxPduCanId = 285201472
        CanIfTxPduCanIdType = EXTENDED_CAN
        CanIfTxPduDlc = 8
        CanIfTxPduUserTxConfirmationName = NULL_PTR
        CanIfTxPduUserTxConfirmationUL = NONE
        CanIfTxPduId = 221
        CanIfTxPduReadNotifyStatus = false
        CanIfTxPduType = STATIC
        CanIfTxPduBufferRef = CanIfBufferCfg_CIOM_BB2_29P_oBackbone2_bfae97b8_Tx
        CanIfTxPduRef = CIOM_BB2_29P_oBackbone2_9c06ea0b_Tx
      VMCU_BB2_20P_oBackbone2_8181e59b_Rx (CanIfRxPduCfg):
        CanIfRxPduCanId = 826
        CanIfRxPduCanIdType = EXTENDED_CAN
        CanIfRxPduDlc = 8
        CanIfRxPduUserRxIndicationName = PduR_CanIfRxIndication
        CanIfRxPduUserRxIndicationUL = PDUR
        CanIfRxPduId = 228
        CanIfRxPduReadData = false
        CanIfRxPduReadNotifyStatus = false
        CanIfRxPduDlcCheck = true
        CanIfRxPduHrhIdRef = CN_Backbone2_7b3866ec_Rx
        CanIfRxPduRef = VMCU_BB2_20P_oBackbone2_43915bb5_Rx
      ERC1_x_RECUFMS_oFMSNet_338e7918_Tx (CanIfTxPduCfg):
        CanIfTxPduCanId = 418381873
        CanIfTxPduCanIdType = EXTENDED_CAN
        CanIfTxPduDlc = 8
        CanIfTxPduUserTxConfirmationName = NULL_PTR
        CanIfTxPduUserTxConfirmationUL = NONE
        CanIfTxPduId = 111
        CanIfTxPduReadNotifyStatus = false
        CanIfTxPduType = STATIC
        CanIfTxPduBufferRef = CanIfBufferCfg_ERC1_x_RECUFMS_oFMSNet_338e7918_Tx
        CanIfTxPduRef = ERC1_x_RECUFMS_oFMSNet_f10a8a51_Tx
      3 x CanIfRxPduCfg, all with CanIfRxPduCanIdType=EXTENDED_CAN, CanIfRxPduDlc=4, CanIfRxPduUserRxIndicationName=PduR_CanIfRxIndication, CanIfRxPduUserRxIndicationUL=PDUR, CanIfRxPduReadData=false, CanIfRxPduReadNotifyStatus=false, CanIfRxPduDlcCheck=true, CanIfRxPduHrhIdRef=CN_Backbone2_7b3866ec_Rx:
        AnmMsg_DACU_Backbone2_oBackbone2_fb766361_Rx: CanIfRxPduCanId=486510594, CanIfRxPduId=160, CanIfRxPduRef=AnmMsg_DACU_Backbone2_oBackbone2_dbe92592_Rx
        AnmMsg_BBM_Backbone2_oBackbone2_604b553c_Rx: CanIfRxPduCanId=486510592, CanIfRxPduId=161, CanIfRxPduRef=AnmMsg_BBM_Backbone2_oBackbone2_03be1070_Rx
        AnmMsg_TECU_Backbone2_oBackbone2_9bd86e99_Rx: CanIfRxPduCanId=486510598, CanIfRxPduId=158, CanIfRxPduRef=AnmMsg_TECU_Backbone2_oBackbone2_d3c774dc_Rx
      CIOM_Cab_27P_oCabSubnet_4a361ca9_Tx (CanIfTxPduCfg):
        CanIfTxPduCanId = 346506304
        CanIfTxPduCanIdType = EXTENDED_CAN
        CanIfTxPduDlc = 8
        CanIfTxPduUserTxConfirmationName = NULL_PTR
        CanIfTxPduUserTxConfirmationUL = NONE
        CanIfTxPduId = 43
        CanIfTxPduReadNotifyStatus = false
        CanIfTxPduType = STATIC
        CanIfTxPduBufferRef = CanIfBufferCfg_CIOM_Cab_27P_oCabSubnet_4a361ca9_Tx
        CanIfTxPduRef = CIOM_Cab_27P_oCabSubnet_c04805e4_Tx
      DDM_Sec_04S_Tp_oSecuritySubnet_c3efbadc_Rx (CanIfRxPduCfg):
        CanIfRxPduCanId = 352298400
        CanIfRxPduCanIdType = EXTENDED_CAN
        CanIfRxPduDlc = 8
        CanIfRxPduUserRxIndicationName = CanTp_RxIndication
        CanIfRxPduUserRxIndicationType = PDUID_PDUINFOPTR
        CanIfRxPduUserRxIndicationUL = CAN_TP
        CanIfRxPduId = 110
        CanIfRxPduReadData = false
        CanIfRxPduReadNotifyStatus = false
        CanIfRxPduDlcCheck = true
        CanIfRxPduHrhIdRef = CN_SecuritySubnet_3840872e_Rx
        CanIfRxPduRef = DDM_Sec_04S_Tp_oSecuritySubnet_ab80932e_Rx
      DiagRespMsgIntHMIIOM_F3_26_BB2_Tp_oBackbone2_aba3af99_Tx (CanIfTxPduCfg):
        CanIfTxPduCanId = 524350246
        CanIfTxPduCanIdType = EXTENDED_CAN
        CanIfTxPduDlc = 8
        CanIfTxPduUserTxConfirmationName = CanTp_TxConfirmation
        CanIfTxPduUserTxConfirmationUL = CAN_TP
        CanIfTxPduId = 163
        CanIfTxPduReadNotifyStatus = false
        CanIfTxPduType = STATIC
        CanIfTxPduBufferRef = CHNL_a6b6a922
        CanIfTxPduRef = DiagRespMsgIntHMIIOM_F3_26_BB2_Tp_oBackbone2_9ec62f70_Tx
      4 x CanIfRxPduCfg, all with CanIfRxPduCanIdType=EXTENDED_CAN, CanIfRxPduReadData=false, CanIfRxPduReadNotifyStatus=false, CanIfRxPduDlcCheck=true:
        CIOM_c15ca2a0_Rx: CanIfRxPduDlc=1, CanIfRxPduUserRxIndicationName=CanNm_RxIndication, CanIfRxPduUserRxIndicationUL=CAN_NM, CanIfRxPduId=31, CanIfRxPduHrhIdRef=CN_CabSubnet_eedbadff_Rx, CanIfRxPduRef=CIOM_70e7b3d8_Rx
          CHNL_62a80bc9 (CanIfRxPduCanIdRange): CanIfRxPduCanIdRangeLowerCanId=486506496, CanIfRxPduCanIdRangeUpperCanId=486506751
        DiagRespMsgIntTGW2_F4_26_Cab_Tp_oCabSubnet_0b131bbc_Rx: CanIfRxPduCanId=524350502, CanIfRxPduDlc=8, CanIfRxPduUserRxIndicationName=CanTp_RxIndication, CanIfRxPduUserRxIndicationType=PDUID_PDUINFOPTR, CanIfRxPduUserRxIndicationUL=CAN_TP, CanIfRxPduId=39, CanIfRxPduHrhIdRef=CN_CabSubnet_eedbadff_Rx, CanIfRxPduRef=DiagRespMsgIntTGW2_F4_26_Cab_Tp_oCabSubnet_23c7de5d_Rx
        PhysDiagRespMsg_F2_53_Cab_Tp_oCabSubnet_4c48e914_Rx: CanIfRxPduCanId=524350035, CanIfRxPduDlc=8, CanIfRxPduUserRxIndicationName=CanTp_RxIndication, CanIfRxPduUserRxIndicationType=PDUID_PDUINFOPTR, CanIfRxPduUserRxIndicationUL=CAN_TP, CanIfRxPduId=46, CanIfRxPduHrhIdRef=CN_CabSubnet_eedbadff_Rx, CanIfRxPduRef=PhysDiagRespMsg_F2_53_Cab_Tp_oCabSubnet_b1260e8d_Rx
        BBM_BB2_03S_CIOM_Tp_oBackbone2_8a8d09f2_Rx: CanIfRxPduCanId=401893862, CanIfRxPduDlc=8, CanIfRxPduUserRxIndicationUL=CAN_TP, CanIfRxPduId=164, CanIfRxPduUserRxIndicationName=CanTp_RxIndication, CanIfRxPduUserRxIndicationType=PDUID_PDUINFOPTR, CanIfRxPduHrhIdRef=CN_Backbone2_7b3866ec_Rx, CanIfRxPduRef=BBM_BB2_03S_CIOM_Tp_oBackbone2_8a23ab77_Rx
      CIOM_Cab_28S_oCabSubnet_0dafccc7_Tx (CanIfTxPduCfg):
        CanIfTxPduCanId = 285163328
        CanIfTxPduCanIdType = EXTENDED_CAN
        CanIfTxPduDlc = 8
        CanIfTxPduUserTxConfirmationName = PduR_CanIfTxConfirmation
        CanIfTxPduUserTxConfirmationUL = PDUR
        CanIfTxPduId = 53
        CanIfTxPduReadNotifyStatus = false
        CanIfTxPduType = STATIC
        CanIfTxPduBufferRef = CanIfBufferCfg_CIOM_Cab_28S_oCabSubnet_0dafccc7_Tx
        CanIfTxPduRef = CIOM_Cab_28S_oCabSubnet_88e11a56_Tx
      3 x CanIfRxPduCfg, all with CanIfRxPduCanIdType=EXTENDED_CAN, CanIfRxPduDlc=8, CanIfRxPduUserRxIndicationName=CanTp_RxIndication, CanIfRxPduUserRxIndicationType=PDUID_PDUINFOPTR, CanIfRxPduUserRxIndicationUL=CAN_TP, CanIfRxPduReadData=false, CanIfRxPduReadNotifyStatus=false, CanIfRxPduDlcCheck=true:
        DiagRespMsgIntHMIIOM_F3_A2_Cab_Tp_oCabSubnet_15c35ee3_Rx: CanIfRxPduCanId=524350370, CanIfRxPduId=40, CanIfRxPduHrhIdRef=CN_CabSubnet_eedbadff_Rx, CanIfRxPduRef=DiagRespMsgIntHMIIOM_F3_A2_Cab_Tp_oCabSubnet_1e41af2d_Rx
        DiagReqMsgIntTGW2_53_F4_BB2_Tp_oBackbone2_0f9dcb70_Rx: CanIfRxPduCanId=524309492, CanIfRxPduId=146, CanIfRxPduHrhIdRef=CN_Backbone2_7b3866ec_Rx, CanIfRxPduRef=DiagReqMsgIntTGW2_53_F4_BB2_Tp_oBackbone2_a3669146_Rx
        DiagReqMsgIntHMIIOM_98_F3_BB2_Tp_oBackbone2_3994cb72_Rx: CanIfRxPduCanId=524327155, CanIfRxPduId=144, CanIfRxPduHrhIdRef=CN_Backbone2_7b3866ec_Rx, CanIfRxPduRef=DiagReqMsgIntHMIIOM_98_F3_BB2_Tp_oBackbone2_212b5419_Rx
      TPDirect_0FE6B_Tp_oFMSNet_5c137171_Tx (CanIfTxPduCfg):
        CanIfTxPduCanId = 419326974
        CanIfTxPduCanIdMask = 3758096384
        CanIfTxPduCanIdType = EXTENDED_CAN
        CanIfTxPduDlc = 8
        CanIfTxPduUserTxConfirmationName = J1939Tp_TxConfirmation
        CanIfTxPduUserTxConfirmationUL = J1939TP
        CanIfTxPduId = 105
        CanIfTxPduReadNotifyStatus = false
        CanIfTxPduType = STATIC
        CanIfTxPduBufferRef = CanIfBufferCfg_TPDirect_0FE6B_Tp_oFMSNet_5c137171_Tx
        CanIfTxPduRef = TPDirect_0FE6B_Tp_oFMSNet_0aa5f2bd_Tx
      CIOM_0462631a_Rx (CanIfRxPduCfg):
        CanIfRxPduCanIdType = EXTENDED_CAN
        CanIfRxPduDlc = 1
        CanIfRxPduUserRxIndicationName = CanNm_RxIndication
        CanIfRxPduUserRxIndicationUL = CAN_NM
        CanIfRxPduId = 85
        CanIfRxPduReadData = false
        CanIfRxPduReadNotifyStatus = false
        CanIfRxPduDlcCheck = true
        CanIfRxPduHrhIdRef = CN_SecuritySubnet_3840872e_Rx
        CanIfRxPduRef = CIOM_0632302a_Rx
        CHNL_294abb36 (CanIfRxPduCanIdRange): CanIfRxPduCanIdRangeLowerCanId=486506496, CanIfRxPduCanIdRangeUpperCanId=486506751
      CIOM_Cab_04S_Tp_oCabSubnet_e3ca2569_Tx (CanIfTxPduCfg):
        CanIfTxPduCanId = 285173824
        CanIfTxPduCanIdType = EXTENDED_CAN
        CanIfTxPduDlc = 8
        CanIfTxPduUserTxConfirmationName = CanTp_TxConfirmation
        CanIfTxPduUserTxConfirmationUL = CAN_TP
        CanIfTxPduId = 49
        CanIfTxPduReadNotifyStatus = false
        CanIfTxPduType = STATIC
        CanIfTxPduBufferRef = CanIfBufferCfg_CIOM_Cab_04S_Tp_oCabSubnet_e3ca2569_Tx
        CanIfTxPduRef = CIOM_Cab_04S_Tp_oCabSubnet_efa71d2d_Tx
      HMIIOM_BB2_36S_Tp_oBackbone2_95bfb681_Rx (CanIfRxPduCfg):
        CanIfRxPduCanId = 1396
        CanIfRxPduCanIdType = EXTENDED_CAN
        CanIfRxPduDlc = 8
        CanIfRxPduUserRxIndicationName = CanTp_RxIndication
        CanIfRxPduUserRxIndicationType = PDUID_PDUINFOPTR
        CanIfRxPduUserRxIndicationUL = CAN_TP
        CanIfRxPduId = 176
        CanIfRxPduReadData = false
        CanIfRxPduReadNotifyStatus = false
        CanIfRxPduDlcCheck = true
        CanIfRxPduHrhIdRef = CN_Backbone2_7b3866ec_Rx
        CanIfRxPduRef = HMIIOM_BB2_36S_Tp_oBackbone2_b5567a42_Rx
      PhysDiagRespMsg_F2_C0_BB2_Tp_oBackbone2_ae5b54dc_Tx (CanIfTxPduCfg):
        CanIfTxPduCanId = 524350144
        CanIfTxPduCanIdType = EXTENDED_CAN
        CanIfTxPduDlc = 8
        CanIfTxPduUserTxConfirmationName = CanTp_TxConfirmation
        CanIfTxPduUserTxConfirmationUL = CAN_TP
        CanIfTxPduId = 164
        CanIfTxPduReadNotifyStatus = false
        CanIfTxPduType = STATIC
        CanIfTxPduBufferRef = CHNL_a6b6a922
        CanIfTxPduRef = PhysDiagRespMsg_F2_C0_BB2_Tp_oBackbone2_882550b0_Tx
      5 x CanIfRxPduCfg, all with CanIfRxPduCanIdType=EXTENDED_CAN, CanIfRxPduDlc=8, CanIfRxPduReadData=false, CanIfRxPduReadNotifyStatus=false, CanIfRxPduDlcCheck=true:
        DiagFaultStat_WRCS_Cab_oCabSubnet_b86e4ab7_Rx: CanIfRxPduCanId=419573791, CanIfRxPduUserRxIndicationName=PduR_CanIfRxIndication, CanIfRxPduUserRxIndicationUL=PDUR, CanIfRxPduId=53, CanIfRxPduHrhIdRef=CN_CabSubnet_eedbadff_Rx, CanIfRxPduRef=DiagFaultStat_WRCS_Cab_oCabSubnet_6c860dc8_Rx
        DiagRespMsgIntHMIIOM_F3_98_Cab_Tp_oCabSubnet_b05496ae_Rx: CanIfRxPduCanId=524350360, CanIfRxPduUserRxIndicationName=CanTp_RxIndication, CanIfRxPduUserRxIndicationType=PDUID_PDUINFOPTR, CanIfRxPduUserRxIndicationUL=CAN_TP, CanIfRxPduId=41, CanIfRxPduHrhIdRef=CN_CabSubnet_eedbadff_Rx, CanIfRxPduRef=DiagRespMsgIntHMIIOM_F3_98_Cab_Tp_oCabSubnet_ea9ab2d7_Rx
        HMIIOM_BB2_20S_Tp_oBackbone2_ce8859ea_Rx: CanIfRxPduCanId=1343, CanIfRxPduUserRxIndicationName=CanTp_RxIndication, CanIfRxPduUserRxIndicationType=PDUID_PDUINFOPTR, CanIfRxPduUserRxIndicationUL=CAN_TP, CanIfRxPduId=185, CanIfRxPduHrhIdRef=CN_Backbone2_7b3866ec_Rx, CanIfRxPduRef=HMIIOM_BB2_20S_Tp_oBackbone2_ecf1d4a4_Rx
        CIOM_Cab_04P_FCM_Tp_oCabSubnet_b91c0468_Rx: CanIfRxPduCanId=285173825, CanIfRxPduUserRxIndicationName=CanTp_RxIndication, CanIfRxPduUserRxIndicationUL=CAN_TP, CanIfRxPduId=77, CanIfRxPduHrhIdRef=CN_CabSubnet_eedbadff_Rx, CanIfRxPduRef=CIOM_Cab_04P_FCM_Tp_oCabSubnet_87d6ec3a_Rx
        VMCU_BB2_80P_oBackbone2_82707e91_Rx: CanIfRxPduCanId=830, CanIfRxPduUserRxIndicationName=PduR_CanIfRxIndication, CanIfRxPduUserRxIndicationUL=PDUR, CanIfRxPduId=227, CanIfRxPduHrhIdRef=CN_Backbone2_7b3866ec_Rx, CanIfRxPduRef=VMCU_BB2_80P_oBackbone2_4291fb8a_Rx
      7 x CanIfTxPduCfg, all with CanIfTxPduCanIdType=EXTENDED_CAN, CanIfTxPduReadNotifyStatus=false, CanIfTxPduType=STATIC:
        CIOM_BB2_25P_oBackbone2_732f917b_Tx: CanIfTxPduCanId=335494976, CanIfTxPduDlc=8, CanIfTxPduUserTxConfirmationName=NULL_PTR, CanIfTxPduUserTxConfirmationUL=NONE, CanIfTxPduId=192, CanIfTxPduBufferRef=CHNL_a6b6a922, CanIfTxPduRef=CIOM_BB2_25P_oBackbone2_0e98c475_Tx
        NmAsr_CIOM_Cab_oCabSubnet_153d3c7d_Tx: CanIfTxPduCanId=486506560, CanIfTxPduDlc=1, CanIfTxPduUserTxConfirmationName=CanNm_TxConfirmation, CanIfTxPduUserTxConfirmationUL=CAN_NM, CanIfTxPduId=19, CanIfTxPduBufferRef=CanIfBufferCfg_NmAsr_CIOM_Cab_oCabSubnet_153d3c7d_Tx, CanIfTxPduRef=NmAsr_CIOM_Cab_oCabSubnet_2c086e5c_Tx
        LFE_X_CIOMFMS_oFMSNet_adac24c8_Tx: CanIfTxPduCanId=419361329, CanIfTxPduDlc=8, CanIfTxPduUserTxConfirmationName=NULL_PTR, CanIfTxPduUserTxConfirmationUL=NONE, CanIfTxPduId=95, CanIfTxPduBufferRef=CanIfBufferCfg_LFE_X_CIOMFMS_oFMSNet_adac24c8_Tx, CanIfTxPduRef=LFE_X_CIOMFMS_oFMSNet_582911c6_Tx
        CIOM_Cab_02P_oCabSubnet_694518ea_Tx: CanIfTxPduCanId=284262208, CanIfTxPduDlc=8, CanIfTxPduUserTxConfirmationName=NULL_PTR, CanIfTxPduUserTxConfirmationUL=NONE, CanIfTxPduId=55, CanIfTxPduBufferRef=CanIfBufferCfg_CIOM_Cab_02P_oCabSubnet_694518ea_Tx, CanIfTxPduRef=CIOM_Cab_02P_oCabSubnet_2dfd3b82_Tx
        DD_X_CIOMFMS_oFMSNet_95f62c09_Tx: CanIfTxPduCanId=419363889, CanIfTxPduDlc=8, CanIfTxPduUserTxConfirmationName=NULL_PTR, CanIfTxPduUserTxConfirmationUL=NONE, CanIfTxPduId=93, CanIfTxPduBufferRef=CanIfBufferCfg_DD_X_CIOMFMS_oFMSNet_95f62c09_Tx, CanIfTxPduRef=DD_X_CIOMFMS_oFMSNet_c8687b55_Tx
        DiagFaultStat_SRS_BB2_oBackbone2_e1ef7eee_Tx: CanIfTxPduCanId=1517, CanIfTxPduDlc=8, CanIfTxPduUserTxConfirmationName=PduR_CanIfTxConfirmation, CanIfTxPduUserTxConfirmationUL=PDUR, CanIfTxPduId=201, CanIfTxPduBufferRef=CHNL_a6b6a922, CanIfTxPduRef=DiagFaultStat_SRS_BB2_oBackbone2_c5219865_Tx
        TesterFuncDiagMsg_Cab_Tp_oCabSubnet_d293ecaa_Tx: CanIfTxPduCanId=524419058, CanIfTxPduDlc=8, CanIfTxPduUserTxConfirmationName=CanTp_TxConfirmation, CanIfTxPduUserTxConfirmationUL=CAN_TP, CanIfTxPduId=5, CanIfTxPduBufferRef=CanIfBufferCfg_TesterFuncDiagMsg_Cab_Tp_oCabSubnet_d293ecaa_Tx, CanIfTxPduRef=TesterFuncDiagMsg_Cab_Tp_oCabSubnet_2a1b6745_Tx
      VP232_X_ERAU_oFMSNet_8c33d56b_Rx (CanIfRxPduCfg):
        CanIfRxPduCanId = 419424331
        CanIfRxPduCanIdMask = 67108863
        CanIfRxPduCanIdType = EXTENDED_CAN
        CanIfRxPduDlc = 8
        CanIfRxPduUserRxIndicationName = PduR_CanIfRxIndication
        CanIfRxPduUserRxIndicationUL = PDUR
        CanIfRxPduId = 127
        CanIfRxPduReadData = false
        CanIfRxPduReadNotifyStatus = false
        CanIfRxPduDlcCheck = true
        CanIfRxPduHrhIdRef = CN_FMSNet_41e51372_Rx
        CanIfRxPduRef = VP232_X_ERAU_oFMSNet_67abd5b0_Rx
      DiagUUDTRespMsg1_F2_A2_BB2_oBackbone2_8af81a14_Tx (CanIfTxPduCfg):
        CanIfTxPduCanId = 524481186
        CanIfTxPduCanIdType = EXTENDED_CAN
        CanIfTxPduDlc = 8
        CanIfTxPduUserTxConfirmationName = NULL_PTR
        CanIfTxPduUserTxConfirmationUL = NONE
        CanIfTxPduId = 141
        CanIfTxPduReadNotifyStatus = false
        CanIfTxPduType = STATIC
        CanIfTxPduBufferRef = CHNL_a6b6a922
        CanIfTxPduRef = DiagUUDTRespMsg1_F2_A2_BB2_oBackbone2_ca0e375a_Tx
      CIOM_BB2_11P_oBackbone2_37f8d7b9_Tx (CanIfTxPduCfg):
        CanIfTxPduCanId = 351257920
        CanIfTxPduCanIdType = EXTENDED_CAN
        CanIfTxPduDlc = 8
        CanIfTxPduUserTxConfirmationName = NULL_PTR
        CanIfTxPduUserTxConfirmationUL = NONE
        CanIfTxPduId = 188
        CanIfTxPduReadNotifyStatus = false
        CanIfTxPduType = STATIC
        CanIfTxPduBufferRef = CHNL_a6b6a922
        CanIfTxPduRef = CIOM_BB2_11P_oBackbone2_24056f4a_Tx
      HMIIOM_BB2_34S_oBackbone2_6313bb35_Rx (CanIfRxPduCfg):
        CanIfRxPduCanId = 967
        CanIfRxPduCanIdType = EXTENDED_CAN
        CanIfRxPduDlc = 8
        CanIfRxPduUserRxIndicationName = PduR_CanIfRxIndication
        CanIfRxPduUserRxIndicationUL = PDUR
        CanIfRxPduId = 216
        CanIfRxPduReadData = false
        CanIfRxPduReadNotifyStatus = false
        CanIfRxPduDlcCheck = true
        CanIfRxPduHrhIdRef = CN_Backbone2_7b3866ec_Rx
        CanIfRxPduRef = HMIIOM_BB2_34S_oBackbone2_c2eeee4b_Rx
      CIOM_BB2_05P_oBackbone2_73e01679_Tx (CanIfTxPduCfg):
        CanIfTxPduCanId = 335489600
        CanIfTxPduCanIdType = EXTENDED_CAN
        CanIfTxPduDlc = 8
        CanIfTxPduUserTxConfirmationName = NULL_PTR
        CanIfTxPduUserTxConfirmationUL = NONE
        CanIfTxPduId = 193
        CanIfTxPduReadNotifyStatus = false
        CanIfTxPduType = STATIC
        CanIfTxPduBufferRef = CHNL_a6b6a922
        CanIfTxPduRef = CIOM_BB2_05P_oBackbone2_637de593_Tx
      DiagReqMsgIntTGW2_A1_F4_Sec_Tp_oSecuritySubnet_eb89cc56_Tx (CanIfTxPduCfg):
        CanIfTxPduCanId = 524329460
        CanIfTxPduCanIdType = EXTENDED_CAN
        CanIfTxPduDlc = 8
        CanIfTxPduUserTxConfirmationName = CanTp_TxConfirmation
        CanIfTxPduUserTxConfirmationUL = CAN_TP
        CanIfTxPduId = 61
        CanIfTxPduReadNotifyStatus = false
        CanIfTxPduType = STATIC
        CanIfTxPduBufferRef = CanIfBufferCfg_DiagReqMsgIntTGW2_A1_F4_Sec_Tp_oSecuritySubnet_eb89cc56_Tx
        CanIfTxPduRef = DiagReqMsgIntTGW2_A1_F4_Sec_Tp_oSecuritySubnet_c2be3c4f_Tx
      AnmMsg_ECUspare6_CabSubnet_oCabSubnet_582cafe8_Rx (CanIfRxPduCfg):
        CanIfRxPduCanId = 486510672
        CanIfRxPduCanIdType = EXTENDED_CAN
        CanIfRxPduDlc = 4
        CanIfRxPduUserRxIndicationName = PduR_CanIfRxIndication
        CanIfRxPduUserRxIndicationUL = PDUR
        CanIfRxPduId = 48
        CanIfRxPduReadData = false
        CanIfRxPduReadNotifyStatus = false
        CanIfRxPduDlcCheck = true
        CanIfRxPduHrhIdRef = CN_CabSubnet_eedbadff_Rx
        CanIfRxPduRef = AnmMsg_ECUspare6_CabSubnet_oCabSubnet_3fe72d0f_Rx
      DiagFaultStat_CIOM_BB2_oBackbone2_04d7302e_Tx (CanIfTxPduCfg):
        CanIfTxPduCanId = 1508
        CanIfTxPduCanIdType = EXTENDED_CAN
        CanIfTxPduDlc = 8
        CanIfTxPduUserTxConfirmationName = PduR_CanIfTxConfirmation
        CanIfTxPduUserTxConfirmationUL = PDUR
        CanIfTxPduId = 205
        CanIfTxPduReadNotifyStatus = false
        CanIfTxPduType = STATIC
        CanIfTxPduBufferRef = CHNL_a6b6a922
        CanIfTxPduRef = DiagFaultStat_CIOM_BB2_oBackbone2_e34a7a3f_Tx
      VMCU_BB2_08P_oBackbone2_09b0661b_Rx (CanIfRxPduCfg):
        CanIfRxPduCanId = 1050
        CanIfRxPduCanIdType = EXTENDED_CAN
        CanIfRxPduDlc = 8
        CanIfRxPduUserRxIndicationName = PduR_CanIfRxIndication
        CanIfRxPduUserRxIndicationUL = PDUR
        CanIfRxPduId = 210
        CanIfRxPduReadData = false
        CanIfRxPduReadNotifyStatus = false
        CanIfRxPduDlcCheck = true
        CanIfRxPduHrhIdRef = CN_Backbone2_7b3866ec_Rx
        CanIfRxPduRef = VMCU_BB2_08P_oBackbone2_cd604e07_Rx
      DiagReqMsgIntTGW2_53_F4_Cab_Tp_oCabSubnet_75ef26c1_Tx (CanIfTxPduCfg):
        CanIfTxPduCanId = 524309492
        CanIfTxPduCanIdType = EXTENDED_CAN
        CanIfTxPduDlc = 8
        CanIfTxPduUserTxConfirmationName = CanTp_TxConfirmation
        CanIfTxPduUserTxConfirmationUL = CAN_TP
        CanIfTxPduId = 12
        CanIfTxPduReadNotifyStatus = false
        CanIfTxPduType = STATIC
        CanIfTxPduBufferRef = CanIfBufferCfg_DiagReqMsgIntTGW2_53_F4_Cab_Tp_oCabSubnet_75ef26c1_Tx
        CanIfTxPduRef = DiagReqMsgIntTGW2_53_F4_Cab_Tp_oCabSubnet_31cbbdc9_Tx
      CIOM_Cab_13S_Tp_oCabSubnet_e50870d8_Tx (CanIfTxPduCfg):
        CanIfTxPduCanId = 418490367
        CanIfTxPduCanIdType = EXTENDED_CAN
        CanIfTxPduDlc = 8
        CanIfTxPduUserTxConfirmationName = CanTp_TxConfirmation
        CanIfTxPduUserTxConfirmationUL = CAN_TP
        CanIfTxPduId = 31
        CanIfTxPduReadNotifyStatus = false
        CanIfTxPduType = STATIC
        CanIfTxPduBufferRef = CanIfBufferCfg_CIOM_Cab_13S_Tp_oCabSubnet_e50870d8_Tx
        CanIfTxPduRef = CIOM_Cab_13S_Tp_oCabSubnet_799ea403_Tx
      CIOM_Sec_07S_FCM_Tp_oSecuritySubnet_5acc46b8_Rx (CanIfRxPduCfg):
        CanIfRxPduCanId = 352280480
        CanIfRxPduCanIdType = EXTENDED_CAN
        CanIfRxPduDlc = 8
        CanIfRxPduUserRxIndicationName = CanTp_RxIndication
        CanIfRxPduUserRxIndicationUL = CAN_TP
        CanIfRxPduId = 114
        CanIfRxPduReadData = false
        CanIfRxPduReadNotifyStatus = false
        CanIfRxPduDlcCheck = true
        CanIfRxPduHrhIdRef = CN_SecuritySubnet_3840872e_Rx
        CanIfRxPduRef = CIOM_Sec_07S_FCM_Tp_oSecuritySubnet_1badd8e4_Rx
