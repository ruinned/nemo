[part 2 of 2: package /ActiveEcuC]
AUTOSAR XML (schema 4-2-1)
package /ActiveEcuC  (continued)
  module config CanIf: implementation-config-variant=VARIANT-PRE-COMPILE, module-description=CanIf_Impl  (continued)
    CanIfInitCfg  (continued)
      DiagReqMsgIntHMIIOM_C0_F3_Sec_Tp_oSecuritySubnet_3aaf1649_Tx (CanIfTxPduCfg):
        CanIfTxPduCanId = 524337395
        CanIfTxPduCanIdType = EXTENDED_CAN
        CanIfTxPduDlc = 8
        CanIfTxPduUserTxConfirmationName = CanTp_TxConfirmation
        CanIfTxPduUserTxConfirmationUL = CAN_TP
        CanIfTxPduId = 59
        CanIfTxPduReadNotifyStatus = false
        CanIfTxPduType = STATIC
        CanIfTxPduBufferRef = CanIfBufferCfg_DiagReqMsgIntHMIIOM_C0_F3_Sec_Tp_oSecuritySubnet_3aaf1649_Tx
        CanIfTxPduRef = DiagReqMsgIntHMIIOM_C0_F3_Sec_Tp_oSecuritySubnet_2af00b55_Tx
      DiagReqMsgIntHMIIOM_40_F3_BB2_Tp_oBackbone2_a4e3bf32_Rx (CanIfRxPduCfg):
        CanIfRxPduCanId = 524304627
        CanIfRxPduCanIdType = EXTENDED_CAN
        CanIfRxPduDlc = 8
        CanIfRxPduUserRxIndicationName = CanTp_RxIndication
        CanIfRxPduUserRxIndicationType = PDUID_PDUINFOPTR
        CanIfRxPduUserRxIndicationUL = CAN_TP
        CanIfRxPduId = 150
        CanIfRxPduReadData = false
        CanIfRxPduReadNotifyStatus = false
        CanIfRxPduDlcCheck = true
        CanIfRxPduHrhIdRef = CN_Backbone2_7b3866ec_Rx
        CanIfRxPduRef = DiagReqMsgIntHMIIOM_40_F3_BB2_Tp_oBackbone2_4d846137_Rx
      CIOM_Cab_03P_oCabSubnet_0e8699ea_Tx (CanIfTxPduCfg):
        CanIfTxPduCanId = 285167936
        CanIfTxPduCanIdType = EXTENDED_CAN
        CanIfTxPduDlc = 8
        CanIfTxPduUserTxConfirmationName = NULL_PTR
        CanIfTxPduUserTxConfirmationUL = NONE
        CanIfTxPduId = 50
        CanIfTxPduReadNotifyStatus = false
        CanIfTxPduType = STATIC
        CanIfTxPduBufferRef = CanIfBufferCfg_CIOM_Cab_03P_oCabSubnet_0e8699ea_Tx
        CanIfTxPduRef = CIOM_Cab_03P_oCabSubnet_dc273e28_Tx
      SERV_X_CIOMFMS_oFMSNet_0f3b4ff2_Tx (CanIfTxPduCfg):
        CanIfTxPduCanId = 419348529
        CanIfTxPduCanIdType = EXTENDED_CAN
        CanIfTxPduDlc = 8
        CanIfTxPduUserTxConfirmationName = NULL_PTR
        CanIfTxPduUserTxConfirmationUL = NONE
        CanIfTxPduId = 102
        CanIfTxPduReadNotifyStatus = false
        CanIfTxPduType = STATIC
        CanIfTxPduBufferRef = CanIfBufferCfg_SERV_X_CIOMFMS_oFMSNet_0f3b4ff2_Tx
        CanIfTxPduRef = SERV_X_CIOMFMS_oFMSNet_2bbb6097_Tx
      HMIIOM_BB2_01P_oBackbone2_0b771160_Rx (CanIfRxPduCfg):
        CanIfRxPduCanId = 514
        CanIfRxPduCanIdType = EXTENDED_CAN
        CanIfRxPduDlc = 8
        CanIfRxPduUserRxIndicationName = PduR_CanIfRxIndication
        CanIfRxPduUserRxIndicationUL = PDUR
        CanIfRxPduId = 243
        CanIfRxPduReadData = false
        CanIfRxPduReadNotifyStatus = false
        CanIfRxPduDlcCheck = true
        CanIfRxPduHrhIdRef = CN_Backbone2_7b3866ec_Rx
        CanIfRxPduRef = HMIIOM_BB2_01P_oBackbone2_0a8179ad_Rx
      CIOM_Cab_33P_oCabSubnet_0e2edd69_Tx (CanIfTxPduCfg):
        CanIfTxPduCanId = 285196352
        CanIfTxPduCanIdType = EXTENDED_CAN
        CanIfTxPduDlc = 8
        CanIfTxPduUserTxConfirmationName = NULL_PTR
        CanIfTxPduUserTxConfirmationUL = NONE
        CanIfTxPduId = 45
        CanIfTxPduReadNotifyStatus = false
        CanIfTxPduType = STATIC
        CanIfTxPduBufferRef = CanIfBufferCfg_CIOM_Cab_33P_oCabSubnet_0e2edd69_Tx
        CanIfTxPduRef = CIOM_Cab_33P_oCabSubnet_87308f3d_Tx
      NmAsr_CIOM_BB2_oBackbone2_9b0338b4_Tx (CanIfTxPduCfg):
        CanIfTxPduCanId = 486506560
        CanIfTxPduCanIdType = EXTENDED_CAN
        CanIfTxPduDlc = 1
        CanIfTxPduUserTxConfirmationName = CanNm_TxConfirmation
        CanIfTxPduUserTxConfirmationUL = CAN_NM
        CanIfTxPduId = 220
        CanIfTxPduReadNotifyStatus = false
        CanIfTxPduType = STATIC
        CanIfTxPduBufferRef = CanIfBufferCfg_NmAsr_CIOM_BB2_oBackbone2_9b0338b4_Tx
        CanIfTxPduRef = NmAsr_CIOM_BB2_oBackbone2_a8a5afaa_Tx
      SRS_Cab_04P_oCabSubnet_5f6f582a_Rx (CanIfRxPduCfg):
        CanIfRxPduCanId = 368748371
        CanIfRxPduCanIdType = EXTENDED_CAN
        CanIfRxPduDlc = 8
        CanIfRxPduUserRxIndicationName = PduR_CanIfRxIndication
        CanIfRxPduUserRxIndicationUL = PDUR
        CanIfRxPduId = 67
        CanIfRxPduReadData = false
        CanIfRxPduReadNotifyStatus = false
        CanIfRxPduDlcCheck = true
        CanIfRxPduHrhIdRef = CN_CabSubnet_eedbadff_Rx
        CanIfRxPduRef = SRS_Cab_04P_oCabSubnet_01f50fa8_Rx
      PhysDiagReqMsg_A1_F2_Sec_Tp_oSecuritySubnet_5d2e792a_Tx (CanIfTxPduCfg):
        CanIfTxPduCanId = 524329458
        CanIfTxPduCanIdType = EXTENDED_CAN
        CanIfTxPduDlc = 8
        CanIfTxPduUserTxConfirmationName = CanTp_TxConfirmation
        CanIfTxPduUserTxConfirmationUL = CAN_TP
        CanIfTxPduId = 63
        CanIfTxPduReadNotifyStatus = false
        CanIfTxPduType = STATIC
        CanIfTxPduBufferRef = CanIfBufferCfg_PhysDiagReqMsg_A1_F2_Sec_Tp_oSecuritySubnet_5d2e792a_Tx
        CanIfTxPduRef = PhysDiagReqMsg_A1_F2_Sec_Tp_oSecuritySubnet_6093efd4_Tx
      VMCU_BB2_32S_FCM_Tp_oBackbone2_8a7e4a00_Tx (CanIfTxPduCfg):
        CanIfTxPduCanId = 1347
        CanIfTxPduCanIdType = EXTENDED_CAN
        CanIfTxPduDlc = 8
        CanIfTxPduUserTxConfirmationName = CanTp_TxConfirmation
        CanIfTxPduUserTxConfirmationUL = CAN_TP
        CanIfTxPduId = 213
        CanIfTxPduReadNotifyStatus = false
        CanIfTxPduType = STATIC
        CanIfTxPduBufferRef = CHNL_a6b6a922
        CanIfTxPduRef = VMCU_BB2_32S_FCM_Tp_oBackbone2_e47eb58c_Tx
      5 x CanIfRxPduCfg, all with CanIfRxPduCanIdType=EXTENDED_CAN, CanIfRxPduDlc=8, CanIfRxPduReadData=false, CanIfRxPduReadNotifyStatus=false, CanIfRxPduDlcCheck=true:
        CIOM_Cab_30S_FCM_Tp_oCabSubnet_ae18d4ab_Rx: CanIfRxPduCanId=418873409, CanIfRxPduUserRxIndicationName=CanTp_RxIndication, CanIfRxPduUserRxIndicationUL=CAN_TP, CanIfRxPduId=61, CanIfRxPduHrhIdRef=CN_CabSubnet_eedbadff_Rx, CanIfRxPduRef=CIOM_Cab_30S_FCM_Tp_oCabSubnet_01d77430_Rx
        PhysDiagRespMsg_F2_98_Cab_Tp_oCabSubnet_af4ee02a_Rx: CanIfRxPduCanId=524350104, CanIfRxPduUserRxIndicationName=CanTp_RxIndication, CanIfRxPduUserRxIndicationType=PDUID_PDUINFOPTR, CanIfRxPduUserRxIndicationUL=CAN_TP, CanIfRxPduId=45, CanIfRxPduHrhIdRef=CN_CabSubnet_eedbadff_Rx, CanIfRxPduRef=PhysDiagRespMsg_F2_98_Cab_Tp_oCabSubnet_b3218b12_Rx
        DiagRespMsgIntHMIIOM_F3_26_Cab_Tp_oCabSubnet_68d46304_Rx: CanIfRxPduCanId=524350246, CanIfRxPduUserRxIndicationName=CanTp_RxIndication, CanIfRxPduUserRxIndicationType=PDUID_PDUINFOPTR, CanIfRxPduUserRxIndicationUL=CAN_TP, CanIfRxPduId=43, CanIfRxPduHrhIdRef=CN_CabSubnet_eedbadff_Rx, CanIfRxPduRef=DiagRespMsgIntHMIIOM_F3_26_Cab_Tp_oCabSubnet_0c6b03ff_Rx
        CCM_Cab_08P_oCabSubnet_674b573f_Rx: CanIfRxPduCanId=285157016, CanIfRxPduUserRxIndicationName=PduR_CanIfRxIndication, CanIfRxPduUserRxIndicationUL=PDUR, CanIfRxPduId=80, CanIfRxPduHrhIdRef=CN_CabSubnet_eedbadff_Rx, CanIfRxPduRef=CCM_Cab_08P_oCabSubnet_c4134f5d_Rx
        DiagReqMsgIntTGW2_A1_F4_BB2_Tp_oBackbone2_91dc1a3b_Rx: CanIfRxPduCanId=524329460, CanIfRxPduUserRxIndicationName=CanTp_RxIndication, CanIfRxPduUserRxIndicationType=PDUID_PDUINFOPTR, CanIfRxPduUserRxIndicationUL=CAN_TP, CanIfRxPduId=137, CanIfRxPduHrhIdRef=CN_Backbone2_7b3866ec_Rx, CanIfRxPduRef=DiagReqMsgIntTGW2_A1_F4_BB2_Tp_oBackbone2_38ceb134_Rx
      3 x CanIfTxPduCfg, all with CanIfTxPduCanIdType=EXTENDED_CAN, CanIfTxPduDlc=8, CanIfTxPduUserTxConfirmationName=CanTp_TxConfirmation, CanIfTxPduUserTxConfirmationUL=CAN_TP, CanIfTxPduReadNotifyStatus=false, CanIfTxPduType=STATIC:
        DiagReqMsgIntHMIIOM_26_F3_Cab_Tp_oCabSubnet_2e1f9ada_Tx: CanIfTxPduCanId=524297971, CanIfTxPduId=16, CanIfTxPduBufferRef=CanIfBufferCfg_DiagReqMsgIntHMIIOM_26_F3_Cab_Tp_oCabSubnet_2e1f9ada_Tx, CanIfTxPduRef=DiagReqMsgIntHMIIOM_26_F3_Cab_Tp_oCabSubnet_b2bc325b_Tx
        PhysDiagReqMsg_53_F1_Cab_Tp_oCabSubnet_682570ce_Tx: CanIfTxPduCanId=416961521, CanIfTxPduId=34, CanIfTxPduBufferRef=CanIfBufferCfg_PhysDiagReqMsg_53_F1_Cab_Tp_oCabSubnet_682570ce_Tx, CanIfTxPduRef=PhysDiagReqMsg_53_F1_Cab_Tp_oCabSubnet_6a584031_Tx
        DiagReqMsgIntHMIIOM_A1_F3_Sec_Tp_oSecuritySubnet_a1b03b66_Tx: CanIfTxPduCanId=524329459, CanIfTxPduId=62, CanIfTxPduBufferRef=CanIfBufferCfg_DiagReqMsgIntHMIIOM_A1_F3_Sec_Tp_oSecuritySubnet_a1b03b66_Tx, CanIfTxPduRef=DiagReqMsgIntHMIIOM_A1_F3_Sec_Tp_oSecuritySubnet_335700dc_Tx
      CIOM_Sec_06S_FCM_Tp_oSecuritySubnet_76df7446_Rx (CanIfRxPduCfg):
        CanIfRxPduCanId = 352264160
        CanIfRxPduCanIdType = EXTENDED_CAN
        CanIfRxPduDlc = 8
        CanIfRxPduUserRxIndicationName = CanTp_RxIndication
        CanIfRxPduUserRxIndicationUL = CAN_TP
        CanIfRxPduId = 118
        CanIfRxPduReadData = false
        CanIfRxPduReadNotifyStatus = false
        CanIfRxPduDlcCheck = true
        CanIfRxPduHrhIdRef = CN_SecuritySubnet_3840872e_Rx
        CanIfRxPduRef = CIOM_Sec_06S_FCM_Tp_oSecuritySubnet_94f5f7f7_Rx
      TesterFuncDiagMsg_Sec_Tp_oSecuritySubnet_7f5a7347_Tx (CanIfTxPduCfg):
        CanIfTxPduCanId = 524419058
        CanIfTxPduCanIdType = EXTENDED_CAN
        CanIfTxPduDlc = 8
        CanIfTxPduUserTxConfirmationName = CanTp_TxConfirmation
        CanIfTxPduUserTxConfirmationUL = CAN_TP
        CanIfTxPduId = 57
        CanIfTxPduReadNotifyStatus = false
        CanIfTxPduType = STATIC
        CanIfTxPduBufferRef = CanIfBufferCfg_TesterFuncDiagMsg_Sec_Tp_oSecuritySubnet_7f5a7347_Tx
        CanIfTxPduRef = TesterFuncDiagMsg_Sec_Tp_oSecuritySubnet_3840a9b6_Tx
      5 x CanIfRxPduCfg, all with CanIfRxPduCanIdType=EXTENDED_CAN, CanIfRxPduDlc=8, CanIfRxPduReadData=false, CanIfRxPduReadNotifyStatus=false, CanIfRxPduDlcCheck=true:
        TECU_BB2_06S_Tp_oBackbone2_0c47cb8e_Rx: CanIfRxPduCanId=1445, CanIfRxPduUserRxIndicationName=CanTp_RxIndication, CanIfRxPduUserRxIndicationType=PDUID_PDUINFOPTR, CanIfRxPduUserRxIndicationUL=CAN_TP, CanIfRxPduId=172, CanIfRxPduHrhIdRef=CN_Backbone2_7b3866ec_Rx, CanIfRxPduRef=TECU_BB2_06S_Tp_oBackbone2_51e58e52_Rx
        DiagUUDTRespMsg1_F2_A2_Cab_oCabSubnet_faf51f79_Rx: CanIfRxPduCanId=524481186, CanIfRxPduUserRxIndicationUL=PDUR, CanIfRxPduId=32, CanIfRxPduUserRxIndicationName=PduR_CanIfRxIndication, CanIfRxPduHrhIdRef=CN_CabSubnet_eedbadff_Rx, CanIfRxPduRef=DiagUUDTRespMsg1_F2_A2_Cab_oCabSubnet_4ea3f6ac_Rx
        VMCU_BB2_04P_oBackbone2_c53160d8_Rx: CanIfRxPduCanId=721, CanIfRxPduUserRxIndicationName=PduR_CanIfRxIndication, CanIfRxPduUserRxIndicationUL=PDUR, CanIfRxPduId=234, CanIfRxPduHrhIdRef=CN_Backbone2_7b3866ec_Rx, CanIfRxPduRef=VMCU_BB2_04P_oBackbone2_5ffe6079_Rx
        DiagFaultStat_CCM_Cab_oCabSubnet_2b754d89_Rx: CanIfRxPduCanId=419573788, CanIfRxPduUserRxIndicationName=PduR_CanIfRxIndication, CanIfRxPduUserRxIndicationUL=PDUR, CanIfRxPduId=56, CanIfRxPduHrhIdRef=CN_CabSubnet_eedbadff_Rx, CanIfRxPduRef=DiagFaultStat_CCM_Cab_oCabSubnet_1ee92cda_Rx
        CIOM_Cab_29S_FCM_Tp_oCabSubnet_8230888a_Rx: CanIfRxPduCanId=285196097, CanIfRxPduUserRxIndicationName=CanTp_RxIndication, CanIfRxPduUserRxIndicationUL=CAN_TP, CanIfRxPduId=74, CanIfRxPduHrhIdRef=CN_CabSubnet_eedbadff_Rx, CanIfRxPduRef=CIOM_Cab_29S_FCM_Tp_oCabSubnet_f9c1ba55_Rx
      PhysDiagRespMsg_F2_53_BB2_Tp_oBackbone2_ef1139d4_Tx (CanIfTxPduCfg):
        CanIfTxPduCanId = 524350035
        CanIfTxPduCanIdType = EXTENDED_CAN
        CanIfTxPduDlc = 8
        CanIfTxPduUserTxConfirmationName = CanTp_TxConfirmation
        CanIfTxPduUserTxConfirmationUL = CAN_TP
        CanIfTxPduId = 169
        CanIfTxPduReadNotifyStatus = false
        CanIfTxPduType = STATIC
        CanIfTxPduBufferRef = CHNL_a6b6a922
        CanIfTxPduRef = PhysDiagRespMsg_F2_53_BB2_Tp_oBackbone2_238b2202_Tx
      PDM_Sec_01P_oSecuritySubnet_073fa36a_Rx (CanIfRxPduCfg):
        CanIfRxPduCanId = 285206945
        CanIfRxPduCanIdType = EXTENDED_CAN
        CanIfRxPduDlc = 8
        CanIfRxPduUserRxIndicationName = PduR_CanIfRxIndication
        CanIfRxPduUserRxIndicationUL = PDUR
        CanIfRxPduId = 121
        CanIfRxPduReadData = false
        CanIfRxPduReadNotifyStatus = false
        CanIfRxPduDlcCheck = true
        CanIfRxPduHrhIdRef = CN_SecuritySubnet_3840872e_Rx
        CanIfRxPduRef = PDM_Sec_01P_oSecuritySubnet_5921b61c_Rx
      5 x CanIfTxPduCfg, all with CanIfTxPduCanIdType=EXTENDED_CAN, CanIfTxPduDlc=8, CanIfTxPduReadNotifyStatus=false, CanIfTxPduType=STATIC:
        TPDT_Tp_oFMSNet_3018618a_Tx: CanIfTxPduCanId=485228286, CanIfTxPduCanIdMask=3825139712, CanIfTxPduUserTxConfirmationName=J1939Tp_TxConfirmation, CanIfTxPduUserTxConfirmationUL=J1939TP, CanIfTxPduId=91, CanIfTxPduBufferRef=CanIfBufferCfg_TPDT_Tp_oFMSNet_3018618a_Tx, CanIfTxPduRef=TPDT_Tp_oFMSNet_b75dd625_Tx
        DiagReqMsgIntHMIIOM_A2_F3_Cab_Tp_oCabSubnet_fcbc8d7d_Tx: CanIfTxPduCanId=524329715, CanIfTxPduUserTxConfirmationName=CanTp_TxConfirmation, CanIfTxPduUserTxConfirmationUL=CAN_TP, CanIfTxPduId=7, CanIfTxPduBufferRef=CanIfBufferCfg_DiagReqMsgIntHMIIOM_A2_F3_Cab_Tp_oCabSubnet_fcbc8d7d_Tx, CanIfTxPduRef=DiagReqMsgIntHMIIOM_A2_F3_Cab_Tp_oCabSubnet_e5b8e924_Tx
        PhysDiagRespMsg_F2_A0_BB2_Tp_oBackbone2_d77a4b8a_Tx: CanIfTxPduCanId=524350112, CanIfTxPduUserTxConfirmationName=CanTp_TxConfirmation, CanIfTxPduUserTxConfirmationUL=CAN_TP, CanIfTxPduId=167, CanIfTxPduBufferRef=CHNL_a6b6a922, CanIfTxPduRef=PhysDiagRespMsg_F2_A0_BB2_Tp_oBackbone2_153747e2_Tx
        CIOM_Cab_18P_oCabSubnet_2e5bdde9_Tx: CanIfTxPduCanId=419186687, CanIfTxPduUserTxConfirmationName=NULL_PTR, CanIfTxPduUserTxConfirmationUL=NONE, CanIfTxPduId=23, CanIfTxPduBufferRef=CanIfBufferCfg_CIOM_Cab_18P_oCabSubnet_2e5bdde9_Tx, CanIfTxPduRef=CIOM_Cab_18P_oCabSubnet_c0de9230_Tx
        CIOM_BB2_28P_oBackbone2_d86d16b8_Tx: CanIfTxPduCanId=418594624, CanIfTxPduUserTxConfirmationName=NULL_PTR, CanIfTxPduUserTxConfirmationUL=NONE, CanIfTxPduId=178, CanIfTxPduBufferRef=CHNL_a6b6a922, CanIfTxPduRef=CIOM_BB2_28P_oBackbone2_6ddcefa1_Tx
      TECU_BB2_05S_Tp_oBackbone2_01d5ac34_Rx (CanIfRxPduCfg):
        CanIfRxPduCanId = 938
        CanIfRxPduCanIdType = EXTENDED_CAN
        CanIfRxPduDlc = 8
        CanIfRxPduUserRxIndicationName = CanTp_RxIndication
        CanIfRxPduUserRxIndicationType = PDUID_PDUINFOPTR
        CanIfRxPduUserRxIndicationUL = CAN_TP
        CanIfRxPduId = 219
        CanIfRxPduReadData = false
        CanIfRxPduReadNotifyStatus = false
        CanIfRxPduDlcCheck = true
        CanIfRxPduHrhIdRef = CN_Backbone2_7b3866ec_Rx
        CanIfRxPduRef = TECU_BB2_05S_Tp_oBackbone2_da36b04b_Rx
      VMCU_BB2_05P_oBackbone2_a2f2e1d8_Rx (CanIfRxPduCfg):
        CanIfRxPduCanId = 725
        CanIfRxPduCanIdType = EXTENDED_CAN
        CanIfRxPduDlc = 8
        CanIfRxPduUserRxIndicationName = PduR_CanIfRxIndication
        CanIfRxPduUserRxIndicationUL = PDUR
        CanIfRxPduId = 233
        CanIfRxPduReadData = false
        CanIfRxPduReadNotifyStatus = false
        CanIfRxPduDlcCheck = true
        CanIfRxPduHrhIdRef = CN_Backbone2_7b3866ec_Rx
        CanIfRxPduRef = VMCU_BB2_05P_oBackbone2_ae2465d3_Rx
      DDM_Sec_03S_FCM_Tp_oSecuritySubnet_5a2ee2bf_Tx (CanIfTxPduCfg):
        CanIfTxPduCanId = 352292001
        CanIfTxPduCanIdType = EXTENDED_CAN
        CanIfTxPduDlc = 8
        CanIfTxPduUserTxConfirmationName = CanTp_TxConfirmation
        CanIfTxPduUserTxConfirmationUL = CAN_TP
        CanIfTxPduId = 78
        CanIfTxPduReadNotifyStatus = false
        CanIfTxPduType = STATIC
        CanIfTxPduBufferRef = CanIfBufferCfg_DDM_Sec_03S_FCM_Tp_oSecuritySubnet_5a2ee2bf_Tx
        CanIfTxPduRef = DDM_Sec_03S_FCM_Tp_oSecuritySubnet_3674851a_Tx
      6 x CanIfRxPduCfg, all with CanIfRxPduCanIdType=EXTENDED_CAN, CanIfRxPduUserRxIndicationName=PduR_CanIfRxIndication, CanIfRxPduUserRxIndicationUL=PDUR, CanIfRxPduReadData=false, CanIfRxPduReadNotifyStatus=false, CanIfRxPduDlcCheck=true:
        EMS_BB2_01P_oBackbone2_9dd8bb44_Rx: CanIfRxPduCanId=719, CanIfRxPduDlc=8, CanIfRxPduId=235, CanIfRxPduHrhIdRef=CN_Backbone2_7b3866ec_Rx, CanIfRxPduRef=EMS_BB2_01P_oBackbone2_440afce7_Rx
        VMCU_BB2_07P_oBackbone2_6d75e3d8_Rx: CanIfRxPduCanId=931, CanIfRxPduDlc=8, CanIfRxPduId=220, CanIfRxPduHrhIdRef=CN_Backbone2_7b3866ec_Rx, CanIfRxPduRef=VMCU_BB2_07P_oBackbone2_96e168c6_Rx
        AnmMsg_ECUspare5_SecuritySubnet_oSecuritySubnet_25af973c_Rx: CanIfRxPduCanId=486510665, CanIfRxPduDlc=4, CanIfRxPduId=98, CanIfRxPduHrhIdRef=CN_SecuritySubnet_3840872e_Rx, CanIfRxPduRef=AnmMsg_ECUspare5_SecuritySubnet_oSecuritySubnet_40a00d45_Rx
        VMCU_BB2_03P_oBackbone2_290ae199_Rx: CanIfRxPduCanId=534, CanIfRxPduDlc=8, CanIfRxPduId=237, CanIfRxPduHrhIdRef=CN_Backbone2_7b3866ec_Rx, CanIfRxPduRef=VMCU_BB2_03P_oBackbone2_e76b72ec_Rx
        DiagFaultStat_PDM_Sec_oSecuritySubnet_b17b40b8_Rx: CanIfRxPduCanId=436196513, CanIfRxPduDlc=8, CanIfRxPduId=102, CanIfRxPduHrhIdRef=CN_SecuritySubnet_3840872e_Rx, CanIfRxPduRef=DiagFaultStat_PDM_Sec_oSecuritySubnet_7823c535_Rx
        DiagUUDTRespMsg1_F2_26_Cab_oCabSubnet_8c457eb7_Rx: CanIfRxPduCanId=524481062, CanIfRxPduDlc=8, CanIfRxPduId=35, CanIfRxPduHrhIdRef=CN_CabSubnet_eedbadff_Rx, CanIfRxPduRef=DiagUUDTRespMsg1_F2_26_Cab_oCabSubnet_698cfba7_Rx
      FMS_X_CIOMFMS_oFMSNet_68f86b37_Tx (CanIfTxPduCfg):
        CanIfTxPduCanId = 486396209
        CanIfTxPduCanIdType = EXTENDED_CAN
        CanIfTxPduDlc = 8
        CanIfTxPduUserTxConfirmationName = NULL_PTR
        CanIfTxPduUserTxConfirmationUL = NONE
        CanIfTxPduId = 89
        CanIfTxPduReadNotifyStatus = false
        CanIfTxPduType = STATIC
        CanIfTxPduBufferRef = CanIfBufferCfg_FMS_X_CIOMFMS_oFMSNet_68f86b37_Tx
        CanIfTxPduRef = FMS_X_CIOMFMS_oFMSNet_c973602f_Tx
      CIOM_BB2_12S_FCM_Tp_oBackbone2_13bf5a99_Rx (CanIfRxPduCfg):
        CanIfRxPduCanId = 352264001
        CanIfRxPduCanIdType = EXTENDED_CAN
        CanIfRxPduDlc = 8
        CanIfRxPduUserRxIndicationUL = CAN_TP
        CanIfRxPduId = 166
        CanIfRxPduReadData = false
        CanIfRxPduReadNotifyStatus = false
        CanIfRxPduUserRxIndicationName = CanTp_RxIndication
        CanIfRxPduDlcCheck = true
        CanIfRxPduHrhIdRef = CN_Backbone2_7b3866ec_Rx
        CanIfRxPduRef = CIOM_BB2_12S_FCM_Tp_oBackbone2_8a196d83_Rx
      PhysDiagReqMsg_26_F2_Cab_Tp_oCabSubnet_e2a6386f_Tx (CanIfTxPduCfg):
        CanIfTxPduCanId = 524297970
        CanIfTxPduCanIdType = EXTENDED_CAN
        CanIfTxPduDlc = 8
        CanIfTxPduUserTxConfirmationName = CanTp_TxConfirmation
        CanIfTxPduUserTxConfirmationUL = CAN_TP
        CanIfTxPduId = 17
        CanIfTxPduReadNotifyStatus = false
        CanIfTxPduType = STATIC
        CanIfTxPduBufferRef = CanIfBufferCfg_PhysDiagReqMsg_26_F2_Cab_Tp_oCabSubnet_e2a6386f_Tx
        CanIfTxPduRef = PhysDiagReqMsg_26_F2_Cab_Tp_oCabSubnet_08550cf9_Tx
      DiagReqMsgIntHMIIOM_26_F3_BB2_Tp_oBackbone2_3a21aae6_Rx (CanIfRxPduCfg):
        CanIfRxPduCanId = 524297971
        CanIfRxPduCanIdType = EXTENDED_CAN
        CanIfRxPduDlc = 8
        CanIfRxPduUserRxIndicationName = CanTp_RxIndication
        CanIfRxPduUserRxIndicationType = PDUID_PDUINFOPTR
        CanIfRxPduUserRxIndicationUL = CAN_TP
        CanIfRxPduId = 153
        CanIfRxPduReadData = false
        CanIfRxPduReadNotifyStatus = false
        CanIfRxPduDlcCheck = true
        CanIfRxPduHrhIdRef = CN_Backbone2_7b3866ec_Rx
        CanIfRxPduRef = DiagReqMsgIntHMIIOM_26_F3_BB2_Tp_oBackbone2_20111ed4_Rx
      AIR1_X_CIOMFMS_oFMSNet_9b1ec537_Tx (CanIfTxPduCfg):
        CanIfTxPduCanId = 419343921
        CanIfTxPduCanIdType = EXTENDED_CAN
        CanIfTxPduDlc = 8
        CanIfTxPduUserTxConfirmationName = NULL_PTR
        CanIfTxPduUserTxConfirmationUL = NONE
        CanIfTxPduId = 103
        CanIfTxPduReadNotifyStatus = false
        CanIfTxPduType = STATIC
        CanIfTxPduBufferRef = CanIfBufferCfg_AIR1_X_CIOMFMS_oFMSNet_9b1ec537_Tx
        CanIfTxPduRef = AIR1_X_CIOMFMS_oFMSNet_94b967fe_Tx
      DiagReqMsgIntTGW2_C0_F4_Sec_Tp_oSecuritySubnet_0ba24808_Tx (CanIfTxPduCfg):
        CanIfTxPduCanId = 524337396
        CanIfTxPduCanIdType = EXTENDED_CAN
        CanIfTxPduDlc = 8
        CanIfTxPduUserTxConfirmationName = CanTp_TxConfirmation
        CanIfTxPduUserTxConfirmationUL = CAN_TP
        CanIfTxPduId = 58
        CanIfTxPduReadNotifyStatus = false
        CanIfTxPduType = STATIC
        CanIfTxPduBufferRef = CanIfBufferCfg_DiagReqMsgIntTGW2_C0_F4_Sec_Tp_oSecuritySubnet_0ba24808_Tx
        CanIfTxPduRef = DiagReqMsgIntTGW2_C0_F4_Sec_Tp_oSecuritySubnet_db1937c6_Tx
      DiagFaultStat_SRS_Cab_oCabSubnet_e5f44b73_Rx (CanIfRxPduCfg):
        CanIfRxPduCanId = 419573790
        CanIfRxPduCanIdType = EXTENDED_CAN
        CanIfRxPduDlc = 8
        CanIfRxPduUserRxIndicationName = PduR_CanIfRxIndication
        CanIfRxPduUserRxIndicationUL = PDUR
        CanIfRxPduId = 54
        CanIfRxPduReadData = false
        CanIfRxPduReadNotifyStatus = false
        CanIfRxPduDlcCheck = true
        CanIfRxPduHrhIdRef = CN_CabSubnet_eedbadff_Rx
        CanIfRxPduRef = DiagFaultStat_SRS_Cab_oCabSubnet_418c5993_Rx
      ERC1_x_EMSRetFMS_oFMSNet_d863a207_Tx (CanIfTxPduCfg):
        CanIfTxPduCanId = 418381839
        CanIfTxPduCanIdType = EXTENDED_CAN
        CanIfTxPduDlc = 8
        CanIfTxPduUserTxConfirmationName = NULL_PTR
        CanIfTxPduUserTxConfirmationUL = NONE
        CanIfTxPduId = 112
        CanIfTxPduReadNotifyStatus = false
        CanIfTxPduType = STATIC
        CanIfTxPduBufferRef = CanIfBufferCfg_ERC1_x_EMSRetFMS_oFMSNet_d863a207_Tx
        CanIfTxPduRef = ERC1_x_EMSRetFMS_oFMSNet_04fe6f08_Tx
      DiagReqMsgIntTGW2_C0_F4_BB2_Tp_oBackbone2_92584732_Rx (CanIfRxPduCfg):
        CanIfRxPduCanId = 524337396
        CanIfRxPduCanIdType = EXTENDED_CAN
        CanIfRxPduDlc = 8
        CanIfRxPduUserRxIndicationName = CanTp_RxIndication
        CanIfRxPduUserRxIndicationType = PDUID_PDUINFOPTR
        CanIfRxPduUserRxIndicationUL = CAN_TP
        CanIfRxPduId = 131
        CanIfRxPduReadData = false
        CanIfRxPduReadNotifyStatus = false
        CanIfRxPduDlcCheck = true
        CanIfRxPduHrhIdRef = CN_Backbone2_7b3866ec_Rx
        CanIfRxPduRef = DiagReqMsgIntTGW2_C0_F4_BB2_Tp_oBackbone2_49db2e08_Rx
      DiagRespMsgIntHMIIOM_F3_40_BB2_Tp_oBackbone2_7b130fa6_Tx (CanIfTxPduCfg):
        CanIfTxPduCanId = 524350272
        CanIfTxPduCanIdType = EXTENDED_CAN
        CanIfTxPduDlc = 8
        CanIfTxPduUserTxConfirmationName = CanTp_TxConfirmation
        CanIfTxPduUserTxConfirmationUL = CAN_TP
        CanIfTxPduId = 162
        CanIfTxPduReadNotifyStatus = false
        CanIfTxPduType = STATIC
        CanIfTxPduBufferRef = CHNL_a6b6a922
        CanIfTxPduRef = DiagRespMsgIntHMIIOM_F3_40_BB2_Tp_oBackbone2_79511009_Tx
      EMS_BB2_13P_oBackbone2_036dfbaa_Rx (CanIfRxPduCfg):
        CanIfRxPduCanId = 1282
        CanIfRxPduCanIdType = EXTENDED_CAN
        CanIfRxPduDlc = 8
        CanIfRxPduUserRxIndicationName = PduR_CanIfRxIndication
        CanIfRxPduUserRxIndicationUL = PDUR
        CanIfRxPduId = 201
        CanIfRxPduReadData = false
        CanIfRxPduReadNotifyStatus = false
        CanIfRxPduDlcCheck = true
        CanIfRxPduHrhIdRef = CN_Backbone2_7b3866ec_Rx
        CanIfRxPduRef = EMS_BB2_13P_oBackbone2_4a3d6101_Rx
      VMCU_BB2_54P_oBackbone2_c4c9ad5d_Rx (CanIfRxPduCfg):
        CanIfRxPduCanId = 925
        CanIfRxPduCanIdType = EXTENDED_CAN
        CanIfRxPduDlc = 8
        CanIfRxPduUserRxIndicationName = PduR_CanIfRxIndication
        CanIfRxPduUserRxIndicationUL = PDUR
        CanIfRxPduId = 221
        CanIfRxPduReadData = false
        CanIfRxPduReadNotifyStatus = false
        CanIfRxPduDlcCheck = true
        CanIfRxPduHrhIdRef = CN_Backbone2_7b3866ec_Rx
        CanIfRxPduRef = VMCU_BB2_54P_oBackbone2_b2c6b346_Rx
      3 x CanIfTxPduCfg, all with CanIfTxPduCanIdType=EXTENDED_CAN, CanIfTxPduDlc=8, CanIfTxPduReadNotifyStatus=false, CanIfTxPduType=STATIC:
        TPCM_Tp_oFMSNet_55e2f930_Tx: CanIfTxPduCanId=485293822, CanIfTxPduCanIdMask=3825139712, CanIfTxPduUserTxConfirmationName=J1939Tp_TxConfirmation, CanIfTxPduUserTxConfirmationUL=J1939TP, CanIfTxPduId=90, CanIfTxPduBufferRef=CanIfBufferCfg_TPCM_Tp_oFMSNet_55e2f930_Tx, CanIfTxPduRef=TPCM_Tp_oFMSNet_527e1bbd_Tx
        EEC1_X_CIOMFMS_oFMSNet_954d78de_Tx: CanIfTxPduCanId=217056305, CanIfTxPduUserTxConfirmationName=NULL_PTR, CanIfTxPduUserTxConfirmationUL=NONE, CanIfTxPduId=116, CanIfTxPduBufferRef=CanIfBufferCfg_EEC1_X_CIOMFMS_oFMSNet_954d78de_Tx, CanIfTxPduRef=EEC1_X_CIOMFMS_oFMSNet_09cdd7bd_Tx
        CIOM_Cab_24P_oCabSubnet_e2729fa9_Tx: CanIfTxPduCanId=368644416, CanIfTxPduUserTxConfirmationName=NULL_PTR, CanIfTxPduUserTxConfirmationUL=NONE, CanIfTxPduId=39, CanIfTxPduBufferRef=CanIfBufferCfg_CIOM_Cab_24P_oCabSubnet_e2729fa9_Tx, CanIfTxPduRef=CIOM_Cab_24P_oCabSubnet_09570d5b_Tx
      PhysDiagRespMsg_F2_C0_Sec_Tp_oSecuritySubnet_614a0693_Rx (CanIfRxPduCfg):
        CanIfRxPduCanId = 524350144
        CanIfRxPduCanIdType = EXTENDED_CAN
        CanIfRxPduDlc = 8
        CanIfRxPduUserRxIndicationName = CanTp_RxIndication
        CanIfRxPduUserRxIndicationType = PDUID_PDUINFOPTR
        CanIfRxPduUserRxIndicationUL = CAN_TP
        CanIfRxPduId = 95
        CanIfRxPduReadData = false
        CanIfRxPduReadNotifyStatus = false
        CanIfRxPduDlcCheck = true
        CanIfRxPduHrhIdRef = CN_SecuritySubnet_3840872e_Rx
        CanIfRxPduRef = PhysDiagRespMsg_F2_C0_Sec_Tp_oSecuritySubnet_fed2760b_Rx
      SRS_Cab_05P_oCabSubnet_2fb89566_Rx (CanIfRxPduCfg):
        CanIfRxPduCanId = 419342163
        CanIfRxPduCanIdType = EXTENDED_CAN
        CanIfRxPduDlc = 8
        CanIfRxPduUserRxIndicationName = PduR_CanIfRxIndication
        CanIfRxPduUserRxIndicationUL = PDUR
        CanIfRxPduId = 59
        CanIfRxPduReadData = false
        CanIfRxPduReadNotifyStatus = false
        CanIfRxPduDlcCheck = true
        CanIfRxPduHrhIdRef = CN_CabSubnet_eedbadff_Rx
        CanIfRxPduRef = SRS_Cab_05P_oCabSubnet_f02f0a02_Rx
      VDHR_X_CIOMFMS_oFMSNet_67a02fb8_Tx (CanIfTxPduCfg):
        CanIfTxPduCanId = 419348785
        CanIfTxPduCanIdType = EXTENDED_CAN
        CanIfTxPduDlc = 8
        CanIfTxPduUserTxConfirmationName = NULL_PTR
        CanIfTxPduUserTxConfirmationUL = NONE
        CanIfTxPduId = 101
        CanIfTxPduReadNotifyStatus = false
        CanIfTxPduType = STATIC
        CanIfTxPduBufferRef = CanIfBufferCfg_VDHR_X_CIOMFMS_oFMSNet_67a02fb8_Tx
        CanIfTxPduRef = VDHR_X_CIOMFMS_oFMSNet_9598589a_Tx
      DiagFaultStat_Alarm_Sec_oSecuritySubnet_6cedaf7c_Rx (CanIfRxPduCfg):
        CanIfRxPduCanId = 436153024
        CanIfRxPduCanIdType = EXTENDED_CAN
        CanIfRxPduDlc = 8
        CanIfRxPduUserRxIndicationName = PduR_CanIfRxIndication
        CanIfRxPduUserRxIndicationUL = PDUR
        CanIfRxPduId = 104
        CanIfRxPduReadData = false
        CanIfRxPduReadNotifyStatus = false
        CanIfRxPduDlcCheck = true
        CanIfRxPduHrhIdRef = CN_SecuritySubnet_3840872e_Rx
        CanIfRxPduRef = DiagFaultStat_Alarm_Sec_oSecuritySubnet_c6873827_Rx
      DiagRespMsgIntTGW2_F4_A1_Sec_Tp_oSecuritySubnet_efa76b9d_Rx (CanIfRxPduCfg):
        CanIfRxPduCanId = 524350625
        CanIfRxPduCanIdType = EXTENDED_CAN
        CanIfRxPduDlc = 8
        CanIfRxPduUserRxIndicationName = CanTp_RxIndication
        CanIfRxPduUserRxIndicationType = PDUID_PDUINFOPTR
        CanIfRxPduUserRxIndicationUL = CAN_TP
        CanIfRxPduId = 90
        CanIfRxPduReadData = false
        CanIfRxPduReadNotifyStatus = false
        CanIfRxPduDlcCheck = true
        CanIfRxPduHrhIdRef = CN_SecuritySubnet_3840872e_Rx
        CanIfRxPduRef = DiagRespMsgIntTGW2_F4_A1_Sec_Tp_oSecuritySubnet_ab85d07d_Rx
      CL_X_CIOMFMS_oFMSNet_fc518547_Tx (CanIfTxPduCfg):
        CanIfTxPduCanId = 416350001
        CanIfTxPduCanIdType = EXTENDED_CAN
        CanIfTxPduDlc = 8
        CanIfTxPduUserTxConfirmationName = NULL_PTR
        CanIfTxPduUserTxConfirmationUL = NONE
        CanIfTxPduId = 114
        CanIfTxPduReadNotifyStatus = false
        CanIfTxPduType = STATIC
        CanIfTxPduBufferRef = CanIfBufferCfg_CL_X_CIOMFMS_oFMSNet_fc518547_Tx
        CanIfTxPduRef = CL_X_CIOMFMS_oFMSNet_5e9df939_Tx
      3 x CanIfRxPduCfg, all with CanIfRxPduCanIdType=EXTENDED_CAN, CanIfRxPduUserRxIndicationName=PduR_CanIfRxIndication, CanIfRxPduUserRxIndicationUL=PDUR, CanIfRxPduReadData=false, CanIfRxPduReadNotifyStatus=false, CanIfRxPduDlcCheck=true:
        AnmMsg_DDM_SecuritySubnet_oSecuritySubnet_669221a0_Rx: CanIfRxPduCanId=486510631, CanIfRxPduDlc=4, CanIfRxPduId=100, CanIfRxPduHrhIdRef=CN_SecuritySubnet_3840872e_Rx, CanIfRxPduRef=AnmMsg_DDM_SecuritySubnet_oSecuritySubnet_c6114aa9_Rx
        HMIIOM_BB2_33P_oBackbone2_59bf9fe2_Rx: CanIfRxPduCanId=822, CanIfRxPduDlc=8, CanIfRxPduId=229, CanIfRxPduHrhIdRef=CN_Backbone2_7b3866ec_Rx, CanIfRxPduRef=HMIIOM_BB2_33P_oBackbone2_6953c5ad_Rx
        DiagUUDTRespMsg1_F2_C0_Sec_oSecuritySubnet_d0c97a87_Rx: CanIfRxPduCanId=524481216, CanIfRxPduDlc=8, CanIfRxPduId=86, CanIfRxPduHrhIdRef=CN_SecuritySubnet_3840872e_Rx, CanIfRxPduRef=DiagUUDTRespMsg1_F2_C0_Sec_oSecuritySubnet_c4b8dd22_Rx
      CIOM_Sec_09S_Tp_oSecuritySubnet_ba09ccac_Tx (CanIfTxPduCfg):
        CanIfTxPduCanId = 352265792
        CanIfTxPduCanIdType = EXTENDED_CAN
        CanIfTxPduDlc = 8
        CanIfTxPduUserTxConfirmationName = CanTp_TxConfirmation
        CanIfTxPduUserTxConfirmationUL = CAN_TP
        CanIfTxPduId = 83
        CanIfTxPduReadNotifyStatus = false
        CanIfTxPduType = STATIC
        CanIfTxPduBufferRef = CanIfBufferCfg_CIOM_Sec_09S_Tp_oSecuritySubnet_ba09ccac_Tx
        CanIfTxPduRef = CIOM_Sec_09S_Tp_oSecuritySubnet_c7eade0e_Tx
      CIOM_Sec_11S_FCM_Tp_oSecuritySubnet_e88f2495_Rx (CanIfRxPduCfg):
        CanIfRxPduCanId = 352278849
        CanIfRxPduCanIdType = EXTENDED_CAN
        CanIfRxPduDlc = 8
        CanIfRxPduUserRxIndicationName = CanTp_RxIndication
        CanIfRxPduUserRxIndicationUL = CAN_TP
        CanIfRxPduId = 115
        CanIfRxPduReadData = false
        CanIfRxPduReadNotifyStatus = false
        CanIfRxPduDlcCheck = true
        CanIfRxPduHrhIdRef = CN_SecuritySubnet_3840872e_Rx
        CanIfRxPduRef = CIOM_Sec_11S_FCM_Tp_oSecuritySubnet_0aae2ffd_Rx
      CIOM_Cab_11S_FCM_Tp_oCabSubnet_a74b983f_Rx (CanIfRxPduCfg):
        CanIfRxPduCanId = 418351104
        CanIfRxPduCanIdType = EXTENDED_CAN
        CanIfRxPduDlc = 8
        CanIfRxPduUserRxIndicationName = CanTp_RxIndication
        CanIfRxPduUserRxIndicationUL = CAN_TP
        CanIfRxPduId = 65
        CanIfRxPduReadData = false
        CanIfRxPduReadNotifyStatus = false
        CanIfRxPduDlcCheck = true
        CanIfRxPduHrhIdRef = CN_CabSubnet_eedbadff_Rx
        CanIfRxPduRef = CIOM_Cab_11S_FCM_Tp_oCabSubnet_caa65d56_Rx
      DiagRespMsgIntTGW2_F4_A1_BB2_Tp_oBackbone2_bca8fbcc_Tx (CanIfTxPduCfg):
        CanIfTxPduCanId = 524350625
        CanIfTxPduCanIdType = EXTENDED_CAN
        CanIfTxPduDlc = 8
        CanIfTxPduUserTxConfirmationName = CanTp_TxConfirmation
        CanIfTxPduUserTxConfirmationUL = CAN_TP
        CanIfTxPduId = 150
        CanIfTxPduReadNotifyStatus = false
        CanIfTxPduType = STATIC
        CanIfTxPduBufferRef = CHNL_a6b6a922
        CanIfTxPduRef = DiagRespMsgIntTGW2_F4_A1_BB2_Tp_oBackbone2_eea85e67_Tx
      HMIIOM_BB2_09P_oBackbone2_08c205a9_Rx (CanIfRxPduCfg):
        CanIfRxPduCanId = 979
        CanIfRxPduCanIdType = EXTENDED_CAN
        CanIfRxPduDlc = 8
        CanIfRxPduUserRxIndicationName = PduR_CanIfRxIndication
        CanIfRxPduUserRxIndicationUL = PDUR
        CanIfRxPduId = 213
        CanIfRxPduReadData = false
        CanIfRxPduReadNotifyStatus = false
        CanIfRxPduDlcCheck = true
        CanIfRxPduHrhIdRef = CN_Backbone2_7b3866ec_Rx
        CanIfRxPduRef = HMIIOM_BB2_09P_oBackbone2_e9954df9_Rx
      PhysDiagRespMsg_F2_A1_BB2_Tp_oBackbone2_441131ae_Tx (CanIfTxPduCfg):
        CanIfTxPduCanId = 524350113
        CanIfTxPduCanIdType = EXTENDED_CAN
        CanIfTxPduDlc = 8
        CanIfTxPduUserTxConfirmationName = CanTp_TxConfirmation
        CanIfTxPduUserTxConfirmationUL = CAN_TP
        CanIfTxPduId = 166
        CanIfTxPduReadNotifyStatus = false
        CanIfTxPduType = STATIC
        CanIfTxPduBufferRef = CHNL_a6b6a922
        CanIfTxPduRef = PhysDiagRespMsg_F2_A1_BB2_Tp_oBackbone2_98bfba00_Tx
      DiagReqMsgIntTGW2_98_F4_BB2_Tp_oBackbone2_54fed8f2_Rx (CanIfRxPduCfg):
        CanIfRxPduCanId = 524327156
        CanIfRxPduCanIdType = EXTENDED_CAN
        CanIfRxPduDlc = 8
        CanIfRxPduUserRxIndicationName = CanTp_RxIndication
        CanIfRxPduUserRxIndicationType = PDUID_PDUINFOPTR
        CanIfRxPduUserRxIndicationUL = CAN_TP
        CanIfRxPduId = 143
        CanIfRxPduReadData = false
        CanIfRxPduReadNotifyStatus = false
        CanIfRxPduDlcCheck = true
        CanIfRxPduHrhIdRef = CN_Backbone2_7b3866ec_Rx
        CanIfRxPduRef = DiagReqMsgIntTGW2_98_F4_BB2_Tp_oBackbone2_8db99724_Rx
      CIOM_Sec_02P_oSecuritySubnet_04f0ad2a_Tx (CanIfTxPduCfg):
        CanIfTxPduCanId = 419408448
        CanIfTxPduCanIdType = EXTENDED_CAN
        CanIfTxPduDlc = 8
        CanIfTxPduUserTxConfirmationName = NULL_PTR
        CanIfTxPduUserTxConfirmationUL = NONE
        CanIfTxPduId = 69
        CanIfTxPduReadNotifyStatus = false
        CanIfTxPduType = STATIC
        CanIfTxPduBufferRef = CanIfBufferCfg_CIOM_Sec_02P_oSecuritySubnet_04f0ad2a_Tx
        CanIfTxPduRef = CIOM_Sec_02P_oSecuritySubnet_4807c695_Tx
      Alarm_Sec_02P_oSecuritySubnet_a902993f_Rx (CanIfRxPduCfg):
        CanIfRxPduCanId = 285160896
        CanIfRxPduCanIdType = EXTENDED_CAN
        CanIfRxPduDlc = 8
        CanIfRxPduUserRxIndicationName = PduR_CanIfRxIndication
        CanIfRxPduUserRxIndicationUL = PDUR
        CanIfRxPduId = 123
        CanIfRxPduReadData = false
        CanIfRxPduReadNotifyStatus = false
        CanIfRxPduDlcCheck = true
        CanIfRxPduHrhIdRef = CN_SecuritySubnet_3840872e_Rx
        CanIfRxPduRef = Alarm_Sec_02P_oSecuritySubnet_0cca1998_Rx
      FMS1_X_CIOMFMS_oFMSNet_fb3c9fbd_Tx (CanIfTxPduCfg):
        CanIfTxPduCanId = 419265841
        CanIfTxPduCanIdType = EXTENDED_CAN
        CanIfTxPduDlc = 8
        CanIfTxPduUserTxConfirmationName = NULL_PTR
        CanIfTxPduUserTxConfirmationUL = NONE
        CanIfTxPduId = 109
        CanIfTxPduReadNotifyStatus = false
        CanIfTxPduType = STATIC
        CanIfTxPduBufferRef = CanIfBufferCfg_FMS1_X_CIOMFMS_oFMSNet_fb3c9fbd_Tx
        CanIfTxPduRef = FMS1_X_CIOMFMS_oFMSNet_79c218f8_Tx
      DiagReqMsgIntTGW2_26_F4_BB2_Tp_oBackbone2_ce56ef15_Rx (CanIfRxPduCfg):
        CanIfRxPduCanId = 524297972
        CanIfRxPduCanIdType = EXTENDED_CAN
        CanIfRxPduDlc = 8
        CanIfRxPduUserRxIndicationName = CanTp_RxIndication
        CanIfRxPduUserRxIndicationType = PDUID_PDUINFOPTR
        CanIfRxPduUserRxIndicationUL = CAN_TP
        CanIfRxPduId = 152
        CanIfRxPduReadData = false
        CanIfRxPduReadNotifyStatus = false
        CanIfRxPduDlcCheck = true
        CanIfRxPduHrhIdRef = CN_Backbone2_7b3866ec_Rx
        CanIfRxPduRef = DiagReqMsgIntTGW2_26_F4_BB2_Tp_oBackbone2_8c83dde9_Rx
      DiagRespMsgIntHMIIOM_F3_C0_Sec_Tp_oSecuritySubnet_77f0a36b_Rx (CanIfRxPduCfg):
        CanIfRxPduCanId = 524350400
        CanIfRxPduCanIdType = EXTENDED_CAN
        CanIfRxPduDlc = 8
        CanIfRxPduUserRxIndicationName = CanTp_RxIndication
        CanIfRxPduUserRxIndicationType = PDUID_PDUINFOPTR
        CanIfRxPduUserRxIndicationUL = CAN_TP
        CanIfRxPduId = 92
        CanIfRxPduReadData = false
        CanIfRxPduReadNotifyStatus = false
        CanIfRxPduDlcCheck = true
        CanIfRxPduHrhIdRef = CN_SecuritySubnet_3840872e_Rx
        CanIfRxPduRef = DiagRespMsgIntHMIIOM_F3_C0_Sec_Tp_oSecuritySubnet_df07a3f2_Rx
      4 x CanIfTxPduCfg, all with CanIfTxPduCanIdType=EXTENDED_CAN, CanIfTxPduDlc=8, CanIfTxPduReadNotifyStatus=false, CanIfTxPduType=STATIC:
        PhysDiagReqMsg_A2_F2_Cab_Tp_oCabSubnet_6d74e481_Tx: CanIfTxPduCanId=524329714, CanIfTxPduUserTxConfirmationName=CanTp_TxConfirmation, CanIfTxPduUserTxConfirmationUL=CAN_TP, CanIfTxPduId=8, CanIfTxPduBufferRef=CanIfBufferCfg_PhysDiagReqMsg_A2_F2_Cab_Tp_oCabSubnet_6d74e481_Tx, CanIfTxPduRef=PhysDiagReqMsg_A2_F2_Cab_Tp_oCabSubnet_5f51d786_Tx
        DiagRespMsgIntHMIIOM_F3_A1_BB2_Tp_oBackbone2_08540fc1_Tx: CanIfTxPduCanId=524350369, CanIfTxPduUserTxConfirmationName=CanTp_TxConfirmation, CanIfTxPduUserTxConfirmationUL=CAN_TP, CanIfTxPduId=158, CanIfTxPduBufferRef=CHNL_a6b6a922, CanIfTxPduRef=DiagRespMsgIntHMIIOM_F3_A1_BB2_Tp_oBackbone2_c10483c5_Tx
        Alarm_Sec_07S_FCM_Tp_oSecuritySubnet_94ec21d2_Tx: CanIfTxPduCanId=352304960, CanIfTxPduUserTxConfirmationName=CanTp_TxConfirmation, CanIfTxPduUserTxConfirmationUL=CAN_TP, CanIfTxPduId=75, CanIfTxPduBufferRef=CanIfBufferCfg_Alarm_Sec_07S_FCM_Tp_oSecuritySubnet_94ec21d2_Tx, CanIfTxPduRef=Alarm_Sec_07S_FCM_Tp_oSecuritySubnet_9ce1f4de_Tx
        CIOM_Cab_19P_oCabSubnet_49985ce9_Tx: CanIfTxPduCanId=419325951, CanIfTxPduUserTxConfirmationName=NULL_PTR, CanIfTxPduUserTxConfirmationUL=NONE, CanIfTxPduId=22, CanIfTxPduBufferRef=CanIfBufferCfg_CIOM_Cab_19P_oCabSubnet_49985ce9_Tx, CanIfTxPduRef=CIOM_Cab_19P_oCabSubnet_3104979a_Tx
      7 x CanIfRxPduCfg, all with CanIfRxPduCanIdType=EXTENDED_CAN, CanIfRxPduDlc=8, CanIfRxPduReadData=false, CanIfRxPduReadNotifyStatus=false, CanIfRxPduDlcCheck=true:
        EMS_BB2_04P_oBackbone2_f5214579_Rx: CanIfRxPduCanId=1291, CanIfRxPduUserRxIndicationName=PduR_CanIfRxIndication, CanIfRxPduUserRxIndicationUL=PDUR, CanIfRxPduId=200, CanIfRxPduHrhIdRef=CN_Backbone2_7b3866ec_Rx, CanIfRxPduRef=EMS_BB2_04P_oBackbone2_c45ae367_Rx
        VMCU_BB2_53P_oBackbone2_28f22c1c_Rx: CanIfRxPduCanId=849, CanIfRxPduUserRxIndicationName=PduR_CanIfRxIndication, CanIfRxPduUserRxIndicationUL=PDUR, CanIfRxPduId=223, CanIfRxPduHrhIdRef=CN_Backbone2_7b3866ec_Rx, CanIfRxPduRef=VMCU_BB2_53P_oBackbone2_0a53a1d3_Rx
        DiagReqMsgIntHMIIOM_A0_F3_BB2_Tp_oBackbone2_3d55549e_Rx: CanIfRxPduCanId=524329203, CanIfRxPduUserRxIndicationName=CanTp_RxIndication, CanIfRxPduUserRxIndicationType=PDUID_PDUINFOPTR, CanIfRxPduUserRxIndicationUL=CAN_TP, CanIfRxPduId=141, CanIfRxPduHrhIdRef=CN_Backbone2_7b3866ec_Rx, CanIfRxPduRef=DiagReqMsgIntHMIIOM_A0_F3_BB2_Tp_oBackbone2_7c4be2a8_Rx
        HMIIOM_BB2_24P_oBackbone2_e4a369b5_Rx: CanIfRxPduCanId=837, CanIfRxPduUserRxIndicationName=PduR_CanIfRxIndication, CanIfRxPduUserRxIndicationUL=PDUR, CanIfRxPduId=226, CanIfRxPduHrhIdRef=CN_Backbone2_7b3866ec_Rx, CanIfRxPduRef=HMIIOM_BB2_24P_oBackbone2_e73447cb_Rx
        CIOM_Sec_08S_FCM_Tp_oSecuritySubnet_255d4bf3_Rx: CanIfRxPduCanId=352259137, CanIfRxPduUserRxIndicationName=CanTp_RxIndication, CanIfRxPduUserRxIndicationUL=CAN_TP, CanIfRxPduId=120, CanIfRxPduHrhIdRef=CN_SecuritySubnet_3840872e_Rx, CanIfRxPduRef=CIOM_Sec_08S_FCM_Tp_oSecuritySubnet_a0207401_Rx
        DDM_Sec_05S_Tp_oSecuritySubnet_5a1ed97b_Rx: CanIfRxPduCanId=352305056, CanIfRxPduUserRxIndicationName=CanTp_RxIndication, CanIfRxPduUserRxIndicationType=PDUID_PDUINFOPTR, CanIfRxPduUserRxIndicationUL=CAN_TP, CanIfRxPduId=108, CanIfRxPduHrhIdRef=CN_SecuritySubnet_3840872e_Rx, CanIfRxPduRef=DDM_Sec_05S_Tp_oSecuritySubnet_0816bb62_Rx
        DiagReqMsgIntHMIIOM_C0_F3_BB2_Tp_oBackbone2_2bec4c32_Rx: CanIfRxPduCanId=524337395, CanIfRxPduUserRxIndicationName=CanTp_RxIndication, CanIfRxPduUserRxIndicationType=PDUID_PDUINFOPTR, CanIfRxPduUserRxIndicationUL=CAN_TP, CanIfRxPduId=132, CanIfRxPduHrhIdRef=CN_Backbone2_7b3866ec_Rx, CanIfRxPduRef=DiagReqMsgIntHMIIOM_C0_F3_BB2_Tp_oBackbone2_e549ed35_Rx
      BBM_BB2_03S_CIOM_FCM_Tp_oBackbone2_29c4ac8e_Tx (CanIfTxPduCfg):
        CanIfTxPduCanId = 401893863
        CanIfTxPduCanIdType = EXTENDED_CAN
        CanIfTxPduDlc = 8
        CanIfTxPduUserTxConfirmationUL = CAN_TP
        CanIfTxPduId = 180
        CanIfTxPduReadNotifyStatus = false
        CanIfTxPduType = STATIC
        CanIfTxPduUserTxConfirmationName = CanTp_TxConfirmation
        CanIfTxPduBufferRef = CHNL_a6b6a922
        CanIfTxPduRef = BBM_BB2_03S_CIOM_FCM_Tp_oBackbone2_f963b5b4_Tx
      CIOM_263e35c1_Rx (CanIfRxPduCfg):
        CanIfRxPduCanIdType = EXTENDED_CAN
        CanIfRxPduDlc = 1
        CanIfRxPduUserRxIndicationName = CanNm_RxIndication
        CanIfRxPduUserRxIndicationUL = CAN_NM
        CanIfRxPduId = 128
        CanIfRxPduReadData = false
        CanIfRxPduReadNotifyStatus = false
        CanIfRxPduDlcCheck = true
        CanIfRxPduHrhIdRef = CN_Backbone2_7b3866ec_Rx
        CanIfRxPduRef = CIOM_9582cf37_Rx
        CHNL_e3df285f (CanIfRxPduCanIdRange): CanIfRxPduCanIdRangeLowerCanId=486506496, CanIfRxPduCanIdRangeUpperCanId=486506751
      4 x CanIfTxPduCfg, all with CanIfTxPduCanIdType=EXTENDED_CAN, CanIfTxPduDlc=8, CanIfTxPduReadNotifyStatus=false, CanIfTxPduType=STATIC:
        CIOM_BB2_21S_oBackbone2_140cc697_Tx: CanIfTxPduCanId=369029363, CanIfTxPduUserTxConfirmationName=PduR_CanIfTxConfirmation, CanIfTxPduUserTxConfirmationUL=PDUR, CanIfTxPduId=181, CanIfTxPduBufferRef=CHNL_a6b6a922, CanIfTxPduRef=CIOM_BB2_21S_oBackbone2_6c3ae72c_Tx
        DiagReqMsgIntHMIIOM_98_F3_Cab_Tp_oCabSubnet_2daafb4e_Tx: CanIfTxPduCanId=524327155, CanIfTxPduUserTxConfirmationName=CanTp_TxConfirmation, CanIfTxPduUserTxConfirmationUL=CAN_TP, CanIfTxPduId=10, CanIfTxPduBufferRef=CanIfBufferCfg_DiagReqMsgIntHMIIOM_98_F3_Cab_Tp_oCabSubnet_2daafb4e_Tx, CanIfTxPduRef=DiagReqMsgIntHMIIOM_98_F3_Cab_Tp_oCabSubnet_b3867896_Tx
        PDM_Sec_04S_FCM_Tp_oSecuritySubnet_90a313cf_Tx: CanIfTxPduCanId=352318114, CanIfTxPduUserTxConfirmationName=CanTp_TxConfirmation, CanIfTxPduUserTxConfirmationUL=CAN_TP, CanIfTxPduId=71, CanIfTxPduBufferRef=CanIfBufferCfg_PDM_Sec_04S_FCM_Tp_oSecuritySubnet_90a313cf_Tx, CanIfTxPduRef=PDM_Sec_04S_FCM_Tp_oSecuritySubnet_ab25905a_Tx
        CCM_Cab_03P_FCM_Tp_oCabSubnet_af75b436_Tx: CanIfTxPduCanId=285150105, CanIfTxPduUserTxConfirmationName=CanTp_TxConfirmation, CanIfTxPduUserTxConfirmationUL=CAN_TP, CanIfTxPduId=54, CanIfTxPduBufferRef=CanIfBufferCfg_CCM_Cab_03P_FCM_Tp_oCabSubnet_af75b436_Tx, CanIfTxPduRef=CCM_Cab_03P_FCM_Tp_oCabSubnet_c07ad38a_Tx
      6 x CanIfRxPduCfg, all with CanIfRxPduCanIdType=EXTENDED_CAN, CanIfRxPduReadData=false, CanIfRxPduReadNotifyStatus=false, CanIfRxPduDlcCheck=true:
        AnmMsg_PDM_SecuritySubnet_oSecuritySubnet_d922132b_Rx: CanIfRxPduCanId=486510633, CanIfRxPduDlc=4, CanIfRxPduUserRxIndicationName=PduR_CanIfRxIndication, CanIfRxPduUserRxIndicationUL=PDUR, CanIfRxPduId=99, CanIfRxPduHrhIdRef=CN_SecuritySubnet_3840872e_Rx, CanIfRxPduRef=AnmMsg_PDM_SecuritySubnet_oSecuritySubnet_412a9e12_Rx
        TesterFuncDiagMsg_BB2_Tp_oBackbone2_6ec04186_Rx: CanIfRxPduCanId=524419058, CanIfRxPduDlc=8, CanIfRxPduUserRxIndicationName=CanTp_RxIndication, CanIfRxPduUserRxIndicationType=PDUID_PDUINFOPTR, CanIfRxPduUserRxIndicationUL=CAN_TP, CanIfRxPduId=130, CanIfRxPduHrhIdRef=CN_Backbone2_7b3866ec_Rx, CanIfRxPduRef=TesterFuncDiagMsg_BB2_Tp_oBackbone2_b8b64bca_Rx
        CIOM_Sec_12S_FCM_Tp_oSecuritySubnet_9cba7397_Rx: CanIfRxPduCanId=352285249, CanIfRxPduDlc=8, CanIfRxPduUserRxIndicationName=CanTp_RxIndication, CanIfRxPduUserRxIndicationUL=CAN_TP, CanIfRxPduId=113, CanIfRxPduHrhIdRef=CN_SecuritySubnet_3840872e_Rx, CanIfRxPduRef=CIOM_Sec_12S_FCM_Tp_oSecuritySubnet_40375889_Rx
        EMS_BB2_09S_Tp_oBackbone2_ef0c9958_Rx: CanIfRxPduCanId=1341, CanIfRxPduDlc=8, CanIfRxPduUserRxIndicationName=CanTp_RxIndication, CanIfRxPduUserRxIndicationType=PDUID_PDUINFOPTR, CanIfRxPduUserRxIndicationUL=CAN_TP, CanIfRxPduId=186, CanIfRxPduHrhIdRef=CN_Backbone2_7b3866ec_Rx, CanIfRxPduRef=EMS_BB2_09S_Tp_oBackbone2_5929f3fc_Rx
        CCM_Cab_01P_oCabSubnet_27c0fc91_Rx: CanIfRxPduCanId=285153688, CanIfRxPduDlc=8, CanIfRxPduUserRxIndicationName=PduR_CanIfRxIndication, CanIfRxPduUserRxIndicationUL=PDUR, CanIfRxPduId=82, CanIfRxPduHrhIdRef=CN_CabSubnet_eedbadff_Rx, CanIfRxPduRef=CCM_Cab_01P_oCabSubnet_d6dd7ea3_Rx
        BBM_BB2_01P_oBackbone2_0057383e_Rx: CanIfRxPduCanId=318734310, CanIfRxPduDlc=8, CanIfRxPduUserRxIndicationName=PduR_CanIfRxIndication, CanIfRxPduUserRxIndicationUL=PDUR, CanIfRxPduId=169, CanIfRxPduHrhIdRef=CN_Backbone2_7b3866ec_Rx, CanIfRxPduRef=BBM_BB2_01P_oBackbone2_679bb0c1_Rx
      3 x CanIfTxPduCfg, all with CanIfTxPduCanIdType=EXTENDED_CAN, CanIfTxPduDlc=8, CanIfTxPduReadNotifyStatus=false, CanIfTxPduType=STATIC:
        CIOM_Cab_23P_oCabSubnet_0e491ee8_Tx: CanIfTxPduCanId=352195648, CanIfTxPduUserTxConfirmationName=NULL_PTR, CanIfTxPduUserTxConfirmationUL=NONE, CanIfTxPduId=42, CanIfTxPduBufferRef=CanIfBufferCfg_CIOM_Cab_23P_oCabSubnet_0e491ee8_Tx, CanIfTxPduRef=CIOM_Cab_23P_oCabSubnet_b1c21fce_Tx
        DiagReqMsgIntTGW2_A2_F4_Cab_Tp_oCabSubnet_fc611706_Tx: CanIfTxPduCanId=524329716, CanIfTxPduUserTxConfirmationName=CanTp_TxConfirmation, CanIfTxPduUserTxConfirmationUL=CAN_TP, CanIfTxPduId=6, CanIfTxPduBufferRef=CanIfBufferCfg_DiagReqMsgIntTGW2_A2_F4_Cab_Tp_oCabSubnet_fc611706_Tx, CanIfTxPduRef=DiagReqMsgIntTGW2_A2_F4_Cab_Tp_oCabSubnet_492a2a19_Tx
        HMIIOM_BB2_20S_FCM_Tp_oBackbone2_2def59ba_Tx: CanIfTxPduCanId=1344, CanIfTxPduUserTxConfirmationName=CanTp_TxConfirmation, CanIfTxPduUserTxConfirmationUL=CAN_TP, CanIfTxPduId=214, CanIfTxPduBufferRef=CHNL_a6b6a922, CanIfTxPduRef=HMIIOM_BB2_20S_FCM_Tp_oBackbone2_85f0ef5e_Tx
      WRCS_Cab_03P_oCabSubnet_37a4b7c4_Rx (CanIfRxPduCfg):
        CanIfRxPduCanId = 352288550
        CanIfRxPduCanIdType = EXTENDED_CAN
        CanIfRxPduDlc = 8
        CanIfRxPduUserRxIndicationName = PduR_CanIfRxIndication
        CanIfRxPduUserRxIndicationUL = PDUR
        CanIfRxPduId = 70
        CanIfRxPduReadData = false
        CanIfRxPduReadNotifyStatus = false
        CanIfRxPduDlcCheck = true
        CanIfRxPduHrhIdRef = CN_CabSubnet_eedbadff_Rx
        CanIfRxPduRef = WRCS_Cab_03P_oCabSubnet_4e7c5881_Rx
      CIOM_Cab_09P_oCabSubnet_49ff9f68_Tx (CanIfTxPduCfg):
        CanIfTxPduCanId = 285203520
        CanIfTxPduCanIdType = EXTENDED_CAN
        CanIfTxPduDlc = 8
        CanIfTxPduUserTxConfirmationName = NULL_PTR
        CanIfTxPduUserTxConfirmationUL = NONE
        CanIfTxPduId = 44
        CanIfTxPduReadNotifyStatus = false
        CanIfTxPduType = STATIC
        CanIfTxPduBufferRef = CanIfBufferCfg_CIOM_Cab_09P_oCabSubnet_49ff9f68_Tx
        CanIfTxPduRef = CIOM_Cab_09P_oCabSubnet_07f60769_Tx
      AnmMsg_Alarm_SecuritySubnet_oSecuritySubnet_38c19358_Rx (CanIfRxPduCfg):
        CanIfRxPduCanId = 486510628
        CanIfRxPduCanIdType = EXTENDED_CAN
        CanIfRxPduDlc = 4
        CanIfRxPduUserRxIndicationName = PduR_CanIfRxIndication
        CanIfRxPduUserRxIndicationUL = PDUR
        CanIfRxPduId = 101
        CanIfRxPduReadData = false
        CanIfRxPduReadNotifyStatus = false
        CanIfRxPduDlcCheck = true
        CanIfRxPduHrhIdRef = CN_SecuritySubnet_3840872e_Rx
        CanIfRxPduRef = AnmMsg_Alarm_SecuritySubnet_oSecuritySubnet_9d33373d_Rx
      VMCU_BB2_74P_oBackbone2_c4062a5f_Rx (CanIfRxPduCfg):
        CanIfRxPduCanId = 1035
        CanIfRxPduCanIdType = EXTENDED_CAN
        CanIfRxPduDlc = 8
        CanIfRxPduUserRxIndicationName = PduR_CanIfRxIndication
        CanIfRxPduUserRxIndicationUL = PDUR
        CanIfRxPduId = 211
        CanIfRxPduReadData = false
        CanIfRxPduReadNotifyStatus = false
        CanIfRxPduDlcCheck = true
        CanIfRxPduHrhIdRef = CN_Backbone2_7b3866ec_Rx
        CanIfRxPduRef = VMCU_BB2_74P_oBackbone2_df2392a0_Rx
      3 x CanIfTxPduCfg, all with CanIfTxPduCanIdType=EXTENDED_CAN, CanIfTxPduDlc=8, CanIfTxPduUserTxConfirmationName=NULL_PTR, CanIfTxPduUserTxConfirmationUL=NONE, CanIfTxPduReadNotifyStatus=false, CanIfTxPduType=STATIC:
        CIOM_Sec_04P_oSecuritySubnet_6a707225_Tx: CanIfTxPduCanId=285178688, CanIfTxPduId=87, CanIfTxPduBufferRef=CanIfBufferCfg_CIOM_Sec_04P_oSecuritySubnet_6a707225_Tx, CanIfTxPduRef=CIOM_Sec_04P_oSecuritySubnet_3870d073_Tx
        CIOM_Cab_21P_oCabSubnet_c1ce1ce8_Tx: CanIfTxPduCanId=419395583, CanIfTxPduId=20, CanIfTxPduBufferRef=CanIfBufferCfg_CIOM_Cab_21P_oCabSubnet_c1ce1ce8_Tx, CanIfTxPduRef=CIOM_Cab_21P_oCabSubnet_890712db_Tx
        ET1_X_CIOMFMS_oFMSNet_ff39068f_Tx: CanIfTxPduCanId=419360305, CanIfTxPduId=97, CanIfTxPduBufferRef=CanIfBufferCfg_ET1_X_CIOMFMS_oFMSNet_ff39068f_Tx, CanIfTxPduRef=ET1_X_CIOMFMS_oFMSNet_a8a2ee82_Tx
      DiagRespMsgIntTGW2_F4_A2_Cab_Tp_oCabSubnet_748ab027_Rx (CanIfRxPduCfg):
        CanIfRxPduCanId = 524350626
        CanIfRxPduCanIdType = EXTENDED_CAN
        CanIfRxPduDlc = 8
        CanIfRxPduUserRxIndicationName = CanTp_RxIndication
        CanIfRxPduUserRxIndicationType = PDUID_PDUINFOPTR
        CanIfRxPduUserRxIndicationUL = CAN_TP
        CanIfRxPduId = 36
        CanIfRxPduReadData = false
        CanIfRxPduReadNotifyStatus = false
        CanIfRxPduDlcCheck = true
        CanIfRxPduHrhIdRef = CN_CabSubnet_eedbadff_Rx
        CanIfRxPduRef = DiagRespMsgIntTGW2_F4_A2_Cab_Tp_oCabSubnet_31ed728f_Rx
      DiagFaultStat_LECM_Cab_oCabSubnet_6e0076c7_Rx (CanIfRxPduCfg):
        CanIfRxPduCanId = 419573789
        CanIfRxPduCanIdType = EXTENDED_CAN
        CanIfRxPduDlc = 8
        CanIfRxPduUserRxIndicationName = PduR_CanIfRxIndication
        CanIfRxPduUserRxIndicationUL = PDUR
        CanIfRxPduId = 55
        CanIfRxPduReadData = false
        CanIfRxPduReadNotifyStatus = false
        CanIfRxPduDlcCheck = true
        CanIfRxPduHrhIdRef = CN_CabSubnet_eedbadff_Rx
        CanIfRxPduRef = DiagFaultStat_LECM_Cab_oCabSubnet_3cdbae0b_Rx
      DiagFaultStat_LECM_BB2_oBackbone2_0cb60c21_Tx (CanIfTxPduCfg):
        CanIfTxPduCanId = 1513
        CanIfTxPduCanIdType = EXTENDED_CAN
        CanIfTxPduDlc = 8
        CanIfTxPduUserTxConfirmationName = PduR_CanIfTxConfirmation
        CanIfTxPduUserTxConfirmationUL = PDUR
        CanIfTxPduId = 203
        CanIfTxPduReadNotifyStatus = false
        CanIfTxPduType = STATIC
        CanIfTxPduBufferRef = CHNL_a6b6a922
        CanIfTxPduRef = DiagFaultStat_LECM_BB2_oBackbone2_b8766ffd_Tx
      CCM_Cab_03P_Tp_oCabSubnet_bfb45635_Rx (CanIfRxPduCfg):
        CanIfRxPduCanId = 285150104
        CanIfRxPduCanIdType = EXTENDED_CAN
        CanIfRxPduDlc = 8
        CanIfRxPduUserRxIndicationName = CanTp_RxIndication
        CanIfRxPduUserRxIndicationType = PDUID_PDUINFOPTR
        CanIfRxPduUserRxIndicationUL = CAN_TP
        CanIfRxPduId = 83
        CanIfRxPduReadData = false
        CanIfRxPduReadNotifyStatus = false
        CanIfRxPduDlcCheck = true
        CanIfRxPduHrhIdRef = CN_CabSubnet_eedbadff_Rx
        CanIfRxPduRef = CCM_Cab_03P_Tp_oCabSubnet_85540a71_Rx
      DiagUUDTRespMsg1_F2_53_BB2_oBackbone2_a51c09cf_Tx (CanIfTxPduCfg):
        CanIfTxPduCanId = 524481107
        CanIfTxPduCanIdType = EXTENDED_CAN
        CanIfTxPduDlc = 8
        CanIfTxPduUserTxConfirmationName = NULL_PTR
        CanIfTxPduUserTxConfirmationUL = NONE
        CanIfTxPduId = 145
        CanIfTxPduReadNotifyStatus = false
        CanIfTxPduType = STATIC
        CanIfTxPduBufferRef = CHNL_a6b6a922
        CanIfTxPduRef = DiagUUDTRespMsg1_F2_53_BB2_oBackbone2_f6955d52_Tx
      PhysDiagReqMsg_98_F2_BB2_Tp_oBackbone2_c6fd39ec_Rx (CanIfRxPduCfg):
        CanIfRxPduCanId = 524327154
        CanIfRxPduCanIdType = EXTENDED_CAN
        CanIfRxPduDlc = 8
        CanIfRxPduUserRxIndicationName = CanTp_RxIndication
        CanIfRxPduUserRxIndicationType = PDUID_PDUINFOPTR
        CanIfRxPduUserRxIndicationUL = CAN_TP
        CanIfRxPduId = 145
        CanIfRxPduReadData = false
        CanIfRxPduReadNotifyStatus = false
        CanIfRxPduDlcCheck = true
        CanIfRxPduHrhIdRef = CN_Backbone2_7b3866ec_Rx
        CanIfRxPduRef = PhysDiagReqMsg_98_F2_BB2_Tp_oBackbone2_9bc26abb_Rx
      DiagFaultStat_CCM_BB2_oBackbone2_2f6e7814_Tx (CanIfTxPduCfg):
        CanIfTxPduCanId = 1507
        CanIfTxPduCanIdType = EXTENDED_CAN
        CanIfTxPduDlc = 8
        CanIfTxPduUserTxConfirmationName = PduR_CanIfTxConfirmation
        CanIfTxPduUserTxConfirmationUL = PDUR
        CanIfTxPduId = 206
        CanIfTxPduReadNotifyStatus = false
        CanIfTxPduType = STATIC
        CanIfTxPduBufferRef = CHNL_a6b6a922
        CanIfTxPduRef = DiagFaultStat_CCM_BB2_oBackbone2_9a44ed2c_Tx
      PDM_Sec_04S_Tp_oSecuritySubnet_596ba3c3_Rx (CanIfRxPduCfg):
        CanIfRxPduCanId = 352318113
        CanIfRxPduCanIdType = EXTENDED_CAN
        CanIfRxPduDlc = 8
        CanIfRxPduUserRxIndicationName = CanTp_RxIndication
        CanIfRxPduUserRxIndicationType = PDUID_PDUINFOPTR
        CanIfRxPduUserRxIndicationUL = CAN_TP
        CanIfRxPduId = 105
        CanIfRxPduReadData = false
        CanIfRxPduReadNotifyStatus = false
        CanIfRxPduDlcCheck = true
        CanIfRxPduHrhIdRef = CN_SecuritySubnet_3840872e_Rx
        CanIfRxPduRef = PDM_Sec_04S_Tp_oSecuritySubnet_b74cae96_Rx
      DiagReqMsgIntTGW2_A2_F4_BB2_Tp_oBackbone2_8613fab7_Rx (CanIfRxPduCfg):
        CanIfRxPduCanId = 524329716
        CanIfRxPduCanIdType = EXTENDED_CAN
        CanIfRxPduDlc = 8
        CanIfRxPduUserRxIndicationName = CanTp_RxIndication
        CanIfRxPduUserRxIndicationType = PDUID_PDUINFOPTR
        CanIfRxPduUserRxIndicationUL = CAN_TP
        CanIfRxPduId = 134
        CanIfRxPduReadData = false
        CanIfRxPduReadNotifyStatus = false
        CanIfRxPduDlcCheck = true
        CanIfRxPduHrhIdRef = CN_Backbone2_7b3866ec_Rx
        CanIfRxPduRef = DiagReqMsgIntTGW2_A2_F4_BB2_Tp_oBackbone2_db870696_Rx
      DiagReqMsgIntHMIIOM_53_F3_Cab_Tp_oCabSubnet_e9059d48_Tx (CanIfTxPduCfg):
        CanIfTxPduCanId = 524309491
        CanIfTxPduCanIdType = EXTENDED_CAN
        CanIfTxPduDlc = 8
        CanIfTxPduUserTxConfirmationName = CanTp_TxConfirmation
        CanIfTxPduUserTxConfirmationUL = CAN_TP
        CanIfTxPduId = 13
        CanIfTxPduReadNotifyStatus = false
        CanIfTxPduType = STATIC
        CanIfTxPduBufferRef = CanIfBufferCfg_DiagReqMsgIntHMIIOM_53_F3_Cab_Tp_oCabSubnet_e9059d48_Tx
        CanIfTxPduRef = DiagReqMsgIntHMIIOM_53_F3_Cab_Tp_oCabSubnet_9d597ef4_Tx
      Alarm_Sec_06S_Tp_oSecuritySubnet_2b24d209_Rx (CanIfRxPduCfg):
        CanIfRxPduCanId = 352294079
        CanIfRxPduCanIdType = EXTENDED_CAN
        CanIfRxPduDlc = 8
        CanIfRxPduUserRxIndicationName = CanTp_RxIndication
        CanIfRxPduUserRxIndicationType = PDUID_PDUINFOPTR
        CanIfRxPduUserRxIndicationUL = CAN_TP
        CanIfRxPduId = 111
        CanIfRxPduReadData = false
        CanIfRxPduReadNotifyStatus = false
        CanIfRxPduDlcCheck = true
        CanIfRxPduHrhIdRef = CN_SecuritySubnet_3840872e_Rx
        CanIfRxPduRef = Alarm_Sec_06S_Tp_oSecuritySubnet_eca1ae05_Rx
      4 x CanIfTxPduCfg, all with CanIfTxPduCanIdType=EXTENDED_CAN, CanIfTxPduReadNotifyStatus=false, CanIfTxPduType=STATIC:
        CIOM_Cab_25S_Tp_oCabSubnet_d5957759_Tx: CanIfTxPduCanId=418873152, CanIfTxPduDlc=8, CanIfTxPduUserTxConfirmationName=CanTp_TxConfirmation, CanIfTxPduUserTxConfirmationUL=CAN_TP, CanIfTxPduId=28, CanIfTxPduBufferRef=CanIfBufferCfg_CIOM_Cab_25S_Tp_oCabSubnet_d5957759_Tx, CanIfTxPduRef=CIOM_Cab_25S_Tp_oCabSubnet_d1a9a58e_Tx
        DDM_Sec_05S_FCM_Tp_oSecuritySubnet_d14dc345_Tx: CanIfTxPduCanId=352305057, CanIfTxPduDlc=8, CanIfTxPduUserTxConfirmationName=CanTp_TxConfirmation, CanIfTxPduUserTxConfirmationUL=CAN_TP, CanIfTxPduId=74, CanIfTxPduBufferRef=CanIfBufferCfg_DDM_Sec_05S_FCM_Tp_oSecuritySubnet_d14dc345_Tx, CanIfTxPduRef=DDM_Sec_05S_FCM_Tp_oSecuritySubnet_a3466bf2_Tx
        CIOM_Cab_16P_oCabSubnet_2d5dd92a_Tx: CanIfTxPduCanId=418908159, CanIfTxPduDlc=8, CanIfTxPduUserTxConfirmationName=NULL_PTR, CanIfTxPduUserTxConfirmationUL=NONE, CanIfTxPduId=25, CanIfTxPduBufferRef=CanIfBufferCfg_CIOM_Cab_16P_oCabSubnet_2d5dd92a_Tx, CanIfTxPduRef=CIOM_Cab_16P_oCabSubnet_6a85b15b_Tx
        NmAsr_CIOM_Sec_oSecuritySubnet_dae88b7d_Tx: CanIfTxPduCanId=486506560, CanIfTxPduDlc=1, CanIfTxPduUserTxConfirmationName=CanNm_TxConfirmation, CanIfTxPduUserTxConfirmationUL=CAN_NM, CanIfTxPduId=68, CanIfTxPduBufferRef=CanIfBufferCfg_NmAsr_CIOM_Sec_oSecuritySubnet_dae88b7d_Tx, CanIfTxPduRef=NmAsr_CIOM_Sec_oSecuritySubnet_2d797674_Tx
      CIOM_Cab_34P_FCM_Tp_oCabSubnet_d2bbef9e_Rx (CanIfRxPduCfg):
        CanIfRxPduCanId = 418873665
        CanIfRxPduCanIdType = EXTENDED_CAN
        CanIfRxPduDlc = 8
        CanIfRxPduUserRxIndicationName = CanTp_RxIndication
        CanIfRxPduUserRxIndicationUL = CAN_TP
        CanIfRxPduId = 60
        CanIfRxPduReadData = false
        CanIfRxPduReadNotifyStatus = false
        CanIfRxPduDlcCheck = true
        CanIfRxPduHrhIdRef = CN_CabSubnet_eedbadff_Rx
        CanIfRxPduRef = CIOM_Cab_34P_FCM_Tp_oCabSubnet_ad6a5cb2_Rx
      3 x CanIfTxPduCfg, all with CanIfTxPduCanIdType=EXTENDED_CAN, CanIfTxPduDlc=8, CanIfTxPduReadNotifyStatus=false, CanIfTxPduType=STATIC:
        PhysDiagReqMsg_C0_F2_Sec_Tp_oSecuritySubnet_f27248ff_Tx: CanIfTxPduCanId=524337394, CanIfTxPduUserTxConfirmationName=CanTp_TxConfirmation, CanIfTxPduUserTxConfirmationUL=CAN_TP, CanIfTxPduId=60, CanIfTxPduBufferRef=CanIfBufferCfg_PhysDiagReqMsg_C0_F2_Sec_Tp_oSecuritySubnet_f27248ff_Tx, CanIfTxPduRef=PhysDiagReqMsg_C0_F2_Sec_Tp_oSecuritySubnet_7934e45d_Tx
        CIOM_Cab_08P_oCabSubnet_2e3c1e68_Tx: CanIfTxPduCanId=402638144, CanIfTxPduUserTxConfirmationName=NULL_PTR, CanIfTxPduUserTxConfirmationUL=NONE, CanIfTxPduId=35, CanIfTxPduBufferRef=CanIfBufferCfg_CIOM_Cab_08P_oCabSubnet_2e3c1e68_Tx, CanIfTxPduRef=CIOM_Cab_08P_oCabSubnet_f62c02c3_Tx
        CIOM_Sec_07S_Tp_oSecuritySubnet_69506b1a_Tx: CanIfTxPduCanId=352280479, CanIfTxPduUserTxConfirmationName=CanTp_TxConfirmation, CanIfTxPduUserTxConfirmationUL=CAN_TP, CanIfTxPduId=80, CanIfTxPduBufferRef=CanIfBufferCfg_CIOM_Sec_07S_Tp_oSecuritySubnet_69506b1a_Tx, CanIfTxPduRef=CIOM_Sec_07S_Tp_oSecuritySubnet_a49a7283_Tx
      DiagUUDTRespMsg1_F2_A1_Sec_oSecuritySubnet_67c5eccf_Rx (CanIfRxPduCfg):
        CanIfRxPduCanId = 524481185
        CanIfRxPduCanIdType = EXTENDED_CAN
        CanIfRxPduDlc = 8
        CanIfRxPduUserRxIndicationUL = PDUR
        CanIfRxPduId = 87
        CanIfRxPduReadData = false
        CanIfRxPduReadNotifyStatus = false
        CanIfRxPduUserRxIndicationName = PduR_CanIfRxIndication
        CanIfRxPduDlcCheck = true
        CanIfRxPduHrhIdRef = CN_SecuritySubnet_3840872e_Rx
        CanIfRxPduRef = DiagUUDTRespMsg1_F2_A1_Sec_oSecuritySubnet_98bdc248_Rx
      AnmMsg_WRCS_CabSubnet_oCabSubnet_62e3be6f_Rx (CanIfRxPduCfg):
        CanIfRxPduCanId = 486510635
        CanIfRxPduCanIdType = EXTENDED_CAN
        CanIfRxPduDlc = 4
        CanIfRxPduUserRxIndicationName = PduR_CanIfRxIndication
        CanIfRxPduUserRxIndicationUL = PDUR
        CanIfRxPduId = 49
        CanIfRxPduReadData = false
        CanIfRxPduReadNotifyStatus = false
        CanIfRxPduDlcCheck = true
        CanIfRxPduHrhIdRef = CN_CabSubnet_eedbadff_Rx
        CanIfRxPduRef = AnmMsg_WRCS_CabSubnet_oCabSubnet_dea22ca5_Rx
      4 x CanIfTxPduCfg, all with CanIfTxPduCanIdType=EXTENDED_CAN, CanIfTxPduDlc=8, CanIfTxPduReadNotifyStatus=false, CanIfTxPduType=STATIC:
        CIOM_Cab_05S_Tp_oCabSubnet_e74407ff_Tx: CanIfTxPduCanId=285179712, CanIfTxPduUserTxConfirmationName=CanTp_TxConfirmation, CanIfTxPduUserTxConfirmationUL=CAN_TP, CanIfTxPduId=48, CanIfTxPduBufferRef=CanIfBufferCfg_CIOM_Cab_05S_Tp_oCabSubnet_e74407ff_Tx, CanIfTxPduRef=CIOM_Cab_05S_Tp_oCabSubnet_20390ae5_Tx
        Alarm_Sec_06S_FCM_Tp_oSecuritySubnet_a3ee35ea_Tx: CanIfTxPduCanId=352294080, CanIfTxPduUserTxConfirmationName=CanTp_TxConfirmation, CanIfTxPduUserTxConfirmationUL=CAN_TP, CanIfTxPduId=77, CanIfTxPduBufferRef=CanIfBufferCfg_Alarm_Sec_06S_FCM_Tp_oSecuritySubnet_a3ee35ea_Tx, CanIfTxPduRef=Alarm_Sec_06S_FCM_Tp_oSecuritySubnet_13b9dbcd_Tx
        DiagRespMsgIntHMIIOM_F3_C0_BB2_Tp_oBackbone2_9924f26b_Tx: CanIfTxPduCanId=524350400, CanIfTxPduUserTxConfirmationName=CanTp_TxConfirmation, CanIfTxPduUserTxConfirmationUL=CAN_TP, CanIfTxPduId=156, CanIfTxPduBufferRef=CHNL_a6b6a922, CanIfTxPduRef=DiagRespMsgIntHMIIOM_F3_C0_BB2_Tp_oBackbone2_d19e6975_Tx
        TCO1_X_CIOMFMS_oFMSNet_567baf3d_Tx: CanIfTxPduCanId=218000433, CanIfTxPduUserTxConfirmationName=NULL_PTR, CanIfTxPduUserTxConfirmationUL=NONE, CanIfTxPduId=115, CanIfTxPduBufferRef=CanIfBufferCfg_TCO1_X_CIOMFMS_oFMSNet_567baf3d_Tx, CanIfTxPduRef=TCO1_X_CIOMFMS_oFMSNet_cdc54e4b_Tx
      3 x CanIfRxPduCfg, all with CanIfRxPduCanIdType=EXTENDED_CAN, CanIfRxPduDlc=8, CanIfRxPduReadData=false, CanIfRxPduReadNotifyStatus=false, CanIfRxPduDlcCheck=true, CanIfRxPduHrhIdRef=CN_Backbone2_7b3866ec_Rx:
        EMS_BB2_05P_oBackbone2_85f68835_Rx: CanIfRxPduCanId=1276, CanIfRxPduUserRxIndicationName=PduR_CanIfRxIndication, CanIfRxPduUserRxIndicationUL=PDUR, CanIfRxPduId=202, CanIfRxPduRef=EMS_BB2_05P_oBackbone2_3580e6cd_Rx
        PhysDiagReqMsg_53_F2_BB2_Tp_oBackbone2_1012d7c4_Rx: CanIfRxPduCanId=524309490, CanIfRxPduUserRxIndicationName=CanTp_RxIndication, CanIfRxPduUserRxIndicationType=PDUID_PDUINFOPTR, CanIfRxPduUserRxIndicationUL=CAN_TP, CanIfRxPduId=148, CanIfRxPduRef=PhysDiagReqMsg_53_F2_BB2_Tp_oBackbone2_b51d6cd9_Rx
        VMCU_BB2_52P_oBackbone2_4f31ad1c_Rx: CanIfRxPduCanId=735, CanIfRxPduUserRxIndicationName=PduR_CanIfRxIndication, CanIfRxPduUserRxIndicationUL=PDUR, CanIfRxPduId=231, CanIfRxPduRef=VMCU_BB2_52P_oBackbone2_fb89a479_Rx
      CIOM_BB2_20S_oBackbone2_73cf4797_Tx (CanIfTxPduCfg):
        CanIfTxPduCanId = 352317682
        CanIfTxPduCanIdType = EXTENDED_CAN
        CanIfTxPduDlc = 8
        CanIfTxPduUserTxConfirmationName = PduR_CanIfTxConfirmation
        CanIfTxPduUserTxConfirmationUL = PDUR
        CanIfTxPduId = 184
        CanIfTxPduReadNotifyStatus = false
        CanIfTxPduType = STATIC
        CanIfTxPduBufferRef = CHNL_a6b6a922
        CanIfTxPduRef = CIOM_BB2_20S_oBackbone2_9de0e286_Tx
      PTODE_X_CIOMFMS_oFMSNet_8abc23b8_Tx (CanIfTxPduCfg):
        CanIfTxPduCanId = 419275825
        CanIfTxPduCanIdType = EXTENDED_CAN
        CanIfTxPduDlc = 8
        CanIfTxPduUserTxConfirmationName = NULL_PTR
        CanIfTxPduUserTxConfirmationUL = NONE
        CanIfTxPduId = 108
        CanIfTxPduReadNotifyStatus = false
        CanIfTxPduType = STATIC
        CanIfTxPduBufferRef = CanIfBufferCfg_PTODE_X_CIOMFMS_oFMSNet_8abc23b8_Tx
        CanIfTxPduRef = PTODE_X_CIOMFMS_oFMSNet_abdf0c74_Tx
      CIOM_Cab_05P_FCM_Tp_oCabSubnet_fd75fa58_Rx (CanIfRxPduCfg):
        CanIfRxPduCanId = 285179713
        CanIfRxPduCanIdType = EXTENDED_CAN
        CanIfRxPduDlc = 8
        CanIfRxPduUserRxIndicationName = CanTp_RxIndication
        CanIfRxPduUserRxIndicationUL = CAN_TP
        CanIfRxPduId = 76
        CanIfRxPduReadData = false
        CanIfRxPduReadNotifyStatus = false
        CanIfRxPduDlcCheck = true
        CanIfRxPduHrhIdRef = CN_CabSubnet_eedbadff_Rx
        CanIfRxPduRef = CIOM_Cab_05P_FCM_Tp_oCabSubnet_c95fe793_Rx
      EMS_BB2_11S_FCM_Tp_oBackbone2_6cd5cf95_Tx (CanIfTxPduCfg):
        CanIfTxPduCanId = 961
        CanIfTxPduCanIdType = EXTENDED_CAN
        CanIfTxPduDlc = 8
        CanIfTxPduUserTxConfirmationName = CanTp_TxConfirmation
        CanIfTxPduUserTxConfirmationUL = CAN_TP
        CanIfTxPduId = 217
        CanIfTxPduReadNotifyStatus = false
        CanIfTxPduType = STATIC
        CanIfTxPduBufferRef = CHNL_a6b6a922
        CanIfTxPduRef = EMS_BB2_11S_FCM_Tp_oBackbone2_f23e55ae_Tx
      TECU_BB2_01P_oBackbone2_a19b59bc_Rx (CanIfRxPduCfg):
        CanIfRxPduCanId = 516
        CanIfRxPduCanIdType = EXTENDED_CAN
        CanIfRxPduDlc = 8
        CanIfRxPduUserRxIndicationName = PduR_CanIfRxIndication
        CanIfRxPduUserRxIndicationUL = PDUR
        CanIfRxPduId = 241
        CanIfRxPduReadData = false
        CanIfRxPduReadNotifyStatus = false
        CanIfRxPduDlcCheck = true
        CanIfRxPduHrhIdRef = CN_Backbone2_7b3866ec_Rx
        CanIfRxPduRef = TECU_BB2_01P_oBackbone2_6bd4ec68_Rx
      CIOM_Sec_11S_Tp_oSecuritySubnet_dc8daaf0_Tx (CanIfTxPduCfg):
        CanIfTxPduCanId = 352278848
        CanIfTxPduCanIdType = EXTENDED_CAN
        CanIfTxPduDlc = 8
        CanIfTxPduUserTxConfirmationName = CanTp_TxConfirmation
        CanIfTxPduUserTxConfirmationUL = CAN_TP
        CanIfTxPduId = 81
        CanIfTxPduReadNotifyStatus = false
        CanIfTxPduType = STATIC
        CanIfTxPduBufferRef = CanIfBufferCfg_CIOM_Sec_11S_Tp_oSecuritySubnet_dc8daaf0_Tx
        CanIfTxPduRef = CIOM_Sec_11S_Tp_oSecuritySubnet_a4c5143a_Tx
      CIOM_BB2_06P_oBackbone2_dba49579_Tx (CanIfTxPduCfg):
        CanIfTxPduCanId = 335511360
        CanIfTxPduCanIdType = EXTENDED_CAN
        CanIfTxPduDlc = 8
        CanIfTxPduUserTxConfirmationName = NULL_PTR
        CanIfTxPduUserTxConfirmationUL = NONE
        CanIfTxPduId = 191
        CanIfTxPduReadNotifyStatus = false
        CanIfTxPduType = STATIC
        CanIfTxPduBufferRef = CHNL_a6b6a922
        CanIfTxPduRef = CIOM_BB2_06P_oBackbone2_aa62ed2c_Tx
      CIOM_BB2_13S_FCM_Tp_oBackbone2_57d6a4a9_Rx (CanIfRxPduCfg):
        CanIfRxPduCanId = 352280385
        CanIfRxPduCanIdType = EXTENDED_CAN
        CanIfRxPduDlc = 8
        CanIfRxPduUserRxIndicationUL = CAN_TP
        CanIfRxPduId = 165
        CanIfRxPduReadData = false
        CanIfRxPduReadNotifyStatus = false
        CanIfRxPduUserRxIndicationName = CanTp_RxIndication
        CanIfRxPduDlcCheck = true
        CanIfRxPduHrhIdRef = CN_Backbone2_7b3866ec_Rx
        CanIfRxPduRef = CIOM_BB2_13S_FCM_Tp_oBackbone2_c490662a_Rx
      DiagFaultStat_DDM_Sec_oSecuritySubnet_3b5b41e4_Rx (CanIfRxPduCfg):
        CanIfRxPduCanId = 436174752
        CanIfRxPduCanIdType = EXTENDED_CAN
        CanIfRxPduDlc = 8
        CanIfRxPduUserRxIndicationName = PduR_CanIfRxIndication
        CanIfRxPduUserRxIndicationUL = PDUR
        CanIfRxPduId = 103
        CanIfRxPduReadData = false
        CanIfRxPduReadNotifyStatus = false
        CanIfRxPduDlcCheck = true
        CanIfRxPduHrhIdRef = CN_SecuritySubnet_3840872e_Rx
        CanIfRxPduRef = DiagFaultStat_DDM_Sec_oSecuritySubnet_279347f5_Rx
      3 x CanIfTxPduCfg, all with CanIfTxPduCanIdType=EXTENDED_CAN, CanIfTxPduReadNotifyStatus=false, CanIfTxPduType=STATIC:
        CIOM_Sec_12S_Tp_oSecuritySubnet_2d9a0e12_Tx: CanIfTxPduCanId=352285248, CanIfTxPduDlc=8, CanIfTxPduUserTxConfirmationName=CanTp_TxConfirmation, CanIfTxPduUserTxConfirmationUL=CAN_TP, CanIfTxPduId=79, CanIfTxPduBufferRef=CanIfBufferCfg_CIOM_Sec_12S_Tp_oSecuritySubnet_2d9a0e12_Tx, CanIfTxPduRef=CIOM_Sec_12S_Tp_oSecuritySubnet_9b0e6aaf_Tx
        AnmMsg_CIOM_SecuritySubnet_oSecuritySubnet_d0267e59_Tx: CanIfTxPduCanId=486510656, CanIfTxPduDlc=4, CanIfTxPduUserTxConfirmationName=NULL_PTR, CanIfTxPduUserTxConfirmationUL=NONE, CanIfTxPduId=67, CanIfTxPduBufferRef=CanIfBufferCfg_AnmMsg_CIOM_SecuritySubnet_oSecuritySubnet_d0267e59_Tx, CanIfTxPduRef=AnmMsg_CIOM_SecuritySubnet_oSecuritySubnet_e244ca05_Tx
        DiagRespMsgIntHMIIOM_F3_A0_BB2_Tp_oBackbone2_f4db796b_Tx: CanIfTxPduCanId=524350368, CanIfTxPduDlc=8, CanIfTxPduUserTxConfirmationName=CanTp_TxConfirmation, CanIfTxPduUserTxConfirmationUL=CAN_TP, CanIfTxPduId=159, CanIfTxPduBufferRef=CHNL_a6b6a922, CanIfTxPduRef=DiagRespMsgIntHMIIOM_F3_A0_BB2_Tp_oBackbone2_4c8c7e27_Tx
      PhysDiagReqMsg_26_F2_BB2_Tp_oBackbone2_680a80cc_Rx (CanIfRxPduCfg):
        CanIfRxPduCanId = 524297970
        CanIfRxPduCanIdType = EXTENDED_CAN
        CanIfRxPduDlc = 8
        CanIfRxPduUserRxIndicationName = CanTp_RxIndication
        CanIfRxPduUserRxIndicationType = PDUID_PDUINFOPTR
        CanIfRxPduUserRxIndicationUL = CAN_TP
        CanIfRxPduId = 154
        CanIfRxPduReadData = false
        CanIfRxPduReadNotifyStatus = false
        CanIfRxPduDlcCheck = true
        CanIfRxPduHrhIdRef = CN_Backbone2_7b3866ec_Rx
        CanIfRxPduRef = PhysDiagReqMsg_26_F2_BB2_Tp_oBackbone2_9af82076_Rx
      DiagUUDTRespMsg1_F2_53_Cab_oCabSubnet_d5110ca2_Rx (CanIfRxPduCfg):
        CanIfRxPduCanId = 524481107
        CanIfRxPduCanIdType = EXTENDED_CAN
        CanIfRxPduDlc = 8
        CanIfRxPduUserRxIndicationUL = PDUR
        CanIfRxPduId = 34
        CanIfRxPduReadData = false
        CanIfRxPduReadNotifyStatus = false
        CanIfRxPduUserRxIndicationName = PduR_CanIfRxIndication
        CanIfRxPduDlcCheck = true
        CanIfRxPduHrhIdRef = CN_CabSubnet_eedbadff_Rx
        CanIfRxPduRef = DiagUUDTRespMsg1_F2_53_Cab_oCabSubnet_72389ca4_Rx
      AMB_X_CIOMFMS_oFMSNet_f6109b97_Tx (CanIfTxPduCfg):
        CanIfTxPduCanId = 419362097
        CanIfTxPduCanIdType = EXTENDED_CAN
        CanIfTxPduDlc = 8
        CanIfTxPduUserTxConfirmationName = NULL_PTR
        CanIfTxPduUserTxConfirmationUL = NONE
        CanIfTxPduId = 94
        CanIfTxPduReadNotifyStatus = false
        CanIfTxPduType = STATIC
        CanIfTxPduBufferRef = CanIfBufferCfg_AMB_X_CIOMFMS_oFMSNet_f6109b97_Tx
        CanIfTxPduRef = AMB_X_CIOMFMS_oFMSNet_7d255a73_Tx
      PhysDiagRespMsg_F2_A0_Sec_Tp_oSecuritySubnet_207d0e64_Rx (CanIfRxPduCfg):
        CanIfRxPduCanId = 524350112
        CanIfRxPduCanIdType = EXTENDED_CAN
        CanIfRxPduDlc = 8
        CanIfRxPduUserRxIndicationName = CanTp_RxIndication
        CanIfRxPduUserRxIndicationType = PDUID_PDUINFOPTR
        CanIfRxPduUserRxIndicationUL = CAN_TP
        CanIfRxPduId = 97
        CanIfRxPduReadData = false
        CanIfRxPduReadNotifyStatus = false
        CanIfRxPduDlcCheck = true
        CanIfRxPduHrhIdRef = CN_SecuritySubnet_3840872e_Rx
        CanIfRxPduRef = PhysDiagRespMsg_F2_A0_Sec_Tp_oSecuritySubnet_3b132e6c_Rx
      3 x CanIfTxPduCfg, all with CanIfTxPduCanIdType=EXTENDED_CAN, CanIfTxPduDlc=8, CanIfTxPduUserTxConfirmationName=CanTp_TxConfirmation, CanIfTxPduUserTxConfirmationUL=CAN_TP, CanIfTxPduReadNotifyStatus=false, CanIfTxPduType=STATIC:
        PhysDiagReqMsg_98_F2_Cab_Tp_oCabSubnet_4c51814f_Tx: CanIfTxPduCanId=524327154, CanIfTxPduId=11, CanIfTxPduBufferRef=CanIfBufferCfg_PhysDiagReqMsg_98_F2_Cab_Tp_oCabSubnet_4c51814f_Tx, CanIfTxPduRef=PhysDiagReqMsg_98_F2_Cab_Tp_oCabSubnet_096f4634_Tx
        PhysDiagReqMsg_A0_F2_Sec_Tp_oSecuritySubnet_cb87d97b_Tx: CanIfTxPduCanId=524329202, CanIfTxPduId=66, CanIfTxPduBufferRef=CanIfBufferCfg_PhysDiagReqMsg_A0_F2_Sec_Tp_oSecuritySubnet_cb87d97b_Tx, CanIfTxPduRef=PhysDiagReqMsg_A0_F2_Sec_Tp_oSecuritySubnet_aaad1c47_Tx
        PhysDiagRespMsg_F1_53_BB2_Tp_oBackbone2_be0c70d1_Tx: CanIfTxPduCanId=417001811, CanIfTxPduId=179, CanIfTxPduBufferRef=CHNL_a6b6a922, CanIfTxPduRef=PhysDiagRespMsg_F1_53_BB2_Tp_oBackbone2_c0c295a0_Tx
      DiagReqMsgIntHMIIOM_53_F3_BB2_Tp_oBackbone2_fd3bad74_Rx (CanIfRxPduCfg):
        CanIfRxPduCanId = 524309491
        CanIfRxPduCanIdType = EXTENDED_CAN
        CanIfRxPduDlc = 8
        CanIfRxPduUserRxIndicationName = CanTp_RxIndication
        CanIfRxPduUserRxIndicationType = PDUID_PDUINFOPTR
        CanIfRxPduUserRxIndicationUL = CAN_TP
        CanIfRxPduId = 147
        CanIfRxPduReadData = false
        CanIfRxPduReadNotifyStatus = false
        CanIfRxPduDlcCheck = true
        CanIfRxPduHrhIdRef = CN_Backbone2_7b3866ec_Rx
        CanIfRxPduRef = DiagReqMsgIntHMIIOM_53_F3_BB2_Tp_oBackbone2_0ff4527b_Rx
      CIOM_Sec_03P_oSecuritySubnet_4d58f6b7_Tx (CanIfTxPduCfg):
        CanIfTxPduCanId = 419402816
        CanIfTxPduCanIdType = EXTENDED_CAN
        CanIfTxPduDlc = 8
        CanIfTxPduUserTxConfirmationName = NULL_PTR
        CanIfTxPduUserTxConfirmationUL = NONE
        CanIfTxPduId = 70
        CanIfTxPduReadNotifyStatus = false
        CanIfTxPduType = STATIC
        CanIfTxPduBufferRef = CanIfBufferCfg_CIOM_Sec_03P_oSecuritySubnet_4d58f6b7_Tx
        CanIfTxPduRef = CIOM_Sec_03P_oSecuritySubnet_e93e427b_Tx
      IntTesterTGW2FuncDiagMsg_Cab_Tp_oCabSubnet_96ec8334_Tx (CanIfTxPduCfg):
        CanIfTxPduCanId = 524419060
        CanIfTxPduCanIdType = EXTENDED_CAN
        CanIfTxPduDlc = 8
        CanIfTxPduUserTxConfirmationName = CanTp_TxConfirmation
        CanIfTxPduUserTxConfirmationUL = CAN_TP
        CanIfTxPduId = 4
        CanIfTxPduReadNotifyStatus = false
        CanIfTxPduType = STATIC
        CanIfTxPduBufferRef = CanIfBufferCfg_IntTesterTGW2FuncDiagMsg_Cab_Tp_oCabSubnet_96ec8334_Tx
        CanIfTxPduRef = IntTesterTGW2FuncDiagMsg_Cab_Tp_oCabSubnet_c56b5e45_Tx
      BBM_BB2_06P_oBackbone2_89015c9b_Rx (CanIfRxPduCfg):
        CanIfRxPduCanId = 334501350
        CanIfRxPduCanIdType = EXTENDED_CAN
        CanIfRxPduDlc = 8
        CanIfRxPduUserRxIndicationName = PduR_CanIfRxIndication
        CanIfRxPduUserRxIndicationUL = PDUR
        CanIfRxPduId = 167
        CanIfRxPduReadData = false
        CanIfRxPduReadNotifyStatus = false
        CanIfRxPduDlcCheck = true
        CanIfRxPduHrhIdRef = CN_Backbone2_7b3866ec_Rx
        CanIfRxPduRef = BBM_BB2_06P_oBackbone2_df0ea254_Rx
      LFC_X_CIOMFMS_oFMSNet_16e703d3_Tx (CanIfTxPduCfg):
        CanIfTxPduCanId = 419359025
        CanIfTxPduCanIdType = EXTENDED_CAN
        CanIfTxPduDlc = 8
        CanIfTxPduUserTxConfirmationName = NULL_PTR
        CanIfTxPduUserTxConfirmationUL = NONE
        CanIfTxPduId = 99
        CanIfTxPduReadNotifyStatus = false
        CanIfTxPduType = STATIC
        CanIfTxPduBufferRef = CanIfBufferCfg_LFC_X_CIOMFMS_oFMSNet_16e703d3_Tx
        CanIfTxPduRef = LFC_X_CIOMFMS_oFMSNet_94fe6bb5_Tx
      PhysDiagRespMsg_F2_A1_Sec_Tp_oSecuritySubnet_d47cc691_Rx (CanIfRxPduCfg):
        CanIfRxPduCanId = 524350113
        CanIfRxPduCanIdType = EXTENDED_CAN
        CanIfRxPduDlc = 8
        CanIfRxPduUserRxIndicationName = CanTp_RxIndication
        CanIfRxPduUserRxIndicationType = PDUID_PDUINFOPTR
        CanIfRxPduUserRxIndicationUL = CAN_TP
        CanIfRxPduId = 96
        CanIfRxPduReadData = false
        CanIfRxPduReadNotifyStatus = false
        CanIfRxPduDlcCheck = true
        CanIfRxPduHrhIdRef = CN_SecuritySubnet_3840872e_Rx
        CanIfRxPduRef = PhysDiagRespMsg_F2_A1_Sec_Tp_oSecuritySubnet_06a2c2b0_Rx
      4 x CanIfTxPduCfg, all with CanIfTxPduCanIdType=EXTENDED_CAN, CanIfTxPduDlc=8, CanIfTxPduReadNotifyStatus=false, CanIfTxPduType=STATIC:
        DiagRespMsgIntTGW2_F4_C0_BB2_Tp_oBackbone2_f7aad0d7_Tx: CanIfTxPduCanId=524350656, CanIfTxPduUserTxConfirmationName=CanTp_TxConfirmation, CanIfTxPduUserTxConfirmationUL=CAN_TP, CanIfTxPduId=148, CanIfTxPduBufferRef=CHNL_a6b6a922, CanIfTxPduRef=DiagRespMsgIntTGW2_F4_C0_BB2_Tp_oBackbone2_fe32b4d7_Tx
        HOURS_X_CIOMFMS_oFMSNet_bfc991fc_Tx: CanIfTxPduCanId=419358001, CanIfTxPduUserTxConfirmationName=NULL_PTR, CanIfTxPduUserTxConfirmationUL=NONE, CanIfTxPduId=100, CanIfTxPduBufferRef=CanIfBufferCfg_HOURS_X_CIOMFMS_oFMSNet_bfc991fc_Tx, CanIfTxPduRef=HOURS_X_CIOMFMS_oFMSNet_012e8f51_Tx
        DiagUUDTRespMsg1_F2_C0_BB2_oBackbone2_603e2338_Tx: CanIfTxPduCanId=524481216, CanIfTxPduUserTxConfirmationName=NULL_PTR, CanIfTxPduUserTxConfirmationUL=NONE, CanIfTxPduId=140, CanIfTxPduBufferRef=CHNL_a6b6a922, CanIfTxPduRef=DiagUUDTRespMsg1_F2_C0_BB2_oBackbone2_7fd3b1e0_Tx
        EMS_BB2_09S_FCM_Tp_oBackbone2_41cc37fa_Tx: CanIfTxPduCanId=1342, CanIfTxPduUserTxConfirmationName=CanTp_TxConfirmation, CanIfTxPduUserTxConfirmationUL=CAN_TP, CanIfTxPduId=215, CanIfTxPduBufferRef=CHNL_a6b6a922, CanIfTxPduRef=EMS_BB2_09S_FCM_Tp_oBackbone2_44a19062_Tx
      CIOM_Cab_13S_FCM_Tp_oCabSubnet_2f98645f_Rx (CanIfRxPduCfg):
        CanIfRxPduCanId = 418490368
        CanIfRxPduCanIdType = EXTENDED_CAN
        CanIfRxPduDlc = 8
        CanIfRxPduUserRxIndicationName = CanTp_RxIndication
        CanIfRxPduUserRxIndicationUL = CAN_TP
        CanIfRxPduId = 64
        CanIfRxPduReadData = false
        CanIfRxPduReadNotifyStatus = false
        CanIfRxPduDlcCheck = true
        CanIfRxPduHrhIdRef = CN_CabSubnet_eedbadff_Rx
        CanIfRxPduRef = CIOM_Cab_13S_FCM_Tp_oCabSubnet_57b44a04_Rx
      HMIIOM_BB2_39P_oBackbone2_2c3b8f89_Rx (CanIfRxPduCfg):
        CanIfRxPduCanId = 1422
        CanIfRxPduCanIdType = EXTENDED_CAN
        CanIfRxPduDlc = 8
        CanIfRxPduUserRxIndicationName = PduR_CanIfRxIndication
        CanIfRxPduUserRxIndicationUL = PDUR
        CanIfRxPduId = 173
        CanIfRxPduReadData = false
        CanIfRxPduReadNotifyStatus = false
        CanIfRxPduDlcCheck = true
        CanIfRxPduHrhIdRef = CN_Backbone2_7b3866ec_Rx
        CanIfRxPduRef = HMIIOM_BB2_39P_oBackbone2_b282fcec_Rx
      3 x CanIfTxPduCfg, all with CanIfTxPduCanIdType=EXTENDED_CAN, CanIfTxPduDlc=8, CanIfTxPduReadNotifyStatus=false, CanIfTxPduType=STATIC:
        CIOM_Cab_17P_oCabSubnet_4a9e582a_Tx: CanIfTxPduCanId=419047423, CanIfTxPduUserTxConfirmationName=NULL_PTR, CanIfTxPduUserTxConfirmationUL=NONE, CanIfTxPduId=24, CanIfTxPduBufferRef=CanIfBufferCfg_CIOM_Cab_17P_oCabSubnet_4a9e582a_Tx, CanIfTxPduRef=CIOM_Cab_17P_oCabSubnet_9b5fb4f1_Tx
        HRLFC_X_CIOMFMS_oFMSNet_c55a7a2b_Tx: CanIfTxPduCanId=419236145, CanIfTxPduUserTxConfirmationName=NULL_PTR, CanIfTxPduUserTxConfirmationUL=NONE, CanIfTxPduId=110, CanIfTxPduBufferRef=CanIfBufferCfg_HRLFC_X_CIOMFMS_oFMSNet_c55a7a2b_Tx, CanIfTxPduRef=HRLFC_X_CIOMFMS_oFMSNet_7d441e5f_Tx
        J1939NmTxPdu_2068bfea: CanIfTxPduCanId=418316032, CanIfTxPduCanIdMask=4294967040, CanIfTxPduId=113, CanIfTxPduUserTxConfirmationUL=J1939NM, CanIfTxPduUserTxConfirmationName=J1939Nm_TxConfirmation, CanIfTxPduRef=J1939NmTxPdu_2068bfea, CanIfTxPduBufferRef=CanIfBufferCfg_J1939NmTxPdu_2068bfea
      J1939NmRxPdu_2068bfea (CanIfRxPduCfg):
        CanIfRxPduDlc = 8
        CanIfRxPduCanIdType = EXTENDED_CAN
        CanIfRxPduCanIdMask = 67108608
        CanIfRxPduCanId = 15662848
        CanIfRxPduDlcCheck = true
        CanIfRxPduReadData = false
        CanIfRxPduReadNotifyStatus = false
        CanIfRxPduUserRxIndicationUL = J1939NM
        CanIfRxPduId = 126
        CanIfRxPduUserRxIndicationName = J1939Nm_RxIndication
        CanIfRxPduRef = J1939NmRxPdu_2068bfea
        CanIfRxPduHrhIdRef = CN_FMSNet_41e51372_Rx
      AckmTxPdu_FMSNet_J1939_44d89c3b (CanIfTxPduCfg):
        CanIfTxPduCanId = 15204352
        CanIfTxPduCanIdType = EXTENDED_CAN
        CanIfTxPduDlc = 8
        CanIfTxPduId = 118
        CanIfTxPduReadNotifyStatus = false
        CanIfTxPduType = STATIC
        CanIfTxPduUserTxConfirmationUL = PDUR
        CanIfTxPduUserTxConfirmationName = PduR_CanIfTxConfirmation
        CanIfTxPduCanIdMask = 3825139712
        CanIfTxPduBufferRef = CanIfBufferCfg_AckmTxPdu_FMSNet_J1939_44d89c3b
        CanIfTxPduRef = AckmTxPdu_FMSNet_J1939_44d89c3b
      FcNPdu_FMSNet_J1939_5ab570f8 (CanIfRxPduCfg):
        CanIfRxPduCanIdType = EXTENDED_CAN
        CanIfRxPduDlc = 8
        CanIfRxPduId = 124
        CanIfRxPduReadData = false
        CanIfRxPduReadNotifyStatus = false
        CanIfRxPduUserRxIndicationName = J1939Tp_RxIndication
        CanIfRxPduUserRxIndicationUL = J1939TP
        CanIfRxPduDlcCheck = true
        CanIfRxPduCanId = 15466496
        CanIfRxPduCanIdMask = 67043328
        CanIfRxPduHrhIdRef = CN_FMSNet_41e51372_Rx
        CanIfRxPduRef = FcNPdu_Backbone1J1939_dba64907_Rx
      RqstRxPdu_FMSNet_J1939_44d89c3b (CanIfRxPduCfg):
        CanIfRxPduCanIdType = EXTENDED_CAN
        CanIfRxPduDlc = 3
        CanIfRxPduId = 125
        CanIfRxPduReadData = false
        CanIfRxPduReadNotifyStatus = false
        CanIfRxPduUserRxIndicationName = PduR_CanIfRxIndication
        CanIfRxPduUserRxIndicationUL = PDUR
        CanIfRxPduDlcCheck = true
        CanIfRxPduCanId = 15335424
        CanIfRxPduCanIdMask = 67043328
        CanIfRxPduHrhIdRef = CN_FMSNet_41e51372_Rx
        CanIfRxPduRef = RqstRxPdu_FMNSet_J1939
      121 x CanIfBufferCfg, all with CanIfBufferSize=0, CanIfTxBufferHandlingType=NONE, CanIfTxBufferMappedTxPdus=1, CanIfTxBufferMaxPduLength=8:
        CanIfBufferCfg_CIOM_Sec_01P_oSecuritySubnet_de08418d_Tx: CanIfBufferHthRef=CanIfHthCfg_CIOM_Sec_01P_oSecuritySubnet_de08418d_Tx
        CanIfBufferCfg_IntTesterTGW2FuncDiagMsg_Sec_Tp_oSecuritySubnet_57d96404_Tx: CanIfBufferHthRef=CanIfHthCfg_IntTesterTGW2FuncDiagMsg_Sec_Tp_oSecuritySubnet_57d96404_Tx
        CanIfBufferCfg_DiagReqMsgIntHMIIOM_C0_F3_Sec_Tp_oSecuritySubnet_3aaf1649_Tx: CanIfBufferHthRef=CanIfHthCfg_DiagReqMsgIntHMIIOM_C0_F3_Sec_Tp_oSecuritySubnet_3aaf1649_Tx
        CanIfBufferCfg_TesterFuncDiagMsg_Sec_Tp_oSecuritySubnet_7f5a7347_Tx: CanIfBufferHthRef=CanIfHthCfg_TesterFuncDiagMsg_Sec_Tp_oSecuritySubnet_7f5a7347_Tx
        CanIfBufferCfg_PhysDiagReqMsg_A1_F2_Sec_Tp_oSecuritySubnet_5d2e792a_Tx: CanIfBufferHthRef=CanIfHthCfg_PhysDiagReqMsg_A1_F2_Sec_Tp_oSecuritySubnet_5d2e792a_Tx
        CanIfBufferCfg_DiagReqMsgIntTGW2_A1_F4_Sec_Tp_oSecuritySubnet_eb89cc56_Tx: CanIfBufferHthRef=CanIfHthCfg_DiagReqMsgIntTGW2_A1_F4_Sec_Tp_oSecuritySubnet_eb89cc56_Tx
        CanIfBufferCfg_AnmMsg_CIOM_SecuritySubnet_oSecuritySubnet_d0267e59_Tx: CanIfBufferHthRef=CanIfHthCfg_AnmMsg_CIOM_SecuritySubnet_oSecuritySubnet_d0267e59_Tx
        CanIfBufferCfg_DiagReqMsgIntHMIIOM_A0_F3_Sec_Tp_oSecuritySubnet_09265670_Tx: CanIfBufferHthRef=CanIfHthCfg_DiagReqMsgIntHMIIOM_A0_F3_Sec_Tp_oSecuritySubnet_09265670_Tx
        CanIfBufferCfg_PDM_Sec_04S_FCM_Tp_oSecuritySubnet_90a313cf_Tx: CanIfBufferHthRef=CanIfHthCfg_PDM_Sec_04S_FCM_Tp_oSecuritySubnet_90a313cf_Tx
        CanIfBufferCfg_CIOM_Sec_02P_oSecuritySubnet_04f0ad2a_Tx: CanIfBufferHthRef=CanIfHthCfg_CIOM_Sec_02P_oSecuritySubnet_04f0ad2a_Tx
        CanIfBufferCfg_Alarm_Sec_07S_FCM_Tp_oSecuritySubnet_94ec21d2_Tx: CanIfBufferHthRef=CanIfHthCfg_Alarm_Sec_07S_FCM_Tp_oSecuritySubnet_94ec21d2_Tx
        CanIfBufferCfg_PDM_Sec_03S_FCM_Tp_oSecuritySubnet_2750bd9e_Tx: CanIfBufferHthRef=CanIfHthCfg_PDM_Sec_03S_FCM_Tp_oSecuritySubnet_2750bd9e_Tx
        CanIfBufferCfg_CIOM_Sec_12S_Tp_oSecuritySubnet_2d9a0e12_Tx: CanIfBufferHthRef=CanIfHthCfg_CIOM_Sec_12S_Tp_oSecuritySubnet_2d9a0e12_Tx
        CanIfBufferCfg_Alarm_Sec_06S_FCM_Tp_oSecuritySubnet_a3ee35ea_Tx: CanIfBufferHthRef=CanIfHthCfg_Alarm_Sec_06S_FCM_Tp_oSecuritySubnet_a3ee35ea_Tx
        CanIfBufferCfg_CIOM_Sec_09S_Tp_oSecuritySubnet_ba09ccac_Tx: CanIfBufferHthRef=CanIfHthCfg_CIOM_Sec_09S_Tp_oSecuritySubnet_ba09ccac_Tx
        CanIfBufferCfg_CIOM_Sec_04P_oSecuritySubnet_6a707225_Tx: CanIfBufferHthRef=CanIfHthCfg_CIOM_Sec_04P_oSecuritySubnet_6a707225_Tx
        CanIfBufferCfg_Alarm_Sec_03S_FCM_Tp_oSecuritySubnet_48e47132_Tx: CanIfBufferHthRef=CanIfHthCfg_Alarm_Sec_03S_FCM_Tp_oSecuritySubnet_48e47132_Tx
        CanIfBufferCfg_PhysDiagReqMsg_C0_F2_Sec_Tp_oSecuritySubnet_f27248ff_Tx: CanIfBufferHthRef=CanIfHthCfg_PhysDiagReqMsg_C0_F2_Sec_Tp_oSecuritySubnet_f27248ff_Tx
        CanIfBufferCfg_DiagReqMsgIntTGW2_C0_F4_Sec_Tp_oSecuritySubnet_0ba24808_Tx: CanIfBufferHthRef=CanIfHthCfg_DiagReqMsgIntTGW2_C0_F4_Sec_Tp_oSecuritySubnet_0ba24808_Tx
        CanIfBufferCfg_DiagReqMsgIntTGW2_A0_F4_Sec_Tp_oSecuritySubnet_8adef0bc_Tx: CanIfBufferHthRef=CanIfHthCfg_DiagReqMsgIntTGW2_A0_F4_Sec_Tp_oSecuritySubnet_8adef0bc_Tx
        CanIfBufferCfg_DiagReqMsgIntHMIIOM_A1_F3_Sec_Tp_oSecuritySubnet_a1b03b66_Tx: CanIfBufferHthRef=CanIfHthCfg_DiagReqMsgIntHMIIOM_A1_F3_Sec_Tp_oSecuritySubnet_a1b03b66_Tx
        CanIfBufferCfg_NmAsr_CIOM_Sec_oSecuritySubnet_dae88b7d_Tx: CanIfBufferHthRef=CanIfHthCfg_NmAsr_CIOM_Sec_oSecuritySubnet_dae88b7d_Tx
        CanIfBufferCfg_PhysDiagReqMsg_A0_F2_Sec_Tp_oSecuritySubnet_cb87d97b_Tx: CanIfBufferHthRef=CanIfHthCfg_PhysDiagReqMsg_A0_F2_Sec_Tp_oSecuritySubnet_cb87d97b_Tx
        CanIfBufferCfg_CIOM_Sec_05S_Tp_oSecuritySubnet_c8b553a6_Tx: CanIfBufferHthRef=CanIfHthCfg_CIOM_Sec_05S_Tp_oSecuritySubnet_c8b553a6_Tx
        CanIfBufferCfg_CIOM_Sec_03P_oSecuritySubnet_4d58f6b7_Tx: CanIfBufferHthRef=CanIfHthCfg_CIOM_Sec_03P_oSecuritySubnet_4d58f6b7_Tx
        CanIfBufferCfg_DDM_Sec_04S_FCM_Tp_oSecuritySubnet_eddd4cee_Tx: CanIfBufferHthRef=CanIfHthCfg_DDM_Sec_04S_FCM_Tp_oSecuritySubnet_eddd4cee_Tx
        CanIfBufferCfg_DDM_Sec_05S_FCM_Tp_oSecuritySubnet_d14dc345_Tx: CanIfBufferHthRef=CanIfHthCfg_DDM_Sec_05S_FCM_Tp_oSecuritySubnet_d14dc345_Tx
        CanIfBufferCfg_CIOM_Sec_07S_Tp_oSecuritySubnet_69506b1a_Tx: CanIfBufferHthRef=CanIfHthCfg_CIOM_Sec_07S_Tp_oSecuritySubnet_69506b1a_Tx
        CanIfBufferCfg_DDM_Sec_03S_FCM_Tp_oSecuritySubnet_5a2ee2bf_Tx: CanIfBufferHthRef=CanIfHthCfg_DDM_Sec_03S_FCM_Tp_oSecuritySubnet_5a2ee2bf_Tx
        CanIfBufferCfg_CIOM_Sec_06S_Tp_oSecuritySubnet_39a2f744_Tx: CanIfBufferHthRef=CanIfHthCfg_CIOM_Sec_06S_Tp_oSecuritySubnet_39a2f744_Tx
        CanIfBufferCfg_CIOM_Sec_10S_Tp_oSecuritySubnet_8c7f36ae_Tx: CanIfBufferHthRef=CanIfHthCfg_CIOM_Sec_10S_Tp_oSecuritySubnet_8c7f36ae_Tx
        CanIfBufferCfg_CIOM_Sec_08S_Tp_oSecuritySubnet_eafb50f2_Tx: CanIfBufferHthRef=CanIfHthCfg_CIOM_Sec_08S_Tp_oSecuritySubnet_eafb50f2_Tx
        CanIfBufferCfg_CIOM_Sec_11S_Tp_oSecuritySubnet_dc8daaf0_Tx: CanIfBufferHthRef=CanIfHthCfg_CIOM_Sec_11S_Tp_oSecuritySubnet_dc8daaf0_Tx
        CanIfBufferCfg_J1939NmTxPdu_fa509995: CanIfBufferHthRef=CanIfHthCfg_J1939NmTxPdu_fa509995
        CanIfBufferCfg_CIOM_BB1_01P_oBackbone1J1939_55a00301_Tx: CanIfBufferHthRef=CanIfHthCfg_CIOM_BB1_01P_oBackbone1J1939_55a00301_Tx
        CanIfBufferCfg_FcNPdu_Backbone1J1939_dba64907: CanIfBufferHthRef=CanIfHthCfg_FcNPdu_Backbone1J1939_dba64907
        CanIfBufferCfg_AckmTxPdu_Backbone1J1939_54966c1b: CanIfBufferHthRef=CanIfHthCfg_AckmTxPdu_Backbone1J1939_54966c1b
        CanIfBufferCfg_PTODE_X_CIOMFMS_oFMSNet_8abc23b8_Tx: CanIfBufferHthRef=CanIfHthCfg_PTODE_X_CIOMFMS_oFMSNet_8abc23b8_Tx
        CanIfBufferCfg_AT1T1I1_X_CIOMFMS_oFMSNet_4f6adf75_Tx: CanIfBufferHthRef=CanIfHthCfg_AT1T1I1_X_CIOMFMS_oFMSNet_4f6adf75_Tx
        CanIfBufferCfg_CVW_X_CIOMFMS_oFMSNet_5e9635e8_Tx: CanIfBufferHthRef=CanIfHthCfg_CVW_X_CIOMFMS_oFMSNet_5e9635e8_Tx
        CanIfBufferCfg_SERV_X_CIOMFMS_oFMSNet_0f3b4ff2_Tx: CanIfBufferHthRef=CanIfHthCfg_SERV_X_CIOMFMS_oFMSNet_0f3b4ff2_Tx
        CanIfBufferCfg_EEC1_X_CIOMFMS_oFMSNet_954d78de_Tx: CanIfBufferHthRef=CanIfHthCfg_EEC1_X_CIOMFMS_oFMSNet_954d78de_Tx
        CanIfBufferCfg_CL_X_CIOMFMS_oFMSNet_fc518547_Tx: CanIfBufferHthRef=CanIfHthCfg_CL_X_CIOMFMS_oFMSNet_fc518547_Tx
        CanIfBufferCfg_ERC1_x_EMSRetFMS_oFMSNet_d863a207_Tx: CanIfBufferHthRef=CanIfHthCfg_ERC1_x_EMSRetFMS_oFMSNet_d863a207_Tx
        CanIfBufferCfg_HRLFC_X_CIOMFMS_oFMSNet_c55a7a2b_Tx: CanIfBufferHthRef=CanIfHthCfg_HRLFC_X_CIOMFMS_oFMSNet_c55a7a2b_Tx
        CanIfBufferCfg_DD_X_CIOMFMS_oFMSNet_95f62c09_Tx: CanIfBufferHthRef=CanIfHthCfg_DD_X_CIOMFMS_oFMSNet_95f62c09_Tx
        CanIfBufferCfg_TPDT_Tp_oFMSNet_3018618a_Tx: CanIfBufferHthRef=CanIfHthCfg_TPDT_Tp_oFMSNet_3018618a_Tx
        CanIfBufferCfg_FMS_X_CIOMFMS_oFMSNet_68f86b37_Tx: CanIfBufferHthRef=CanIfHthCfg_FMS_X_CIOMFMS_oFMSNet_68f86b37_Tx
        CanIfBufferCfg_AckmTxPdu_FMSNet_J1939_44d89c3b: CanIfBufferHthRef=CanIfHthCfg_AckmTxPdu_FMSNet_J1939_44d89c3b
        CanIfBufferCfg_VDHR_X_CIOMFMS_oFMSNet_67a02fb8_Tx: CanIfBufferHthRef=CanIfHthCfg_VDHR_X_CIOMFMS_oFMSNet_67a02fb8_Tx
        CanIfBufferCfg_LFC_X_CIOMFMS_oFMSNet_16e703d3_Tx: CanIfBufferHthRef=CanIfHthCfg_LFC_X_CIOMFMS_oFMSNet_16e703d3_Tx
        CanIfBufferCfg_ET1_X_CIOMFMS_oFMSNet_ff39068f_Tx: CanIfBufferHthRef=CanIfHthCfg_ET1_X_CIOMFMS_oFMSNet_ff39068f_Tx
        CanIfBufferCfg_LFE_X_CIOMFMS_oFMSNet_adac24c8_Tx: CanIfBufferHthRef=CanIfHthCfg_LFE_X_CIOMFMS_oFMSNet_adac24c8_Tx
        CanIfBufferCfg_FMS1_X_CIOMFMS_oFMSNet_fb3c9fbd_Tx: CanIfBufferHthRef=CanIfHthCfg_FMS1_X_CIOMFMS_oFMSNet_fb3c9fbd_Tx
        CanIfBufferCfg_EEC14_X_CIOMFMS_oFMSNet_3551b912_Tx: CanIfBufferHthRef=CanIfHthCfg_EEC14_X_CIOMFMS_oFMSNet_3551b912_Tx
        CanIfBufferCfg_TPDirect_0FE6B_Tp_oFMSNet_5c137171_Tx: CanIfBufferHthRef=CanIfHthCfg_TPDirect_0FE6B_Tp_oFMSNet_5c137171_Tx
        CanIfBufferCfg_AIR1_X_CIOMFMS_oFMSNet_9b1ec537_Tx: CanIfBufferHthRef=CanIfHthCfg_AIR1_X_CIOMFMS_oFMSNet_9b1ec537_Tx
        CanIfBufferCfg_EEC2_X_CIOMFMS_oFMSNet_d3e60e6a_Tx: CanIfBufferHthRef=CanIfHthCfg_EEC2_X_CIOMFMS_oFMSNet_d3e60e6a_Tx
        CanIfBufferCfg_TCO1_X_CIOMFMS_oFMSNet_567baf3d_Tx: CanIfBufferHthRef=CanIfHthCfg_TCO1_X_CIOMFMS_oFMSNet_567baf3d_Tx
        CanIfBufferCfg_J1939NmTxPdu_2068bfea: CanIfBufferHthRef=CanIfHthCfg_J1939NmTxPdu_2068bfea
        CanIfBufferCfg_ERC1_x_RECUFMS_oFMSNet_338e7918_Tx: CanIfBufferHthRef=CanIfHthCfg_ERC1_x_RECUFMS_oFMSNet_338e7918_Tx
        CanIfBufferCfg_VP236_X_CIOMFMS_oFMSNet_524bf569_Tx: CanIfBufferHthRef=CanIfHthCfg_VP236_X_CIOMFMS_oFMSNet_524bf569_Tx
        CanIfBufferCfg_TPCM_Tp_oFMSNet_55e2f930_Tx: CanIfBufferHthRef=CanIfHthCfg_TPCM_Tp_oFMSNet_55e2f930_Tx
        CanIfBufferCfg_HOURS_X_CIOMFMS_oFMSNet_bfc991fc_Tx: CanIfBufferHthRef=CanIfHthCfg_HOURS_X_CIOMFMS_oFMSNet_bfc991fc_Tx
        CanIfBufferCfg_VW_X_CIOMFMS_oFMSNet_06d77621_Tx: CanIfBufferHthRef=CanIfHthCfg_VW_X_CIOMFMS_oFMSNet_06d77621_Tx
        CanIfBufferCfg_CCVS_X_CIOMFMS_oFMSNet_1dbcfa70_Tx: CanIfBufferHthRef=CanIfHthCfg_CCVS_X_CIOMFMS_oFMSNet_1dbcfa70_Tx
        CanIfBufferCfg_AMB_X_CIOMFMS_oFMSNet_f6109b97_Tx: CanIfBufferHthRef=CanIfHthCfg_AMB_X_CIOMFMS_oFMSNet_f6109b97_Tx
        CanIfBufferCfg_CIOM_Cab_22P_oCabSubnet_698a9fe8_Tx: CanIfBufferHthRef=CanIfHthCfg_CIOM_Cab_22P_oCabSubnet_698a9fe8_Tx
        CanIfBufferCfg_IntTesterTGW2FuncDiagMsg_Cab_Tp_oCabSubnet_96ec8334_Tx: CanIfBufferHthRef=CanIfHthCfg_IntTesterTGW2FuncDiagMsg_Cab_Tp_oCabSubnet_96ec8334_Tx
        CanIfBufferCfg_CIOM_Cab_26P_oCabSubnet_2df59da9_Tx: CanIfBufferHthRef=CanIfHthCfg_CIOM_Cab_26P_oCabSubnet_2df59da9_Tx
        CanIfBufferCfg_PhysDiagReqMsg_A2_F2_Cab_Tp_oCabSubnet_6d74e481_Tx: CanIfBufferHthRef=CanIfHthCfg_PhysDiagReqMsg_A2_F2_Cab_Tp_oCabSubnet_6d74e481_Tx
        CanIfBufferCfg_CIOM_Cab_15P_oCabSubnet_85195a2a_Tx: CanIfBufferHthRef=CanIfHthCfg_CIOM_Cab_15P_oCabSubnet_85195a2a_Tx
        CanIfBufferCfg_CIOM_Cab_11S_Tp_oCabSubnet_ec1435f4_Tx: CanIfBufferHthRef=CanIfHthCfg_CIOM_Cab_11S_Tp_oCabSubnet_ec1435f4_Tx
        CanIfBufferCfg_CIOM_Cab_28S_oCabSubnet_0dafccc7_Tx: CanIfBufferHthRef=CanIfHthCfg_CIOM_Cab_28S_oCabSubnet_0dafccc7_Tx
        CanIfBufferCfg_CIOM_Cab_21P_oCabSubnet_c1ce1ce8_Tx: CanIfBufferHthRef=CanIfHthCfg_CIOM_Cab_21P_oCabSubnet_c1ce1ce8_Tx
        CanIfBufferCfg_CIOM_Cab_17P_oCabSubnet_4a9e582a_Tx: CanIfBufferHthRef=CanIfHthCfg_CIOM_Cab_17P_oCabSubnet_4a9e582a_Tx
        CanIfBufferCfg_CIOM_Cab_33P_oCabSubnet_0e2edd69_Tx: CanIfBufferHthRef=CanIfHthCfg_CIOM_Cab_33P_oCabSubnet_0e2edd69_Tx
        CanIfBufferCfg_DiagReqMsgIntTGW2_53_F4_Cab_Tp_oCabSubnet_75ef26c1_Tx: CanIfBufferHthRef=CanIfHthCfg_DiagReqMsgIntTGW2_53_F4_Cab_Tp_oCabSubnet_75ef26c1_Tx
        CanIfBufferCfg_CIOM_Cab_04S_Tp_oCabSubnet_e3ca2569_Tx: CanIfBufferHthRef=CanIfHthCfg_CIOM_Cab_04S_Tp_oCabSubnet_e3ca2569_Tx
        CanIfBufferCfg_DiagReqMsgIntHMIIOM_26_F3_Cab_Tp_oCabSubnet_2e1f9ada_Tx: CanIfBufferHthRef=CanIfHthCfg_DiagReqMsgIntHMIIOM_26_F3_Cab_Tp_oCabSubnet_2e1f9ada_Tx
        CanIfBufferCfg_CIOM_Cab_07P_oCabSubnet_4af99bab_Tx: CanIfBufferHthRef=CanIfHthCfg_CIOM_Cab_07P_oCabSubnet_4af99bab_Tx
        CanIfBufferCfg_DiagReqMsgIntHMIIOM_A2_F3_Cab_Tp_oCabSubnet_fcbc8d7d_Tx: CanIfBufferHthRef=CanIfHthCfg_DiagReqMsgIntHMIIOM_A2_F3_Cab_Tp_oCabSubnet_fcbc8d7d_Tx
        CanIfBufferCfg_CIOM_Cab_10P_oCabSubnet_a6a5d96b_Tx: CanIfBufferHthRef=CanIfHthCfg_CIOM_Cab_10P_oCabSubnet_a6a5d96b_Tx
        CanIfBufferCfg_CIOM_Cab_25S_Tp_oCabSubnet_d5957759_Tx: CanIfBufferHthRef=CanIfHthCfg_CIOM_Cab_25S_Tp_oCabSubnet_d5957759_Tx
        CanIfBufferCfg_CIOM_Cab_12P_oCabSubnet_6922db6b_Tx: CanIfBufferHthRef=CanIfHthCfg_CIOM_Cab_12P_oCabSubnet_6922db6b_Tx
        CanIfBufferCfg_NmAsr_CIOM_Cab_oCabSubnet_153d3c7d_Tx: CanIfBufferHthRef=CanIfHthCfg_NmAsr_CIOM_Cab_oCabSubnet_153d3c7d_Tx
        CanIfBufferCfg_CIOM_Cab_32P_oCabSubnet_69ed5c69_Tx: CanIfBufferHthRef=CanIfHthCfg_CIOM_Cab_32P_oCabSubnet_69ed5c69_Tx
        CanIfBufferCfg_CIOM_Cab_18P_oCabSubnet_2e5bdde9_Tx: CanIfBufferHthRef=CanIfHthCfg_CIOM_Cab_18P_oCabSubnet_2e5bdde9_Tx
        CanIfBufferCfg_PhysDiagReqMsg_98_F2_Cab_Tp_oCabSubnet_4c51814f_Tx: CanIfBufferHthRef=CanIfHthCfg_PhysDiagReqMsg_98_F2_Cab_Tp_oCabSubnet_4c51814f_Tx
        CanIfBufferCfg_CIOM_Cab_09P_oCabSubnet_49ff9f68_Tx: CanIfBufferHthRef=CanIfHthCfg_CIOM_Cab_09P_oCabSubnet_49ff9f68_Tx
        CanIfBufferCfg_DiagReqMsgIntTGW2_26_F4_Cab_Tp_oCabSubnet_b42402a4_Tx: CanIfBufferHthRef=CanIfHthCfg_DiagReqMsgIntTGW2_26_F4_Cab_Tp_oCabSubnet_b42402a4_Tx
        CanIfBufferCfg_CIOM_Cab_05S_Tp_oCabSubnet_e74407ff_Tx: CanIfBufferHthRef=CanIfHthCfg_CIOM_Cab_05S_Tp_oCabSubnet_e74407ff_Tx
        CanIfBufferCfg_DiagReqMsgIntTGW2_A2_F4_Cab_Tp_oCabSubnet_fc611706_Tx: CanIfBufferHthRef=CanIfHthCfg_DiagReqMsgIntTGW2_A2_F4_Cab_Tp_oCabSubnet_fc611706_Tx
        CanIfBufferCfg_CIOM_Cab_08P_oCabSubnet_2e3c1e68_Tx: CanIfBufferHthRef=CanIfHthCfg_CIOM_Cab_08P_oCabSubnet_2e3c1e68_Tx
        CanIfBufferCfg_DiagReqMsgIntHMIIOM_98_F3_Cab_Tp_oCabSubnet_2daafb4e_Tx: CanIfBufferHthRef=CanIfHthCfg_DiagReqMsgIntHMIIOM_98_F3_Cab_Tp_oCabSubnet_2daafb4e_Tx
        CanIfBufferCfg_CIOM_Cab_24P_oCabSubnet_e2729fa9_Tx: CanIfBufferHthRef=CanIfHthCfg_CIOM_Cab_24P_oCabSubnet_e2729fa9_Tx
        CanIfBufferCfg_CIOM_Cab_30S_Tp_oCabSubnet_da4b67c4_Tx: CanIfBufferHthRef=CanIfHthCfg_CIOM_Cab_30S_Tp_oCabSubnet_da4b67c4_Tx
        CanIfBufferCfg_CIOM_Cab_13S_Tp_oCabSubnet_e50870d8_Tx: CanIfBufferHthRef=CanIfHthCfg_CIOM_Cab_13S_Tp_oCabSubnet_e50870d8_Tx
        CanIfBufferCfg_CIOM_Cab_19P_oCabSubnet_49985ce9_Tx: CanIfBufferHthRef=CanIfHthCfg_CIOM_Cab_19P_oCabSubnet_49985ce9_Tx
        CanIfBufferCfg_CIOM_Cab_01P_oCabSubnet_c1019bea_Tx: CanIfBufferHthRef=CanIfHthCfg_CIOM_Cab_01P_oCabSubnet_c1019bea_Tx
        CanIfBufferCfg_CIOM_Cab_34P_Tp_oCabSubnet_377e6916_Tx: CanIfBufferHthRef=CanIfHthCfg_CIOM_Cab_34P_Tp_oCabSubnet_377e6916_Tx
        CanIfBufferCfg_CIOM_Cab_02P_oCabSubnet_694518ea_Tx: CanIfBufferHthRef=CanIfHthCfg_CIOM_Cab_02P_oCabSubnet_694518ea_Tx
        CanIfBufferCfg_PhysDiagReqMsg_53_F2_Cab_Tp_oCabSubnet_9abe6f67_Tx: CanIfBufferHthRef=CanIfHthCfg_PhysDiagReqMsg_53_F2_Cab_Tp_oCabSubnet_9abe6f67_Tx
        CanIfBufferCfg_CIOM_Cab_27P_oCabSubnet_4a361ca9_Tx: CanIfBufferHthRef=CanIfHthCfg_CIOM_Cab_27P_oCabSubnet_4a361ca9_Tx
        CanIfBufferCfg_AnmMsg_CIOM_CabSubnet_oCabSubnet_e295c8bd_Tx: CanIfBufferHthRef=CanIfHthCfg_AnmMsg_CIOM_CabSubnet_oCabSubnet_e295c8bd_Tx
        CanIfBufferCfg_CIOM_Cab_06P_oCabSubnet_2d3a1aab_Tx: CanIfBufferHthRef=CanIfHthCfg_CIOM_Cab_06P_oCabSubnet_2d3a1aab_Tx
        CanIfBufferCfg_TesterFuncDiagMsg_Cab_Tp_oCabSubnet_d293ecaa_Tx: CanIfBufferHthRef=CanIfHthCfg_TesterFuncDiagMsg_Cab_Tp_oCabSubnet_d293ecaa_Tx
        CanIfBufferCfg_CIOM_Cab_31P_oCabSubnet_c1a9df69_Tx: CanIfBufferHthRef=CanIfHthCfg_CIOM_Cab_31P_oCabSubnet_c1a9df69_Tx
        CanIfBufferCfg_DiagReqMsgIntTGW2_98_F4_Cab_Tp_oCabSubnet_2e8c3543_Tx: CanIfBufferHthRef=CanIfHthCfg_DiagReqMsgIntTGW2_98_F4_Cab_Tp_oCabSubnet_2e8c3543_Tx
        CanIfBufferCfg_CIOM_Cab_23P_oCabSubnet_0e491ee8_Tx: CanIfBufferHthRef=CanIfHthCfg_CIOM_Cab_23P_oCabSubnet_0e491ee8_Tx
        CanIfBufferCfg_CIOM_Cab_14P_oCabSubnet_e2dadb2a_Tx: CanIfBufferHthRef=CanIfHthCfg_CIOM_Cab_14P_oCabSubnet_e2dadb2a_Tx
        CanIfBufferCfg_PhysDiagReqMsg_53_F1_Cab_Tp_oCabSubnet_682570ce_Tx: CanIfBufferHthRef=CanIfHthCfg_PhysDiagReqMsg_53_F1_Cab_Tp_oCabSubnet_682570ce_Tx
        CanIfBufferCfg_CIOM_Cab_20S_Tp_oCabSubnet_c323df97_Tx: CanIfBufferHthRef=CanIfHthCfg_CIOM_Cab_20S_Tp_oCabSubnet_c323df97_Tx
        CanIfBufferCfg_CCM_Cab_03P_FCM_Tp_oCabSubnet_af75b436_Tx: CanIfBufferHthRef=CanIfHthCfg_CCM_Cab_03P_FCM_Tp_oCabSubnet_af75b436_Tx
        CanIfBufferCfg_CIOM_Cab_16P_oCabSubnet_2d5dd92a_Tx: CanIfBufferHthRef=CanIfHthCfg_CIOM_Cab_16P_oCabSubnet_2d5dd92a_Tx
        CanIfBufferCfg_DiagReqMsgIntHMIIOM_53_F3_Cab_Tp_oCabSubnet_e9059d48_Tx: CanIfBufferHthRef=CanIfHthCfg_DiagReqMsgIntHMIIOM_53_F3_Cab_Tp_oCabSubnet_e9059d48_Tx
        CanIfBufferCfg_CIOM_Cab_29S_Tp_oCabSubnet_e3dce9b1_Tx: CanIfBufferHthRef=CanIfHthCfg_CIOM_Cab_29S_Tp_oCabSubnet_e3dce9b1_Tx
        CanIfBufferCfg_PhysDiagReqMsg_26_F2_Cab_Tp_oCabSubnet_e2a6386f_Tx: CanIfBufferHthRef=CanIfHthCfg_PhysDiagReqMsg_26_F2_Cab_Tp_oCabSubnet_e2a6386f_Tx
        CanIfBufferCfg_CIOM_Cab_03P_oCabSubnet_0e8699ea_Tx: CanIfBufferHthRef=CanIfHthCfg_CIOM_Cab_03P_oCabSubnet_0e8699ea_Tx
        CanIfBufferCfg_NmAsr_CIOM_BB2_oBackbone2_9b0338b4_Tx: CanIfBufferHthRef=CanIfHthCfg_NmAsr_CIOM_BB2_oBackbone2_9b0338b4_Tx
        CanIfBufferCfg_CIOM_BB2_29P_oBackbone2_bfae97b8_Tx: CanIfBufferHthRef=CanIfHthCfg_CIOM_BB2_29P_oBackbone2_bfae97b8_Tx
      DebugCtrl1_SCIM_BB2_oBackbone2_139697c4_Rx (CanIfRxPduCfg):
        CanIfRxPduCanId = 2013
        CanIfRxPduCanIdType = STANDARD_CAN
        CanIfRxPduDlc = 8
        CanIfRxPduUserRxIndicationName = PduR_CanIfRxIndication
        CanIfRxPduUserRxIndicationUL = PDUR
        CanIfRxPduId = 255
        CanIfRxPduReadData = false
        CanIfRxPduReadNotifyStatus = false
        CanIfRxPduDlcCheck = true
        CanIfRxPduHrhIdRef = CanIfHrhCfg_DebugCtrl1_SCIM_BB2_oBackbone2_139697c4_Rx
        CanIfRxPduRef = DebugCtrl1_SCIM_BB2_oBackbone2_c4c282ac_Rx
      VMCU_BB2_90P_oBackbone2_8217bd10_Rx (CanIfRxPduCfg):
        CanIfRxPduCanId = 643
        CanIfRxPduCanIdType = EXTENDED_CAN
        CanIfRxPduDlc = 8
        CanIfRxPduUserRxIndicationName = PduR_CanIfRxIndication
        CanIfRxPduUserRxIndicationUL = PDUR
        CanIfRxPduId = 236
        CanIfRxPduReadData = false
        CanIfRxPduReadNotifyStatus = false
        CanIfRxPduDlcCheck = true
        CanIfRxPduHrhIdRef = CN_Backbone2_7b3866ec_Rx
        CanIfRxPduRef = VMCU_BB2_90P_oBackbone2_74636b79_Rx
      Debug8_SCIM_BB2_oBackbone2_ab7cdc97_Tx (CanIfTxPduCfg):
        CanIfTxPduCanId = 2008
        CanIfTxPduCanIdType = STANDARD_CAN
        CanIfTxPduDlc = 8
        CanIfTxPduUserTxConfirmationName = PduR_CanIfTxConfirmation
        CanIfTxPduUserTxConfirmationUL = PDUR
        CanIfTxPduId = 138
        CanIfTxPduReadNotifyStatus = false
        CanIfTxPduType = STATIC
        CanIfTxPduBufferRef = CHNL_a6b6a922
        CanIfTxPduRef = Debug8_SCIM_BB2_oBackbone2_a6073a94_Tx
      IC3_BB2_01S_oBackbone2_43f34b3f_Rx (CanIfRxPduCfg):
        CanIfRxPduCanId = 515
        CanIfRxPduCanIdType = EXTENDED_CAN
        CanIfRxPduDlc = 8
        CanIfRxPduUserRxIndicationName = PduR_CanIfRxIndication
        CanIfRxPduUserRxIndicationUL = PDUR
        CanIfRxPduId = 242
        CanIfRxPduReadData = false
        CanIfRxPduReadNotifyStatus = false
        CanIfRxPduDlcCheck = true
        CanIfRxPduHrhIdRef = CN_Backbone2_7b3866ec_Rx
        CanIfRxPduRef = IC3_BB2_01S_oBackbone2_ea5b1505_Rx
      Debug12_SCIM_BB2_oBackbone2_1fb838d5_Tx (CanIfTxPduCfg):
        CanIfTxPduCanId = 2012
        CanIfTxPduCanIdType = STANDARD_CAN
        CanIfTxPduDlc = 8
        CanIfTxPduUserTxConfirmationName = PduR_CanIfTxConfirmation
        CanIfTxPduUserTxConfirmationUL = PDUR
        CanIfTxPduId = 134
        CanIfTxPduReadNotifyStatus = false
        CanIfTxPduType = STATIC
        CanIfTxPduBufferRef = CHNL_a6b6a922
        CanIfTxPduRef = Debug12_SCIM_BB2_oBackbone2_352827a4_Tx
      VMCU_BB2_109P_oBackbone2_770d627b_Rx (CanIfRxPduCfg):
        CanIfRxPduCanId = 1316
        CanIfRxPduCanIdType = EXTENDED_CAN
        CanIfRxPduDlc = 8
        CanIfRxPduUserRxIndicationName = PduR_CanIfRxIndication
        CanIfRxPduUserRxIndicationUL = PDUR
        CanIfRxPduId = 188
        CanIfRxPduReadData = false
        CanIfRxPduReadNotifyStatus = false
        CanIfRxPduDlcCheck = true
        CanIfRxPduHrhIdRef = CN_Backbone2_7b3866ec_Rx
        CanIfRxPduRef = VMCU_BB2_109P_oBackbone2_8d441969_Rx
      VMCU_BB2_100P_oBackbone2_aa473d34_Rx (CanIfRxPduCfg):
        CanIfRxPduCanId = 1301
        CanIfRxPduCanIdType = EXTENDED_CAN
        CanIfRxPduDlc = 8
        CanIfRxPduUserRxIndicationName = PduR_CanIfRxIndication
        CanIfRxPduUserRxIndicationUL = PDUR
        CanIfRxPduId = 195
        CanIfRxPduReadData = false
        CanIfRxPduReadNotifyStatus = false
        CanIfRxPduDlcCheck = true
        CanIfRxPduHrhIdRef = CN_Backbone2_7b3866ec_Rx
        CanIfRxPduRef = VMCU_BB2_100P_oBackbone2_9f8a2897_Rx
      Debug9_SCIM_BB2_oBackbone2_cb8b9a3c_Tx (CanIfTxPduCfg):
        CanIfTxPduCanId = 2009
        CanIfTxPduCanIdType = STANDARD_CAN
        CanIfTxPduDlc = 8
        CanIfTxPduUserTxConfirmationName = PduR_CanIfTxConfirmation
        CanIfTxPduUserTxConfirmationUL = PDUR
        CanIfTxPduId = 137
        CanIfTxPduReadNotifyStatus = false
        CanIfTxPduType = STATIC
        CanIfTxPduBufferRef = CHNL_a6b6a922
        CanIfTxPduRef = Debug9_SCIM_BB2_oBackbone2_0943a8d3_Tx
      VMCU_BB2_110P_oBackbone2_8986e413_Rx (CanIfRxPduCfg):
        CanIfRxPduCanId = 1095
        CanIfRxPduCanIdType = EXTENDED_CAN
        CanIfRxPduDlc = 8
        CanIfRxPduUserRxIndicationName = PduR_CanIfRxIndication
        CanIfRxPduUserRxIndicationUL = PDUR
        CanIfRxPduId = 206
        CanIfRxPduReadData = false
        CanIfRxPduReadNotifyStatus = false
        CanIfRxPduDlcCheck = true
        CanIfRxPduHrhIdRef = CN_Backbone2_7b3866ec_Rx
        CanIfRxPduRef = VMCU_BB2_110P_oBackbone2_a978b864_Rx
      Debug11_SCIM_BB2_oBackbone2_aec072bd_Tx (CanIfTxPduCfg):
        CanIfTxPduCanId = 2011
        CanIfTxPduCanIdType = STANDARD_CAN
        CanIfTxPduDlc = 8
        CanIfTxPduUserTxConfirmationName = PduR_CanIfTxConfirmation
        CanIfTxPduUserTxConfirmationUL = PDUR
        CanIfTxPduId = 135
        CanIfTxPduReadNotifyStatus = false
        CanIfTxPduType = STATIC
        CanIfTxPduBufferRef = CHNL_a6b6a922
        CanIfTxPduRef = Debug11_SCIM_BB2_oBackbone2_1f94972c_Tx
      VMCU_BB2_95P_oBackbone2_a1ab3e51_Rx (CanIfRxPduCfg):
        CanIfRxPduCanId = 1296
        CanIfRxPduCanIdType = EXTENDED_CAN
        CanIfRxPduDlc = 8
        CanIfRxPduUserRxIndicationName = PduR_CanIfRxIndication
        CanIfRxPduUserRxIndicationUL = PDUR
        CanIfRxPduId = 199
        CanIfRxPduReadData = false
        CanIfRxPduReadNotifyStatus = false
        CanIfRxPduDlcCheck = true
        CanIfRxPduHrhIdRef = CN_Backbone2_7b3866ec_Rx
        CanIfRxPduRef = VMCU_BB2_95P_oBackbone2_f43374f9_Rx
      VMCU_BB2_96P_oBackbone2_09efbd51_Rx (CanIfRxPduCfg):
        CanIfRxPduCanId = 1297
        CanIfRxPduCanIdType = EXTENDED_CAN
        CanIfRxPduDlc = 8
        CanIfRxPduUserRxIndicationName = PduR_CanIfRxIndication
        CanIfRxPduUserRxIndicationUL = PDUR
        CanIfRxPduId = 198
        CanIfRxPduReadData = false
        CanIfRxPduReadNotifyStatus = false
        CanIfRxPduDlcCheck = true
        CanIfRxPduHrhIdRef = CN_Backbone2_7b3866ec_Rx
        CanIfRxPduRef = VMCU_BB2_96P_oBackbone2_3d2c7c46_Rx
      Debug7_SCIM_BB2_oBackbone2_e391325d_Tx (CanIfTxPduCfg):
        CanIfTxPduCanId = 2007
        CanIfTxPduCanIdType = STANDARD_CAN
        CanIfTxPduDlc = 8
        CanIfTxPduUserTxConfirmationName = PduR_CanIfTxConfirmation
        CanIfTxPduUserTxConfirmationUL = PDUR
        CanIfTxPduId = 139
        CanIfTxPduReadNotifyStatus = false
        CanIfTxPduType = STATIC
        CanIfTxPduBufferRef = CHNL_a6b6a922
        CanIfTxPduRef = Debug7_SCIM_BB2_oBackbone2_2649483c_Tx
      6 x CanIfRxPduCfg, all with CanIfRxPduCanIdType=EXTENDED_CAN, CanIfRxPduDlc=8, CanIfRxPduUserRxIndicationName=PduR_CanIfRxIndication, CanIfRxPduUserRxIndicationUL=PDUR, CanIfRxPduReadData=false, CanIfRxPduReadNotifyStatus=false, CanIfRxPduDlcCheck=true, CanIfRxPduHrhIdRef=CN_Backbone2_7b3866ec_Rx:
        VMCU_BB2_119P_oBackbone2_54ccbb5c_Rx: CanIfRxPduCanId=1271, CanIfRxPduId=203, CanIfRxPduRef=VMCU_BB2_119P_oBackbone2_bbb6899a_Rx
        VMCU_BB2_92P_oBackbone2_4d90bf10_Rx: CanIfRxPduCanId=1380, CanIfRxPduId=181, CanIfRxPduRef=VMCU_BB2_92P_oBackbone2_4ca6666c_Rx
        VMCU_BB2_87P_oBackbone2_6e4bffd0_Rx: CanIfRxPduCanId=323, CanIfRxPduId=245, CanIfRxPduRef=VMCU_BB2_87P_oBackbone2_fa04e91f_Rx
        VMCU_BB2_86P_oBackbone2_09887ed0_Rx: CanIfRxPduCanId=310, CanIfRxPduId=246, CanIfRxPduRef=VMCU_BB2_86P_oBackbone2_0bdeecb5_Rx
        IC3_BB2_02P_oBackbone2_ceb05fa5_Rx: CanIfRxPduCanId=838, CanIfRxPduId=225, CanIfRxPduRef=IC3_BB2_02P_oBackbone2_306c24c9_Rx
        VMCU_BB2_99P_oBackbone2_6d2a3892_Rx: CanIfRxPduCanId=1300, CanIfRxPduId=196, CanIfRxPduRef=VMCU_BB2_99P_oBackbone2_66ad5a87_Rx
      Debug5_SCIM_BB2_oBackbone2_227fbf0b_Tx (CanIfTxPduCfg):
        CanIfTxPduCanId = 1957
        CanIfTxPduCanIdType = STANDARD_CAN
        CanIfTxPduDlc = 8
        CanIfTxPduUserTxConfirmationName = PduR_CanIfTxConfirmation
        CanIfTxPduUserTxConfirmationUL = PDUR
        CanIfTxPduId = 173
        CanIfTxPduReadNotifyStatus = false
        CanIfTxPduType = STATIC
        CanIfTxPduBufferRef = CHNL_a6b6a922
        CanIfTxPduRef = Debug5_SCIM_BB2_oBackbone2_a3b16af3_Tx
      CIOM_BB2_32S_FCM_Tp_oBackbone2_5e85e83d_Rx (CanIfRxPduCfg):
        CanIfRxPduCanId = 936
        CanIfRxPduCanIdType = STANDARD_CAN
        CanIfRxPduDlc = 8
        CanIfRxPduUserRxIndicationName = CanTp_RxIndication
        CanIfRxPduUserRxIndicationUL = CAN_TP
        CanIfRxPduId = 171
        CanIfRxPduReadData = false
        CanIfRxPduReadNotifyStatus = false
        CanIfRxPduDlcCheck = true
        CanIfRxPduHrhIdRef = CN_Backbone2_7b3866ec_Rx
        CanIfRxPduRef = CIOM_BB2_32S_FCM_Tp_oBackbone2_0fe14f4c_Rx
      Debug2_SCIM_BB2_oBackbone2_dbca681b_Tx (CanIfTxPduCfg):
        CanIfTxPduCanId = 1936
        CanIfTxPduCanIdType = STANDARD_CAN
        CanIfTxPduDlc = 8
        CanIfTxPduUserTxConfirmationName = PduR_CanIfTxConfirmation
        CanIfTxPduUserTxConfirmationUL = PDUR
        CanIfTxPduId = 176
        CanIfTxPduReadNotifyStatus = false
        CanIfTxPduType = STATIC
        CanIfTxPduBufferRef = CHNL_a6b6a922
        CanIfTxPduRef = Debug2_SCIM_BB2_oBackbone2_598c99a4_Tx
      8 x CanIfRxPduCfg, all with CanIfRxPduUserRxIndicationName=PduR_CanIfRxIndication, CanIfRxPduUserRxIndicationUL=PDUR, CanIfRxPduReadData=false, CanIfRxPduReadNotifyStatus=false, CanIfRxPduDlcCheck=true, CanIfRxPduHrhIdRef=CN_Backbone2_7b3866ec_Rx:
        VMCU_BB2_93P_oBackbone2_2a533e10_Rx: CanIfRxPduCanId=1383, CanIfRxPduCanIdType=EXTENDED_CAN, CanIfRxPduDlc=8, CanIfRxPduId=180, CanIfRxPduRef=VMCU_BB2_93P_oBackbone2_bd7c63c6_Rx
        IC3_BB2_03S_oBackbone2_a25cd1a7_Rx: CanIfRxPduCanId=839, CanIfRxPduCanIdType=EXTENDED_CAN, CanIfRxPduDlc=8, CanIfRxPduId=224, CanIfRxPduRef=IC3_BB2_03S_oBackbone2_d29e1810_Rx
        VMCU_BB2_89P_oBackbone2_6d4dfb13_Rx: CanIfRxPduCanId=533, CanIfRxPduCanIdType=EXTENDED_CAN, CanIfRxPduDlc=8, CanIfRxPduId=238, CanIfRxPduRef=VMCU_BB2_89P_oBackbone2_505fca74_Rx
        VMCU_BB2_106P_oBackbone2_f9c06f06_Rx: CanIfRxPduCanId=1313, CanIfRxPduCanIdType=EXTENDED_CAN, CanIfRxPduDlc=8, CanIfRxPduId=190, CanIfRxPduRef=VMCU_BB2_106P_oBackbone2_d6c53fa8_Rx
        VMCU_BB2_91P_oBackbone2_e5d43c10_Rx: CanIfRxPduCanId=1378, CanIfRxPduCanIdType=EXTENDED_CAN, CanIfRxPduDlc=8, CanIfRxPduId=182, CanIfRxPduRef=VMCU_BB2_91P_oBackbone2_85b96ed3_Rx
        AnmMsg_IC3_Backbone2_oBackbone2_cdc1c410_Rx: CanIfRxPduCanId=1715, CanIfRxPduCanIdType=STANDARD_CAN, CanIfRxPduDlc=4, CanIfRxPduId=162, CanIfRxPduRef=AnmMsg_IC3_Backbone2_oBackbone2_51836988_Rx
        VMCU_BB2_111P_oBackbone2_91387ce4_Rx: CanIfRxPduCanId=1053, CanIfRxPduCanIdType=EXTENDED_CAN, CanIfRxPduDlc=8, CanIfRxPduId=209, CanIfRxPduRef=VMCU_BB2_111P_oBackbone2_58a2bdce_Rx
        VMCU_BB2_98P_oBackbone2_0ae9b992_Rx: CanIfRxPduCanId=1299, CanIfRxPduCanIdType=EXTENDED_CAN, CanIfRxPduDlc=8, CanIfRxPduId=197, CanIfRxPduRef=VMCU_BB2_98P_oBackbone2_97775f2d_Rx
      CIOM_BB2_31S_oBackbone2_146b0516_Tx (CanIfTxPduCfg):
        CanIfTxPduCanId = 1369
        CanIfTxPduCanIdType = STANDARD_CAN
        CanIfTxPduDlc = 8
        CanIfTxPduUserTxConfirmationName = PduR_CanIfTxConfirmation
        CanIfTxPduUserTxConfirmationUL = PDUR
        CanIfTxPduId = 183
        CanIfTxPduReadNotifyStatus = false
        CanIfTxPduType = STATIC
        CanIfTxPduBufferRef = CHNL_a6b6a922
        CanIfTxPduRef = CIOM_BB2_31S_oBackbone2_5ac877df_Tx
      Debug6_SCIM_BB2_oBackbone2_836674f6_Tx (CanIfTxPduCfg):
        CanIfTxPduCanId = 1964
        CanIfTxPduCanIdType = STANDARD_CAN
        CanIfTxPduDlc = 8
        CanIfTxPduUserTxConfirmationName = PduR_CanIfTxConfirmation
        CanIfTxPduUserTxConfirmationUL = PDUR
        CanIfTxPduId = 172
        CanIfTxPduReadNotifyStatus = false
        CanIfTxPduType = STATIC
        CanIfTxPduBufferRef = CHNL_a6b6a922
        CanIfTxPduRef = Debug6_SCIM_BB2_oBackbone2_890dda7b_Tx
      DebugCtrl2_SCIM_BB2_oBackbone2_57e784a1_Rx (CanIfRxPduCfg):
        CanIfRxPduCanId = 2014
        CanIfRxPduCanIdType = STANDARD_CAN
        CanIfRxPduDlc = 8
        CanIfRxPduUserRxIndicationName = PduR_CanIfRxIndication
        CanIfRxPduUserRxIndicationUL = PDUR
        CanIfRxPduId = 254
        CanIfRxPduReadData = false
        CanIfRxPduReadNotifyStatus = false
        CanIfRxPduDlcCheck = true
        CanIfRxPduHrhIdRef = CanIfHrhCfg_DebugCtrl2_SCIM_BB2_oBackbone2_57e784a1_Rx
        CanIfRxPduRef = DebugCtrl2_SCIM_BB2_oBackbone2_ee7e3224_Rx
      Debug10_SCIM_BB2_oBackbone2_c1e84b65_Tx (CanIfTxPduCfg):
        CanIfTxPduCanId = 2010
        CanIfTxPduCanIdType = STANDARD_CAN
        CanIfTxPduDlc = 8
        CanIfTxPduUserTxConfirmationName = PduR_CanIfTxConfirmation
        CanIfTxPduUserTxConfirmationUL = PDUR
        CanIfTxPduId = 136
        CanIfTxPduReadNotifyStatus = false
        CanIfTxPduType = STATIC
        CanIfTxPduBufferRef = CHNL_a6b6a922
        CanIfTxPduRef = Debug10_SCIM_BB2_oBackbone2_b0d0056b_Tx
      VMCU_BB2_101P_oBackbone2_b2f9a5c3_Rx (CanIfRxPduCfg):
        CanIfRxPduCanId = 1302
        CanIfRxPduCanIdType = EXTENDED_CAN
        CanIfRxPduDlc = 8
        CanIfRxPduUserRxIndicationName = PduR_CanIfRxIndication
        CanIfRxPduUserRxIndicationUL = PDUR
        CanIfRxPduId = 194
        CanIfRxPduReadData = false
        CanIfRxPduReadNotifyStatus = false
        CanIfRxPduDlcCheck = true
        CanIfRxPduHrhIdRef = CN_Backbone2_7b3866ec_Rx
        CanIfRxPduRef = VMCU_BB2_101P_oBackbone2_6e502d3d_Rx
      VMCU_BB2_103P_oBackbone2_8384942d_Rx (CanIfRxPduCfg):
        CanIfRxPduCanId = 1304
        CanIfRxPduCanIdType = EXTENDED_CAN
        CanIfRxPduDlc = 8
        CanIfRxPduUserRxIndicationName = PduR_CanIfRxIndication
        CanIfRxPduUserRxIndicationUL = PDUR
        CanIfRxPduId = 192
        CanIfRxPduReadData = false
        CanIfRxPduReadNotifyStatus = false
        CanIfRxPduDlcCheck = true
        CanIfRxPduHrhIdRef = CN_Backbone2_7b3866ec_Rx
        CanIfRxPduRef = VMCU_BB2_103P_oBackbone2_56952028_Rx
      CIOM_BB2_32S_Tp_oBackbone2_8bc67a6a_Tx (CanIfTxPduCfg):
        CanIfTxPduCanId = 935
        CanIfTxPduCanIdType = STANDARD_CAN
        CanIfTxPduDlc = 8
        CanIfTxPduUserTxConfirmationName = CanTp_TxConfirmation
        CanIfTxPduUserTxConfirmationUL = CAN_TP
        CanIfTxPduId = 197
        CanIfTxPduReadNotifyStatus = false
        CanIfTxPduType = STATIC
        CanIfTxPduBufferRef = CHNL_a6b6a922
        CanIfTxPduRef = CIOM_BB2_32S_Tp_oBackbone2_f25cc990_Tx
      3 x CanIfRxPduCfg, all with CanIfRxPduCanIdType=EXTENDED_CAN, CanIfRxPduDlc=8, CanIfRxPduUserRxIndicationName=PduR_CanIfRxIndication, CanIfRxPduUserRxIndicationUL=PDUR, CanIfRxPduReadData=false, CanIfRxPduReadNotifyStatus=false, CanIfRxPduDlcCheck=true, CanIfRxPduHrhIdRef=CN_Backbone2_7b3866ec_Rx:
        VMCU_BB2_105P_oBackbone2_d003c61f_Rx: CanIfRxPduCanId=1312, CanIfRxPduId=191, CanIfRxPduRef=VMCU_BB2_105P_oBackbone2_1fda3717_Rx
        VMCU_BB2_102P_oBackbone2_9b3a0cda_Rx: CanIfRxPduCanId=1303, CanIfRxPduId=193, CanIfRxPduRef=VMCU_BB2_102P_oBackbone2_a74f2582_Rx
        VMCU_BB2_88P_oBackbone2_0a8e7a13_Rx: CanIfRxPduCanId=421, CanIfRxPduId=244, CanIfRxPduRef=VMCU_BB2_88P_oBackbone2_a185cfde_Rx
      3 x CanIfTxPduCfg, all with CanIfTxPduCanIdType=STANDARD_CAN, CanIfTxPduDlc=8, CanIfTxPduReadNotifyStatus=false, CanIfTxPduType=STATIC, CanIfTxPduBufferRef=CHNL_a6b6a922:
        CIOM_BB2_30P_oBackbone2_50f4d1bb_Tx: CanIfTxPduCanId=551, CanIfTxPduUserTxConfirmationName=NULL_PTR, CanIfTxPduUserTxConfirmationUL=NONE, CanIfTxPduId=199, CanIfTxPduRef=CIOM_BB2_30P_oBackbone2_b83a4b06_Tx
        Debug3_SCIM_BB2_oBackbone2_bb3d2eb0_Tx: CanIfTxPduCanId=1943, CanIfTxPduUserTxConfirmationName=PduR_CanIfTxConfirmation, CanIfTxPduUserTxConfirmationUL=PDUR, CanIfTxPduId=175, CanIfTxPduRef=Debug3_SCIM_BB2_oBackbone2_f6c80be3_Tx
        Debug13_SCIM_BB2_oBackbone2_7090010d_Tx: CanIfTxPduCanId=2015, CanIfTxPduUserTxConfirmationName=PduR_CanIfTxConfirmation, CanIfTxPduUserTxConfirmationUL=PDUR, CanIfTxPduId=133, CanIfTxPduRef=Debug13_SCIM_BB2_oBackbone2_9a6cb5e3_Tx
      VMCU_BB2_107P_oBackbone2_e17ef7f1_Rx (CanIfRxPduCfg):
        CanIfRxPduCanId = 1314
        CanIfRxPduCanIdType = EXTENDED_CAN
        CanIfRxPduDlc = 8
        CanIfRxPduUserRxIndicationName = PduR_CanIfRxIndication
        CanIfRxPduUserRxIndicationUL = PDUR
        CanIfRxPduId = 189
        CanIfRxPduReadData = false
        CanIfRxPduReadNotifyStatus = false
        CanIfRxPduDlcCheck = true
        CanIfRxPduHrhIdRef = CN_Backbone2_7b3866ec_Rx
        CanIfRxPduRef = VMCU_BB2_107P_oBackbone2_271f3a02_Rx
      4 x CanIfTxPduCfg, all with CanIfTxPduCanIdType=STANDARD_CAN, CanIfTxPduDlc=8, CanIfTxPduUserTxConfirmationName=PduR_CanIfTxConfirmation, CanIfTxPduUserTxConfirmationUL=PDUR, CanIfTxPduReadNotifyStatus=false, CanIfTxPduType=STATIC, CanIfTxPduBufferRef=CHNL_a6b6a922:
        Debug4_SCIM_BB2_oBackbone2_4288f9a0_Tx: CanIfTxPduCanId=1950, CanIfTxPduId=174, CanIfTxPduRef=Debug4_SCIM_BB2_oBackbone2_0cf5f8b4_Tx
        Debug14_SCIM_BB2_oBackbone2_a639aa44_Tx: CanIfTxPduCanId=2016, CanIfTxPduId=132, CanIfTxPduRef=Debug14_SCIM_BB2_oBackbone2_605146b4_Tx
        Debug24_SCIM_BB2_oBackbone2_e5e13b64_Tx: CanIfTxPduCanId=2032, CanIfTxPduId=123, CanIfTxPduRef=Debug24_SCIM_BB2_oBackbone2_8318f116_Tx
        Debug25_SCIM_BB2_oBackbone2_8ac902bc_Tx: CanIfTxPduCanId=2033, CanIfTxPduId=122, CanIfTxPduRef=Debug25_SCIM_BB2_oBackbone2_2c5c6351_Tx
      CHNL_e058b4ae (CanIfBufferCfg): CanIfBufferSize=0, CanIfTxBufferHandlingType=NONE, CanIfTxBufferMappedTxPdus=0, CanIfTxBufferMaxPduLength=8, CanIfBufferHthRef=CN_FMSNet_fce1aae5_Tx
      DebugCtrl4_SCIM_BB2_oBackbone2_df05a26b_Rx (CanIfRxPduCfg):
        CanIfRxPduCanId = 2036
        CanIfRxPduCanIdType = STANDARD_CAN
        CanIfRxPduDlc = 8
        CanIfRxPduUserRxIndicationName = PduR_CanIfRxIndication
        CanIfRxPduUserRxIndicationUL = PDUR
        CanIfRxPduId = 252
        CanIfRxPduReadData = false
        CanIfRxPduReadNotifyStatus = false
        CanIfRxPduDlcCheck = true
        CanIfRxPduHrhIdRef = CanIfHrhCfg_DebugCtrl4_SCIM_BB2_oBackbone2_df05a26b_Rx
        CanIfRxPduRef = DebugCtrl4_SCIM_BB2_oBackbone2_bb075334_Rx
      DebugCtrl9_SCIM_BB2_oBackbone2_9f4f1aa2_Rx (CanIfRxPduCfg):
        CanIfRxPduCanId = 2041
        CanIfRxPduCanIdType = STANDARD_CAN
        CanIfRxPduDlc = 8
        CanIfRxPduUserRxIndicationName = PduR_CanIfRxIndication
        CanIfRxPduUserRxIndicationUL = PDUR
        CanIfRxPduId = 247
        CanIfRxPduReadData = false
        CanIfRxPduReadNotifyStatus = false
        CanIfRxPduDlcCheck = true
        CanIfRxPduHrhIdRef = CanIfHrhCfg_DebugCtrl9_SCIM_BB2_oBackbone2_9f4f1aa2_Rx
        CanIfRxPduRef = DebugCtrl9_SCIM_BB2_oBackbone2_beb10353_Rx
      Debug16_SCIM_BB2_oBackbone2_7869d9f4_Tx (CanIfTxPduCfg):
        CanIfTxPduCanId = 2018
        CanIfTxPduCanIdType = STANDARD_CAN
        CanIfTxPduDlc = 8
        CanIfTxPduUserTxConfirmationName = PduR_CanIfTxConfirmation
        CanIfTxPduUserTxConfirmationUL = PDUR
        CanIfTxPduId = 130
        CanIfTxPduReadNotifyStatus = false
        CanIfTxPduType = STATIC
        CanIfTxPduBufferRef = CHNL_a6b6a922
        CanIfTxPduRef = Debug16_SCIM_BB2_oBackbone2_e5a9647b_Tx
      Debug27_SCIM_BB2_oBackbone2_5499710c_Tx (CanIfTxPduCfg):
        CanIfTxPduCanId = 2044
        CanIfTxPduCanIdType = STANDARD_CAN
        CanIfTxPduDlc = 8
        CanIfTxPduUserTxConfirmationName = PduR_CanIfTxConfirmation
        CanIfTxPduUserTxConfirmationUL = PDUR
        CanIfTxPduId = 120
        CanIfTxPduReadNotifyStatus = false
        CanIfTxPduType = STATIC
        CanIfTxPduBufferRef = CHNL_a6b6a922
        CanIfTxPduRef = Debug27_SCIM_BB2_oBackbone2_a9a4419e_Tx
      CHNL_17344684 (CanIfBufferCfg):
        CanIfBufferSize = 0
        CanIfTxBufferHandlingType = NONE
        CanIfTxBufferMappedTxPdus = 0
        CanIfTxBufferMaxPduLength = 8
        CanIfBufferHthRef = CN_Backbone1J1939_0b1f4bae_Tx
      Debug26_SCIM_BB2_oBackbone2_3bb148d4_Tx (CanIfTxPduCfg):
        CanIfTxPduCanId = 2034
        CanIfTxPduCanIdType = STANDARD_CAN
        CanIfTxPduDlc = 8
        CanIfTxPduUserTxConfirmationName = PduR_CanIfTxConfirmation
        CanIfTxPduUserTxConfirmationUL = PDUR
        CanIfTxPduId = 121
        CanIfTxPduReadNotifyStatus = false
        CanIfTxPduType = STATIC
        CanIfTxPduBufferRef = CHNL_a6b6a922
        CanIfTxPduRef = Debug26_SCIM_BB2_oBackbone2_06e0d3d9_Tx
      CHNL_53cce282 (CanIfBufferCfg):
        CanIfBufferSize = 0
        CanIfTxBufferHandlingType = NONE
        CanIfTxBufferMappedTxPdus = 0
        CanIfTxBufferMaxPduLength = 8
        CanIfBufferHthRef = CN_SecuritySubnet_e7a0ee54_Tx
      Debug18_SCIM_BB2_oBackbone2_0e4b8927_Tx (CanIfTxPduCfg):
        CanIfTxPduCanId = 2020
        CanIfTxPduCanIdType = STANDARD_CAN
        CanIfTxPduDlc = 8
        CanIfTxPduUserTxConfirmationName = PduR_CanIfTxConfirmation
        CanIfTxPduUserTxConfirmationUL = PDUR
        CanIfTxPduId = 128
        CanIfTxPduReadNotifyStatus = false
        CanIfTxPduType = STATIC
        CanIfTxPduBufferRef = CHNL_a6b6a922
        CanIfTxPduRef = Debug18_SCIM_BB2_oBackbone2_caa38494_Tx
      DebugCtrl6_SCIM_BB2_oBackbone2_118b4212_Rx (CanIfRxPduCfg):
        CanIfRxPduCanId = 2038
        CanIfRxPduCanIdType = STANDARD_CAN
        CanIfRxPduDlc = 8
        CanIfRxPduUserRxIndicationName = PduR_CanIfRxIndication
        CanIfRxPduUserRxIndicationUL = PDUR
        CanIfRxPduId = 250
        CanIfRxPduReadData = false
        CanIfRxPduReadNotifyStatus = false
        CanIfRxPduDlcCheck = true
        CanIfRxPduHrhIdRef = CanIfHrhCfg_DebugCtrl6_SCIM_BB2_oBackbone2_118b4212_Rx
        CanIfRxPduRef = DebugCtrl6_SCIM_BB2_oBackbone2_3eff71fb_Rx
      Debug17_SCIM_BB2_oBackbone2_1741e02c_Tx (CanIfTxPduCfg):
        CanIfTxPduCanId = 2019
        CanIfTxPduCanIdType = STANDARD_CAN
        CanIfTxPduDlc = 8
        CanIfTxPduUserTxConfirmationName = PduR_CanIfTxConfirmation
        CanIfTxPduUserTxConfirmationUL = PDUR
        CanIfTxPduId = 129
        CanIfTxPduReadNotifyStatus = false
        CanIfTxPduType = STATIC
        CanIfTxPduBufferRef = CHNL_a6b6a922
        CanIfTxPduRef = Debug17_SCIM_BB2_oBackbone2_4aedf63c_Tx
      Debug22_SCIM_BB2_oBackbone2_5c60a9f5_Tx (CanIfTxPduCfg):
        CanIfTxPduCanId = 2024
        CanIfTxPduCanIdType = STANDARD_CAN
        CanIfTxPduDlc = 8
        CanIfTxPduUserTxConfirmationName = PduR_CanIfTxConfirmation
        CanIfTxPduUserTxConfirmationUL = PDUR
        CanIfTxPduId = 124
        CanIfTxPduReadNotifyStatus = false
        CanIfTxPduType = STATIC
        CanIfTxPduBufferRef = CHNL_a6b6a922
        CanIfTxPduRef = Debug22_SCIM_BB2_oBackbone2_d6619006_Tx
      CHNL_df893ad5 (CanIfBufferCfg):
        CanIfBufferSize = 0
        CanIfTxBufferHandlingType = NONE
        CanIfTxBufferMappedTxPdus = 0
        CanIfTxBufferMaxPduLength = 8
        CanIfBufferHthRef = CN_CabSubnet_9ea693f1_Tx
      DebugCtrl3_SCIM_BB2_oBackbone2_dd1877bd_Rx (CanIfRxPduCfg):
        CanIfRxPduCanId = 2035
        CanIfRxPduCanIdType = STANDARD_CAN
        CanIfRxPduDlc = 8
        CanIfRxPduUserRxIndicationName = PduR_CanIfRxIndication
        CanIfRxPduUserRxIndicationUL = PDUR
        CanIfRxPduId = 253
        CanIfRxPduReadData = false
        CanIfRxPduReadNotifyStatus = false
        CanIfRxPduDlcCheck = true
        CanIfRxPduHrhIdRef = CanIfHrhCfg_DebugCtrl3_SCIM_BB2_oBackbone2_dd1877bd_Rx
        CanIfRxPduRef = DebugCtrl3_SCIM_BB2_oBackbone2_413aa063_Rx
      Debug20_SCIM_BB2_oBackbone2_8230da45_Tx (CanIfTxPduCfg):
        CanIfTxPduCanId = 2022
        CanIfTxPduCanIdType = STANDARD_CAN
        CanIfTxPduDlc = 8
        CanIfTxPduUserTxConfirmationName = PduR_CanIfTxConfirmation
        CanIfTxPduUserTxConfirmationUL = PDUR
        CanIfTxPduId = 126
        CanIfTxPduReadNotifyStatus = false
        CanIfTxPduType = STATIC
        CanIfTxPduBufferRef = CHNL_a6b6a922
        CanIfTxPduRef = Debug20_SCIM_BB2_oBackbone2_5399b2c9_Tx
      DebugCtrl5_SCIM_BB2_oBackbone2_55fa5177_Rx (CanIfRxPduCfg):
        CanIfRxPduCanId = 2037
        CanIfRxPduCanIdType = STANDARD_CAN
        CanIfRxPduDlc = 8
        CanIfRxPduUserRxIndicationName = PduR_CanIfRxIndication
        CanIfRxPduUserRxIndicationUL = PDUR
        CanIfRxPduId = 251
        CanIfRxPduReadData = false
        CanIfRxPduReadNotifyStatus = false
        CanIfRxPduDlcCheck = true
        CanIfRxPduHrhIdRef = CanIfHrhCfg_DebugCtrl5_SCIM_BB2_oBackbone2_55fa5177_Rx
        CanIfRxPduRef = DebugCtrl5_SCIM_BB2_oBackbone2_1443c173_Rx
      Debug21_SCIM_BB2_oBackbone2_ed18e39d_Tx (CanIfTxPduCfg):
        CanIfTxPduCanId = 2023
        CanIfTxPduCanIdType = STANDARD_CAN
        CanIfTxPduDlc = 8
        CanIfTxPduUserTxConfirmationName = PduR_CanIfTxConfirmation
        CanIfTxPduUserTxConfirmationUL = PDUR
        CanIfTxPduId = 125
        CanIfTxPduReadNotifyStatus = false
        CanIfTxPduType = STATIC
        CanIfTxPduBufferRef = CHNL_a6b6a922
        CanIfTxPduRef = Debug21_SCIM_BB2_oBackbone2_fcdd208e_Tx
      Debug15_SCIM_BB2_oBackbone2_c911939c_Tx (CanIfTxPduCfg):
        CanIfTxPduCanId = 2017
        CanIfTxPduCanIdType = STANDARD_CAN
        CanIfTxPduDlc = 8
        CanIfTxPduUserTxConfirmationName = PduR_CanIfTxConfirmation
        CanIfTxPduUserTxConfirmationUL = PDUR
        CanIfTxPduId = 131
        CanIfTxPduReadNotifyStatus = false
        CanIfTxPduType = STATIC
        CanIfTxPduBufferRef = CHNL_a6b6a922
        CanIfTxPduRef = Debug15_SCIM_BB2_oBackbone2_cf15d4f3_Tx
      DebugCtrl8_SCIM_BB2_oBackbone2_15b0e9be_Rx (CanIfRxPduCfg):
        CanIfRxPduCanId = 2040
        CanIfRxPduCanIdType = STANDARD_CAN
        CanIfRxPduDlc = 8
        CanIfRxPduUserRxIndicationName = PduR_CanIfRxIndication
        CanIfRxPduUserRxIndicationUL = PDUR
        CanIfRxPduId = 248
        CanIfRxPduReadData = false
        CanIfRxPduReadNotifyStatus = false
        CanIfRxPduDlcCheck = true
        CanIfRxPduHrhIdRef = CanIfHrhCfg_DebugCtrl8_SCIM_BB2_oBackbone2_15b0e9be_Rx
        CanIfRxPduRef = DebugCtrl8_SCIM_BB2_oBackbone2_11f59114_Rx
      Debug19_SCIM_BB2_oBackbone2_6163b0ff_Tx (CanIfTxPduCfg):
        CanIfTxPduCanId = 2021
        CanIfTxPduCanIdType = STANDARD_CAN
        CanIfTxPduDlc = 8
        CanIfTxPduUserTxConfirmationName = PduR_CanIfTxConfirmation
        CanIfTxPduUserTxConfirmationUL = PDUR
        CanIfTxPduId = 127
        CanIfTxPduReadNotifyStatus = false
        CanIfTxPduType = STATIC
        CanIfTxPduBufferRef = CHNL_a6b6a922
        CanIfTxPduRef = Debug19_SCIM_BB2_oBackbone2_65e716d3_Tx
      DebugCtrl7_SCIM_BB2_oBackbone2_9b74b10e_Rx (CanIfRxPduCfg):
        CanIfRxPduCanId = 2039
        CanIfRxPduCanIdType = STANDARD_CAN
        CanIfRxPduDlc = 8
        CanIfRxPduUserRxIndicationName = PduR_CanIfRxIndication
        CanIfRxPduUserRxIndicationUL = PDUR
        CanIfRxPduId = 249
        CanIfRxPduReadData = false
        CanIfRxPduReadNotifyStatus = false
        CanIfRxPduDlcCheck = true
        CanIfRxPduHrhIdRef = CanIfHrhCfg_DebugCtrl7_SCIM_BB2_oBackbone2_9b74b10e_Rx
        CanIfRxPduRef = DebugCtrl7_SCIM_BB2_oBackbone2_91bbe3bc_Rx
      Debug28_SCIM_BB2_oBackbone2_4d931807_Tx (CanIfTxPduCfg):
        CanIfTxPduCanId = 2045
        CanIfTxPduCanIdType = STANDARD_CAN
        CanIfTxPduDlc = 8
        CanIfTxPduUserTxConfirmationName = PduR_CanIfTxConfirmation
        CanIfTxPduUserTxConfirmationUL = PDUR
        CanIfTxPduId = 119
        CanIfTxPduReadNotifyStatus = false
        CanIfTxPduType = STATIC
        CanIfTxPduBufferRef = CHNL_a6b6a922
        CanIfTxPduRef = Debug28_SCIM_BB2_oBackbone2_29ea3336_Tx
    CanIfPrivateCfg:
      CanIfPrivateSoftwareFilterType = LINEAR
      CanIfPrivateDlcCheck = true
      CanIfSupportTTCAN = false
      CanIfTransceiverMapping = false
      CanIfTransceiverHandling = false
      CanIfSupportExtendedIds = true
      CanIfSupportNmOsek = false
      CanIfTxBufferType = BIT_QUEUE
      CanIfOptimizeOneController = false
      CanIfWakeupSupport = false
      CanIfStaticFdTxBufferSupport = false
      CanIfRxSearchConsiderMsgType = false
      CanIfMultipleBasicCANTxObjects = false
      CanIfTxBufferFifoSupport = false
      CanIfSetPduReceptionModeSupport = false
      CanIfDataChecksumRxSupport = false
      CanIfDataChecksumTxSupport = false
    CanIfPublicCfg:
      CanIfPublicPnSupport = false
      CanIfPublicCancelTransmitSupport = true
      CanIfPublicDevErrorDetect = false
      CanIfPublicHandleTypeEnum = UINT8
      CanIfPublicMultipleDrvSupport = false
      CanIfPublicNumberOfCanHwUnits = 1
      CanIfPublicReadRxPduDataApi = false
      CanIfPublicReadRxPduNotifyStatusApi = false
      CanIfPublicReadTxPduNotifyStatusApi = false
      CanIfPublicSetDynamicTxIdApi = false
      CanIfPublicTxBuffering = true
      CanIfPublicTxConfirmPollingSupport = false
      CanIfPublicVersionInfoApi = false
      CanIfPublicWakeupCheckValidSupport = false
      CanIfPnWakeupTxPduFilterSupport = false
      CanIfPnTrcvHandlingSupport = false
      CanIfJ1939DynAddrSupport = DISABLED
      CanIfSafeBswChecks = false
      CanIfSetBaudrateApi = false
