AUTOSAR XML (schema 4-2-1)
package /Resource
  module config Resource: implementation-config-variant=VARIANT-PRE-COMPILE
    CommonPublishedInformation:
      ArReleaseMajorVersion = 4
      ArReleaseMinorVersion = 2
      ArReleaseRevisionVersion = 2
      ModuleId = 0
      SwMajorVersion = 1
      SwMinorVersion = 0
      SwPatchVersion = 0
      VendorId = 43
    ResourceGeneral: ResourceSubderivative=mpc5746c_lqfp176
