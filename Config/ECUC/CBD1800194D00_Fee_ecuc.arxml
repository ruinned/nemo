AUTOSAR XML (schema 4-2-1)
package /ActiveEcuC
  module config Fee: implementation-config-variant=VARIANT-PRE-COMPILE, module-description=Fee_Impl
    FeeGeneral:
      FeeDevErrorDetect = false
      FeeVersionInfoApi = false
      FeePollingMode = false
      FeeSetModeSupported = true
      FeeIndex = 0
      FeeInternalBufferSize = 64
      FeeMainFunctionPeriod = 0.005
      FeeMainFunctionTriggering = FixedCycleTime
      FeeSafeBswChecks = false
      FeeNvmJobErrorNotification = NvM_JobErrorNotification
      FeeNvmJobEndNotification = NvM_JobEndNotification
      FeeDevErrorChecks: FeeDetErrorhook=Det_ReportError, FeeDetIncludeFile=Det.h
    FeeSpecificFeatures:
      FeeApplErrorCallbackFunction = Appl_FeeCriticalErrorCallback
      FeeApplErrorCallbackIncludeFile = ApplMain.h
      FeeGetEraseCycleApi = false
      FeeGetWriteCycleApi = false
      FeeUseApplErrorCallback = false
      FeeUseJobCache = false
      FeeForceSectorSwitchApi = false
      FeeDataConversionApi = false
      FeeFblConfig = false
      FeeMaxLinkTableSize = 4095
      FeeFssControlApi = false
    FeePublishedInformation: FeeBlockOverhead=2, FeeMaximumBlockingTime=1, FeePageOverhead=0, FeeChunkHeader=16, FeeChunkLink=8, FeeSectorHeader=8
    FeePartitionConfiguration:
      FeeBssThresholdReserved = 8192
      FeeFssThresholdReserved = 4096
      FeeLowerSectorAddress = 0
      FeeLowerSectorSize = 16384
      FeeUpperSectorAddress = 16384
      FeeUpperSectorSize = 16384
      FeeAddressAlignment = 16
      FeeWriteAlignment = 8
      FeePartitionDevice = FlsConfigSet
    4 x FeeBlockConfiguration, all with FeeBlockIdFixed=false, FeeBlockIsCritical=false, FeeImmediateData=false, FeeNumberOfChunkInstances=1, FeeNumberOfWriteCycles=10000, FeePartition=FeePartitionConfiguration, FeeDeviceIndex=FlsGeneral:
      FeeConfigBlock: FeeBlockNumber=64, FeeBlockSize=4, FeeNumberOfDatasets=2, FeeBlockId=0
      FeeDemStatusDataBlock: FeeBlockNumber=48, FeeBlockSize=432, FeeNumberOfDatasets=1, FeeBlockId=3
      FeeDemPrimaryDataBlock0: FeeBlockNumber=32, FeeBlockSize=14, FeeNumberOfDatasets=1, FeeBlockId=1
      FeeDemAdminDataBlock: FeeBlockNumber=16, FeeBlockSize=12, FeeNumberOfDatasets=1, FeeBlockId=2
