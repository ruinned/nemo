AUTOSAR XML (schema 4-2-1)
package /Dio
  module config Dio: implementation-config-variant=VARIANT-PRE-COMPILE, module-description=Dio_Impl
    CommonPublishedInformation:
      ArReleaseMajorVersion = 4
      ArReleaseMinorVersion = 2
      ArReleaseRevisionVersion = 2
      ModuleId = 120
      SwMajorVersion = 1
      SwMinorVersion = 0
      SwPatchVersion = 0
      VendorId = 43
    DioConfig
      10 x DioPort:
        DioPort_A: DioPortId=0
          6 x DioChannel:
            LIN6EN: DioChannelId=14
            LIN5EN: DioChannelId=15
            CAN2STB: DioChannelId=2
            Parked_Ctrl: DioChannelId=5
            Living_Ctrl: DioChannelId=6
            V12DCDC_EN: DioChannelId=12
        DioPort_B: DioPortId=1
        DioPort_C: DioPortId=2
          4 x DioChannel:
            LIN_SECURITY_EN: DioChannelId=12
            LIN_PWR_FAULTRST: DioChannelId=2
            LIN_IPS_PWR_SEN: DioChannelId=3
            CAN1STB: DioChannelId=9
        DioPort_D: DioPortId=3
          LFIC_IRQ (DioChannel): DioChannelId=1
          RF_IRQ (DioChannel): DioChannelId=0
        DioPort_E: DioPortId=4
          7 x DioChannel:
            LIN3_EN: DioChannelId=10
            CAPA_SNSR_OUTPUT_1_2: DioChannelId=6
            CAN5STB: DioChannelId=1
            CAN6STB: DioChannelId=2
            DOOR_ACC_INTERF_1: DioChannelId=3
            DOOR_ACC_INTERF_2: DioChannelId=5
            LF_IC_PWR_SHUTDOWN: DioChannelId=12
        DioPort_F: DioPortId=5
          LIN4_EN (DioChannel): DioChannelId=8
          CAN3_STB (DioChannel): DioChannelId=9
        DioPort_G: DioPortId=6
          RFIC_NRES (DioChannel): DioChannelId=10
          LFIC_NRES (DioChannel): DioChannelId=12
        DioPort_H: DioPortId=7
          5 x DioChannel:
            DOWHS_DIAG_EN: DioChannelId=11
            DOWHS_SEL: DioChannelId=12
            Parked_PullUPCtrl: DioChannelId=13
            LIN1_EN: DioChannelId=14
            Living_PullUPCtrl: DioChannelId=15
        DioPort_I: DioPortId=8
          8 x DioChannel:
            DOBHS2_Ctrl: DioChannelId=11
            DOBHS3_Ctrl: DioChannelId=12
            DOBHS4_Ctrl: DioChannelId=13
            IPS_PWR_SEL1: DioChannelId=4
            IPS_PWR_SEL0: DioChannelId=5
            CAN4_STB: DioChannelId=7
            DOBHS1_Ctrl: DioChannelId=8
            DOBHS_IPS2_FAULT: DioChannelId=15
        DioPort_J: DioPortId=9
          3 x DioChannel:
            LIN2_EN: DioChannelId=4
            DOBHS_IPS1_FAULT: DioChannelId=0
            DOWHS_IPS_FAULT: DioChannelId=2
    DioGeneral:
      DioDevErrorDetect = true
      DioEnableUserModeSupport = false
      DioFlipChannelApi = true
      DioMaskedWritePortApi = false
      DioReadZeroForUndefinedPortPins = true
      DioReversePortBits = false
      DioVersionInfoApi = true
