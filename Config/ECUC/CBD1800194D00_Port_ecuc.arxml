AUTOSAR XML (schema 4-2-1)
package /Port
  module config Port: implementation-config-variant=VARIANT-POST-BUILD, module-description=Port_Impl
    CommonPublishedInformation:
      ArReleaseMajorVersion = 4
      ArReleaseMinorVersion = 2
      ArReleaseRevisionVersion = 2
      ModuleId = 124
      SwMajorVersion = 1
      SwMinorVersion = 0
      SwPatchVersion = 0
      VendorId = 43
    PortConfigSet
      NotUsedPortPin: PortPinDirection=PORT_PIN_IN, PortPinLevelValue=PORT_PIN_LEVEL_LOW, PortPinOde=false, PortPinWpe=false, PortPinWps=false
      PortContainer_0 (PortContainer): PortNumberOfPortPins=116
        116 x PortPin, all with PortPinDirectionChangeable=true, PortPinHysteresisControl=false, PortPinInitialMode=PORT_GPIO_MODE, PortPinModeChangeable=true, PortPinOde=false, PortPinSafeMode=false, PortPinSlewRate=HalfDriveWithSlewRate, PortPinWithReadBack=false, PortPinWpe=false, PortPinWps=false:
          PortPin_PA12_12V_SHUTDOWN: PortPinDirection=PORT_PIN_OUT, PortPinId=10, PortPinLevelValue=PORT_PIN_LEVEL_HIGH, PortPinMode=GPIO, PortPinPcr=12
          PortPin_PA13_REG_WDT_OUT: PortPinDirection=PORT_PIN_OUT, PortPinId=11, PortPinLevelValue=PORT_PIN_LEVEL_LOW, PortPinMode=EMIOS0_E0UC_29_Y_OUT, PortPinPcr=13
          PortPin_PA14_LIN_BUS6_EN: PortPinDirection=PORT_PIN_OUT, PortPinId=12, PortPinLevelValue=PORT_PIN_LEVEL_HIGH, PortPinMode=GPIO, PortPinPcr=14
          PortPin_PA15_LIN_BUS5_EN: PortPinDirection=PORT_PIN_OUT, PortPinId=13, PortPinLevelValue=PORT_PIN_LEVEL_HIGH, PortPinMode=GPIO, PortPinPcr=15
          PortPin_PA2_CAN2_STB: PortPinDirection=PORT_PIN_OUT, PortPinId=1, PortPinLevelValue=PORT_PIN_LEVEL_LOW, PortPinMode=GPIO, PortPinPcr=2
          PortPin_PA5_Parked_Ctrl: PortPinDirection=PORT_PIN_OUT, PortPinId=3, PortPinLevelValue=PORT_PIN_LEVEL_HIGH, PortPinMode=GPIO, PortPinPcr=5
          PortPin_PA6_Living_Ctrl: PortPinDirection=PORT_PIN_OUT, PortPinId=4, PortPinLevelValue=PORT_PIN_LEVEL_HIGH, PortPinMode=GPIO, PortPinPcr=6
          PortPin_PA7_LS_PWM1_ADCMON: PortPinDirection=PORT_PIN_IN, PortPinId=5, PortPinLevelValue=PORT_PIN_LEVEL_LOW, PortPinMode=ADC_1_ADC1_S_8, PortPinPcr=7
          PortPin_PA8_LS_PWM2_ADCMON: PortPinDirection=PORT_PIN_IN, PortPinId=6, PortPinLevelValue=PORT_PIN_LEVEL_LOW, PortPinMode=ADC_1_ADC1_S_9, PortPinPcr=8
          PortPin_PA9_LS_PWM3_ADCMON: PortPinDirection=PORT_PIN_IN, PortPinId=7, PortPinLevelValue=PORT_PIN_LEVEL_LOW, PortPinMode=ADC_1_ADC1_S_10, PortPinPcr=9
          PortPin_PB0_CAN3_TX: PortPinDirection=PORT_PIN_OUT, PortPinId=14, PortPinLevelValue=PORT_PIN_LEVEL_LOW, PortPinMode=FlexCAN_0_TX, PortPinPcr=16
          PortPin_PB10_ADI_3: PortPinDirection=PORT_PIN_IN, PortPinId=24, PortPinLevelValue=PORT_PIN_LEVEL_LOW, PortPinMode=ADC_0_ADC0_S_2, PortPinPcr=26
          PortPin_PB12_DOWHS1_MON: PortPinDirection=PORT_PIN_IN, PortPinId=25, PortPinLevelValue=PORT_PIN_LEVEL_LOW, PortPinMode=ADC_0_ADC0_X_0, PortPinPcr=28
          PortPin_PB13_DOWHS2_MON: PortPinDirection=PORT_PIN_IN, PortPinId=26, PortPinLevelValue=PORT_PIN_LEVEL_LOW, PortPinMode=ADC_0_ADC0_X_1, PortPinPcr=29
          PortPin_PB1_CAN3_RX: PortPinDirection=PORT_PIN_IN, PortPinId=15, PortPinLevelValue=PORT_PIN_LEVEL_LOW, PortPinMode=FlexCAN_0_RX, PortPinPcr=17
          PortPin_PB3_LIN2_RX: PortPinDirection=PORT_PIN_IN, PortPinId=17, PortPinLevelValue=PORT_PIN_LEVEL_LOW, PortPinMode=LIN_0_LIN0RX, PortPinPcr=19
          PortPin_PB4_DOBHS_IPS1_CS: PortPinDirection=PORT_PIN_IN, PortPinId=18, PortPinLevelValue=PORT_PIN_LEVEL_LOW, PortPinMode=ADC_1_ADC1_P_0, PortPinPcr=20
          PortPin_PB5_DOBHS_IPS2_CS: PortPinDirection=PORT_PIN_IN, PortPinId=19, PortPinLevelValue=PORT_PIN_LEVEL_LOW, PortPinMode=ADC_1_ADC1_P_1, PortPinPcr=21
          PortPin_PB6_DOWHS_IPS_CS: PortPinDirection=PORT_PIN_IN, PortPinId=20, PortPinLevelValue=PORT_PIN_LEVEL_LOW, PortPinMode=ADC_1_ADC1_P_2, PortPinPcr=22
          PortPin_PB8_ADI_2: PortPinDirection=PORT_PIN_IN, PortPinId=22, PortPinLevelValue=PORT_PIN_LEVEL_LOW, PortPinMode=ADC_0_ADC0_S_0, PortPinPcr=24
          PortPin_PB9_ADI_1: PortPinDirection=PORT_PIN_IN, PortPinId=23, PortPinLevelValue=PORT_PIN_LEVEL_LOW, PortPinMode=ADC_0_ADC0_S_1, PortPinPcr=25
          PortPin_PC0_DEBUG_TDI: PortPinDirection=PORT_PIN_IN, PortPinId=29, PortPinLevelValue=PORT_PIN_LEVEL_LOW, PortPinMode=DCI_TDI, PortPinPcr=32
          PortPin_PC10_CAN4_TX: PortPinDirection=PORT_PIN_OUT, PortPinId=38, PortPinLevelValue=PORT_PIN_LEVEL_LOW, PortPinMode=FlexCAN_1_TX, PortPinPcr=42
          PortPin_PC11_CAN4_RX: PortPinDirection=PORT_PIN_IN, PortPinId=39, PortPinLevelValue=PORT_PIN_LEVEL_LOW, PortPinMode=FlexCAN_1_RX, PortPinPcr=43
          PortPin_PC12_LIN_BUS_SECURITY_EN: PortPinDirection=PORT_PIN_OUT, PortPinId=40, PortPinLevelValue=PORT_PIN_LEVEL_LOW, PortPinMode=GPIO, PortPinPcr=44
          PortPin_PC14_CAN1_TX: PortPinDirection=PORT_PIN_OUT, PortPinId=41, PortPinLevelValue=PORT_PIN_LEVEL_LOW, PortPinMode=FlexCAN_4_TX, PortPinPcr=46
          PortPin_PC15_CAN1_RX: PortPinDirection=PORT_PIN_IN, PortPinId=42, PortPinLevelValue=PORT_PIN_LEVEL_LOW, PortPinMode=FlexCAN_4_RX, PortPinPcr=47
          PortPin_PC1_DEBUG_TDO: PortPinDirection=PORT_PIN_OUT, PortPinId=30, PortPinLevelValue=PORT_PIN_LEVEL_LOW, PortPinMode=DCI_TDO, PortPinPcr=33
          PortPin_PC2_LIN_PWR_IPS_FAULTRST: PortPinDirection=PORT_PIN_OUT, PortPinId=31, PortPinLevelValue=PORT_PIN_LEVEL_LOW, PortPinMode=GPIO, PortPinPcr=34
          PortPin_PC3_IPS_PWR_SEN: PortPinDirection=PORT_PIN_OUT, PortPinId=32, PortPinLevelValue=PORT_PIN_LEVEL_LOW, PortPinMode=GPIO, PortPinPcr=35
          PortPin_PC4_CAN6_RX: PortPinDirection=PORT_PIN_IN, PortPinId=33, PortPinLevelValue=PORT_PIN_LEVEL_LOW, PortPinMode=FlexCAN_3_RX, PortPinPcr=36
          PortPin_PC5_CAN6_TX: PortPinDirection=PORT_PIN_OUT, PortPinId=34, PortPinLevelValue=PORT_PIN_LEVEL_LOW, PortPinMode=FlexCAN_3_TX, PortPinPcr=37
          PortPin_PC6_LIN_BUS5_TX: PortPinDirection=PORT_PIN_OUT, PortPinId=35, PortPinLevelValue=PORT_PIN_LEVEL_LOW, PortPinMode=LIN_1_LIN1TX, PortPinPcr=38
          PortPin_PC7_LIN_BUS5_RX: PortPinDirection=PORT_PIN_IN, PortPinId=36, PortPinLevelValue=PORT_PIN_LEVEL_LOW, PortPinMode=LIN_1_LIN1RX, PortPinPcr=39
          PortPin_PC9_CAN1_STB: PortPinDirection=PORT_PIN_OUT, PortPinId=37, PortPinLevelValue=PORT_PIN_LEVEL_LOW, PortPinMode=GPIO, PortPinPcr=41
          PortPin_PD0_RF_IRQ: PortPinDirection=PORT_PIN_IN, PortPinId=43, PortPinLevelValue=PORT_PIN_LEVEL_LOW, PortPinMode=WKPU_WKPU_27, PortPinPcr=48
          PortPin_PD10_HS_LIN1_IPS_MULTI: PortPinDirection=PORT_PIN_IN, PortPinId=51, PortPinLevelValue=PORT_PIN_LEVEL_LOW, PortPinMode=ADC_1_ADC1_P_14, PortPinPcr=58
          PortPin_PD12_HS_PWM1_OUT: PortPinDirection=PORT_PIN_OUT, PortPinId=52, PortPinLevelValue=PORT_PIN_LEVEL_LOW, PortPinMode=EMIOS0_E0UC_24_X_OUT, PortPinPcr=60
          PortPin_PD13_DOWHS2_Ctrl: PortPinDirection=PORT_PIN_OUT, PortPinId=53, PortPinLevelValue=PORT_PIN_LEVEL_LOW, PortPinMode=EMIOS0_E0UC_25_Y_OUT, PortPinPcr=61
          PortPin_PD1_LFIC_IRQ: PortPinDirection=PORT_PIN_IN, PortPinId=9, PortPinLevelValue=PORT_PIN_LEVEL_LOW, PortPinMode=WKPU_WKPU_28, PortPinPcr=49
          PortPin_PD2_DOBHS3_MON: PortPinDirection=PORT_PIN_IN, PortPinId=45, PortPinLevelValue=PORT_PIN_LEVEL_LOW, PortPinMode=ADC_1_ADC1_P_6, PortPinPcr=50
          PortPin_PD3_DOBHS4_MON: PortPinDirection=PORT_PIN_IN, PortPinId=46, PortPinLevelValue=PORT_PIN_LEVEL_LOW, PortPinMode=ADC_1_ADC1_P_7, PortPinPcr=51
          PortPin_PD4_PS_PARKED_MON: PortPinDirection=PORT_PIN_IN, PortPinId=47, PortPinLevelValue=PORT_PIN_LEVEL_LOW, PortPinMode=ADC_1_ADC1_P_8, PortPinPcr=52
          PortPin_PD5_PS_LIVING_MON: PortPinDirection=PORT_PIN_IN, PortPinId=48, PortPinLevelValue=PORT_PIN_LEVEL_LOW, PortPinMode=ADC_1_ADC1_P_9, PortPinPcr=53
          PortPin_PD7_B_PLUS_MON: PortPinDirection=PORT_PIN_IN, PortPinId=49, PortPinLevelValue=PORT_PIN_LEVEL_LOW, PortPinMode=ADC_1_ADC1_P_11, PortPinPcr=55
          PortPin_PD8_DC2DC_MON: PortPinDirection=PORT_PIN_IN, PortPinId=50, PortPinLevelValue=PORT_PIN_LEVEL_LOW, PortPinMode=ADC_1_ADC1_P_12, PortPinPcr=56
          PortPin_PE10_LIN_BUS3_EN: PortPinDirection=PORT_PIN_OUT, PortPinId=64, PortPinLevelValue=PORT_PIN_LEVEL_HIGH, PortPinMode=GPIO, PortPinPcr=74
          PortPin_PE12_LF_IC_PWR_SHUTDOWN: PortPinDirection=PORT_PIN_OUT, PortPinId=65, PortPinLevelValue=PORT_PIN_LEVEL_LOW, PortPinMode=GPIO, PortPinPcr=76
          PortPin_PE13_CAN1_TERM_H1: PortPinDirection=PORT_PIN_IN, PortPinId=66, PortPinLevelValue=PORT_PIN_LEVEL_LOW, PortPinMode=ADC_1_ADC1_X_3, PortPinPcr=77
          PortPin_PE15_RFIC_SPI_CLK: PortPinDirection=PORT_PIN_OUT, PortPinId=68, PortPinLevelValue=PORT_PIN_LEVEL_LOW, PortPinMode=SPI_2_SCLK_2_OUT, PortPinPcr=79
          PortPin_PE1_CAN5_STB: PortPinDirection=PORT_PIN_OUT, PortPinId=56, PortPinLevelValue=PORT_PIN_LEVEL_LOW, PortPinMode=GPIO, PortPinPcr=65
          PortPin_PE2_CAN6_STB: PortPinDirection=PORT_PIN_OUT, PortPinId=57, PortPinLevelValue=PORT_PIN_LEVEL_LOW, PortPinMode=GPIO, PortPinPcr=66
          PortPin_PE3_DOOR_ACC_INTERF9: PortPinDirection=PORT_PIN_IN, PortPinId=58, PortPinLevelValue=PORT_PIN_LEVEL_LOW, PortPinMode=GPIO, PortPinPcr=67
          PortPin_PE5_DOOR_ACC_INTERF18: PortPinDirection=PORT_PIN_IN, PortPinId=60, PortPinLevelValue=PORT_PIN_LEVEL_LOW, PortPinMode=GPIO, PortPinPcr=69
          PortPin_PE6_CAPA_SNSR_OUT1OR2: PortPinDirection=PORT_PIN_OUT, PortPinId=61, PortPinLevelValue=PORT_PIN_LEVEL_LOW, PortPinMode=GPIO, PortPinPcr=70
          PortPin_PE8_CAN2_TX: PortPinDirection=PORT_PIN_OUT, PortPinId=62, PortPinLevelValue=PORT_PIN_LEVEL_LOW, PortPinMode=FlexCAN_2_TX, PortPinPcr=72
          PortPin_PE9_CAN2_RX: PortPinDirection=PORT_PIN_IN, PortPinId=63, PortPinLevelValue=PORT_PIN_LEVEL_LOW, PortPinMode=FlexCAN_2_RX, PortPinPcr=73
          PortPin_PF0_ADI_4: PortPinDirection=PORT_PIN_IN, PortPinId=69, PortPinLevelValue=PORT_PIN_LEVEL_LOW, PortPinMode=ADC_0_ADC0_S_8, PortPinPcr=80
          PortPin_PF10_LIN_BUS6_TX: PortPinDirection=PORT_PIN_OUT, PortPinId=67, PortPinLevelValue=PORT_PIN_LEVEL_LOW, PortPinMode=LIN_4_LIN4TX, PortPinPcr=90
          PortPin_PF11_LIN_BUS6_RX: PortPinDirection=PORT_PIN_IN, PortPinId=80, PortPinLevelValue=PORT_PIN_LEVEL_LOW, PortPinMode=LIN_4_LIN4RX, PortPinPcr=91
          PortPin_PF14_CAN1_TERM_H2: PortPinDirection=PORT_PIN_IN, PortPinId=83, PortPinLevelValue=PORT_PIN_LEVEL_LOW, PortPinMode=ADC_1_ADC1_X_2, PortPinPcr=94
          PortPin_PF15_CAN1_TERM_L1: PortPinDirection=PORT_PIN_IN, PortPinId=84, PortPinLevelValue=PORT_PIN_LEVEL_LOW, PortPinMode=ADC_1_ADC1_X_1, PortPinPcr=95
          PortPin_PF1_ADI_5: PortPinDirection=PORT_PIN_IN, PortPinId=70, PortPinLevelValue=PORT_PIN_LEVEL_LOW, PortPinMode=ADC_0_ADC0_S_9, PortPinPcr=81
          PortPin_PF2_ADI_6: PortPinDirection=PORT_PIN_IN, PortPinId=71, PortPinLevelValue=PORT_PIN_LEVEL_LOW, PortPinMode=ADC_0_ADC0_S_10, PortPinPcr=82
          PortPin_PF3_ADI_7: PortPinDirection=PORT_PIN_IN, PortPinId=72, PortPinLevelValue=PORT_PIN_LEVEL_LOW, PortPinMode=ADC_0_ADC0_S_11, PortPinPcr=83
          PortPin_PF4_ADI_8: PortPinDirection=PORT_PIN_IN, PortPinId=73, PortPinLevelValue=PORT_PIN_LEVEL_LOW, PortPinMode=ADC_0_ADC0_S_12, PortPinPcr=84
          PortPin_PF5_ADI_9: PortPinDirection=PORT_PIN_IN, PortPinId=74, PortPinLevelValue=PORT_PIN_LEVEL_LOW, PortPinMode=ADC_0_ADC0_S_13, PortPinPcr=85
          PortPin_PF6_ADI_10: PortPinDirection=PORT_PIN_IN, PortPinId=75, PortPinLevelValue=PORT_PIN_LEVEL_LOW, PortPinMode=ADC_0_ADC0_S_14, PortPinPcr=86
          PortPin_PF7_ADI_11: PortPinDirection=PORT_PIN_IN, PortPinId=76, PortPinLevelValue=PORT_PIN_LEVEL_LOW, PortPinMode=ADC_0_ADC0_S_15, PortPinPcr=87
          PortPin_PF8_LIN_BUS4_EN: PortPinDirection=PORT_PIN_OUT, PortPinId=77, PortPinLevelValue=PORT_PIN_LEVEL_HIGH, PortPinMode=GPIO, PortPinPcr=88
          PortPin_PF9_CAN3_STB: PortPinDirection=PORT_PIN_OUT, PortPinId=78, PortPinLevelValue=PORT_PIN_LEVEL_LOW, PortPinMode=GPIO, PortPinPcr=89
          PortPin_PG0_CAN1_TERM_L2: PortPinDirection=PORT_PIN_IN, PortPinId=85, PortPinLevelValue=PORT_PIN_LEVEL_LOW, PortPinMode=ADC_1_ADC1_X_0, PortPinPcr=96
          PortPin_PG10_RFIC_NRES: PortPinDirection=PORT_PIN_OUT, PortPinId=90, PortPinLevelValue=PORT_PIN_LEVEL_LOW, PortPinMode=GPIO, PortPinPcr=106
          PortPin_PG11_RFIC_SPI_CS0: PortPinDirection=PORT_PIN_OUT, PortPinId=27, PortPinLevelValue=PORT_PIN_LEVEL_LOW, PortPinMode=SPI_2_CS0_2, PortPinPcr=107
          PortPin_PG12_LFIC_NRES: PortPinDirection=PORT_PIN_OUT, PortPinId=91, PortPinLevelValue=PORT_PIN_LEVEL_LOW, PortPinMode=GPIO, PortPinPcr=108
          PortPin_PG14_RFIC_SPI_MISO: PortPinDirection=PORT_PIN_IN, PortPinId=55, PortPinLevelValue=PORT_PIN_LEVEL_LOW, PortPinMode=SPI_2_SIN_2, PortPinPcr=110
          PortPin_PG15_RFIC_SPI_MOSI: PortPinDirection=PORT_PIN_OUT, PortPinId=94, PortPinLevelValue=PORT_PIN_LEVEL_LOW, PortPinMode=SPI_2_SOUT_2, PortPinPcr=111
          PortPin_PG2_CAN2_TX: PortPinDirection=PORT_PIN_OUT, PortPinId=87, PortPinLevelValue=PORT_PIN_LEVEL_LOW, PortPinMode=FlexCAN_7_TX, PortPinPcr=98
          PortPin_PG6_LIN4_TX: PortPinDirection=PORT_PIN_OUT, PortPinId=8, PortPinLevelValue=PORT_PIN_LEVEL_LOW, PortPinMode=LIN_6_LIN6TX, PortPinPcr=102
          PortPin_PG7_LIN4_RX: PortPinDirection=PORT_PIN_IN, PortPinId=28, PortPinLevelValue=PORT_PIN_LEVEL_LOW, PortPinMode=LIN_6_LIN6RX, PortPinPcr=103
          PortPin_PG8_LIN_BUS3_TX: PortPinDirection=PORT_PIN_OUT, PortPinId=88, PortPinLevelValue=PORT_PIN_LEVEL_LOW, PortPinMode=LIN_7_LIN7TX, PortPinPcr=104
          PortPin_PG9_LIN_BUS3_RX: PortPinDirection=PORT_PIN_IN, PortPinId=89, PortPinLevelValue=PORT_PIN_LEVEL_LOW, PortPinMode=LIN_7_LIN7RX, PortPinPcr=105
          PortPin_PH0_LFIC_SPI_MISO: PortPinDirection=PORT_PIN_IN, PortPinId=95, PortPinLevelValue=PORT_PIN_LEVEL_LOW, PortPinMode=DSPI_1_dSIN, PortPinPcr=112
          PortPin_PH11_DOWHS_DIAG_EN: PortPinDirection=PORT_PIN_OUT, PortPinId=102, PortPinLevelValue=PORT_PIN_LEVEL_LOW, PortPinMode=GPIO, PortPinPcr=123
          PortPin_PH12_DOWHS_SEL: PortPinDirection=PORT_PIN_OUT, PortPinId=103, PortPinLevelValue=PORT_PIN_LEVEL_LOW, PortPinMode=GPIO, PortPinPcr=124
          PortPin_PH13_Parked_Pull_up_Ctrl: PortPinDirection=PORT_PIN_OUT, PortPinId=79, PortPinLevelValue=PORT_PIN_LEVEL_LOW, PortPinMode=GPIO, PortPinPcr=125
          PortPin_PH14_LIN_BUS1_EN: PortPinDirection=PORT_PIN_OUT, PortPinId=105, PortPinLevelValue=PORT_PIN_LEVEL_HIGH, PortPinMode=GPIO, PortPinPcr=126
          PortPin_PH15_Living_Pull_up_Ctrl: PortPinDirection=PORT_PIN_OUT, PortPinId=106, PortPinLevelValue=PORT_PIN_LEVEL_LOW, PortPinMode=GPIO, PortPinPcr=127
          PortPin_PH1_LFIC_SPI_MOSI: PortPinDirection=PORT_PIN_OUT, PortPinId=96, PortPinLevelValue=PORT_PIN_LEVEL_LOW, PortPinMode=DSPI_1_dSOUT, PortPinPcr=113
          PortPin_PH2_LFIC_SPI_SCLK: PortPinDirection=PORT_PIN_IN, PortPinId=97, PortPinLevelValue=PORT_PIN_LEVEL_LOW, PortPinMode=DSPI_1_dSCLK_OUT, PortPinPcr=114
          PortPin_PH3_LFIC_SPI_CS0: PortPinDirection=PORT_PIN_IN, PortPinId=98, PortPinLevelValue=PORT_PIN_LEVEL_LOW, PortPinMode=DSPI_1_dCS0, PortPinPcr=115
          PortPin_PH4_LSPWM1_GATE: PortPinDirection=PORT_PIN_OUT, PortPinId=99, PortPinLevelValue=PORT_PIN_LEVEL_LOW, PortPinMode=EMIOS1_E1UC_6_H_OUT, PortPinPcr=116
          PortPin_PH5_LSPWM2_GATE: PortPinDirection=PORT_PIN_OUT, PortPinId=100, PortPinLevelValue=PORT_PIN_LEVEL_LOW, PortPinMode=EMIOS1_E1UC_7_H_OUT, PortPinPcr=117
          PortPin_PH6_LSPWM3_GATE: PortPinDirection=PORT_PIN_OUT, PortPinId=101, PortPinLevelValue=PORT_PIN_LEVEL_LOW, PortPinMode=EMIOS1_E1UC_8_X_OUT, PortPinPcr=118
          PortPin_PI11_DOBHS2_Ctrl: PortPinDirection=PORT_PIN_OUT, PortPinId=114, PortPinLevelValue=PORT_PIN_LEVEL_LOW, PortPinMode=GPIO, PortPinPcr=139
          PortPin_PI12_DOBHS3_Ctrl: PortPinDirection=PORT_PIN_OUT, PortPinId=115, PortPinLevelValue=PORT_PIN_LEVEL_LOW, PortPinMode=GPIO, PortPinPcr=140
          PortPin_PI13_DOBHS4_Ctrl: PortPinDirection=PORT_PIN_OUT, PortPinId=93, PortPinLevelValue=PORT_PIN_LEVEL_LOW, PortPinMode=GPIO, PortPinPcr=141
          PortPin_PI14_DOBHS1_MON: PortPinDirection=PORT_PIN_IN, PortPinId=82, PortPinLevelValue=PORT_PIN_LEVEL_LOW, PortPinMode=ADC_0_ADC0_S_22, PortPinPcr=142
          PortPin_PI15_DOBHS_IPS2_FAULT: PortPinDirection=PORT_PIN_IN, PortPinId=81, PortPinLevelValue=PORT_PIN_LEVEL_LOW, PortPinMode=GPIO, PortPinPcr=143
          PortPin_PI1_LIN_SECURITY_RX: PortPinDirection=PORT_PIN_IN, PortPinId=107, PortPinLevelValue=PORT_PIN_LEVEL_LOW, PortPinMode=LIN_8_LIN8RX, PortPinPcr=129
          PortPin_PI3_LIN7_RX: PortPinDirection=PORT_PIN_IN, PortPinId=108, PortPinLevelValue=PORT_PIN_LEVEL_LOW, PortPinMode=LIN_9_LIN9RX, PortPinPcr=131
          PortPin_PI4_IPS_PWR_SEL1: PortPinDirection=PORT_PIN_OUT, PortPinId=110, PortPinLevelValue=PORT_PIN_LEVEL_LOW, PortPinMode=GPIO, PortPinPcr=132
          PortPin_PI5_IPS_PWR_SEL0: PortPinDirection=PORT_PIN_OUT, PortPinId=111, PortPinLevelValue=PORT_PIN_LEVEL_LOW, PortPinMode=GPIO, PortPinPcr=133
          PortPin_PI7_CAN4STB: PortPinDirection=PORT_PIN_OUT, PortPinId=112, PortPinLevelValue=PORT_PIN_LEVEL_LOW, PortPinMode=GPIO, PortPinPcr=135
          PortPin_PI8_DOBHS1_Ctrl: PortPinDirection=PORT_PIN_OUT, PortPinId=113, PortPinLevelValue=PORT_PIN_LEVEL_LOW, PortPinMode=GPIO, PortPinPcr=136
          PortPin_PJ0_DOBHS_IPS1_FAULT: PortPinDirection=PORT_PIN_IN, PortPinId=86, PortPinLevelValue=PORT_PIN_LEVEL_LOW, PortPinMode=GPIO, PortPinPcr=144
          PortPin_PJ1_DOBHS2_MON: PortPinDirection=PORT_PIN_IN, PortPinId=59, PortPinLevelValue=PORT_PIN_LEVEL_LOW, PortPinMode=ADC_0_ADC0_S_25, PortPinPcr=145
          PortPin_PJ2_DOWHS_IPS_FAULT: PortPinDirection=PORT_PIN_IN, PortPinId=54, PortPinLevelValue=PORT_PIN_LEVEL_LOW, PortPinMode=ADC_0_ADC0_S_26, PortPinPcr=146
          PortPin_PJ3_ADI_12: PortPinDirection=PORT_PIN_IN, PortPinId=92, PortPinLevelValue=PORT_PIN_LEVEL_LOW, PortPinMode=ADC_0_ADC0_S_27, PortPinPcr=147
          PortPin_PJ4_LIN2_EN: PortPinDirection=PORT_PIN_OUT, PortPinId=44, PortPinLevelValue=PORT_PIN_LEVEL_HIGH, PortPinMode=GPIO, PortPinPcr=148
          PortPin_PG4_LIN_BUS1_TX: PortPinId=2, PortPinPcr=100, PortPinDirection=PORT_PIN_OUT, PortPinMode=LIN_10_LIN10TX, PortPinLevelValue=PORT_PIN_LEVEL_LOW
          PortPin_PG5_LIN_BUS1_RX: PortPinId=104, PortPinPcr=101, PortPinDirection=PORT_PIN_IN, PortPinMode=LIN_10_LIN10RX, PortPinLevelValue=PORT_PIN_LEVEL_LOW
          PortPin_PI0_LIN_SECURITY_TX: PortPinId=16, PortPinPcr=128, PortPinDirection=PORT_PIN_OUT, PortPinMode=LIN_8_LIN8TX, PortPinLevelValue=PORT_PIN_LEVEL_LOW
          PortPin_PI2_LIN7_TX: PortPinDirection=PORT_PIN_OUT, PortPinId=109, PortPinLevelValue=PORT_PIN_LEVEL_LOW, PortPinMode=LIN_9_LIN9TX, PortPinPcr=130
          PortPin_PB2_LIN2_TX: PortPinDirection=PORT_PIN_IN, PortPinId=21, PortPinLevelValue=PORT_PIN_LEVEL_LOW, PortPinMode=LIN_0_LIN0TX, PortPinPcr=18
          PortPin_PG3_CAN2_RX: PortPinId=116, PortPinPcr=99, PortPinDirection=PORT_PIN_IN, PortPinMode=FlexCAN_7_RX, PortPinLevelValue=PORT_PIN_LEVEL_LOW
    PortGeneral:
      PortDevErrorDetect = false
      PortEnableUserModeSupport = false
      PortSetPinDirectionApi = true
      PortSetPinModeApi = true
      PortSetPinModeDoesNotTouchGpioLevel = false
      PortVersionInfoApi = true
