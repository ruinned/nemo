AUTOSAR XML (schema 4-2-1)
package /ActiveEcuC
  module config LinTp: implementation-config-variant=VARIANT-PRE-COMPILE, module-description=LinTp_Impl
    LinTpGlobalConfig: LinTpMaxNumberOfRespPendingFrames=3, LinTpNumberOfRxNSdu=20, LinTpNumberOfTxNSdu=25, LinTpP2Max=1.5, LinTpP2Timing=0.1
      MasterReq_ILCP1_oLIN00_57efaae5_Tx (LinTpTxNSdu):
        LinTpTxNSduNad = 11
        LinTpNas = 0.1
        LinTpTxNSduId = 14
        LinTpNcs = 0.15
        LinTpTxNSduChannelRef = CHNL_45618847
        LinTpTxNSduPduRef = MasterReq_ILCP1_oLIN00_0bff65a0_Tx
      MasterReq_oLIN00_4a2bb011_Tx (LinTpTxNSdu): LinTpTxNSduNad=126, LinTpNas=0.1, LinTpTxNSduId=20, LinTpTxNSduChannelRef=CHNL_45618847, LinTpTxNSduPduRef=MasterReq_oLIN00_3234fe1b_Tx
      SlaveResp_LECM2_oLIN00_2afc07d8_Rx (LinTpRxNSdu):
        LinTpDl = 8
        LinTpRxNSduNad = 29
        LinTpRxNSduId = 16
        LinTpNcr = 0.15
        LinTpRxNSduChannelRef = CHNL_45618847
        LinTpRxNSduPduRef = SlaveResp_LECM2_oLIN00_71931b12_Rx
      MasterReq_LECMBasic_oLIN00_16bdebb7_Tx (LinTpTxNSdu):
        LinTpTxNSduNad = 30
        LinTpNas = 0.1
        LinTpTxNSduId = 17
        LinTpNcs = 0.15
        LinTpTxNSduChannelRef = CHNL_45618847
        LinTpTxNSduPduRef = MasterReq_LECMBasic_oLIN00_33465f21_Tx
      CHNL_45618847 (LinTpChannelConfig): LinTpDropNotRequestedNad=false, LinTpScheduleChangeDiag=false, LinTpChannelRef=CHNL_45618847
      SlaveResp_FSP1_L1_oLIN00_620b3198_Rx (LinTpRxNSdu):
        LinTpDl = 8
        LinTpRxNSduNad = 2
        LinTpRxNSduId = 4
        LinTpNcr = 0.15
        LinTpRxNSduChannelRef = CHNL_45618847
        LinTpRxNSduPduRef = SlaveResp_FSP1_L1_oLIN00_b9fef1a8_Rx
      SlaveResp_ILCP1_oLIN00_1a12ec88_Rx (LinTpRxNSdu):
        LinTpDl = 8
        LinTpRxNSduNad = 11
        LinTpRxNSduId = 14
        LinTpNcr = 0.15
        LinTpRxNSduChannelRef = CHNL_45618847
        LinTpRxNSduPduRef = SlaveResp_ILCP1_oLIN00_ffca61fb_Rx
      MasterReq_FSP2_L1_oLIN00_b405eb2b_Tx (LinTpTxNSdu):
        LinTpTxNSduNad = 3
        LinTpNas = 0.1
        LinTpTxNSduId = 9
        LinTpNcs = 0.15
        LinTpTxNSduChannelRef = CHNL_45618847
        LinTpTxNSduPduRef = MasterReq_FSP2_L1_oLIN00_158ba8e3_Tx
      SlaveResp_LECMBasic_oLIN00_029997c6_Rx (LinTpRxNSdu):
        LinTpDl = 8
        LinTpRxNSduNad = 30
        LinTpRxNSduId = 17
        LinTpNcr = 0.15
        LinTpRxNSduChannelRef = CHNL_45618847
        LinTpRxNSduPduRef = SlaveResp_LECMBasic_oLIN00_30a28bed_Rx
      SlaveResp_FSP2_L1_oLIN00_fbe95799_Rx (LinTpRxNSdu):
        LinTpDl = 8
        LinTpRxNSduNad = 3
        LinTpRxNSduId = 9
        LinTpNcr = 0.15
        LinTpRxNSduChannelRef = CHNL_45618847
        LinTpRxNSduPduRef = SlaveResp_FSP2_L1_oLIN00_4ba91c50_Rx
      MasterReq_LECM2_oLIN00_670141b5_Tx (LinTpTxNSdu):
        LinTpTxNSduNad = 29
        LinTpNas = 0.1
        LinTpTxNSduId = 16
        LinTpNcs = 0.15
        LinTpTxNSduChannelRef = CHNL_45618847
        LinTpTxNSduPduRef = MasterReq_LECM2_oLIN00_85a61f49_Tx
      MasterReq_FSP1_L1_oLIN00_2de78d2a_Tx (LinTpTxNSdu):
        LinTpTxNSduNad = 2
        LinTpNas = 0.1
        LinTpTxNSduId = 4
        LinTpNcs = 0.15
        LinTpTxNSduChannelRef = CHNL_45618847
        LinTpTxNSduPduRef = MasterReq_FSP1_L1_oLIN00_e7dc451b_Tx
      SlaveResp_FSP2_L2_oLIN01_026160ec_Rx (LinTpRxNSdu):
        LinTpDl = 8
        LinTpRxNSduNad = 3
        LinTpRxNSduId = 10
        LinTpNcr = 0.15
        LinTpRxNSduChannelRef = CHNL_8e3d5be2
        LinTpRxNSduPduRef = SlaveResp_FSP2_L2_oLIN01_e423846a_Rx
      SlaveResp_ELCP2_oLIN03_089ef750_Rx (LinTpRxNSdu):
        LinTpDl = 8
        LinTpRxNSduNad = 35
        LinTpRxNSduId = 3
        LinTpNcr = 0.15
        LinTpRxNSduChannelRef = CHNL_c3f5fae9
        LinTpRxNSduPduRef = SlaveResp_ELCP2_oLIN03_9a2d0041_Rx
      MasterReq_TCP_oLIN02_4b422897_Tx (LinTpTxNSdu):
        LinTpTxNSduNad = 57
        LinTpNas = 0.1
        LinTpTxNSduId = 19
        LinTpNcs = 0.15
        LinTpTxNSduChannelRef = CHNL_08a9294c
        LinTpTxNSduPduRef = MasterReq_TCP_oLIN02_741cea1f_Tx
      MasterReq_ELCP1_oLIN03_cbecb6de_Tx (LinTpTxNSdu):
        LinTpTxNSduNad = 14
        LinTpNas = 0.1
        LinTpTxNSduId = 2
        LinTpNcs = 0.15
        LinTpTxNSduChannelRef = CHNL_c3f5fae9
        LinTpTxNSduPduRef = MasterReq_ELCP1_oLIN03_18fd3d27_Tx
      SlaveResp_FSP3_L2_oLIN01_c3efbf2c_Rx (LinTpRxNSdu):
        LinTpDl = 8
        LinTpRxNSduNad = 4
        LinTpRxNSduId = 12
        LinTpNcr = 0.15
        LinTpRxNSduChannelRef = CHNL_8e3d5be2
        LinTpRxNSduPduRef = SlaveResp_FSP3_L2_oLIN01_033e22fd_Rx
      MasterReq_RCECS_oLIN04_b46d7afd_Tx (LinTpTxNSdu):
        LinTpTxNSduNad = 16
        LinTpNas = 0.1
        LinTpTxNSduId = 18
        LinTpNcs = 0.15
        LinTpTxNSduChannelRef = CHNL_def0ca51
        LinTpTxNSduPduRef = MasterReq_RCECS_oLIN04_dc3c974a_Tx
      SlaveResp_CCFW_oLIN03_d7124ce9_Rx (LinTpRxNSdu): LinTpDl=8, LinTpRxNSduNad=19, LinTpRxNSduId=0, LinTpNcr=0.15, LinTpRxNSduChannelRef=CHNL_c3f5fae9, LinTpRxNSduPduRef=SlaveResp_CCFW_oLIN03_1d1ae08e_Rx
      SlaveResp_ILCP2_oLIN03_0d94bad1_Rx (LinTpRxNSdu):
        LinTpDl = 8
        LinTpRxNSduNad = 32
        LinTpRxNSduId = 15
        LinTpNcr = 0.15
        LinTpRxNSduChannelRef = CHNL_c3f5fae9
        LinTpRxNSduPduRef = SlaveResp_ILCP2_oLIN03_39eebd8e_Rx
      MasterReq_FSP1_L3_oLIN02_81cceb7b_Tx (LinTpTxNSdu):
        LinTpTxNSduNad = 2
        LinTpNas = 0.1
        LinTpTxNSduId = 6
        LinTpNcs = 0.15
        LinTpTxNSduChannelRef = CHNL_08a9294c
        LinTpTxNSduPduRef = MasterReq_FSP1_L3_oLIN02_63e4d2bd_Tx
      CHNL_8e3d5be2 (LinTpChannelConfig): LinTpDropNotRequestedNad=false, LinTpScheduleChangeDiag=false, LinTpChannelRef=CHNL_8e3d5be2
      MasterReq_oLIN03_d322e1ab_Tx (LinTpTxNSdu): LinTpTxNSduNad=126, LinTpNas=0.1, LinTpTxNSduId=23, LinTpTxNSduChannelRef=CHNL_c3f5fae9, LinTpTxNSduPduRef=MasterReq_oLIN03_82f51b53_Tx
      CHNL_08a9294c (LinTpChannelConfig): LinTpDropNotRequestedNad=false, LinTpScheduleChangeDiag=false, LinTpChannelRef=CHNL_08a9294c
      SlaveResp_ELCP1_oLIN03_8611f0b3_Rx (LinTpRxNSdu):
        LinTpDl = 8
        LinTpRxNSduNad = 14
        LinTpRxNSduId = 2
        LinTpNcr = 0.15
        LinTpRxNSduChannelRef = CHNL_c3f5fae9
        LinTpRxNSduPduRef = SlaveResp_ELCP1_oLIN03_ecc8397c_Rx
      3 x LinTpTxNSdu, all with LinTpNas=0.1:
        MasterReq_FSP1_L4_oLIN03_fc0ed2f4_Tx: LinTpTxNSduNad=2, LinTpTxNSduId=7, LinTpNcs=0.15, LinTpTxNSduChannelRef=CHNL_c3f5fae9, LinTpTxNSduPduRef=MasterReq_FSP1_L4_oLIN03_cc32eb14_Tx
        MasterReq_FSP3_L2_oLIN01_8c03039e_Tx: LinTpTxNSduNad=4, LinTpTxNSduId=12, LinTpNcs=0.15, LinTpTxNSduChannelRef=CHNL_8e3d5be2, LinTpTxNSduPduRef=MasterReq_FSP3_L2_oLIN01_5d1c964e_Tx
        MasterReq_oLIN02_a425d13d_Tx: LinTpTxNSduNad=126, LinTpTxNSduId=22, LinTpTxNSduChannelRef=CHNL_08a9294c, LinTpTxNSduPduRef=MasterReq_oLIN02_5b9aba54_Tx
      SlaveResp_FSP1_L4_oLIN03_b3e26e46_Rx (LinTpRxNSdu):
        LinTpDl = 8
        LinTpRxNSduNad = 2
        LinTpRxNSduId = 7
        LinTpNcr = 0.15
        LinTpRxNSduChannelRef = CHNL_c3f5fae9
        LinTpRxNSduPduRef = SlaveResp_FSP1_L4_oLIN03_92105fa7_Rx
      SlaveResp_DLFW_oLIN03_0f2202e7_Rx (LinTpRxNSdu): LinTpDl=8, LinTpRxNSduNad=18, LinTpRxNSduId=1, LinTpNcr=0.15, LinTpRxNSduChannelRef=CHNL_c3f5fae9, LinTpRxNSduPduRef=SlaveResp_DLFW_oLIN03_2782f4b7_Rx
      MasterReq_ILCP2_oLIN03_4069fcbc_Tx (LinTpTxNSdu):
        LinTpTxNSduNad = 32
        LinTpNas = 0.1
        LinTpTxNSduId = 15
        LinTpNcs = 0.15
        LinTpTxNSduChannelRef = CHNL_c3f5fae9
        LinTpTxNSduPduRef = MasterReq_ILCP2_oLIN03_cddbb9d5_Tx
      SlaveResp_FSP4_L2_oLIN01_ead4aaaf_Rx (LinTpRxNSdu):
        LinTpDl = 8
        LinTpRxNSduNad = 5
        LinTpRxNSduId = 13
        LinTpNcr = 0.15
        LinTpRxNSduChannelRef = CHNL_8e3d5be2
        LinTpRxNSduPduRef = SlaveResp_FSP4_L2_oLIN01_dbfd59db_Rx
      4 x LinTpTxNSdu, all with LinTpNas=0.1, LinTpNcs=0.15:
        MasterReq_FSP4_L2_oLIN01_a538161d_Tx: LinTpTxNSduNad=5, LinTpTxNSduId=13, LinTpTxNSduChannelRef=CHNL_8e3d5be2, LinTpTxNSduPduRef=MasterReq_FSP4_L2_oLIN01_85dfed68_Tx
        MasterReq_FSP1_L5_oLIN04_aec047c9_Tx: LinTpTxNSduNad=2, LinTpTxNSduId=8, LinTpTxNSduChannelRef=CHNL_def0ca51, LinTpTxNSduPduRef=MasterReq_FSP1_L5_oLIN04_34dc6c16_Tx
        MasterReq_ELCP2_oLIN03_4563b13d_Tx: LinTpTxNSduNad=35, LinTpTxNSduId=3, LinTpTxNSduChannelRef=CHNL_c3f5fae9, LinTpTxNSduPduRef=MasterReq_ELCP2_oLIN03_6e18041a_Tx
        MasterReq_CCFW_oLIN03_98357989_Tx: LinTpTxNSduNad=19, LinTpTxNSduId=0, LinTpTxNSduChannelRef=CHNL_c3f5fae9, LinTpTxNSduPduRef=MasterReq_CCFW_oLIN03_fcabea98_Tx
      SlaveResp_FSP1_L5_oLIN04_e12cfb7b_Rx (LinTpRxNSdu):
        LinTpDl = 8
        LinTpRxNSduNad = 2
        LinTpRxNSduId = 8
        LinTpNcr = 0.15
        LinTpRxNSduChannelRef = CHNL_def0ca51
        LinTpRxNSduPduRef = SlaveResp_FSP1_L5_oLIN04_6afed8a5_Rx
      CHNL_def0ca51 (LinTpChannelConfig): LinTpDropNotRequestedNad=false, LinTpScheduleChangeDiag=false, LinTpChannelRef=CHNL_def0ca51
      MasterReq_DLFW_oLIN03_40053787_Tx (LinTpTxNSdu):
        LinTpTxNSduNad = 18
        LinTpNas = 0.1
        LinTpTxNSduId = 1
        LinTpNcs = 0.15
        LinTpTxNSduChannelRef = CHNL_c3f5fae9
        LinTpTxNSduPduRef = MasterReq_DLFW_oLIN03_c633fea1_Tx
      CHNL_c3f5fae9 (LinTpChannelConfig): LinTpDropNotRequestedNad=false, LinTpScheduleChangeDiag=false, LinTpChannelRef=CHNL_c3f5fae9
      MasterReq_FSP2_L2_oLIN01_4d8ddc5e_Tx (LinTpTxNSdu):
        LinTpTxNSduNad = 3
        LinTpNas = 0.1
        LinTpTxNSduId = 10
        LinTpNcs = 0.15
        LinTpTxNSduChannelRef = CHNL_8e3d5be2
        LinTpTxNSduPduRef = MasterReq_FSP2_L2_oLIN01_ba0130d9_Tx
      3 x LinTpRxNSdu, all with LinTpDl=8, LinTpNcr=0.15:
        SlaveResp_FSP1_L3_oLIN02_ce2057c9_Rx: LinTpRxNSduNad=2, LinTpRxNSduId=6, LinTpRxNSduChannelRef=CHNL_08a9294c, LinTpRxNSduPduRef=SlaveResp_FSP1_L3_oLIN02_3dc6660e_Rx
        SlaveResp_FSP2_L3_oLIN02_57c231c8_Rx: LinTpRxNSduNad=3, LinTpRxNSduId=11, LinTpRxNSduChannelRef=CHNL_08a9294c, LinTpRxNSduPduRef=SlaveResp_FSP2_L3_oLIN02_cf918bf6_Rx
        SlaveResp_FSP1_L2_oLIN01_9b8306ed_Rx: LinTpRxNSduNad=2, LinTpRxNSduId=5, LinTpRxNSduChannelRef=CHNL_8e3d5be2, LinTpRxNSduPduRef=SlaveResp_FSP1_L2_oLIN01_16746992_Rx
      MasterReq_oLIN04_4d467408_Tx (LinTpTxNSdu): LinTpTxNSduNad=126, LinTpNas=0.1, LinTpTxNSduId=24, LinTpTxNSduChannelRef=CHNL_def0ca51, LinTpTxNSduPduRef=MasterReq_oLIN04_e1687685_Tx
      MasterReq_FSP1_L2_oLIN01_d46fba5f_Tx (LinTpTxNSdu):
        LinTpTxNSduNad = 2
        LinTpNas = 0.1
        LinTpTxNSduId = 5
        LinTpNcs = 0.15
        LinTpTxNSduChannelRef = CHNL_8e3d5be2
        LinTpTxNSduPduRef = MasterReq_FSP1_L2_oLIN01_4856dd21_Tx
      SlaveResp_RCECS_oLIN04_f9903c90_Rx (LinTpRxNSdu):
        LinTpDl = 8
        LinTpRxNSduNad = 16
        LinTpRxNSduId = 18
        LinTpNcr = 0.15
        LinTpRxNSduChannelRef = CHNL_def0ca51
        LinTpRxNSduPduRef = SlaveResp_RCECS_oLIN04_28099311_Rx
      MasterReq_FSP2_L3_oLIN02_182e8d7a_Tx (LinTpTxNSdu):
        LinTpTxNSduNad = 3
        LinTpNas = 0.1
        LinTpTxNSduId = 11
        LinTpNcs = 0.15
        LinTpTxNSduChannelRef = CHNL_08a9294c
        LinTpTxNSduPduRef = MasterReq_FSP2_L3_oLIN02_91b33f45_Tx
      SlaveResp_TCP_oLIN02_b3851a34_Rx (LinTpRxNSdu): LinTpDl=8, LinTpRxNSduNad=57, LinTpRxNSduId=19, LinTpNcr=0.15, LinTpRxNSduChannelRef=CHNL_08a9294c, LinTpRxNSduPduRef=SlaveResp_TCP_oLIN02_cb8ee454_Rx
      MasterReq_oLIN01_3d2c8087_Tx (LinTpTxNSdu): LinTpTxNSduNad=126, LinTpNas=0.1, LinTpTxNSduId=21, LinTpTxNSduChannelRef=CHNL_8e3d5be2, LinTpTxNSduPduRef=MasterReq_oLIN01_eb5b5f1c_Tx
    LinTpGeneral:
      LinTpFunctionalRequestsSupported = true
      LinTpVersionInfoApi = false
      LinTpForwardRespPendingFrames = true
      LinTpRuntimeMeasurementSupport = false
      LinTpBroadcastRequestHandling = false
