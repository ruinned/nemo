AUTOSAR XML (schema 4-2-1)
package /Spi
  module config Spi: implementation-config-variant=VARIANT-PRE-COMPILE, module-description=Spi_Impl
    SpiDriver: SpiMaxChannel=2, SpiMaxJob=2, SpiMaxSequence=2
      LFIC_CH (SpiChannel): SpiChannelId=0, SpiChannelType=EB, SpiDataWidth=8, SpiDefaultData=0, SpiEbMaxLength=100, SpiIbNBuffers=1, SpiTransferStart=MSB
      LFIC (SpiExternalDevice):
        ITSBModeEnable = false
        SpiBaudrate = 2000000
        SpiCsContinous = TRUE
        SpiCsIdentifier = PCS0
        SpiCsPolarity = LOW
        SpiDataShiftEdge = TRAILING
        SpiEnableCs = true
        SpiHwUnit = CSIB0
        SpiShiftClockIdleLevel = LOW
        SpiSlaveMode = false
        SpiTimeClk2Cs = 0.000001
        SpiTimeCs2Clk = 0.000001
        SpiTimeCs2Cs = 0.0000064
        TSBModeEnable = false
        SpiCsSelection = CS_VIA_PERIPHERAL_ENGINE
      LFIC_JOB_DATA (SpiJob):
        ChangeInDataTransfer = false
        DsiCsIdentifier = DPCS0
        DualReceiverSupport = false
        ITSBModeEnable = false
        SecondaryDsiCsIdentifier = DPCS0
        SecondaryFrameSize = 16
        SpiJobId = 0
        SpiJobPriority = 0
        TS0_CONF = PF
        TS0_LEN = 0
        TS1_CONF = PF
        TS1_LEN = 0
        TS2_CONF = PF
        TS2_LEN = 0
        TS3_CONF = PF
        TS3_LEN = 0
        TSBFrameSize = 16
        TSBModeEnable = false
        TransmitDataSource = DSISerializationRegister
        SpiHwUnitSynchronous = SYNCHRONOUS
        SpiDeviceAssignment = LFIC
        SpiChannelList: SpiChannelIndex=0, SpiChannelAssignment=LFIC_CH
      LFIC_SEQ_DATA (SpiSequence): SpiInterruptibleSequence=false, SpiSequenceId=0, SpiJobAssignment=LFIC_JOB_DATA
      RFIC_SEQ_DATA (SpiSequence): SpiInterruptibleSequence=false, SpiSequenceId=1, SpiJobAssignment=RFIC_JOB_DATA
      RFIC_CH (SpiChannel): SpiChannelId=1, SpiChannelType=EB, SpiDataWidth=8, SpiEbMaxLength=100, SpiIbNBuffers=1, SpiTransferStart=MSB, SpiDefaultData=0
      RFIC (SpiExternalDevice):
        SpiSlaveMode = false
        TSBModeEnable = false
        ITSBModeEnable = false
        SpiBaudrate = 500000
        SpiCsIdentifier = PCS0
        SpiCsPolarity = LOW
        SpiDataShiftEdge = TRAILING
        SpiEnableCs = true
        SpiHwUnit = CSIB1
        SpiShiftClockIdleLevel = LOW
        SpiTimeClk2Cs = 0.000035
        SpiTimeCs2Clk = 0.000045
        SpiTimeCs2Cs = 0.00002
        SpiCsContinous = TRUE
        SpiCsSelection = CS_VIA_PERIPHERAL_ENGINE
      RFIC_JOB_DATA (SpiJob):
        TSBModeEnable = false
        ITSBModeEnable = false
        SpiJobId = 1
        SpiJobPriority = 0
        TSBFrameSize = 16
        TS3_LEN = 0
        TS2_LEN = 0
        TS1_LEN = 0
        TS0_LEN = 0
        TS3_CONF = PF
        TS2_CONF = PF
        TS1_CONF = PF
        TS0_CONF = PF
        DsiCsIdentifier = DPCS0
        TransmitDataSource = DSISerializationRegister
        ChangeInDataTransfer = false
        DualReceiverSupport = false
        SecondaryFrameSize = 16
        SecondaryDsiCsIdentifier = DPCS0
        SpiHwUnitSynchronous = SYNCHRONOUS
        SpiDeviceAssignment = RFIC
        SpiChannelList: SpiChannelIndex=0, SpiChannelAssignment=RFIC_CH
    SpiGeneral:
      SpiCancelApi = true
      SpiChannelBuffersAllowed = 1
      SpiDevErrorDetect = false
      SpiGlobalDmaEnable = false
      SpiHwStatusApi = true
      SpiInterruptibleSeqAllowed = false
      SpiLevelDelivered = 0
      SpiOptimizeOneJobSequences = false
      SpiOptimizedChannelsNumber = 0
      SpiOptimizedSeqNumber = 0
      SpiSupportConcurrentSyncTransmit = false
      SpiTransmitTimeout = 50000
      SpiVersionInfoApi = true
      SpiCPUClockRef = F40_CLK
      SpiPhyUnit_LFIC (SpiPhyUnit): SpiPhyUnitAsyncMethod=PIO_FIFO, SpiPhyUnitMapping=DSPI_1, SpiPhyUnitMode=SPI_MASTER, SpiPhyUnitSync=true, SpiPhyUnitClockRef=F40_CLK
      SpiPhyUnit_RFIC (SpiPhyUnit): SpiPhyUnitMapping=SPI_2, SpiPhyUnitMode=SPI_MASTER, SpiPhyUnitSync=true, SpiPhyUnitAsyncMethod=PIO_FIFO, SpiPhyUnitClockRef=F80_CLK
    SpiNonAUTOSAR:
      SpiAllowBigSizeCollections = false
      SpiDisableDemReportErrorStatus = false
      SpiEnableHWUnitAsyncMode = false
      SpiEnableUserModeSupport = false
      SpiITSBModeSupport = false
      SpiJobStartNotificationEnable = false
      SpiSwapDataSupport32bits = false
      SpiTSBModeSupport = false
    SpiPublishedInformation:
      ArReleaseMajorVersion = 4
      ArReleaseMinorVersion = 2
      ArReleaseRevisionVersion = 2
      ModuleId = 83
      SpiMaxHwUnit = 0
      SwMajorVersion = 1
      SwMinorVersion = 0
      SwPatchVersion = 0
      VendorId = 43
    SpiDemEventParameterRefs: SPI_E_HARDWARE_ERROR=AutoCreatedDemEvent_SPI_E_HARDWARE_ERROR
