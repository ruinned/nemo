AUTOSAR XML (schema 4-2-1)
package /Fls
  module config Fls: implementation-config-variant=VARIANT-POST-BUILD, module-description=Fls_Impl
    CommonPublishedInformation:
      ArReleaseMajorVersion = 4
      ArReleaseMinorVersion = 2
      ArReleaseRevisionVersion = 2
      ModuleId = 92
      SwMajorVersion = 1
      SwMinorVersion = 0
      SwPatchVersion = 0
      VendorApiInfix = 
      VendorId = 43
    FlsConfigSet:
      FlsAcErase = 1073751296
      FlsAcErasePointer = NULL_PTR
      FlsAcWrite = 1073751296
      FlsAcWritePointer = NULL_PTR
      FlsCallCycle = 0
      FlsDefaultMode = MEMIF_MODE_SLOW
      FlsMaxReadFastMode = 1048576
      FlsMaxReadNormalMode = 1024
      FlsMaxWriteFastMode = 256
      FlsMaxWriteNormalMode = 8
      FlsProtection = 0
      FlsJobEndNotification = Fee_JobEndNotification
      FlsJobErrorNotification = Fee_JobErrorNotification
      FlsSectorList
        FlsSector_000 (FlsSector):
          FlsNumberOfSectors = 1
          FlsPageSize = 8
          FlsPageWriteAsynch = false
          FlsPhysicalSector = FLS_DATA_ARRAY_0_PART_4_HSM00
          FlsPhysicalSectorUnlock = true
          FlsProgrammingSize = FLS_WRITE_DOUBLE_WORD
          FlsSectorEraseAsynch = false
          FlsSectorIndex = 0
          FlsSectorSize = 16384
          FlsSectorStartaddress = 0
        FlsSector_001 (FlsSector):
          FlsSectorIndex = 1
          FlsPhysicalSectorUnlock = true
          FlsPhysicalSector = FLS_DATA_ARRAY_0_PART_5_HSM01
          FlsNumberOfSectors = 1
          FlsPageSize = 8
          FlsSectorSize = 16384
          FlsSectorStartaddress = 16384
          FlsProgrammingSize = FLS_WRITE_DOUBLE_WORD
          FlsSectorEraseAsynch = false
          FlsPageWriteAsynch = false
      FlsDemEventParameterRefs:
        FLS_E_WRITE_FAILED = AutoCreatedDemEvent_FLS_E_WRITE_FAILED
        FLS_E_UNEXPECTED_FLASH_ID = AutoCreatedDemEvent_FLS_E_UNEXPECTED_FLASH_ID
        FLS_E_READ_FAILED = AutoCreatedDemEvent_FLS_E_READ_FAILED
        FLS_E_ERASE_FAILED = AutoCreatedDemEvent_FLS_E_ERASE_FAILED
        FLS_E_COMPARE_FAILED = AutoCreatedDemEvent_FLS_E_COMPARE_FAILED
    FlsGeneral:
      FlsAcLoadOnJobStart = false
      FlsBaseAddress = 0
      FlsBlankCheckApi = false
      FlsCancelApi = true
      FlsCompareApi = true
      FlsDevErrorDetect = true
      FlsDriverIndex = 0
      FlsDsiHandlerApi = false
      FlsEraseBlankCheck = true
      FlsGetJobResultApi = true
      FlsGetStatusApi = true
      FlsMaxEraseBlankCheck = 256
      FlsRuntimeErrorDetect = true
      FlsSetModeApi = true
      FlsTotalSize = 0
      FlsUseInterrupts = false
      FlsVersionInfoApi = true
      FlsWriteBlankCheck = true
      FlsWriteVerifyCheck = true
    FlsPublishedInformation:
      FlsAcLocationErase = 0
      FlsAcLocationWrite = 0
      FlsAcSizeErase = 0
      FlsAcSizeWrite = 0
      FlsEraseTime = 5
      FlsErasedValue = 4294967295
      FlsExpectedHwId = 0
      FlsSpecifiedEraseCycles = 100000
      FlsWriteTime = 0.0005
    NonAutosar: FlsDisableDemReportErrorStatus=false, FlsEnableUserModeSupport=false, FlsExtendedReadErrorCheck=false, FlsSynchronizeCache=false
