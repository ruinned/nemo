AUTOSAR XML (schema 4-2-1)
package /ActiveEcuC
  module config Lin: implementation-config-variant=VARIANT-PRE-COMPILE, module-description=Lin_Impl
    LinGeneral:
      LinDevErrorDetect = false
      LinIndex = 0
      LinTimeoutDuration = 100
      LinVersionInfoApi = false
      LinTypeOfInterruptFunction = CATEGORY2
      LinRuntimeMeasurementSupport = false
    LinGlobalConfig
      5 x LinChannel, all with LinChannelBaudRate=9600, LinChannelWakeupSupport=false:
        CN_LIN00_2cd9a7df: LinChannelId=0, LinUart=10, LinChannelEcuMWakeupSource=CN_LIN00_2cd9a7df, LinClockRef=F80_CLK
        CN_LIN03_b5d0f665: LinChannelId=3, LinUart=6, LinChannelEcuMWakeupSource=CN_LIN03_b5d0f665, LinClockRef=F80_CLK
        CN_LIN04_2bb463c6: LinChannelId=4, LinUart=1, LinChannelEcuMWakeupSource=CN_LIN04_2bb463c6, LinClockRef=F80_CLK
        CN_LIN01_5bde9749: LinChannelId=1, LinUart=0, LinChannelEcuMWakeupSource=CN_LIN01_5bde9749, LinClockRef=F40_CLK
        CN_LIN02_c2d7c6f3: LinChannelId=2, LinUart=7, LinChannelEcuMWakeupSource=CN_LIN02_c2d7c6f3, LinClockRef=F80_CLK
      LinDemEventParameterRefs: LIN_E_TIMEOUT=AutoCreatedDemEvent_LIN_E_TIMEOUT
    LinPlatformConfig:
      LinRegisterAddresses = 0xFFE8C000UL 0xFBE8C000UL 0xFFE90000UL 0xFBE90000UL 0xFFE94000UL 0xFBE94000UL 0xFFE98000UL 0xFBE98000UL 0xFFE9C000UL 0xFBE9C000UL 0xFFEA0000UL 0xFBEA0000UL 0xFFEA4000UL 0xFBEA4000UL 0xFFEA8000UL 0xFBEA8000UL 0xFFEAC000UL 0xFBEAC000UL
