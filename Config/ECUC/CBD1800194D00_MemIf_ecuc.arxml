AUTOSAR XML (schema 4-2-1)
package /ActiveEcuC
  module config MemIf: implementation-config-variant=VARIANT-PRE-COMPILE, module-description=MemIf_Impl
    MemIfGeneral: MemIfDevErrorDetect=true, MemIfVersionInfoApi=false, MemIfSafeBswChecks=false
    MemIfMemHwA: MemIfMemHwAId=0, MemIfMemHwARef=FeeGeneral
