AUTOSAR XML (schema 4-2-1)
package /Icu
  module config Icu: implementation-config-variant=VARIANT-POST-BUILD, module-description=Icu_Impl
    CommonPublishedInformation:
      ArReleaseMajorVersion = 4
      ArReleaseMinorVersion = 2
      ArReleaseRevisionVersion = 2
      ModuleId = 122
      SwMajorVersion = 1
      SwMinorVersion = 0
      SwPatchVersion = 0
      VendorId = 43
    IcuConfigSet: IcuMaxChannel=3
      121 x IcuHwInterruptConfigList:
        IcuHwInterruptConfigList_0: IcuIsrEnable=false, IcuIsrHwId=EMIOS_0_CH_0
        IcuHwInterruptConfigList_1: IcuIsrEnable=false, IcuIsrHwId=EMIOS_0_CH_1
        IcuHwInterruptConfigList_10: IcuIsrEnable=false, IcuIsrHwId=EMIOS_0_CH_10
        IcuHwInterruptConfigList_100: IcuIsrEnable=false, IcuIsrHwId=WKPU_CH_11
        IcuHwInterruptConfigList_101: IcuIsrEnable=false, IcuIsrHwId=WKPU_CH_12
        IcuHwInterruptConfigList_102: IcuIsrEnable=false, IcuIsrHwId=WKPU_CH_13
        IcuHwInterruptConfigList_103: IcuIsrEnable=false, IcuIsrHwId=WKPU_CH_14
        IcuHwInterruptConfigList_104: IcuIsrEnable=false, IcuIsrHwId=WKPU_CH_15
        IcuHwInterruptConfigList_105: IcuIsrEnable=false, IcuIsrHwId=WKPU_CH_16
        IcuHwInterruptConfigList_106: IcuIsrEnable=false, IcuIsrHwId=WKPU_CH_17
        IcuHwInterruptConfigList_107: IcuIsrEnable=false, IcuIsrHwId=WKPU_CH_18
        IcuHwInterruptConfigList_108: IcuIsrEnable=false, IcuIsrHwId=WKPU_CH_19
        IcuHwInterruptConfigList_109: IcuIsrEnable=false, IcuIsrHwId=WKPU_CH_20
        IcuHwInterruptConfigList_11: IcuIsrEnable=false, IcuIsrHwId=EMIOS_0_CH_11
        IcuHwInterruptConfigList_110: IcuIsrEnable=false, IcuIsrHwId=WKPU_CH_21
        IcuHwInterruptConfigList_111: IcuIsrEnable=false, IcuIsrHwId=WKPU_CH_22
        IcuHwInterruptConfigList_112: IcuIsrEnable=false, IcuIsrHwId=WKPU_CH_23
        IcuHwInterruptConfigList_113: IcuIsrEnable=false, IcuIsrHwId=WKPU_CH_24
        IcuHwInterruptConfigList_114: IcuIsrEnable=false, IcuIsrHwId=WKPU_CH_25
        IcuHwInterruptConfigList_115: IcuIsrEnable=false, IcuIsrHwId=WKPU_CH_26
        IcuHwInterruptConfigList_116: IcuIsrEnable=true, IcuIsrHwId=WKPU_CH_27
        IcuHwInterruptConfigList_117: IcuIsrEnable=true, IcuIsrHwId=WKPU_CH_28
        IcuHwInterruptConfigList_118: IcuIsrEnable=false, IcuIsrHwId=WKPU_CH_29
        IcuHwInterruptConfigList_119: IcuIsrEnable=false, IcuIsrHwId=WKPU_CH_30
        IcuHwInterruptConfigList_12: IcuIsrEnable=false, IcuIsrHwId=EMIOS_0_CH_12
        IcuHwInterruptConfigList_120: IcuIsrEnable=false, IcuIsrHwId=WKPU_CH_31
        IcuHwInterruptConfigList_{13..19}: IcuIsrEnable=false, IcuIsrHwId=EMIOS_0_CH_{13..19}
        IcuHwInterruptConfigList_2: IcuIsrEnable=false, IcuIsrHwId=EMIOS_0_CH_2
        IcuHwInterruptConfigList_{20..29}: IcuIsrEnable=false, IcuIsrHwId=EMIOS_0_CH_{20..29}
        IcuHwInterruptConfigList_3: IcuIsrEnable=false, IcuIsrHwId=EMIOS_0_CH_3
        IcuHwInterruptConfigList_30: IcuIsrEnable=false, IcuIsrHwId=EMIOS_0_CH_30
        IcuHwInterruptConfigList_31: IcuIsrEnable=false, IcuIsrHwId=EMIOS_0_CH_31
        IcuHwInterruptConfigList_32: IcuIsrEnable=false, IcuIsrHwId=EMIOS_1_CH_0
        IcuHwInterruptConfigList_33: IcuIsrEnable=false, IcuIsrHwId=EMIOS_1_CH_1
        IcuHwInterruptConfigList_34: IcuIsrEnable=false, IcuIsrHwId=EMIOS_1_CH_2
        IcuHwInterruptConfigList_35: IcuIsrEnable=false, IcuIsrHwId=EMIOS_1_CH_3
        IcuHwInterruptConfigList_36: IcuIsrEnable=false, IcuIsrHwId=EMIOS_1_CH_4
        IcuHwInterruptConfigList_37: IcuIsrEnable=false, IcuIsrHwId=EMIOS_1_CH_5
        IcuHwInterruptConfigList_38: IcuIsrEnable=false, IcuIsrHwId=EMIOS_1_CH_6
        IcuHwInterruptConfigList_39: IcuIsrEnable=false, IcuIsrHwId=EMIOS_1_CH_7
        IcuHwInterruptConfigList_4: IcuIsrEnable=false, IcuIsrHwId=EMIOS_0_CH_4
        IcuHwInterruptConfigList_40: IcuIsrEnable=false, IcuIsrHwId=EMIOS_1_CH_8
        IcuHwInterruptConfigList_41: IcuIsrEnable=false, IcuIsrHwId=EMIOS_1_CH_9
        IcuHwInterruptConfigList_42: IcuIsrEnable=false, IcuIsrHwId=EMIOS_1_CH_10
        IcuHwInterruptConfigList_43: IcuIsrEnable=false, IcuIsrHwId=EMIOS_1_CH_11
        IcuHwInterruptConfigList_44: IcuIsrEnable=false, IcuIsrHwId=EMIOS_1_CH_12
        IcuHwInterruptConfigList_45: IcuIsrEnable=false, IcuIsrHwId=EMIOS_1_CH_13
        IcuHwInterruptConfigList_46: IcuIsrEnable=false, IcuIsrHwId=EMIOS_1_CH_14
        IcuHwInterruptConfigList_47: IcuIsrEnable=false, IcuIsrHwId=EMIOS_1_CH_15
        IcuHwInterruptConfigList_48: IcuIsrEnable=false, IcuIsrHwId=EMIOS_1_CH_16
        IcuHwInterruptConfigList_49: IcuIsrEnable=false, IcuIsrHwId=EMIOS_1_CH_17
        IcuHwInterruptConfigList_5: IcuIsrEnable=false, IcuIsrHwId=EMIOS_0_CH_5
        IcuHwInterruptConfigList_50: IcuIsrEnable=false, IcuIsrHwId=EMIOS_1_CH_18
        IcuHwInterruptConfigList_51: IcuIsrEnable=false, IcuIsrHwId=EMIOS_1_CH_19
        IcuHwInterruptConfigList_52: IcuIsrEnable=false, IcuIsrHwId=EMIOS_1_CH_20
        IcuHwInterruptConfigList_53: IcuIsrEnable=false, IcuIsrHwId=EMIOS_1_CH_21
        IcuHwInterruptConfigList_54: IcuIsrEnable=false, IcuIsrHwId=EMIOS_1_CH_22
        IcuHwInterruptConfigList_55: IcuIsrEnable=false, IcuIsrHwId=EMIOS_1_CH_23
        IcuHwInterruptConfigList_56: IcuIsrEnable=false, IcuIsrHwId=EMIOS_1_CH_24
        IcuHwInterruptConfigList_57: IcuIsrEnable=false, IcuIsrHwId=EMIOS_1_CH_25
        IcuHwInterruptConfigList_58: IcuIsrEnable=false, IcuIsrHwId=EMIOS_1_CH_26
        IcuHwInterruptConfigList_59: IcuIsrEnable=false, IcuIsrHwId=EMIOS_1_CH_27
        IcuHwInterruptConfigList_6: IcuIsrEnable=false, IcuIsrHwId=EMIOS_0_CH_6
        IcuHwInterruptConfigList_60: IcuIsrEnable=false, IcuIsrHwId=EMIOS_1_CH_28
        IcuHwInterruptConfigList_61: IcuIsrEnable=false, IcuIsrHwId=EMIOS_1_CH_29
        IcuHwInterruptConfigList_62: IcuIsrEnable=false, IcuIsrHwId=EMIOS_1_CH_30
        IcuHwInterruptConfigList_63: IcuIsrEnable=false, IcuIsrHwId=EMIOS_1_CH_31
        IcuHwInterruptConfigList_64: IcuIsrEnable=false, IcuIsrHwId=IRQ_CH_0
        IcuHwInterruptConfigList_65: IcuIsrEnable=false, IcuIsrHwId=IRQ_CH_1
        IcuHwInterruptConfigList_66: IcuIsrEnable=false, IcuIsrHwId=IRQ_CH_2
        IcuHwInterruptConfigList_67: IcuIsrEnable=false, IcuIsrHwId=IRQ_CH_3
        IcuHwInterruptConfigList_68: IcuIsrEnable=false, IcuIsrHwId=IRQ_CH_4
        IcuHwInterruptConfigList_69: IcuIsrEnable=false, IcuIsrHwId=IRQ_CH_5
        IcuHwInterruptConfigList_7: IcuIsrEnable=false, IcuIsrHwId=EMIOS_0_CH_7
        IcuHwInterruptConfigList_70: IcuIsrEnable=false, IcuIsrHwId=IRQ_CH_6
        IcuHwInterruptConfigList_71: IcuIsrEnable=false, IcuIsrHwId=IRQ_CH_7
        IcuHwInterruptConfigList_72: IcuIsrEnable=false, IcuIsrHwId=IRQ_CH_8
        IcuHwInterruptConfigList_73: IcuIsrEnable=false, IcuIsrHwId=IRQ_CH_9
        IcuHwInterruptConfigList_74: IcuIsrEnable=false, IcuIsrHwId=IRQ_CH_10
        IcuHwInterruptConfigList_75: IcuIsrEnable=false, IcuIsrHwId=IRQ_CH_11
        IcuHwInterruptConfigList_76: IcuIsrEnable=false, IcuIsrHwId=IRQ_CH_12
        IcuHwInterruptConfigList_77: IcuIsrEnable=false, IcuIsrHwId=IRQ_CH_13
        IcuHwInterruptConfigList_78: IcuIsrEnable=false, IcuIsrHwId=IRQ_CH_14
        IcuHwInterruptConfigList_79: IcuIsrEnable=false, IcuIsrHwId=IRQ_CH_15
        IcuHwInterruptConfigList_8: IcuIsrEnable=false, IcuIsrHwId=EMIOS_0_CH_8
        IcuHwInterruptConfigList_80: IcuIsrEnable=false, IcuIsrHwId=IRQ_CH_16
        IcuHwInterruptConfigList_81: IcuIsrEnable=false, IcuIsrHwId=IRQ_CH_17
        IcuHwInterruptConfigList_82: IcuIsrEnable=false, IcuIsrHwId=IRQ_CH_18
        IcuHwInterruptConfigList_83: IcuIsrEnable=false, IcuIsrHwId=IRQ_CH_19
        IcuHwInterruptConfigList_84: IcuIsrEnable=false, IcuIsrHwId=IRQ_CH_20
        IcuHwInterruptConfigList_85: IcuIsrEnable=false, IcuIsrHwId=IRQ_CH_21
        IcuHwInterruptConfigList_86: IcuIsrEnable=false, IcuIsrHwId=IRQ_CH_22
        IcuHwInterruptConfigList_87: IcuIsrEnable=false, IcuIsrHwId=IRQ_CH_23
        IcuHwInterruptConfigList_88: IcuIsrEnable=false, IcuIsrHwId=IRQ_CH_31
        IcuHwInterruptConfigList_89: IcuIsrEnable=false, IcuIsrHwId=WKPU_CH_0
        IcuHwInterruptConfigList_9: IcuIsrEnable=false, IcuIsrHwId=EMIOS_0_CH_9
        IcuHwInterruptConfigList_90: IcuIsrEnable=false, IcuIsrHwId=WKPU_CH_1
        IcuHwInterruptConfigList_91: IcuIsrEnable=false, IcuIsrHwId=WKPU_CH_2
        IcuHwInterruptConfigList_92: IcuIsrEnable=false, IcuIsrHwId=WKPU_CH_3
        IcuHwInterruptConfigList_93: IcuIsrEnable=false, IcuIsrHwId=WKPU_CH_4
        IcuHwInterruptConfigList_94: IcuIsrEnable=false, IcuIsrHwId=WKPU_CH_5
        IcuHwInterruptConfigList_95: IcuIsrEnable=false, IcuIsrHwId=WKPU_CH_6
        IcuHwInterruptConfigList_96: IcuIsrEnable=false, IcuIsrHwId=WKPU_CH_7
        IcuHwInterruptConfigList_97: IcuIsrEnable=false, IcuIsrHwId=WKPU_CH_8
        IcuHwInterruptConfigList_98: IcuIsrEnable=false, IcuIsrHwId=WKPU_CH_9
        IcuHwInterruptConfigList_99: IcuIsrEnable=false, IcuIsrHwId=WKPU_CH_10
      IcueMios_0 (IcueMios): IcueMiosModule=EMIOS_0
        IcueMiosChannels_0 (IcueMiosChannels):
          IcuEmiosBusSelect = EMIOS_BUS_INTERNAL_COUNTER
          IcuEmiosDigitalFilter = EMIOS_DIGITAL_FILTER_BYPASSED
          IcuEmiosFreeze = false
          IcuEmiosPrescaler = EMIOS_PRESCALER_DIVIDE_1
          IcuEmiosPrescaler_Alternate = EMIOS_PRESCALER_DIVIDE_1
          IcuSignalMeasureWithoutInterrupt = false
          IcuUserModeForDutycycle = SAIC
          IcueMiosChannel = CH_0
      IcuChannel_RFIC_IRQ (IcuChannel):
        IcuChannelId = 2
        IcuHwIP = WKPU
        IcuDMAChannelEnable = false
        IcuDefaultStartEdge = ICU_RISING_EDGE
        IcuMeasurementMode = ICU_MODE_SIGNAL_EDGE_DETECT
        IcuOverflowNotification = NULL_PTR
        IcuLockableChannel = false
        IcuWakeupCapability = false
        IcuWkpuChannelRef = IcuWkpuChannels_RFIC_IRQ
        IcuSignalEdgeDetection: IcuSignalNotification=CDD_IcuNotification_RFIC_IRQ
      IcuChannel_LFIC_IRQ (IcuChannel):
        IcuChannelId = 1
        IcuHwIP = WKPU
        IcuDMAChannelEnable = false
        IcuDefaultStartEdge = ICU_RISING_EDGE
        IcuMeasurementMode = ICU_MODE_SIGNAL_EDGE_DETECT
        IcuOverflowNotification = NULL_PTR
        IcuLockableChannel = false
        IcuWakeupCapability = false
        IcuWkpuChannelRef = IcuWkpuChannels_LFIC_IRQ
        IcuSignalEdgeDetection: IcuSignalNotification=CDD_IcuNotification_LFIC_IRQ
      IcuWkpu
        IcuWkpuChannels_RFIC_IRQ (IcuWkpuChannels): IcuWkpuChannel=WKPU_CH_27, Icu_EXT_ISR_WIFERDigitalFilter=false, IcuWKPU_ISR_WIPUER=false
        IcuWkpuChannels_LFIC_IRQ (IcuWkpuChannels): IcuWkpuChannel=WKPU_CH_28, Icu_EXT_ISR_WIFERDigitalFilter=false, IcuWKPU_ISR_WIPUER=false
      IcuChannel_0 (IcuChannel):
        IcuChannelId = 0
        IcuHwIP = EMIOS
        IcuDMAChannelEnable = false
        IcuDefaultStartEdge = ICU_RISING_EDGE
        IcuMeasurementMode = ICU_MODE_EDGE_COUNTER
        IcuOverflowNotification = NULL_PTR
        IcuLockableChannel = false
        IcuWakeupCapability = false
        IcueMiosChannelRef = IcueMiosChannels_0
    IcuGeneral: IcuDevErrorDetect=true, IcuEnableUserModeSupport=false, IcuIndex=0, IcuReportWakeupSource=true
    IcuNonAUTOSAR:
      IcuEnableDualClockMode = false
      IcuGetCaptureRegisterValueApi = false
      IcuGetInputLevelApi = false
      IcuOverflowNotificationApi = false
      IcuRegisterLockingMode = NO_REGISTER_LOCKING
      IcuSupportSAICModeApi = true
      IcuWkpuStandbyWakeupSupport = false
    IcuOptionalApis:
      IcuDeInitApi = true
      IcuDisableWakeupApi = true
      IcuEdgeCountApi = true
      IcuEdgeDetectApi = true
      IcuEnableWakeupApi = true
      IcuGetDutyCycleValuesApi = true
      IcuGetInputStateApi = true
      IcuGetTimeElapsedApi = true
      IcuGetVersionInfoApi = true
      IcuSetModeApi = true
      IcuSignalMeasurementApi = true
      IcuTimestampApi = true
      IcuWakeupFunctionalityApi = true
