AUTOSAR XML (schema 4-2-1)
package /Base
  module config Base: implementation-config-variant=VARIANT-PRE-COMPILE, module-description=Base_Impl
    CommonPublishedInformation:
      ArReleaseMajorVersion = 4
      ArReleaseMinorVersion = 2
      ArReleaseRevisionVersion = 2
      ModuleId = 0
      SwMajorVersion = 1
      SwMinorVersion = 0
      SwPatchVersion = 0
      VendorId = 43
