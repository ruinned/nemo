AUTOSAR XML (schema 4-2-1)
package /ActiveEcuC
  module config Dcm: implementation-config-variant=VARIANT-PRE-COMPILE, module-description=Dcm_Impl
    DcmConfigSet
      DcmDsl
        DcmDslProtocol
          DcmDslProtocolRow_29812fbf (DcmDslProtocolRow):
            DcmDslProtocolID = DCM_UDS_ON_CAN
            DcmDslProtocolEndiannessConvEnabled = false
            DcmDslProtocolIsParallelExecutab = false
            DcmDslProtocolPreemptTimeout = 0
            DcmDslProtocolPriority = 0
            DcmSendRespPendOnTransToBoot = true
            DcmTimStrP2ServerAdjust = 0
            DcmTimStrP2StarServerAdjust = 0
            DcmDslProtocolRxBufferID = DcmDslBuffer
            DcmDslProtocolSIDTable = DcmDsdServiceTable
            DcmDslProtocolTxBufferID = DcmDslBuffer
            4 x DcmDslConnection:
              DcmDslConnection_46b54530
                DcmDslPeriodicTransmission: DcmDslPeriodicTxConfirmationTimeout=0.1
                  DiagUUDTRespMsg1_F2_40_BB2_oBackbone2_a38250b2_Tx_faed6f92 (DcmDslPeriodicConnection): DcmDslPeriodicTxConfirmationPduId=2, DcmDslPeriodicTxPduRef=DiagUUDTRespMsg1_F2_40_BB2_oBackbone2_a38250b2_Tx
              DC_0xF340_oCIOM_oBackbone2_79f643d9
                DcmDslMainConnection: DcmDslProtocolRxTesterSourceAddr=243
                  DiagRespMsgIntHMIIOM_F3_40_BB2_oBackbone2_af2ada4c_Tx_7eced95c (DcmDslProtocolTx): DcmDslTxConfirmationPduId=0, DcmDslProtocolTxPduRef=DiagRespMsgIntHMIIOM_F3_40_BB2_oBackbone2_af2ada4c_Tx
                  DiagReqMsgIntHMIIOM_40_F3_BB2_oBackbone2_7ba98dfb_Rx_08579738 (DcmDslProtocolRx):
                    DcmDslProtocolRxAddrType = DCM_PHYSICAL_TYPE
                    DcmDslProtocolRxPduId = 0
                    DcmDslProtocolRxChannelId = 0
                    DcmDslProtocolRxComMChannelRef = CN_Backbone2_78967e2c
                    DcmDslProtocolRxPduRef = DiagReqMsgIntHMIIOM_40_F3_BB2_oBackbone2_7ba98dfb_Rx
              DC_0xF440_oCIOM_oBackbone2_98b2e54a
                DcmDslMainConnection: DcmDslProtocolRxTesterSourceAddr=244
                  IntTesterTGW2FuncDiagMsg_BB2_oBackbone2_5e7bda8e_Rx_c6c5e268 (DcmDslProtocolRx):
                    DcmDslProtocolRxAddrType = DCM_FUNCTIONAL_TYPE
                    DcmDslProtocolRxPduId = 2
                    DcmDslProtocolRxChannelId = 0
                    DcmDslProtocolRxComMChannelRef = CN_Backbone2_78967e2c
                    DcmDslProtocolRxPduRef = IntTesterTGW2FuncDiagMsg_BB2_oBackbone2_5e7bda8e_Rx
                  DiagReqMsgIntTGW2_40_F4_BB2_oBackbone2_8112e50d_Rx_8bc4b712 (DcmDslProtocolRx):
                    DcmDslProtocolRxAddrType = DCM_PHYSICAL_TYPE
                    DcmDslProtocolRxPduId = 1
                    DcmDslProtocolRxChannelId = 0
                    DcmDslProtocolRxComMChannelRef = CN_Backbone2_78967e2c
                    DcmDslProtocolRxPduRef = DiagReqMsgIntTGW2_40_F4_BB2_oBackbone2_8112e50d_Rx
                  DiagRespMsgIntTGW2_F4_40_BB2_oBackbone2_fbc59a63_Tx_ce680ebf (DcmDslProtocolTx): DcmDslTxConfirmationPduId=1, DcmDslProtocolTxPduRef=DiagRespMsgIntTGW2_F4_40_BB2_oBackbone2_fbc59a63_Tx
              DC_0xF240_oCIOM_oBackbone2_1c91789f
                DcmDslMainConnection: DcmDslProtocolRxTesterSourceAddr=242, DcmDslPeriodicTranmissionConRef=DcmDslPeriodicTransmission
                  PhysDiagReqMsg_40_F2_BB2_oBackbone2_e5e9f9a5_Rx_4b17e256 (DcmDslProtocolRx):
                    DcmDslProtocolRxAddrType = DCM_PHYSICAL_TYPE
                    DcmDslProtocolRxPduId = 3
                    DcmDslProtocolRxChannelId = 0
                    DcmDslProtocolRxComMChannelRef = CN_Backbone2_78967e2c
                    DcmDslProtocolRxPduRef = PhysDiagReqMsg_40_F2_BB2_oBackbone2_e5e9f9a5_Rx
                  TesterFuncDiagMsg_BB2_oBackbone2_7fc3ea4b_Rx_5c679bc8 (DcmDslProtocolRx):
                    DcmDslProtocolRxAddrType = DCM_FUNCTIONAL_TYPE
                    DcmDslProtocolRxPduId = 4
                    DcmDslProtocolRxChannelId = 0
                    DcmDslProtocolRxComMChannelRef = CN_Backbone2_78967e2c
                    DcmDslProtocolRxPduRef = TesterFuncDiagMsg_BB2_oBackbone2_7fc3ea4b_Rx
                  PhysDiagRespMsg_F2_40_BB2_oBackbone2_d76075a5_Tx_1937d81a (DcmDslProtocolTx): DcmDslTxConfirmationPduId=3, DcmDslProtocolTxPduRef=PhysDiagRespMsg_F2_40_BB2_oBackbone2_d76075a5_Tx
        DcmDslDiagResp: DcmDslDiagRespMaxNumRespPend=0, DcmDslDiagRespOnSecondDeclinedRequest=false, DcmDslDiagRespMaxNumOfDeclinedRequests=3
        DcmDslBuffer: DcmDslBufferSize=50
      DcmGeneral:
        DcmDevErrorDetect = true
        DcmRequestManufacturerNotificationEnabled = false
        DcmRequestSupplierNotificationEnabled = false
        DcmRespondAllRequest = true
        DcmTaskTime = 0.01
        DcmVersionInfoApi = false
        DcmDspDataDefaultEndianness = LITTLE_ENDIAN
        DcmSafeBswChecks = false
        DcmSupportedIDCalculationSuppressionEnabled = false
        DcmDtrDataProvisionViaDemEnabled = true
        DcmForeignDiagnosticRequestDetectionEnabled = false
        DcmSuppressResponseOnCanTpFuncMixedAddrRequests = false
        DcmSenderReceiverPRPortsEnabled = false
      DcmDsd
        DcmDsdServiceTable
          DcmDsdService_10 (DcmDsdService): DcmDsdSidTabServiceId=16, DcmDsdSidTabSubfuncAvail=true
            DcmDsdSubService: DcmDsdSubServiceId=1
          DcmDsdService_3E (DcmDsdService): DcmDsdSidTabServiceId=62, DcmDsdSidTabSubfuncAvail=true, DcmDsdSidTabFnc=Dcm_DiagnosticService_0x01
      DcmDsp: DcmDspReadDIDReportsNODIByte=false
        DcmDspSession
          DcmDspSessionRow: DcmDspSessionForBoot=DCM_SYS_BOOT, DcmDspSessionLevel=1, DcmDspSessionP2ServerMax=0.05, DcmDspSessionP2StarServerMax=0.5
        DcmDspSecurity
        DidInfo_DID_StartApplication (DcmDspDidInfo)
          DcmDspDidAccess
            DcmDspDidRead
            DcmDspDidWrite
        DataInfo_DID_StartApplication (DcmDspDataInfo): DcmDspDataFixedLength=true
        Data_DID_StartApplication (DcmDspData):
          DcmDspDataConditionCheckReadFncUsed = false
          DcmDspDataSize = 16
          DcmDspDataUsePort = USE_DATA_SYNCH_CLIENT_SERVER
          DcmDspDataType = UINT16
          DcmDspDataInfoRef = DataInfo_DID_StartApplication
        DID_StartApplication (DcmDspDid): DcmDspDidIdentifier=85, DcmDspDidUsed=true, DcmDspDidUsePort=USE_DATA_ELEMENT_SPECIFIC_INTERFACES, DcmDspDidInfoRef=DidInfo_DID_StartApplication
          DcmDspDidSignal_Data_DID_StartApplication (DcmDspDidSignal): DcmDspDidDataPos=0, DcmDspDidDataRef=Data_DID_StartApplication
      DcmPageBufferCfg: DcmPagedBufferEnabled=true
