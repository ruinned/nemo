AUTOSAR XML (schema 4-2-1)
package /ActiveEcuC
  module config BswM: implementation-config-variant=VARIANT-PRE-COMPILE, module-description=BswM_Impl
    BswMGeneral:
      BswMCanSMEnabled = true
      BswMComMEnabled = true
      BswMDcmEnabled = true
      BswMDevErrorDetect = true
      BswMEcuMEnabled = true
      BswMEthIfEnabled = false
      BswMEthSMEnabled = false
      BswMFrSMEnabled = false
      BswMGenericRequestEnabled = true
      BswMJ1939DcmEnabled = false
      BswMJ1939NmEnabled = true
      BswMLinSMEnabled = true
      BswMLinTPEnabled = true
      BswMNmEnabled = false
      BswMNvMEnabled = true
      BswMPduREnabled = false
      BswMRuleControlEnabled = false
      BswMSdEnabled = false
      BswMVersionInfoApi = false
      BswMWdgMEnabled = false
      BswMModeCheck = true
      BswMActionListQueueSearchAlgorithm = LINEAR_SEARCH
      BswMMainFunctionPeriod = 0.01
      BswMCommonData
      BswMGeneration:
        BswMOutOfBoundsWriteSanitizer = false
        BswMOutOfBoundsReadSanitizer = false
        BswMReduceConstantData2Define = true
        BswMReduceDataByStreaming = false
        BswMBoolDataInArrayOfStructStrategy = BITMASKING
        BswMInterfacesForDeactivatedData = false
      BswMUserIncludeFiles: BswMUserIncludeFile=EcuM_Init_PBCfg.h
    BswMConfig
      BswMArbitration
        ISSM_RunRequest (BswMModeRequestPort): BswMArbitrateOnInit=false, BswMRequestProcessing=BSWM_IMMEDIATE
          BswMModeRequestSource
            BswMIssmRunRequest (BswMGenericRequest): BswMModeRequesterId=0, BswMRequestedModeMax=1
              ISSM_NO_RUN_REQUEST (BswMGenericRequestMode): BswMGenericRequestModeValue=0
              ISSM_RUN_REQUEST (BswMGenericRequestMode): BswMGenericRequestModeValue=1
          BswMModeInitValue
            BswMBswModeInitValue: BswMBswModeInitValueMode=ISSM_NO_RUN_REQUEST
        CC_CN_CabSubnet_9ea693f1_RX_DM (BswMRule):
          BswMNestedExecutionOnly = false
          BswMRuleId = 7
          BswMRuleInitState = BSWM_FALSE
          BswMRuleExpressionRef = CC_LE_CN_CabSubnet_9ea693f1_RX_DM
          BswMRuleFalseActionList = CC_AL_CN_CabSubnet_9ea693f1_Disable_DM
          BswMRuleTrueActionList = CC_AL_CN_CabSubnet_9ea693f1_Enable_DM
        CC_LE_CN_CabSubnet_9ea693f1_RX_DM (BswMLogicalExpression): BswMLogicalOperator=BSWM_AND, BswMArgumentRef=CC_Cond_CanSMIndication_CN_CabSubnet_9ea693f1_EQ_CANSM_BSWM_FULL_COMMUNICATION
        CC_Cond_CanSMIndication_CN_CabSubnet_9ea693f1_EQ_CANSM_BSWM_FULL_COMMUNICATION (BswMModeCondition): BswMConditionType=BSWM_EQUALS, BswMConditionMode=CC_CanSMIndication_CN_CabSubnet_9ea693f1
          BswMConditionValue
            BswMBswMode: BswMBswRequestedMode=CANSM_BSWM_FULL_COMMUNICATION
        CC_CanSMIndication_CN_CabSubnet_9ea693f1 (BswMModeRequestPort): BswMArbitrateOnInit=false, BswMRequestProcessing=BSWM_IMMEDIATE
          BswMModeRequestSource
            BswMCanSMIndication: BswMCanSMChannelRef=CN_CabSubnet_9ea693f1
          BswMModeInitValue
            BswMBswModeInitValue: BswMBswModeInitValueMode=CANSM_BSWM_NO_COMMUNICATION
        CC_J1939NmIndication_CN_Backbone1J1939_0b1f4bae_CIOM_4d5cd289 (BswMModeRequestPort): BswMArbitrateOnInit=false, BswMRequestProcessing=BSWM_IMMEDIATE
          BswMModeRequestSource
            BswMJ1939NmIndication: BswMJ1939NmChannelRef=CN_Backbone1J1939_0b1f4bae, BswMJ1939NmNodeRef=CIOM_4d5cd289
          BswMModeInitValue
            BswMBswModeInitValue: BswMBswModeInitValueMode=NM_STATE_BUS_SLEEP
        CC_CN_Backbone2_78967e2c_RX_DM (BswMRule):
          BswMNestedExecutionOnly = false
          BswMRuleId = 4
          BswMRuleInitState = BSWM_FALSE
          BswMRuleExpressionRef = CC_LE_CN_Backbone2_78967e2c_RX_DM
          BswMRuleFalseActionList = CC_AL_LIN1_ScheduleTable_to_MasterReq_SlaveResp_Table_1
          BswMRuleTrueActionList = CC_AL_LIN5_ScheduleTable_to_MasterReq_SlaveResp
        CC_LE_CN_Backbone2_78967e2c_RX_DM (BswMLogicalExpression): BswMLogicalOperator=BSWM_AND, BswMArgumentRef=CC_Cond_CanSMIndication_CN_Backbone2_78967e2c_EQ_CANSM_BSWM_FULL_COMMUNICATION
        CC_Cond_CanSMIndication_CN_Backbone2_78967e2c_EQ_CANSM_BSWM_FULL_COMMUNICATION (BswMModeCondition): BswMConditionType=BSWM_EQUALS, BswMConditionMode=CC_CanSMIndication_CN_Backbone2_78967e2c
          BswMConditionValue
            BswMBswMode: BswMBswRequestedMode=CANSM_BSWM_FULL_COMMUNICATION
        CC_CanSMIndication_CN_Backbone2_78967e2c (BswMModeRequestPort): BswMArbitrateOnInit=false, BswMRequestProcessing=BSWM_IMMEDIATE
          BswMModeRequestSource
            BswMCanSMIndication: BswMCanSMChannelRef=CN_Backbone2_78967e2c
          BswMModeInitValue
            BswMBswModeInitValue: BswMBswModeInitValueMode=CANSM_BSWM_NO_COMMUNICATION
        CC_CN_SecuritySubnet_e7a0ee54_TX (BswMRule):
          BswMNestedExecutionOnly = false
          BswMRuleId = 20
          BswMRuleInitState = BSWM_FALSE
          BswMRuleExpressionRef = CC_LE_CN_SecuritySubnet_e7a0ee54_TX
          BswMRuleFalseActionList = CC_AL_CN_SecuritySubnet_e7a0ee54_TX_Disable
          BswMRuleTrueActionList = CC_AL_CN_SecuritySubnet_e7a0ee54_TX_EnableNoinit
        CC_LE_CN_SecuritySubnet_e7a0ee54_TX (BswMLogicalExpression): BswMLogicalOperator=BSWM_AND, BswMArgumentRef=CC_Cond_CanSMIndication_CN_SecuritySubnet_e7a0ee54_EQ_CANSM_BSWM_FULL_COMMUNICATION
        CC_Cond_CanSMIndication_CN_SecuritySubnet_e7a0ee54_EQ_CANSM_BSWM_FULL_COMMUNICATION (BswMModeCondition): BswMConditionType=BSWM_EQUALS, BswMConditionMode=CC_CanSMIndication_CN_SecuritySubnet_e7a0ee54
          BswMConditionValue
            BswMBswMode: BswMBswRequestedMode=CANSM_BSWM_FULL_COMMUNICATION
        CC_CanSMIndication_CN_SecuritySubnet_e7a0ee54 (BswMModeRequestPort): BswMArbitrateOnInit=false, BswMRequestProcessing=BSWM_IMMEDIATE
          BswMModeRequestSource
            BswMCanSMIndication: BswMCanSMChannelRef=CN_SecuritySubnet_e7a0ee54
          BswMModeInitValue
            BswMBswModeInitValue: BswMBswModeInitValueMode=CANSM_BSWM_NO_COMMUNICATION
        CC_CN_LIN02_c2d7c6f3 (BswMRule):
          BswMNestedExecutionOnly = false
          BswMRuleId = 15
          BswMRuleInitState = BSWM_FALSE
          BswMRuleExpressionRef = CC_LE_CN_LIN02_c2d7c6f3
          BswMRuleFalseActionList = CC_AL_CN_LIN02_c2d7c6f3_Disable
          BswMRuleTrueActionList = CC_AL_CN_LIN02_c2d7c6f3_Enable
        CC_LE_CN_LIN02_c2d7c6f3 (BswMLogicalExpression): BswMLogicalOperator=BSWM_AND, BswMArgumentRef=CC_Cond_LinSMIndication_CN_LIN02_c2d7c6f3_EQ_LINSM_BSWM_FULL_COM
        CC_Cond_LinSMIndication_CN_LIN02_c2d7c6f3_EQ_LINSM_BSWM_FULL_COM (BswMModeCondition): BswMConditionType=BSWM_EQUALS, BswMConditionMode=CC_LinSMIndication_CN_LIN02_c2d7c6f3
          BswMConditionValue
            BswMBswMode: BswMBswRequestedMode=LINSM_BSWM_FULL_COM
        CC_LinSMIndication_CN_LIN02_c2d7c6f3 (BswMModeRequestPort): BswMArbitrateOnInit=false, BswMRequestProcessing=BSWM_IMMEDIATE
          BswMModeRequestSource
            BswMLinSMIndication: BswMLinSMChannelRef=CN_LIN02_c2d7c6f3
          BswMModeInitValue
            BswMBswModeInitValue: BswMBswModeInitValueMode=LINSM_BSWM_NO_COM
        CC_CN_SecuritySubnet_e7a0ee54_RX (BswMRule):
          BswMNestedExecutionOnly = false
          BswMRuleId = 18
          BswMRuleInitState = BSWM_FALSE
          BswMRuleExpressionRef = CC_LE_CN_SecuritySubnet_e7a0ee54_RX
          BswMRuleFalseActionList = CC_AL_CN_SecuritySubnet_e7a0ee54_RX_Disable
          BswMRuleTrueActionList = CC_AL_CN_SecuritySubnet_e7a0ee54_RX_EnableNoinit
        CC_LE_CN_SecuritySubnet_e7a0ee54_RX (BswMLogicalExpression): BswMLogicalOperator=BSWM_AND, BswMArgumentRef=CC_Cond_CanSMIndication_CN_SecuritySubnet_e7a0ee54_NEQ_CANSM_BSWM_NO_COMMUNICATION
        CC_Cond_CanSMIndication_CN_SecuritySubnet_e7a0ee54_NEQ_CANSM_BSWM_NO_COMMUNICATION (BswMModeCondition): BswMConditionType=BSWM_EQUALS_NOT, BswMConditionMode=CC_CanSMIndication_CN_SecuritySubnet_e7a0ee54
          BswMConditionValue
            BswMBswMode: BswMBswRequestedMode=CANSM_BSWM_NO_COMMUNICATION
        CC_CN_SecuritySubnet_e7a0ee54_RX_DM (BswMRule):
          BswMNestedExecutionOnly = false
          BswMRuleId = 19
          BswMRuleInitState = BSWM_FALSE
          BswMRuleExpressionRef = CC_LE_CN_SecuritySubnet_e7a0ee54_RX_DM
          BswMRuleFalseActionList = CC_AL_CN_SecuritySubnet_e7a0ee54_Disable_DM
          BswMRuleTrueActionList = CC_AL_CN_SecuritySubnet_e7a0ee54_Enable_DM
        CC_LE_CN_SecuritySubnet_e7a0ee54_RX_DM (BswMLogicalExpression): BswMLogicalOperator=BSWM_AND, BswMArgumentRef=CC_Cond_CanSMIndication_CN_SecuritySubnet_e7a0ee54_EQ_CANSM_BSWM_FULL_COMMUNICATION
        CC_CN_Backbone2_78967e2c_RX (BswMRule):
          BswMNestedExecutionOnly = false
          BswMRuleId = 3
          BswMRuleInitState = BSWM_FALSE
          BswMRuleExpressionRef = CC_LE_CN_Backbone2_78967e2c_RX
          BswMRuleFalseActionList = CC_AL_CN_Backbone2_78967e2c_RX_Disable
          BswMRuleTrueActionList = CC_AL_CN_Backbone2_78967e2c_RX_EnableNoinit
        CC_LE_CN_Backbone2_78967e2c_RX (BswMLogicalExpression): BswMLogicalOperator=BSWM_AND, BswMArgumentRef=CC_Cond_CanSMIndication_CN_Backbone2_78967e2c_NEQ_CANSM_BSWM_NO_COMMUNICATION
        CC_Cond_CanSMIndication_CN_Backbone2_78967e2c_NEQ_CANSM_BSWM_NO_COMMUNICATION (BswMModeCondition): BswMConditionType=BSWM_EQUALS_NOT, BswMConditionMode=CC_CanSMIndication_CN_Backbone2_78967e2c
          BswMConditionValue
            BswMBswMode: BswMBswRequestedMode=CANSM_BSWM_NO_COMMUNICATION
        CC_CN_CabSubnet_9ea693f1_TX (BswMRule):
          BswMNestedExecutionOnly = false
          BswMRuleId = 8
          BswMRuleInitState = BSWM_FALSE
          BswMRuleExpressionRef = CC_LE_CN_CabSubnet_9ea693f1_TX
          BswMRuleFalseActionList = CC_AL_CN_CabSubnet_9ea693f1_TX_Disable
          BswMRuleTrueActionList = CC_AL_CN_CabSubnet_9ea693f1_TX_EnableNoinit
        CC_LE_CN_CabSubnet_9ea693f1_TX (BswMLogicalExpression): BswMLogicalOperator=BSWM_AND, BswMArgumentRef=CC_Cond_CanSMIndication_CN_CabSubnet_9ea693f1_EQ_CANSM_BSWM_FULL_COMMUNICATION
        CC_CN_Backbone2_78967e2c_TX (BswMRule):
          BswMNestedExecutionOnly = false
          BswMRuleId = 5
          BswMRuleInitState = BSWM_FALSE
          BswMRuleExpressionRef = CC_LE_CN_Backbone2_78967e2c_TX
          BswMRuleFalseActionList = CC_AL_CN_Backbone2_78967e2c_TX_Disable
          BswMRuleTrueActionList = CC_AL_CN_Backbone2_78967e2c_TX_EnableNoinit
        CC_LE_CN_Backbone2_78967e2c_TX (BswMLogicalExpression): BswMLogicalOperator=BSWM_AND, BswMArgumentRef=CC_Cond_CanSMIndication_CN_Backbone2_78967e2c_EQ_CANSM_BSWM_FULL_COMMUNICATION
        CC_CN_CabSubnet_9ea693f1_RX (BswMRule):
          BswMNestedExecutionOnly = false
          BswMRuleId = 6
          BswMRuleInitState = BSWM_FALSE
          BswMRuleExpressionRef = CC_LE_CN_CabSubnet_9ea693f1_RX
          BswMRuleFalseActionList = CC_AL_LIN2_ScheduleTable_to_Table_E
          BswMRuleTrueActionList = CC_AL_CN_CabSubnet_9ea693f1_RX_EnableNoinit
        CC_LE_CN_CabSubnet_9ea693f1_RX (BswMLogicalExpression): BswMLogicalOperator=BSWM_AND, BswMArgumentRef=CC_Cond_CanSMIndication_CN_CabSubnet_9ea693f1_NEQ_CANSM_BSWM_NO_COMMUNICATION
        CC_Cond_CanSMIndication_CN_CabSubnet_9ea693f1_NEQ_CANSM_BSWM_NO_COMMUNICATION (BswMModeCondition): BswMConditionType=BSWM_EQUALS_NOT, BswMConditionMode=CC_CanSMIndication_CN_CabSubnet_9ea693f1
          BswMConditionValue
            BswMBswMode: BswMBswRequestedMode=CANSM_BSWM_NO_COMMUNICATION
        CC_CN_LIN03_b5d0f665 (BswMRule):
          BswMNestedExecutionOnly = false
          BswMRuleId = 16
          BswMRuleInitState = BSWM_FALSE
          BswMRuleExpressionRef = CC_LE_CN_LIN03_b5d0f665
          BswMRuleFalseActionList = CC_AL_LIN5_ScheduleTable_to_Table2
          BswMRuleTrueActionList = CC_AL_CN_LIN03_b5d0f665_Enable
        CC_LE_CN_LIN03_b5d0f665 (BswMLogicalExpression): BswMLogicalOperator=BSWM_AND, BswMArgumentRef=CC_Cond_LinSMIndication_CN_LIN03_b5d0f665_EQ_LINSM_BSWM_FULL_COM
        CC_Cond_LinSMIndication_CN_LIN03_b5d0f665_EQ_LINSM_BSWM_FULL_COM (BswMModeCondition): BswMConditionType=BSWM_EQUALS, BswMConditionMode=CC_LinSMIndication_CN_LIN03_b5d0f665
          BswMConditionValue
            BswMBswMode: BswMBswRequestedMode=LINSM_BSWM_FULL_COM
        CC_LinSMIndication_CN_LIN03_b5d0f665 (BswMModeRequestPort): BswMArbitrateOnInit=false, BswMRequestProcessing=BSWM_IMMEDIATE
          BswMModeRequestSource
            BswMLinSMIndication: BswMLinSMChannelRef=CN_LIN03_b5d0f665
          BswMModeInitValue
            BswMBswModeInitValue: BswMBswModeInitValueMode=LINSM_BSWM_NO_COM
        CC_CN_LIN01_5bde9749 (BswMRule):
          BswMNestedExecutionOnly = false
          BswMRuleId = 14
          BswMRuleInitState = BSWM_FALSE
          BswMRuleExpressionRef = CC_LE_CN_LIN01_5bde9749
          BswMRuleFalseActionList = CC_AL_CN_LIN01_5bde9749_Disable
          BswMRuleTrueActionList = CC_AL_CN_LIN01_5bde9749_Enable
        CC_LE_CN_LIN01_5bde9749 (BswMLogicalExpression): BswMLogicalOperator=BSWM_AND, BswMArgumentRef=CC_Cond_LinSMIndication_CN_LIN01_5bde9749_EQ_LINSM_BSWM_FULL_COM
        CC_Cond_LinSMIndication_CN_LIN01_5bde9749_EQ_LINSM_BSWM_FULL_COM (BswMModeCondition): BswMConditionType=BSWM_EQUALS, BswMConditionMode=CC_LinSMIndication_CN_LIN01_5bde9749
          BswMConditionValue
            BswMBswMode: BswMBswRequestedMode=LINSM_BSWM_FULL_COM
        CC_LinSMIndication_CN_LIN01_5bde9749 (BswMModeRequestPort): BswMArbitrateOnInit=false, BswMRequestProcessing=BSWM_IMMEDIATE
          BswMModeRequestSource
            BswMLinSMIndication: BswMLinSMChannelRef=CN_LIN01_5bde9749
          BswMModeInitValue
            BswMBswModeInitValue: BswMBswModeInitValueMode=LINSM_BSWM_NO_COM
        CC_CN_LIN04_2bb463c6 (BswMRule):
          BswMNestedExecutionOnly = false
          BswMRuleId = 17
          BswMRuleInitState = BSWM_FALSE
          BswMRuleExpressionRef = CC_LE_CN_LIN04_2bb463c6
          BswMRuleFalseActionList = CC_AL_CN_LIN04_2bb463c6_Disable
          BswMRuleTrueActionList = CC_AL_CN_LIN04_2bb463c6_Enable
        CC_LE_CN_LIN04_2bb463c6 (BswMLogicalExpression): BswMLogicalOperator=BSWM_AND, BswMArgumentRef=CC_Cond_LinSMIndication_CN_LIN04_2bb463c6_EQ_LINSM_BSWM_FULL_COM
        CC_Cond_LinSMIndication_CN_LIN04_2bb463c6_EQ_LINSM_BSWM_FULL_COM (BswMModeCondition): BswMConditionType=BSWM_EQUALS, BswMConditionMode=CC_LinSMIndication_CN_LIN04_2bb463c6
          BswMConditionValue
            BswMBswMode: BswMBswRequestedMode=LINSM_BSWM_FULL_COM
        CC_LinSMIndication_CN_LIN04_2bb463c6 (BswMModeRequestPort): BswMArbitrateOnInit=false, BswMRequestProcessing=BSWM_IMMEDIATE
          BswMModeRequestSource
            BswMLinSMIndication: BswMLinSMChannelRef=CN_LIN04_2bb463c6
          BswMModeInitValue
            BswMBswModeInitValue: BswMBswModeInitValueMode=LINSM_BSWM_NO_COM
        CC_CN_Backbone1J1939_0b1f4bae_RX (BswMRule):
          BswMNestedExecutionOnly = false
          BswMRuleId = 1
          BswMRuleInitState = BSWM_FALSE
          BswMRuleExpressionRef = CC_LE_CN_Backbone1J1939_0b1f4bae_RX
          BswMRuleFalseActionList = CC_AL_CN_Backbone1J1939_0b1f4bae_RX_Disable
          BswMRuleTrueActionList = CC_AL_LIN4_ScheduleTable_to_MasterReq_SlaveResp
        CC_LE_CN_Backbone1J1939_0b1f4bae_RX (BswMLogicalExpression): BswMLogicalOperator=BSWM_AND, BswMArgumentRef=CC_Cond_CanSMIndication_CN_Backbone1J1939_0b1f4bae_NEQ_CANSM_BSWM_NO_COMMUNICATION
        CC_Cond_CanSMIndication_CN_Backbone1J1939_0b1f4bae_NEQ_CANSM_BSWM_NO_COMMUNICATION (BswMModeCondition): BswMConditionType=BSWM_EQUALS_NOT, BswMConditionMode=CC_CanSMIndication_CN_Backbone1J1939_0b1f4bae
          BswMConditionValue
            BswMBswMode: BswMBswRequestedMode=CANSM_BSWM_NO_COMMUNICATION
        CC_CanSMIndication_CN_Backbone1J1939_0b1f4bae (BswMModeRequestPort): BswMArbitrateOnInit=false, BswMRequestProcessing=BSWM_IMMEDIATE
          BswMModeRequestSource
            BswMCanSMIndication: BswMCanSMChannelRef=CN_Backbone1J1939_0b1f4bae
          BswMModeInitValue
            BswMBswModeInitValue: BswMBswModeInitValueMode=CANSM_BSWM_NO_COMMUNICATION
        CC_CN_Backbone1J1939_0b1f4bae_RX_DM (BswMRule):
          BswMNestedExecutionOnly = false
          BswMRuleId = 2
          BswMRuleInitState = BSWM_FALSE
          BswMRuleExpressionRef = CC_LE_CN_Backbone1J1939_0b1f4bae_RX_DM
          BswMRuleFalseActionList = CC_AL_CN_Backbone1J1939_0b1f4bae_Disable_DM
          BswMRuleTrueActionList = CC_AL_CN_Backbone1J1939_0b1f4bae_Enable_DM
        CC_LE_CN_Backbone1J1939_0b1f4bae_RX_DM (BswMLogicalExpression): BswMLogicalOperator=BSWM_AND, BswMArgumentRef=CC_Cond_CanSMIndication_CN_Backbone1J1939_0b1f4bae_EQ_CANSM_BSWM_FULL_COMMUNICATION
        CC_Cond_CanSMIndication_CN_Backbone1J1939_0b1f4bae_EQ_CANSM_BSWM_FULL_COMMUNICATION (BswMModeCondition): BswMConditionType=BSWM_EQUALS, BswMConditionMode=CC_CanSMIndication_CN_Backbone1J1939_0b1f4bae
          BswMConditionValue
            BswMBswMode: BswMBswRequestedMode=CANSM_BSWM_FULL_COMMUNICATION
        CC_CN_LIN00_2cd9a7df (BswMRule):
          BswMNestedExecutionOnly = false
          BswMRuleId = 13
          BswMRuleInitState = BSWM_FALSE
          BswMRuleExpressionRef = CC_LE_CN_LIN00_2cd9a7df
          BswMRuleFalseActionList = CC_AL_CN_LIN00_2cd9a7df_Disable
          BswMRuleTrueActionList = CC_AL_CN_LIN00_2cd9a7df_Enable
        CC_LE_CN_LIN00_2cd9a7df (BswMLogicalExpression): BswMLogicalOperator=BSWM_AND, BswMArgumentRef=CC_Cond_LinSMIndication_CN_LIN00_2cd9a7df_EQ_LINSM_BSWM_FULL_COM
        CC_Cond_LinSMIndication_CN_LIN00_2cd9a7df_EQ_LINSM_BSWM_FULL_COM (BswMModeCondition): BswMConditionType=BSWM_EQUALS, BswMConditionMode=CC_LinSMIndication_CN_LIN00_2cd9a7df
          BswMConditionValue
            BswMBswMode: BswMBswRequestedMode=LINSM_BSWM_FULL_COM
        CC_LinSMIndication_CN_LIN00_2cd9a7df (BswMModeRequestPort): BswMArbitrateOnInit=false, BswMRequestProcessing=BSWM_IMMEDIATE
          BswMModeRequestSource
            BswMLinSMIndication: BswMLinSMChannelRef=CN_LIN00_2cd9a7df
          BswMModeInitValue
            BswMBswModeInitValue: BswMBswModeInitValueMode=LINSM_BSWM_NO_COM
        ESH_RunToPostRun (BswMRule):
          BswMNestedExecutionOnly = false
          BswMRuleId = 60
          BswMRuleInitState = BSWM_FALSE
          BswMRuleExpressionRef = ESH_LE_RunToPostRun
          BswMRuleTrueActionList = ESH_AL_ExitRun
        ESH_LE_RunToPostRun (BswMLogicalExpression):
          BswMLogicalOperator = BSWM_AND
          BswMArgumentRef = ESH_Cond_StateIsRun
          BswMArgumentRef = ESH_LE_AllChannelsNoCom
          BswMArgumentRef = ESH_LE_RunReleased
          BswMArgumentRef = ESH_Cond_SelfRunReqTimerExpired
          BswMArgumentRef = ESH_Cond_ModeIsRun
        ESH_Cond_StateIsRun (BswMModeCondition): BswMConditionType=BSWM_EQUALS, BswMConditionMode=ESH_State
          BswMConditionValue
            BswMBswMode: BswMBswRequestedMode=ESH_RUN
        ESH_State (BswMModeRequestPort): BswMArbitrateOnInit=true, BswMRequestProcessing=BSWM_IMMEDIATE
          BswMModeRequestSource
            BswMGenericRequest: BswMModeRequesterId=230, BswMRequestedModeMax=7
              7 x BswMGenericRequestMode:
                ESH_INIT: BswMGenericRequestModeValue=0
                ESH_RUN: BswMGenericRequestModeValue=1
                ESH_POST_RUN: BswMGenericRequestModeValue=2
                ESH_PREP_SHUTDOWN: BswMGenericRequestModeValue=3
                ESH_WAIT_FOR_NVM: BswMGenericRequestModeValue=4
                ESH_SHUTDOWN: BswMGenericRequestModeValue=5
                ESH_WAKEUP: BswMGenericRequestModeValue=6
          BswMModeInitValue
            BswMBswModeInitValue: BswMBswModeInitValueMode=ESH_INIT
        ESH_LE_AllChannelsNoCom (BswMLogicalExpression):
          BswMLogicalOperator = BSWM_AND
          BswMArgumentRef = ESH_Cond_NoComOn_CN_Backbone1J1939_0b1f4bae
          BswMArgumentRef = ESH_Cond_NoComOn_CN_LIN00_2cd9a7df
          BswMArgumentRef = ESH_Cond_NoComOn_CN_LIN02_c2d7c6f3
          BswMArgumentRef = ESH_Cond_NoComOn_CN_LIN04_2bb463c6
          BswMArgumentRef = ESH_Cond_NoComOn_CN_CabSubnet_9ea693f1
          BswMArgumentRef = ESH_Cond_NoComOn_CN_LIN03_b5d0f665
          BswMArgumentRef = ESH_Cond_NoComOn_CN_Backbone2_78967e2c
          BswMArgumentRef = ESH_Cond_NoComOn_CN_LIN01_5bde9749
          BswMArgumentRef = ESH_Cond_NoComOn_CN_FMSNet_fce1aae5
          BswMArgumentRef = ESH_Cond_NoComOn_CN_SecuritySubnet_e7a0ee54
        ESH_LE_RunReleased (BswMLogicalExpression): BswMLogicalOperator=BSWM_AND, BswMArgumentRef=ESH_Cond_RunRequest0IsReleased, BswMArgumentRef=ESH_Cond_RunRequest1IsReleased
        ESH_Cond_RunRequest0IsReleased (BswMModeCondition): BswMConditionType=BSWM_EQUALS, BswMConditionMode=ESH_RunRequest_0
          BswMConditionValue
            BswMModeDeclaration: BswMModeValueRef=RELEASED
        ESH_RunRequest_0 (BswMModeRequestPort): BswMArbitrateOnInit=false, BswMRequestProcessing=BSWM_DEFERRED
          BswMModeRequestSource
            BswMSwcModeRequest: BswMModeRequestDataElementPrototypeName=requestedMode, BswMSwcModeRequestModeDeclarationGroupPrototypeRef=BswM_MDGP_ESH_RunRequest
          BswMModeInitValue
            BswMSwcModeInitValue: BswMSwcModeInitValueRef=RELEASED
        ESH_Cond_RunRequest1IsReleased (BswMModeCondition): BswMConditionType=BSWM_EQUALS, BswMConditionMode=ESH_RunRequest_1
          BswMConditionValue
            BswMModeDeclaration: BswMModeValueRef=RELEASED
        ESH_RunRequest_1 (BswMModeRequestPort): BswMArbitrateOnInit=false, BswMRequestProcessing=BSWM_DEFERRED
          BswMModeRequestSource
            BswMSwcModeRequest: BswMModeRequestDataElementPrototypeName=requestedMode, BswMSwcModeRequestModeDeclarationGroupPrototypeRef=BswM_MDGP_ESH_RunRequest
          BswMModeInitValue
            BswMSwcModeInitValue: BswMSwcModeInitValueRef=RELEASED
        ESH_Cond_SelfRunReqTimerExpired (BswMModeCondition): BswMConditionType=BSWM_EQUALS, BswMConditionMode=ESH_SelfRunRequestTimer
          BswMConditionValue
            BswMBswMode: BswMBswRequestedMode=BSWM_TIMER_EXPIRED
        ESH_SelfRunRequestTimer (BswMModeRequestPort): BswMArbitrateOnInit=false, BswMRequestProcessing=BSWM_DEFERRED
          BswMModeRequestSource
            BswMTimer
          BswMModeInitValue
            BswMBswModeInitValue: BswMBswModeInitValueMode=BSWM_TIMER_STOPPED
        ESH_Cond_ModeIsRun (BswMModeCondition): BswMConditionType=BSWM_EQUALS, BswMConditionMode=ESH_ModeNotification
          BswMConditionValue
            BswMModeDeclaration: BswMModeValueRef=RUN
        ESH_ModeNotification (BswMModeRequestPort): BswMArbitrateOnInit=false, BswMRequestProcessing=BSWM_DEFERRED
          BswMModeRequestSource
            BswMSwcModeNotification: BswMSwcModeNotificationModeDeclarationGroupPrototypeRef=BswM_MDGP_ESH_Mode
          BswMModeInitValue
            BswMSwcModeInitValue: BswMSwcModeInitValueRef=STARTUP
        ESH_RunToPostRunNested (BswMRule):
          BswMNestedExecutionOnly = true
          BswMRuleId = 61
          BswMRuleInitState = BSWM_FALSE
          BswMRuleExpressionRef = ESH_LE_ComMNoPendingRequests
          BswMRuleTrueActionList = ESH_AL_RunToPostRun
        ESH_LE_ComMNoPendingRequests (BswMLogicalExpression): BswMLogicalOperator=BSWM_AND, BswMArgumentRef=ESH_Cond_ComMNoPendingRequests
        ESH_Cond_ComMNoPendingRequests (BswMModeCondition): BswMConditionType=BSWM_EQUALS, BswMConditionMode=ESH_ComMPendingRequests
          BswMConditionValue
            BswMBswMode: BswMBswRequestedMode=ESH_COMM_NO_REQUEST
        ESH_ComMPendingRequests (BswMModeRequestPort): BswMArbitrateOnInit=false, BswMRequestProcessing=BSWM_DEFERRED
          BswMModeRequestSource
            BswMGenericRequest: BswMModeRequesterId=232, BswMRequestedModeMax=2
              ESH_COMM_NO_REQUEST (BswMGenericRequestMode): BswMGenericRequestModeValue=0
              ESH_COMM_PENDING_REQUEST (BswMGenericRequestMode): BswMGenericRequestModeValue=1
          BswMModeInitValue
            BswMBswModeInitValue: BswMBswModeInitValueMode=ESH_COMM_NO_REQUEST
        ESH_WaitToShutdown (BswMRule):
          BswMNestedExecutionOnly = false
          BswMRuleId = 62
          BswMRuleInitState = BSWM_FALSE
          BswMRuleExpressionRef = ESH_LE_WaitForNvMToShutdown
          BswMRuleTrueActionList = ESH_AL_WaitForNvMToShutdown
        ESH_LE_WaitForNvMToShutdown (BswMLogicalExpression): BswMLogicalOperator=BSWM_AND, BswMArgumentRef=ESH_Cond_StateIsWaitForNvm, BswMArgumentRef=ESH_LE_WriteNotPending, BswMArgumentRef=ESH_LE_NoWakeup
        ESH_Cond_StateIsWaitForNvm (BswMModeCondition): BswMConditionType=BSWM_EQUALS, BswMConditionMode=ESH_State
          BswMConditionValue
            BswMBswMode: BswMBswRequestedMode=ESH_WAIT_FOR_NVM
        ESH_LE_WriteNotPending (BswMLogicalExpression): BswMLogicalOperator=BSWM_OR, BswMArgumentRef=ESH_Cond_NvMWAIsNotPending, BswMArgumentRef=ESH_Cond_NvWWriteAllTimerNotRunning
        ESH_Cond_NvMWAIsNotPending (BswMModeCondition): BswMConditionType=BSWM_EQUALS_NOT, BswMConditionMode=ESH_NvMIndication
          BswMConditionValue
            BswMBswMode: BswMBswRequestedMode=NVM_REQ_PENDING
        ESH_NvMIndication (BswMModeRequestPort): BswMArbitrateOnInit=false, BswMRequestProcessing=BSWM_DEFERRED
          BswMModeRequestSource
            BswMNvMJobModeIndication: BswMNvmService=NvmWriteAll
          BswMModeInitValue
            BswMBswModeInitValue: BswMBswModeInitValueMode=NVM_REQ_OK
        ESH_Cond_NvWWriteAllTimerNotRunning (BswMModeCondition): BswMConditionType=BSWM_EQUALS_NOT, BswMConditionMode=ESH_NvM_WriteAllTimer
          BswMConditionValue
            BswMBswMode: BswMBswRequestedMode=BSWM_TIMER_STARTED
        ESH_NvM_WriteAllTimer (BswMModeRequestPort): BswMArbitrateOnInit=false, BswMRequestProcessing=BSWM_DEFERRED
          BswMModeRequestSource
            BswMTimer
          BswMModeInitValue
            BswMBswModeInitValue: BswMBswModeInitValueMode=BSWM_TIMER_STOPPED
        ESH_LE_NoWakeup (BswMLogicalExpression): BswMLogicalOperator=BSWM_AND, BswMArgumentRef=ESH_Cond_NoValidatedWakeups, BswMArgumentRef=ESH_Cond_ComMNoPendingRequests
        ESH_Cond_NoValidatedWakeups (BswMModeCondition): BswMConditionType=BSWM_EQUALS, BswMConditionMode=ESH_EcuM_GetValidatedWakeupEvents
          BswMConditionValue
            BswMBswMode: BswMBswRequestedMode=0
        ESH_EcuM_GetValidatedWakeupEvents (BswMModeRequestPort): BswMArbitrateOnInit=false, BswMRequestProcessing=BSWM_DEFERRED
          BswMModeRequestSource
            BswMUserConditionRequest: BswMUserCondition=EcuM_GetValidatedWakeupEvents()
        ESH_WakeupToPrep (BswMRule):
          BswMNestedExecutionOnly = false
          BswMRuleId = 64
          BswMRuleInitState = BSWM_FALSE
          BswMRuleExpressionRef = ESH_LE_WakeupToPrepShutdown
          BswMRuleTrueActionList = ESH_AL_WakeupToPrep
        ESH_LE_WakeupToPrepShutdown (BswMLogicalExpression):
          BswMLogicalOperator = BSWM_AND
          BswMArgumentRef = ESH_Cond_StateIsWakeup
          BswMArgumentRef = ESH_LE_CancelNotPending
          BswMArgumentRef = ESH_Cond_NoPendingWakeups
          BswMArgumentRef = ESH_LE_NoWakeup
          BswMArgumentRef = ESH_Cond_ModeIsWakeup
        ESH_Cond_StateIsWakeup (BswMModeCondition): BswMConditionType=BSWM_EQUALS, BswMConditionMode=ESH_State
          BswMConditionValue
            BswMBswMode: BswMBswRequestedMode=ESH_WAKEUP
        ESH_LE_CancelNotPending (BswMLogicalExpression): BswMLogicalOperator=BSWM_OR, BswMArgumentRef=ESH_Cond_NvMWAIsNotPending, BswMArgumentRef=ESH_Cond_NvWCancelTimerNotRunning
        ESH_Cond_NvWCancelTimerNotRunning (BswMModeCondition): BswMConditionType=BSWM_EQUALS_NOT, BswMConditionMode=ESH_NvM_CancelWriteAllTimer
          BswMConditionValue
            BswMBswMode: BswMBswRequestedMode=BSWM_TIMER_STARTED
        ESH_NvM_CancelWriteAllTimer (BswMModeRequestPort): BswMArbitrateOnInit=false, BswMRequestProcessing=BSWM_DEFERRED
          BswMModeRequestSource
            BswMTimer
          BswMModeInitValue
            BswMBswModeInitValue: BswMBswModeInitValueMode=BSWM_TIMER_STOPPED
        ESH_Cond_NoPendingWakeups (BswMModeCondition): BswMConditionType=BSWM_EQUALS, BswMConditionMode=ESH_EcuM_GetPendingWakeupEvents
          BswMConditionValue
            BswMBswMode: BswMBswRequestedMode=0
        ESH_EcuM_GetPendingWakeupEvents (BswMModeRequestPort): BswMArbitrateOnInit=false, BswMRequestProcessing=BSWM_DEFERRED
          BswMModeRequestSource
            BswMUserConditionRequest: BswMUserCondition=EcuM_GetPendingWakeupEvents()
        ESH_Cond_ModeIsWakeup (BswMModeCondition): BswMConditionType=BSWM_EQUALS, BswMConditionMode=ESH_ModeNotification
          BswMConditionValue
            BswMModeDeclaration: BswMModeValueRef=WAKEUP
        ESH_WaitToWakeup (BswMRule):
          BswMNestedExecutionOnly = false
          BswMRuleId = 63
          BswMRuleInitState = BSWM_FALSE
          BswMRuleExpressionRef = ESH_LE_WaitForNvMToWakeup
          BswMRuleTrueActionList = ESH_AL_WaitForNvMWakeup
        ESH_LE_WaitForNvMToWakeup (BswMLogicalExpression): BswMLogicalOperator=BSWM_AND, BswMArgumentRef=ESH_Cond_StateIsWaitForNvm, BswMArgumentRef=ESH_LE_ValidWakeup
        ESH_LE_ValidWakeup (BswMLogicalExpression): BswMLogicalOperator=BSWM_OR, BswMArgumentRef=ESH_Cond_ValidatedWakeups, BswMArgumentRef=ESH_Cond_ComMPendingRequests
        ESH_Cond_ValidatedWakeups (BswMModeCondition): BswMConditionType=BSWM_EQUALS_NOT, BswMConditionMode=ESH_EcuM_GetValidatedWakeupEvents
          BswMConditionValue
            BswMBswMode: BswMBswRequestedMode=0
        ESH_Cond_ComMPendingRequests (BswMModeCondition): BswMConditionType=BSWM_EQUALS, BswMConditionMode=ESH_ComMPendingRequests
          BswMConditionValue
            BswMBswMode: BswMBswRequestedMode=ESH_COMM_PENDING_REQUEST
        ESH_WakeupToRun (BswMRule):
          BswMNestedExecutionOnly = false
          BswMRuleId = 65
          BswMRuleInitState = BSWM_FALSE
          BswMRuleExpressionRef = ESH_LE_WakeupToRun
          BswMRuleTrueActionList = ESH_AL_WakeupToRun
        ESH_LE_WakeupToRun (BswMLogicalExpression):
          BswMLogicalOperator = BSWM_AND
          BswMArgumentRef = ESH_Cond_StateIsWakeup
          BswMArgumentRef = ESH_LE_ValidWakeup
          BswMArgumentRef = ESH_LE_CancelNotPending
          BswMArgumentRef = ESH_Cond_ModeIsWakeup
        ESH_DemInit (BswMRule):
          BswMNestedExecutionOnly = true
          BswMRuleId = 54
          BswMRuleInitState = BSWM_FALSE
          BswMRuleExpressionRef = ESH_LE_DemNotInitialized
          BswMRuleTrueActionList = ESH_AL_DemInit
        ESH_LE_DemNotInitialized (BswMLogicalExpression): BswMLogicalOperator=BSWM_OR, BswMArgumentRef=ESH_Cond_DemNotInitialized
        ESH_Cond_DemNotInitialized (BswMModeCondition): BswMConditionType=BSWM_EQUALS, BswMConditionMode=ESH_DemInitStatus
          BswMConditionValue
            BswMBswMode: BswMBswRequestedMode=DEM_NOT_INITIALIZED
        ESH_DemInitStatus (BswMModeRequestPort): BswMArbitrateOnInit=false, BswMRequestProcessing=BSWM_IMMEDIATE
          BswMModeRequestSource
            BswMGenericRequest: BswMModeRequesterId=231, BswMRequestedModeMax=2
              DEM_INITIALIZED (BswMGenericRequestMode): BswMGenericRequestModeValue=0
              DEM_NOT_INITIALIZED (BswMGenericRequestMode): BswMGenericRequestModeValue=1
          BswMModeInitValue
            BswMBswModeInitValue: BswMBswModeInitValueMode=DEM_INITIALIZED
        ESH_InitToWakeup (BswMRule):
          BswMNestedExecutionOnly = false
          BswMRuleId = 55
          BswMRuleInitState = BSWM_FALSE
          BswMRuleExpressionRef = ESH_LE_InitToWakeup
          BswMRuleTrueActionList = ESH_AL_InitToWakeup
        ESH_LE_InitToWakeup (BswMLogicalExpression): BswMLogicalOperator=BSWM_AND, BswMArgumentRef=ESH_Cond_StateIsInit
        ESH_Cond_StateIsInit (BswMModeCondition): BswMConditionType=BSWM_EQUALS, BswMConditionMode=ESH_State
          BswMConditionValue
            BswMBswMode: BswMBswRequestedMode=ESH_INIT
        ESH_PostRunToPrepNested (BswMRule):
          BswMNestedExecutionOnly = true
          BswMRuleId = 58
          BswMRuleInitState = BSWM_FALSE
          BswMRuleExpressionRef = ESH_LE_PostRunToPrep
          BswMRuleTrueActionList = ESH_AL_PostRunToPrepShutdown
        ESH_LE_PostRunToPrep (BswMLogicalExpression): BswMLogicalOperator=BSWM_AND, BswMArgumentRef=ESH_LE_PostRunReleased
        ESH_LE_PostRunReleased (BswMLogicalExpression): BswMLogicalOperator=BSWM_AND, BswMArgumentRef=ESH_Cond_PostRunRequest0IsReleased, BswMArgumentRef=ESH_Cond_PostRunRequest1IsReleased
        ESH_Cond_PostRunRequest0IsReleased (BswMModeCondition): BswMConditionType=BSWM_EQUALS, BswMConditionMode=ESH_PostRunRequest_0
          BswMConditionValue
            BswMModeDeclaration: BswMModeValueRef=RELEASED
        ESH_PostRunRequest_0 (BswMModeRequestPort): BswMArbitrateOnInit=false, BswMRequestProcessing=BSWM_DEFERRED
          BswMModeRequestSource
            BswMSwcModeRequest: BswMModeRequestDataElementPrototypeName=requestedMode, BswMSwcModeRequestModeDeclarationGroupPrototypeRef=BswM_MDGP_ESH_RunRequest
          BswMModeInitValue
            BswMSwcModeInitValue: BswMSwcModeInitValueRef=RELEASED
        ESH_Cond_PostRunRequest1IsReleased (BswMModeCondition): BswMConditionType=BSWM_EQUALS, BswMConditionMode=ESH_PostRunRequest_1
          BswMConditionValue
            BswMModeDeclaration: BswMModeValueRef=RELEASED
        ESH_PostRunRequest_1 (BswMModeRequestPort): BswMArbitrateOnInit=false, BswMRequestProcessing=BSWM_DEFERRED
          BswMModeRequestSource
            BswMSwcModeRequest: BswMModeRequestDataElementPrototypeName=requestedMode, BswMSwcModeRequestModeDeclarationGroupPrototypeRef=BswM_MDGP_ESH_RunRequest
          BswMModeInitValue
            BswMSwcModeInitValue: BswMSwcModeInitValueRef=RELEASED
        ESH_PostRunNested (BswMRule):
          BswMNestedExecutionOnly = true
          BswMRuleId = 57
          BswMRuleInitState = BSWM_FALSE
          BswMRuleExpressionRef = ESH_LE_RunRequestsOrWakeup
          BswMRuleFalseActionList = ESH_AL_ESH_PostRunToPrepCheck
          BswMRuleTrueActionList = ESH_AL_PostRunToRun
        ESH_LE_RunRequestsOrWakeup (BswMLogicalExpression): BswMLogicalOperator=BSWM_OR, BswMArgumentRef=ESH_LE_RunRequested, BswMArgumentRef=ESH_LE_ValidWakeup
        ESH_LE_RunRequested (BswMLogicalExpression): BswMLogicalOperator=BSWM_OR, BswMArgumentRef=ESH_Cond_RunRequest0IsRequested, BswMArgumentRef=ESH_Cond_RunRequest1IsRequested
        ESH_Cond_RunRequest0IsRequested (BswMModeCondition): BswMConditionType=BSWM_EQUALS, BswMConditionMode=ESH_RunRequest_0
          BswMConditionValue
            BswMModeDeclaration: BswMModeValueRef=REQUESTED
        ESH_Cond_RunRequest1IsRequested (BswMModeCondition): BswMConditionType=BSWM_EQUALS, BswMConditionMode=ESH_RunRequest_1
          BswMConditionValue
            BswMModeDeclaration: BswMModeValueRef=REQUESTED
        ESH_PostRun (BswMRule):
          BswMNestedExecutionOnly = false
          BswMRuleId = 56
          BswMRuleInitState = BSWM_FALSE
          BswMRuleExpressionRef = ESH_LE_PostRun
          BswMRuleTrueActionList = ESH_AL_ExitPostRun
        ESH_LE_PostRun (BswMLogicalExpression): BswMLogicalOperator=BSWM_AND, BswMArgumentRef=ESH_Cond_StateIsPostRun, BswMArgumentRef=ESH_Cond_ModeIsPostRun
        ESH_Cond_StateIsPostRun (BswMModeCondition): BswMConditionType=BSWM_EQUALS, BswMConditionMode=ESH_State
          BswMConditionValue
            BswMBswMode: BswMBswRequestedMode=ESH_POST_RUN
        ESH_Cond_ModeIsPostRun (BswMModeCondition): BswMConditionType=BSWM_EQUALS, BswMConditionMode=ESH_ModeNotification
          BswMConditionValue
            BswMModeDeclaration: BswMModeValueRef=POSTRUN
        ESH_PrepToWait (BswMRule):
          BswMNestedExecutionOnly = false
          BswMRuleId = 59
          BswMRuleInitState = BSWM_FALSE
          BswMRuleExpressionRef = ESH_LE_PrepShutdownToWaitForNvM
          BswMRuleTrueActionList = ESH_AL_PrepShutdownToWaitForNvM
        ESH_LE_PrepShutdownToWaitForNvM (BswMLogicalExpression): BswMLogicalOperator=BSWM_AND, BswMArgumentRef=ESH_Cond_StateIsPrepShutdown, BswMArgumentRef=ESH_Cond_ModeIsShutdown
        3 x BswMModeCondition, all with BswMConditionType=BSWM_EQUALS:
          ESH_Cond_StateIsPrepShutdown: BswMConditionMode=ESH_State
            BswMConditionValue
              BswMBswMode: BswMBswRequestedMode=ESH_PREP_SHUTDOWN
          ESH_Cond_ModeIsShutdown: BswMConditionMode=ESH_ModeNotification
            BswMConditionValue
              BswMModeDeclaration: BswMModeValueRef=SHUTDOWN
          CC_Cond_CanSMIndication_CN_FMSNet_fce1aae5_EQ_CANSM_BSWM_FULL_COMMUNICATION: BswMConditionMode=CC_CanSMIndication_CN_FMSNet_fce1aae5
            BswMConditionValue
              BswMBswMode: BswMBswRequestedMode=CANSM_BSWM_FULL_COMMUNICATION
        CC_CanSMIndication_CN_FMSNet_fce1aae5 (BswMModeRequestPort): BswMArbitrateOnInit=false, BswMRequestProcessing=BSWM_IMMEDIATE
          BswMModeRequestSource
            BswMCanSMIndication: BswMCanSMChannelRef=CN_FMSNet_fce1aae5
          BswMModeInitValue
            BswMBswModeInitValue: BswMBswModeInitValueMode=CANSM_BSWM_NO_COMMUNICATION
        CC_CN_FMSNet_fce1aae5_RX (BswMRule):
          BswMNestedExecutionOnly = false
          BswMRuleId = 10
          BswMRuleInitState = BSWM_FALSE
          BswMRuleExpressionRef = CC_LE_CN_FMSNet_fce1aae5_RX
          BswMRuleFalseActionList = CC_AL_CN_FMSNet_fce1aae5_RX_Disable
          BswMRuleTrueActionList = CC_AL_CN_FMSNet_fce1aae5_RX_EnableNoinit
        CC_LE_CN_FMSNet_fce1aae5_RX (BswMLogicalExpression): BswMLogicalOperator=BSWM_AND, BswMArgumentRef=CC_Cond_CanSMIndication_CN_FMSNet_fce1aae5_NEQ_CANSM_BSWM_NO_COMMUNICATION
        CC_Cond_CanSMIndication_CN_FMSNet_fce1aae5_NEQ_CANSM_BSWM_NO_COMMUNICATION (BswMModeCondition): BswMConditionType=BSWM_EQUALS_NOT, BswMConditionMode=CC_CanSMIndication_CN_FMSNet_fce1aae5
          BswMConditionValue
            BswMBswMode: BswMBswRequestedMode=CANSM_BSWM_NO_COMMUNICATION
        CC_CN_FMSNet_fce1aae5_RX_DM (BswMRule):
          BswMNestedExecutionOnly = false
          BswMRuleId = 11
          BswMRuleInitState = BSWM_FALSE
          BswMRuleExpressionRef = CC_LE_CN_FMSNet_fce1aae5_RX_DM
          BswMRuleFalseActionList = CC_AL_CN_FMSNet_fce1aae5_Disable_DM
          BswMRuleTrueActionList = CC_AL_CN_FMSNet_fce1aae5_Enable_DM
        CC_LE_CN_FMSNet_fce1aae5_RX_DM (BswMLogicalExpression): BswMLogicalOperator=BSWM_AND, BswMArgumentRef=CC_Cond_CanSMIndication_CN_FMSNet_fce1aae5_EQ_CANSM_BSWM_FULL_COMMUNICATION
        CC_CN_Backbone1J1939_0b1f4bae_CIOM_4d5cd289_TX (BswMRule):
          BswMNestedExecutionOnly = false
          BswMRuleId = 0
          BswMRuleInitState = BSWM_FALSE
          BswMRuleExpressionRef = CC_LE_CN_Backbone1J1939_0b1f4bae_CIOM_4d5cd289_TX
          BswMRuleFalseActionList = CC_AL_CN_Backbone1J1939_0b1f4bae_CIOM_4d5cd289_TX_Disable
          BswMRuleTrueActionList = CC_AL_CN_Backbone1J1939_0b1f4bae_CIOM_4d5cd289_TX_EnableNoinit
        CC_LE_CN_Backbone1J1939_0b1f4bae_CIOM_4d5cd289_TX (BswMLogicalExpression):
          BswMLogicalOperator = BSWM_AND
          BswMArgumentRef = CC_Cond_CanSMIndication_CN_Backbone1J1939_0b1f4bae_EQ_CANSM_BSWM_FULL_COMMUNICATION
          BswMArgumentRef = CC_Cond_J1939NmIndication_CN_Backbone1J1939_0b1f4bae_CIOM_4d5cd289_NEQ_NM_STATE_OFFLINE
        CC_Cond_J1939NmIndication_CN_Backbone1J1939_0b1f4bae_CIOM_4d5cd289_NEQ_NM_STATE_OFFLINE (BswMModeCondition): BswMConditionType=BSWM_EQUALS_NOT, BswMConditionMode=CC_J1939NmIndication_CN_Backbone1J1939_0b1f4bae_CIOM_4d5cd289
          BswMConditionValue
            BswMBswMode: BswMBswRequestedMode=NM_STATE_OFFLINE
        CC_CN_FMSNet_fce1aae5_CIOM_4d5cd289_TX (BswMRule):
          BswMNestedExecutionOnly = false
          BswMRuleId = 9
          BswMRuleInitState = BSWM_FALSE
          BswMRuleExpressionRef = CC_LE_CN_FMSNet_fce1aae5_CIOM_4d5cd289_TX
          BswMRuleFalseActionList = CC_AL_CN_FMSNet_fce1aae5_CIOM_4d5cd289_TX_Disable
          BswMRuleTrueActionList = CC_AL_CN_FMSNet_fce1aae5_CIOM_4d5cd289_TX_EnableNoinit
        CC_LE_CN_FMSNet_fce1aae5_CIOM_4d5cd289_TX (BswMLogicalExpression):
          BswMLogicalOperator = BSWM_AND
          BswMArgumentRef = CC_Cond_CanSMIndication_CN_FMSNet_fce1aae5_EQ_CANSM_BSWM_FULL_COMMUNICATION
          BswMArgumentRef = CC_Cond_J1939NmIndication_CN_FMSNet_fce1aae5_CIOM_4d5cd289_NEQ_NM_STATE_OFFLINE
        CC_Cond_J1939NmIndication_CN_FMSNet_fce1aae5_CIOM_4d5cd289_NEQ_NM_STATE_OFFLINE (BswMModeCondition): BswMConditionType=BSWM_EQUALS_NOT, BswMConditionMode=CC_J1939NmIndication_CN_FMSNet_fce1aae5_CIOM_4d5cd289
          BswMConditionValue
            BswMBswMode: BswMBswRequestedMode=NM_STATE_OFFLINE
        CC_J1939NmIndication_CN_FMSNet_fce1aae5_CIOM_4d5cd289 (BswMModeRequestPort): BswMArbitrateOnInit=false, BswMRequestProcessing=BSWM_IMMEDIATE
          BswMModeRequestSource
            BswMJ1939NmIndication: BswMJ1939NmChannelRef=CN_FMSNet_fce1aae5, BswMJ1939NmNodeRef=CIOM_4d5cd289
          BswMModeInitValue
            BswMBswModeInitValue: BswMBswModeInitValueMode=NM_STATE_BUS_SLEEP
        LIN3_ScheduleTableRequestMode (BswMModeRequestPort): BswMArbitrateOnInit=false, BswMRequestProcessing=BSWM_IMMEDIATE
          BswMModeRequestSource
            BswMSwcModeRequest: BswMSwcModeRequestPortInterfaceRef=requestedMode
          BswMModeInitValue
            BswMCompuScaleModeValue: BswMCompuConstText=LIN3_NULL, BswMCompuMethodRef=BswM_BswMRteMDG_LIN3Schedule
        CC_Cond_LIN3_Schedule_to_Table1 (BswMModeCondition): BswMConditionType=BSWM_EQUALS, BswMConditionMode=LIN3_ScheduleTableRequestMode
          BswMConditionValue
            BswMModeDeclaration: BswMModeValueRef=LIN3_TABLE1
        CC_Rule_LIN3_Schedule_To_Table1 (BswMRule):
          BswMNestedExecutionOnly = false
          BswMRuleId = 37
          BswMRuleInitState = BSWM_FALSE
          BswMRuleExpressionRef = LE_LIN3_Schedule_To_Table1
          BswMRuleTrueActionList = CC_AL_LIN3_ScheduleTable_to_Table1
        LE_LIN3_Schedule_To_Table1 (BswMLogicalExpression): BswMArgumentRef=CC_Cond_LIN3_Schedule_to_Table1
        CC_Cond_LIN3_Schedule_to_NULL (BswMModeCondition): BswMConditionType=BSWM_EQUALS, BswMConditionMode=LIN3_ScheduleTableRequestMode
          BswMConditionValue
            BswMModeDeclaration: BswMModeValueRef=LIN3_NULL
        LE_LIN3_Schedule_To_NULL (BswMLogicalExpression): BswMArgumentRef=CC_Cond_LIN3_Schedule_to_NULL
        CC_Rule_LIN3_Schedule_To_NULL (BswMRule):
          BswMNestedExecutionOnly = false
          BswMRuleId = 36
          BswMRuleInitState = BSWM_FALSE
          BswMRuleExpressionRef = LE_LIN3_Schedule_To_NULL
          BswMRuleTrueActionList = CC_AL_LIN3_ScheduleTable_to_NULL
        5 x BswMModeCondition, all with BswMConditionType=BSWM_EQUALS, BswMConditionMode=LIN3_ScheduleTableRequestMode:
          CC_Cond_LIN3_Schedule_to_Table2
            BswMConditionValue
              BswMModeDeclaration: BswMModeValueRef=LIN3_TABLE2
          CC_Cond_LIN3_Schedule_to_Table_E
            BswMConditionValue
              BswMModeDeclaration: BswMModeValueRef=LIN3_TABLE_E
          CC_Cond_LIN3_Schedule_to_MasterReq_SlaveResp
            BswMConditionValue
              BswMModeDeclaration: BswMModeValueRef=LIN3_MasterReq_SlaveResp
          CC_Cond_LIN3_Schedule_to_MasterReq_SlaveResp_Table1
            BswMConditionValue
              BswMModeDeclaration: BswMModeValueRef=LIN3_MasterReq_SlaveResp_Table1
          CC_Cond_LIN3_Schedule_to_MasterReq_SlaveResp_Table2
            BswMConditionValue
              BswMModeDeclaration: BswMModeValueRef=LIN3_MasterReq_SlaveResp_Table2
        5 x BswMLogicalExpression:
          LE_LIN3_Schedule_To_Table2: BswMArgumentRef=CC_Cond_LIN3_Schedule_to_Table2
          LE_LIN3_Schedule_To_Table_E: BswMArgumentRef=CC_Cond_LIN3_Schedule_to_Table_E
          LE_LIN3_Schedule_To_MasterReq_SlaveResp: BswMArgumentRef=CC_Cond_LIN3_Schedule_to_MasterReq_SlaveResp
          LE_LIN3_Schedule_To_MasterReq_SlaveResp_Table1: BswMArgumentRef=CC_Cond_LIN3_Schedule_to_MasterReq_SlaveResp_Table1
          LE_LIN3_Schedule_To_MasterReq_SlaveResp_Table2: BswMArgumentRef=CC_Cond_LIN3_Schedule_to_MasterReq_SlaveResp_Table2
        5 x BswMRule, all with BswMNestedExecutionOnly=false, BswMRuleInitState=BSWM_FALSE:
          CC_Rule_LIN3_Schedule_To_Table2: BswMRuleId=38, BswMRuleExpressionRef=LE_LIN3_Schedule_To_Table2, BswMRuleTrueActionList=CC_AL_LIN3_ScheduleTable_to_Table2
          CC_Rule_LIN3_Schedule_To_Table_E: BswMRuleId=39, BswMRuleExpressionRef=LE_LIN3_Schedule_To_Table_E, BswMRuleTrueActionList=CC_AL_LIN3_ScheduleTable_to_Table_E
          CC_Rule_LIN3_Schedule_To_MasterReq_SlaveResp: BswMRuleId=33, BswMRuleExpressionRef=LE_LIN3_Schedule_To_MasterReq_SlaveResp, BswMRuleTrueActionList=CC_AL_LIN3_ScheduleTable_to_MasterReq_SlaveResp
          CC_Rule_LIN3_Schedule_To_MasterReq_SlaveResp_Table1: BswMRuleId=34, BswMRuleExpressionRef=LE_LIN3_Schedule_To_MasterReq_SlaveResp_Table1, BswMRuleTrueActionList=CC_AL_LIN3_ScheduleTable_to_MasterReq_SlaveResp_Table_1
          CC_Rule_LIN3_Schedule_To_MasterReq_SlaveResp_Table2: BswMRuleId=35, BswMRuleExpressionRef=LE_LIN3_Schedule_To_MasterReq_SlaveResp_Table2, BswMRuleTrueActionList=CC_AL_LIN3_ScheduleTable_to_MasterReq_SlaveResp_Table_2
        4 x BswMModeRequestPort, all with BswMArbitrateOnInit=false, BswMRequestProcessing=BSWM_IMMEDIATE:
          LIN1_ScheduleTableRequestMode
            BswMModeRequestSource
              BswMSwcModeRequest: BswMSwcModeRequestPortInterfaceRef=requestedMode
            BswMModeInitValue
              BswMCompuScaleModeValue: BswMCompuConstText=LIN1_NULL, BswMCompuMethodRef=BswM_BswMRteMDG_LIN1Schedule
          LIN2_ScheduleTableRequestMode
            BswMModeRequestSource
              BswMSwcModeRequest: BswMSwcModeRequestPortInterfaceRef=requestedMode
            BswMModeInitValue
              BswMCompuScaleModeValue: BswMCompuConstText=LIN2_NULL, BswMCompuMethodRef=BswM_BswMRteMDG_LIN2Schedule
          LIN4_ScheduleTableRequestMode
            BswMModeRequestSource
              BswMSwcModeRequest: BswMSwcModeRequestPortInterfaceRef=requestedMode
            BswMModeInitValue
              BswMCompuScaleModeValue: BswMCompuConstText=LIN4_NULL, BswMCompuMethodRef=BswM_BswMRteMDG_LIN4Schedule
          LIN5_ScheduleTableRequestMode
            BswMModeRequestSource
              BswMSwcModeRequest: BswMSwcModeRequestPortInterfaceRef=requestedMode
            BswMModeInitValue
              BswMCompuScaleModeValue: BswMCompuConstText=LIN5_NULL, BswMCompuMethodRef=BswM_BswMRteMDG_LIN5Schedule
        26 x BswMModeCondition, all with BswMConditionType=BSWM_EQUALS:
          CC_Cond_LIN1_Schedule_to_MasterReq_SlaveResp: BswMConditionMode=LIN1_ScheduleTableRequestMode
            BswMConditionValue
              BswMModeDeclaration: BswMModeValueRef=LIN1_MasterReq_SlaveResp
          CC_Cond_LIN1_Schedule_to_MasterReq_SlaveResp_Table2: BswMConditionMode=LIN1_ScheduleTableRequestMode
            BswMConditionValue
              BswMModeDeclaration: BswMModeValueRef=LIN1_MasterReq_SlaveResp_Table2
          CC_Cond_LIN1_Schedule_to_MasterReq_SlaveResp_Table1: BswMConditionMode=LIN1_ScheduleTableRequestMode
            BswMConditionValue
              BswMModeDeclaration: BswMModeValueRef=LIN1_MasterReq_SlaveResp_Table1
          CC_Cond_LIN1Schedule_to_Table_E: BswMConditionMode=LIN1_ScheduleTableRequestMode
            BswMConditionValue
              BswMModeDeclaration: BswMModeValueRef=LIN1_Table_E
          CC_Cond_LIN1_Schedule_to_Table2: BswMConditionMode=LIN1_ScheduleTableRequestMode
            BswMConditionValue
              BswMModeDeclaration: BswMModeValueRef=LIN1_Table2
          CC_Cond_LIN1_Schedule_to_Table1: BswMConditionMode=LIN1_ScheduleTableRequestMode
            BswMConditionValue
              BswMModeDeclaration: BswMModeValueRef=LIN1_Table1
          CC_Cond_LIN2_Schedule_to_NULL: BswMConditionMode=LIN2_ScheduleTableRequestMode
            BswMConditionValue
              BswMModeDeclaration: BswMModeValueRef=LIN2_NULL
          CC_Cond_LIN2_Schedule_to_Table0: BswMConditionMode=LIN2_ScheduleTableRequestMode
            BswMConditionValue
              BswMModeDeclaration: BswMModeValueRef=LIN2_TABLE0
          CC_Cond_LIN2_Schedule_to_Table_E: BswMConditionMode=LIN2_ScheduleTableRequestMode
            BswMConditionValue
              BswMModeDeclaration: BswMModeValueRef=LIN2_TABLE_E
          CC_Cond_LIN4_Schedule_to_NULL: BswMConditionMode=LIN4_ScheduleTableRequestMode
            BswMConditionValue
              BswMModeDeclaration: BswMModeValueRef=LIN4_NULL
          CC_Cond_LIN2_Schedule_to_MasterReq_SlaveResp_Table0: BswMConditionMode=LIN2_ScheduleTableRequestMode
            BswMConditionValue
              BswMModeDeclaration: BswMModeValueRef=LIN2_MasterReq_SlaveResp_TABLE0
          CC_Cond_LIN5_Schedule_to_NULL: BswMConditionMode=LIN5_ScheduleTableRequestMode
            BswMConditionValue
              BswMModeDeclaration: BswMModeValueRef=LIN5_NULL
          CC_Cond_LIN5_Schedule_to_Table1: BswMConditionMode=LIN5_ScheduleTableRequestMode
            BswMConditionValue
              BswMModeDeclaration: BswMModeValueRef=LIN5_TABLE1
          CC_Cond_LIN5_Schedule_to_Table2: BswMConditionMode=LIN5_ScheduleTableRequestMode
            BswMConditionValue
              BswMModeDeclaration: BswMModeValueRef=LIN5_TABLE2
          CC_Cond_LIN4_Schedule_to_Table1: BswMConditionMode=LIN4_ScheduleTableRequestMode
            BswMConditionValue
              BswMModeDeclaration: BswMModeValueRef=LIN4_MasterReq_SlaveResp_Table1
          CC_Cond_LIN4_Schedule_to_Table2: BswMConditionMode=LIN4_ScheduleTableRequestMode
            BswMConditionValue
              BswMModeDeclaration: BswMModeValueRef=LIN4_MasterReq_SlaveResp_Table2
          CC_Cond_LIN4_Schedule_to_Table_E: BswMConditionMode=LIN4_ScheduleTableRequestMode
            BswMConditionValue
              BswMModeDeclaration: BswMModeValueRef=LIN4_TABLE_E
          CC_Cond_LIN1_Schedule_to_NULL: BswMConditionMode=LIN1_ScheduleTableRequestMode
            BswMConditionValue
              BswMModeDeclaration: BswMModeValueRef=LIN1_NULL
          CC_Cond_LIN5_Schedule_to_Table_E: BswMConditionMode=LIN5_ScheduleTableRequestMode
            BswMConditionValue
              BswMModeDeclaration: BswMModeValueRef=LIN5_TABLE_E
          CC_Cond_LIN2_Schedule_to_MasterReq_SlaveResp: BswMConditionMode=LIN2_ScheduleTableRequestMode
            BswMConditionValue
              BswMModeDeclaration: BswMModeValueRef=LIN2_MasterReq_SlaveResp
          CC_Cond_LIN5_Schedule_to_MasterReq_SlaveResp: BswMConditionMode=LIN5_ScheduleTableRequestMode
            BswMConditionValue
              BswMModeDeclaration: BswMModeValueRef=LIN5_MasterReq_SlaveResp
          CC_Cond_LIN4_Schedule_to_MasterReq_SlaveResp_Table1: BswMConditionMode=LIN4_ScheduleTableRequestMode
            BswMConditionValue
              BswMModeDeclaration: BswMModeValueRef=LIN4_MasterReq_SlaveResp_Table1
          CC_Cond_LIN5_Schedule_to_MasterReq_SlaveResp_Table1: BswMConditionMode=LIN5_ScheduleTableRequestMode
            BswMConditionValue
              BswMModeDeclaration: BswMModeValueRef=LIN5_MasterReq_SlaveResp_Table1
          CC_Cond_LIN5_Schedule_to_MasterReq_SlaveResp_Table2: BswMConditionMode=LIN5_ScheduleTableRequestMode
            BswMConditionValue
              BswMModeDeclaration: BswMModeValueRef=LIN5_MasterReq_SlaveResp_Table2
          CC_Cond_LIN4_Schedule_to_MasterReq_SlaveResp_Table2: BswMConditionMode=LIN4_ScheduleTableRequestMode
            BswMConditionValue
              BswMModeDeclaration: BswMModeValueRef=LIN4_MasterReq_SlaveResp_Table2
          CC_Cond_LIN4_Schedule_to_MasterReq_SlaveResp: BswMConditionMode=LIN4_ScheduleTableRequestMode
            BswMConditionValue
              BswMModeDeclaration: BswMModeValueRef=LIN4_MasterReq_SlaveResp
        26 x BswMLogicalExpression:
          LE_LIN1_Schedule_To_MasterReq_SlaveResp: BswMArgumentRef=CC_Cond_LIN1_Schedule_to_MasterReq_SlaveResp
          LE_LIN1_Schedule_To_MasterReq_SlaveResp_Table1: BswMArgumentRef=CC_Cond_LIN1_Schedule_to_MasterReq_SlaveResp_Table1
          LE_LIN1_Schedule_To_MasterReq_SlaveResp_Table2: BswMArgumentRef=CC_Cond_LIN1_Schedule_to_MasterReq_SlaveResp_Table2
          LE_LIN1_Schedule_To_NULL: BswMArgumentRef=CC_Cond_LIN1_Schedule_to_NULL
          LE_LIN1_Schedule_To_Table1: BswMArgumentRef=CC_Cond_LIN1_Schedule_to_Table1
          LE_LIN1_Schedule_To_Table2: BswMArgumentRef=CC_Cond_LIN1_Schedule_to_Table2
          LE_LIN1_Schedule_To_Table_E: BswMArgumentRef=CC_Cond_LIN1Schedule_to_Table_E
          LE_LIN2_Schedule_To_MasterReq_SlaveResp: BswMArgumentRef=CC_Cond_LIN2_Schedule_to_MasterReq_SlaveResp
          LE_LIN2_Schedule_To_MasterReq_SlaveResp_Table0: BswMArgumentRef=CC_Cond_LIN2_Schedule_to_MasterReq_SlaveResp_Table0
          LE_LIN2_Schedule_To_NULL: BswMArgumentRef=CC_Cond_LIN2_Schedule_to_NULL
          LE_LIN2_Schedule_To_Table0: BswMArgumentRef=CC_Cond_LIN2_Schedule_to_Table0
          LE_LIN2_Schedule_To_Table_E: BswMArgumentRef=CC_Cond_LIN2_Schedule_to_Table_E
          LE_LIN4_Schedule_To_MasterReq_SlaveResp: BswMArgumentRef=CC_Cond_LIN4_Schedule_to_MasterReq_SlaveResp
          LE_LIN4_Schedule_To_MasterReq_SlaveResp_Table1: BswMArgumentRef=CC_Cond_LIN4_Schedule_to_MasterReq_SlaveResp_Table1
          LE_LIN4_Schedule_To_MasterReq_SlaveResp_Table2: BswMArgumentRef=CC_Cond_LIN4_Schedule_to_MasterReq_SlaveResp_Table2
          LE_LIN4_Schedule_To_NULL: BswMArgumentRef=CC_Cond_LIN4_Schedule_to_NULL
          LE_LIN4_Schedule_To_Table1: BswMArgumentRef=BswMModeCondition_001
          LE_LIN4_Schedule_To_Table2: BswMArgumentRef=BswMModeCondition
          LE_LIN4_Schedule_To_Table_E: BswMArgumentRef=CC_Cond_LIN4_Schedule_to_Table_E
          LE_LIN5_Schedule_To_MasterReq_SlaveResp: BswMArgumentRef=CC_Cond_LIN5_Schedule_to_MasterReq_SlaveResp
          LE_LIN5_Schedule_To_MasterReq_SlaveResp_Table1: BswMArgumentRef=CC_Cond_LIN5_Schedule_to_MasterReq_SlaveResp_Table1
          LE_LIN5_Schedule_To_MasterReq_SlaveResp_Table2: BswMArgumentRef=CC_Cond_LIN5_Schedule_to_MasterReq_SlaveResp_Table2
          LE_LIN5_Schedule_To_NULL: BswMArgumentRef=CC_Cond_LIN5_Schedule_to_NULL
          LE_LIN5_Schedule_To_Table1: BswMArgumentRef=CC_Cond_LIN5_Schedule_to_Table1
          LE_LIN5_Schedule_To_Table2: BswMArgumentRef=CC_Cond_LIN5_Schedule_to_Table2
          LE_LIN5_Schedule_To_Table_E: BswMArgumentRef=CC_Cond_LIN5_Schedule_to_Table_E
        27 x BswMRule, all with BswMNestedExecutionOnly=false, BswMRuleInitState=BSWM_FALSE:
          CC_Rule_LIN1_Schedule_To_MasterReq_SlaveResp: BswMRuleId=21, BswMRuleExpressionRef=LE_LIN1_Schedule_To_MasterReq_SlaveResp, BswMRuleTrueActionList=CC_AL_LIN1_ScheduleTable_to_MasterReq_SlaveResp
          CC_Rule_LIN1_Schedule_To_MasterReq_SlaveResp_Table1: BswMRuleId=22, BswMRuleExpressionRef=LE_LIN1_Schedule_To_MasterReq_SlaveResp_Table1, BswMRuleTrueActionList=CC_AL_LIN1_ScheduleTable_to_MasterReq_SlaveResp_Table_1
          CC_Rule_LIN1_Schedule_To_MasterReq_SlaveResp_Table2: BswMRuleId=23, BswMRuleExpressionRef=LE_LIN1_Schedule_To_MasterReq_SlaveResp_Table2, BswMRuleTrueActionList=CC_AL_LIN1_ScheduleTable_to_MasterReq_SlaveResp_Table_2
          CC_Rule_LIN1_Schedule_To_NULL: BswMRuleId=24, BswMRuleExpressionRef=LE_LIN1_Schedule_To_NULL, BswMRuleTrueActionList=CC_AL_LIN1_ScheduleTable_to_NULL
          CC_Rule_LIN1_Schedule_To_Table1: BswMRuleId=25, BswMRuleExpressionRef=LE_LIN1_Schedule_To_Table1, BswMRuleTrueActionList=CC_AL_LIN1_ScheduleTable_to_Table1
          CC_Rule_LIN1_Schedule_To_Table2: BswMRuleId=26, BswMRuleExpressionRef=LE_LIN1_Schedule_To_Table2, BswMRuleTrueActionList=CC_AL_LIN1_ScheduleTable_to_Table2
          CC_Rule_LIN1_Schedule_To_Table_E: BswMRuleId=27, BswMRuleExpressionRef=LE_LIN1_Schedule_To_Table_E, BswMRuleTrueActionList=CC_AL_LIN1_ScheduleTable_to_Table_E
          CC_Rule_LIN2_Schedule_To_MasterReq_SlaveResp: BswMRuleId=28, BswMRuleExpressionRef=LE_LIN2_Schedule_To_MasterReq_SlaveResp, BswMRuleTrueActionList=CC_AL_LIN2_ScheduleTable_to_MasterReq_SlaveResp
          CC_Rule_LIN2_Schedule_To_MasterReq_SlaveResp_Table0: BswMRuleId=29, BswMRuleExpressionRef=LE_LIN2_Schedule_To_MasterReq_SlaveResp_Table0, BswMRuleTrueActionList=CC_AL_LIN2_ScheduleTable_to_MasterReq_SlaveResp_Table_0
          CC_Rule_LIN2_Schedule_To_NULL: BswMRuleId=30, BswMRuleExpressionRef=LE_LIN2_Schedule_To_NULL, BswMRuleTrueActionList=CC_AL_LIN2_ScheduleTable_to_NULL
          CC_Rule_LIN2_Schedule_To_Table0: BswMRuleId=31, BswMRuleExpressionRef=LE_LIN2_Schedule_To_Table0, BswMRuleTrueActionList=CC_AL_LIN2_ScheduleTable_to_Table0
          CC_Rule_LIN2_Schedule_To_Table_E: BswMRuleId=32, BswMRuleExpressionRef=LE_LIN2_Schedule_To_Table_E, BswMRuleTrueActionList=CC_AL_LIN2_ScheduleTable_to_Table_E
          CC_Rule_LIN4_Schedule_To_MasterReq_SlaveResp: BswMRuleId=40, BswMRuleExpressionRef=LE_LIN4_Schedule_To_MasterReq_SlaveResp, BswMRuleTrueActionList=CC_AL_LIN4_ScheduleTable_to_MasterReq_SlaveResp
          CC_Rule_LIN4_Schedule_To_MasterReq_SlaveResp_Table1: BswMRuleId=41, BswMRuleExpressionRef=LE_LIN4_Schedule_To_MasterReq_SlaveResp_Table1, BswMRuleTrueActionList=CC_AL_LIN4_ScheduleTable_to_MasterReq_SlaveResp_Table_1
          CC_Rule_LIN4_Schedule_To_MasterReq_SlaveResp_Table2: BswMRuleId=42, BswMRuleExpressionRef=LE_LIN4_Schedule_To_MasterReq_SlaveResp_Table2, BswMRuleTrueActionList=CC_AL_LIN4_ScheduleTable_to_MasterReq_SlaveResp_Table_2
          CC_Rule_LIN4_Schedule_To_NULL: BswMRuleId=43, BswMRuleExpressionRef=LE_LIN4_Schedule_To_NULL, BswMRuleTrueActionList=CC_AL_LIN4_ScheduleTable_to_NULL
          CC_Rule_LIN4_Schedule_To_Table1: BswMRuleId=44, BswMRuleExpressionRef=LE_LIN4_Schedule_To_Table1, BswMRuleTrueActionList=CC_AL_LIN4_ScheduleTable_to_Table1
          CC_Rule_LIN4_Schedule_To_Table2: BswMRuleId=45, BswMRuleExpressionRef=LE_LIN4_Schedule_To_Table2, BswMRuleTrueActionList=CC_AL_LIN4_ScheduleTable_to_Table2
          CC_Rule_LIN4_Schedule_To_Table_E: BswMRuleId=46, BswMRuleExpressionRef=LE_LIN4_Schedule_To_Table_E, BswMRuleTrueActionList=CC_AL_LIN4_ScheduleTable_to_Table_E
          CC_Rule_LIN5_Schedule_To_MasterReq_SlaveResp: BswMRuleId=47, BswMRuleExpressionRef=LE_LIN5_Schedule_To_MasterReq_SlaveResp, BswMRuleTrueActionList=CC_AL_LIN5_ScheduleTable_to_MasterReq_SlaveResp
          CC_Rule_LIN5_Schedule_To_MasterReq_SlaveResp_Table1: BswMRuleId=48, BswMRuleExpressionRef=LE_LIN5_Schedule_To_MasterReq_SlaveResp_Table1, BswMRuleTrueActionList=CC_AL_LIN5_ScheduleTable_to_MasterReq_SlaveResp_Table_1
          CC_Rule_LIN5_Schedule_To_MasterReq_SlaveResp_Table2: BswMRuleId=49, BswMRuleExpressionRef=LE_LIN5_Schedule_To_MasterReq_SlaveResp_Table2, BswMRuleTrueActionList=CC_AL_LIN5_ScheduleTable_to_MasterReq_SlaveResp_Table_2
          CC_Rule_LIN5_Schedule_To_NULL: BswMRuleId=50, BswMRuleExpressionRef=LE_LIN5_Schedule_To_NULL, BswMRuleTrueActionList=CC_AL_LIN5_ScheduleTable_to_NULL
          CC_Rule_LIN5_Schedule_To_Table1: BswMRuleId=51, BswMRuleExpressionRef=LE_LIN5_Schedule_To_Table1, BswMRuleTrueActionList=CC_AL_LIN5_ScheduleTable_to_Table1
          CC_Rule_LIN5_Schedule_To_Table2: BswMRuleId=52, BswMRuleExpressionRef=LE_LIN5_Schedule_To_Table2, BswMRuleTrueActionList=CC_AL_LIN5_ScheduleTable_to_Table2
          CC_Rule_LIN5_Schedule_To_Table_E: BswMRuleId=53, BswMRuleExpressionRef=LE_LIN5_Schedule_To_Table_E, BswMRuleTrueActionList=CC_AL_LIN5_ScheduleTable_to_Table_E
          CC_CN_FMSNet_fce1aae5_TX: BswMRuleId=12, BswMRuleExpressionRef=CC_LE_CN_FMSNet_fce1aae5_TX, BswMRuleFalseActionList=CC_AL_CN_FMSNet_fce1aae5_TX_Disable, BswMRuleTrueActionList=CC_AL_CN_FMSNet_fce1aae5_TX_EnableNoinit
        CC_LE_CN_FMSNet_fce1aae5_TX (BswMLogicalExpression): BswMLogicalOperator=BSWM_AND, BswMArgumentRef=CC_Cond_CanSMIndication_CN_FMSNet_fce1aae5_EQ_CANSM_BSWM_FULL_COMMUNICATION
        ESH_Cond_NoComOn_CN_Backbone2_78967e2c (BswMModeCondition): BswMConditionType=BSWM_EQUALS, BswMConditionMode=ESH_ComMIndication_CN_Backbone2_78967e2c
          BswMConditionValue
            BswMBswMode: BswMBswRequestedMode=COMM_NO_COMMUNICATION
        ESH_ComMIndication_CN_Backbone2_78967e2c (BswMModeRequestPort): BswMArbitrateOnInit=false, BswMRequestProcessing=BSWM_DEFERRED
          BswMModeRequestSource
            BswMComMIndication: BswMComMChannelRef=CN_Backbone2_78967e2c
          BswMModeInitValue
            BswMBswModeInitValue: BswMBswModeInitValueMode=COMM_NO_COMMUNICATION
        ESH_Cond_NoComOn_CN_Backbone1J1939_0b1f4bae (BswMModeCondition): BswMConditionType=BSWM_EQUALS, BswMConditionMode=ESH_ComMIndication_CN_Backbone1J1939_0b1f4bae
          BswMConditionValue
            BswMBswMode: BswMBswRequestedMode=COMM_NO_COMMUNICATION
        ESH_ComMIndication_CN_Backbone1J1939_0b1f4bae (BswMModeRequestPort): BswMArbitrateOnInit=false, BswMRequestProcessing=BSWM_DEFERRED
          BswMModeRequestSource
            BswMComMIndication: BswMComMChannelRef=CN_Backbone1J1939_0b1f4bae
          BswMModeInitValue
            BswMBswModeInitValue: BswMBswModeInitValueMode=COMM_NO_COMMUNICATION
        ESH_Cond_NoComOn_CN_LIN00_2cd9a7df (BswMModeCondition): BswMConditionType=BSWM_EQUALS, BswMConditionMode=ESH_ComMIndication_CN_LIN00_2cd9a7df
          BswMConditionValue
            BswMBswMode: BswMBswRequestedMode=COMM_NO_COMMUNICATION
        ESH_ComMIndication_CN_LIN00_2cd9a7df (BswMModeRequestPort): BswMArbitrateOnInit=false, BswMRequestProcessing=BSWM_DEFERRED
          BswMModeRequestSource
            BswMComMIndication: BswMComMChannelRef=CN_LIN00_2cd9a7df
          BswMModeInitValue
            BswMBswModeInitValue: BswMBswModeInitValueMode=COMM_NO_COMMUNICATION
        ESH_Cond_NoComOn_CN_LIN02_c2d7c6f3 (BswMModeCondition): BswMConditionType=BSWM_EQUALS, BswMConditionMode=ESH_ComMIndication_CN_LIN02_c2d7c6f3
          BswMConditionValue
            BswMBswMode: BswMBswRequestedMode=COMM_NO_COMMUNICATION
        ESH_ComMIndication_CN_LIN02_c2d7c6f3 (BswMModeRequestPort): BswMArbitrateOnInit=false, BswMRequestProcessing=BSWM_DEFERRED
          BswMModeRequestSource
            BswMComMIndication: BswMComMChannelRef=CN_LIN02_c2d7c6f3
          BswMModeInitValue
            BswMBswModeInitValue: BswMBswModeInitValueMode=COMM_NO_COMMUNICATION
        ESH_Cond_NoComOn_CN_LIN04_2bb463c6 (BswMModeCondition): BswMConditionType=BSWM_EQUALS, BswMConditionMode=ESH_ComMIndication_CN_LIN04_2bb463c6
          BswMConditionValue
            BswMBswMode: BswMBswRequestedMode=COMM_NO_COMMUNICATION
        ESH_ComMIndication_CN_LIN04_2bb463c6 (BswMModeRequestPort): BswMArbitrateOnInit=false, BswMRequestProcessing=BSWM_DEFERRED
          BswMModeRequestSource
            BswMComMIndication: BswMComMChannelRef=CN_LIN04_2bb463c6
          BswMModeInitValue
            BswMBswModeInitValue: BswMBswModeInitValueMode=COMM_NO_COMMUNICATION
        ESH_Cond_NoComOn_CN_CabSubnet_9ea693f1 (BswMModeCondition): BswMConditionType=BSWM_EQUALS, BswMConditionMode=ESH_ComMIndication_CN_CabSubnet_9ea693f1
          BswMConditionValue
            BswMBswMode: BswMBswRequestedMode=COMM_NO_COMMUNICATION
        ESH_ComMIndication_CN_CabSubnet_9ea693f1 (BswMModeRequestPort): BswMArbitrateOnInit=false, BswMRequestProcessing=BSWM_DEFERRED
          BswMModeRequestSource
            BswMComMIndication: BswMComMChannelRef=CN_CabSubnet_9ea693f1
          BswMModeInitValue
            BswMBswModeInitValue: BswMBswModeInitValueMode=COMM_NO_COMMUNICATION
        ESH_Cond_NoComOn_CN_LIN03_b5d0f665 (BswMModeCondition): BswMConditionType=BSWM_EQUALS, BswMConditionMode=ESH_ComMIndication_CN_LIN03_b5d0f665
          BswMConditionValue
            BswMBswMode: BswMBswRequestedMode=COMM_NO_COMMUNICATION
        ESH_ComMIndication_CN_LIN03_b5d0f665 (BswMModeRequestPort): BswMArbitrateOnInit=false, BswMRequestProcessing=BSWM_DEFERRED
          BswMModeRequestSource
            BswMComMIndication: BswMComMChannelRef=CN_LIN03_b5d0f665
          BswMModeInitValue
            BswMBswModeInitValue: BswMBswModeInitValueMode=COMM_NO_COMMUNICATION
        ESH_Cond_NoComOn_CN_LIN01_5bde9749 (BswMModeCondition): BswMConditionType=BSWM_EQUALS, BswMConditionMode=ESH_ComMIndication_CN_LIN01_5bde9749
          BswMConditionValue
            BswMBswMode: BswMBswRequestedMode=COMM_NO_COMMUNICATION
        ESH_ComMIndication_CN_LIN01_5bde9749 (BswMModeRequestPort): BswMArbitrateOnInit=false, BswMRequestProcessing=BSWM_DEFERRED
          BswMModeRequestSource
            BswMComMIndication: BswMComMChannelRef=CN_LIN01_5bde9749
          BswMModeInitValue
            BswMBswModeInitValue: BswMBswModeInitValueMode=COMM_NO_COMMUNICATION
        ESH_Cond_NoComOn_CN_FMSNet_fce1aae5 (BswMModeCondition): BswMConditionType=BSWM_EQUALS, BswMConditionMode=ESH_ComMIndication_CN_FMSNet_fce1aae5
          BswMConditionValue
            BswMBswMode: BswMBswRequestedMode=COMM_NO_COMMUNICATION
        ESH_ComMIndication_CN_FMSNet_fce1aae5 (BswMModeRequestPort): BswMArbitrateOnInit=false, BswMRequestProcessing=BSWM_DEFERRED
          BswMModeRequestSource
            BswMComMIndication: BswMComMChannelRef=CN_FMSNet_fce1aae5
          BswMModeInitValue
            BswMBswModeInitValue: BswMBswModeInitValueMode=COMM_NO_COMMUNICATION
        ESH_Cond_NoComOn_CN_SecuritySubnet_e7a0ee54 (BswMModeCondition): BswMConditionType=BSWM_EQUALS, BswMConditionMode=ESH_ComMIndication_CN_SecuritySubnet_e7a0ee54
          BswMConditionValue
            BswMBswMode: BswMBswRequestedMode=COMM_NO_COMMUNICATION
        ESH_ComMIndication_CN_SecuritySubnet_e7a0ee54 (BswMModeRequestPort): BswMArbitrateOnInit=false, BswMRequestProcessing=BSWM_DEFERRED
          BswMModeRequestSource
            BswMComMIndication: BswMComMChannelRef=CN_SecuritySubnet_e7a0ee54
          BswMModeInitValue
            BswMBswModeInitValue: BswMBswModeInitValueMode=COMM_NO_COMMUNICATION
        BswMModeCondition: BswMConditionType=BSWM_EQUALS, BswMConditionMode=LIN4_ScheduleTableRequestMode
          BswMConditionValue
            BswMBswMode: BswMBswRequestedMode=LIN4_TABLE2
        BswMModeCondition_001 (BswMModeCondition): BswMConditionType=BSWM_EQUALS, BswMConditionMode=LIN4_ScheduleTableRequestMode
          BswMConditionValue
            BswMBswMode: BswMBswRequestedMode=LIN4_TABLE1
      BswMModeControl: BswMInitActionListRef=INIT_AL_Initialize
        BswMIssmExitRunAction (BswMAction)
          BswMAvailableActions
            BswMIssmExitRunCallout (BswMUserCallout): BswMUserCalloutFunction=Issm_BswM_EcuRunState( FALSE ), BswMCreateCallout=false, BswMUserIncludeFile=Issm_Cbk.h
        BswMIssmEnterRunAction (BswMAction)
          BswMAvailableActions
            BswMIssmEnterRunCallout (BswMUserCallout): BswMUserCalloutFunction=Issm_BswM_EcuRunState( TRUE ), BswMCreateCallout=false, BswMUserIncludeFile=Issm_Cbk.h
        CC_AL_CN_CabSubnet_9ea693f1_Disable_DM (BswMActionList): BswMActionListExecution=BSWM_TRIGGER
          CC_DisableDM_CIOM_oCabSubnet_Rx_063a5fbc (BswMActionListItem): BswMAbortOnFail=false, BswMActionListItemIndex=0, BswMActionListItemRef=BswMModeControl/CC_DisableDM_CIOM_oCabSubnet_Rx_063a5fbc
        CC_DisableDM_CIOM_oCabSubnet_Rx_063a5fbc (BswMAction)
          BswMAvailableActions
            BswMDeadlineMonitoringControl: BswMDisabledDMPduGroupRef=CIOM_oCabSubnet_Rx_063a5fbc
        CC_AL_CN_CabSubnet_9ea693f1_Enable_DM (BswMActionList): BswMActionListExecution=BSWM_TRIGGER
          CC_EnableDM_CIOM_oCabSubnet_Rx_063a5fbc (BswMActionListItem): BswMAbortOnFail=false, BswMActionListItemIndex=0, BswMActionListItemRef=BswMModeControl/CC_EnableDM_CIOM_oCabSubnet_Rx_063a5fbc
        CC_EnableDM_CIOM_oCabSubnet_Rx_063a5fbc (BswMAction)
          BswMAvailableActions
            BswMDeadlineMonitoringControl: BswMEnabledDMPduGroupRef=CIOM_oCabSubnet_Rx_063a5fbc
        CC_AL_LIN1_ScheduleTable_to_MasterReq_SlaveResp_Table_1 (BswMActionList): BswMActionListExecution=BSWM_TRIGGER
          LinSM_ScheduleRequest_MasterReq_SlaveResp_Table_1_2a158a89 (BswMActionListItem):
            BswMAbortOnFail = false
            BswMActionListItemIndex = 0
            BswMActionListItemRef = BswMModeControl/LinSM_ScheduleRequest_MasterReq_SlaveResp_Table_1_2a158a89
          CC_DisableDM_CIOM_oBackbone2_Rx_4e624434 (BswMActionListItem): BswMAbortOnFail=false, BswMActionListItemIndex=1, BswMActionListItemRef=BswMModeControl/CC_DisableDM_CIOM_oBackbone2_Rx_4e624434
        CC_DisableDM_CIOM_oBackbone2_Rx_4e624434 (BswMAction)
          BswMAvailableActions
            BswMDeadlineMonitoringControl: BswMDisabledDMPduGroupRef=CIOM_oBackbone2_Rx_4e624434
        CC_AL_LIN5_ScheduleTable_to_MasterReq_SlaveResp (BswMActionList): BswMActionListExecution=BSWM_TRIGGER
          CC_EnableDM_CIOM_oBackbone2_Rx_4e624434 (BswMActionListItem): BswMAbortOnFail=false, BswMActionListItemIndex=0, BswMActionListItemRef=BswMModeControl/CC_EnableDM_CIOM_oBackbone2_Rx_4e624434
        CC_EnableDM_CIOM_oBackbone2_Rx_4e624434 (BswMAction)
          BswMAvailableActions
            BswMDeadlineMonitoringControl: BswMEnabledDMPduGroupRef=CIOM_oBackbone2_Rx_4e624434
        CC_AL_CN_SecuritySubnet_e7a0ee54_TX_Disable (BswMActionList): BswMActionListExecution=BSWM_TRIGGER
          CC_DisablePDUGroup_CIOM_oSecuritySubnet_Tx_6c66ba3a (BswMActionListItem): BswMAbortOnFail=false, BswMActionListItemIndex=0, BswMActionListItemRef=BswMModeControl/CC_DisablePDUGroup_CIOM_oSecuritySubnet_Tx_6c66ba3a
        CC_DisablePDUGroup_CIOM_oSecuritySubnet_Tx_6c66ba3a (BswMAction)
          BswMAvailableActions
            BswMPduGroupSwitch: BswMPduGroupSwitchReinit=false, BswMDisabledPduGroupRef=CIOM_oSecuritySubnet_Tx_6c66ba3a
        CC_AL_CN_SecuritySubnet_e7a0ee54_TX_EnableNoinit (BswMActionList): BswMActionListExecution=BSWM_TRIGGER
          CC_EnablePDUGroup_CIOM_oSecuritySubnet_Tx_6c66ba3a (BswMActionListItem): BswMAbortOnFail=false, BswMActionListItemIndex=0, BswMActionListItemRef=BswMModeControl/CC_EnablePDUGroup_CIOM_oSecuritySubnet_Tx_6c66ba3a
        CC_EnablePDUGroup_CIOM_oSecuritySubnet_Tx_6c66ba3a (BswMAction)
          BswMAvailableActions
            BswMPduGroupSwitch: BswMPduGroupSwitchReinit=false, BswMEnabledPduGroupRef=CIOM_oSecuritySubnet_Tx_6c66ba3a
        CC_AL_CN_LIN02_c2d7c6f3_Disable (BswMActionList): BswMActionListExecution=BSWM_TRIGGER
          CC_DisablePDUGroup_CIOM_oLIN02_Tx_214b70a7 (BswMActionListItem): BswMAbortOnFail=false, BswMActionListItemIndex=0, BswMActionListItemRef=BswMModeControl/CC_DisablePDUGroup_CIOM_oLIN02_Tx_214b70a7
          CC_DisablePDUGroup_CIOM_oLIN02_Rx_7711d721 (BswMActionListItem): BswMAbortOnFail=false, BswMActionListItemIndex=1, BswMActionListItemRef=BswMModeControl/CC_DisablePDUGroup_CIOM_oLIN02_Rx_7711d721
        CC_DisablePDUGroup_CIOM_oLIN02_Tx_214b70a7 (BswMAction)
          BswMAvailableActions
            BswMPduGroupSwitch: BswMPduGroupSwitchReinit=false, BswMDisabledPduGroupRef=CIOM_oLIN02_Tx_214b70a7
        CC_DisablePDUGroup_CIOM_oLIN02_Rx_7711d721 (BswMAction)
          BswMAvailableActions
            BswMPduGroupSwitch: BswMPduGroupSwitchReinit=false, BswMDisabledPduGroupRef=CIOM_oLIN02_Rx_7711d721
        CC_AL_CN_LIN02_c2d7c6f3_Enable (BswMActionList): BswMActionListExecution=BSWM_TRIGGER
          CC_EnablePDUGroup_CIOM_oLIN02_Tx_214b70a7 (BswMActionListItem): BswMAbortOnFail=false, BswMActionListItemIndex=0, BswMActionListItemRef=BswMModeControl/CC_EnablePDUGroup_CIOM_oLIN02_Tx_214b70a7
          CC_EnablePDUGroup_CIOM_oLIN02_Rx_7711d721 (BswMActionListItem): BswMAbortOnFail=false, BswMActionListItemIndex=1, BswMActionListItemRef=BswMModeControl/CC_EnablePDUGroup_CIOM_oLIN02_Rx_7711d721
        CC_EnablePDUGroup_CIOM_oLIN02_Tx_214b70a7 (BswMAction)
          BswMAvailableActions
            BswMPduGroupSwitch: BswMPduGroupSwitchReinit=false, BswMEnabledPduGroupRef=CIOM_oLIN02_Tx_214b70a7
        CC_EnablePDUGroup_CIOM_oLIN02_Rx_7711d721 (BswMAction)
          BswMAvailableActions
            BswMPduGroupSwitch: BswMPduGroupSwitchReinit=false, BswMEnabledPduGroupRef=CIOM_oLIN02_Rx_7711d721
        CC_AL_CN_SecuritySubnet_e7a0ee54_RX_Disable (BswMActionList): BswMActionListExecution=BSWM_TRIGGER
          CC_DisablePDUGroup_CIOM_oSecuritySubnet_Rx_3a3c1dbc (BswMActionListItem): BswMAbortOnFail=false, BswMActionListItemIndex=0, BswMActionListItemRef=BswMModeControl/CC_DisablePDUGroup_CIOM_oSecuritySubnet_Rx_3a3c1dbc
        CC_DisablePDUGroup_CIOM_oSecuritySubnet_Rx_3a3c1dbc (BswMAction)
          BswMAvailableActions
            BswMPduGroupSwitch: BswMPduGroupSwitchReinit=false, BswMDisabledPduGroupRef=CIOM_oSecuritySubnet_Rx_3a3c1dbc
        CC_AL_CN_SecuritySubnet_e7a0ee54_RX_EnableNoinit (BswMActionList): BswMActionListExecution=BSWM_TRIGGER
          CC_EnablePDUGroup_CIOM_oSecuritySubnet_Rx_3a3c1dbc (BswMActionListItem): BswMAbortOnFail=false, BswMActionListItemIndex=0, BswMActionListItemRef=BswMModeControl/CC_EnablePDUGroup_CIOM_oSecuritySubnet_Rx_3a3c1dbc
        CC_EnablePDUGroup_CIOM_oSecuritySubnet_Rx_3a3c1dbc (BswMAction)
          BswMAvailableActions
            BswMPduGroupSwitch: BswMPduGroupSwitchReinit=false, BswMEnabledPduGroupRef=CIOM_oSecuritySubnet_Rx_3a3c1dbc
        CC_AL_CN_SecuritySubnet_e7a0ee54_Disable_DM (BswMActionList): BswMActionListExecution=BSWM_TRIGGER
          CC_DisableDM_CIOM_oSecuritySubnet_Rx_3a3c1dbc (BswMActionListItem): BswMAbortOnFail=false, BswMActionListItemIndex=0, BswMActionListItemRef=BswMModeControl/CC_DisableDM_CIOM_oSecuritySubnet_Rx_3a3c1dbc
        CC_DisableDM_CIOM_oSecuritySubnet_Rx_3a3c1dbc (BswMAction)
          BswMAvailableActions
            BswMDeadlineMonitoringControl: BswMDisabledDMPduGroupRef=CIOM_oSecuritySubnet_Rx_3a3c1dbc
        CC_AL_CN_SecuritySubnet_e7a0ee54_Enable_DM (BswMActionList): BswMActionListExecution=BSWM_TRIGGER
          CC_EnableDM_CIOM_oSecuritySubnet_Rx_3a3c1dbc (BswMActionListItem): BswMAbortOnFail=false, BswMActionListItemIndex=0, BswMActionListItemRef=BswMModeControl/CC_EnableDM_CIOM_oSecuritySubnet_Rx_3a3c1dbc
        CC_EnableDM_CIOM_oSecuritySubnet_Rx_3a3c1dbc (BswMAction)
          BswMAvailableActions
            BswMDeadlineMonitoringControl: BswMEnabledDMPduGroupRef=CIOM_oSecuritySubnet_Rx_3a3c1dbc
        CC_AL_CN_Backbone2_78967e2c_RX_Disable (BswMActionList): BswMActionListExecution=BSWM_TRIGGER
          CC_DisablePDUGroup_CIOM_oBackbone2_Rx_4e624434 (BswMActionListItem): BswMAbortOnFail=false, BswMActionListItemIndex=0, BswMActionListItemRef=BswMModeControl/CC_DisablePDUGroup_CIOM_oBackbone2_Rx_4e624434
        CC_DisablePDUGroup_CIOM_oBackbone2_Rx_4e624434 (BswMAction)
          BswMAvailableActions
            BswMPduGroupSwitch: BswMPduGroupSwitchReinit=false, BswMDisabledPduGroupRef=CIOM_oBackbone2_Rx_4e624434
        CC_AL_CN_Backbone2_78967e2c_RX_EnableNoinit (BswMActionList): BswMActionListExecution=BSWM_TRIGGER
          CC_EnablePDUGroup_CIOM_oBackbone2_Rx_4e624434 (BswMActionListItem): BswMAbortOnFail=false, BswMActionListItemIndex=0, BswMActionListItemRef=BswMModeControl/CC_EnablePDUGroup_CIOM_oBackbone2_Rx_4e624434
        CC_EnablePDUGroup_CIOM_oBackbone2_Rx_4e624434 (BswMAction)
          BswMAvailableActions
            BswMPduGroupSwitch: BswMPduGroupSwitchReinit=false, BswMEnabledPduGroupRef=CIOM_oBackbone2_Rx_4e624434
        CC_AL_CN_CabSubnet_9ea693f1_TX_Disable (BswMActionList): BswMActionListExecution=BSWM_TRIGGER
          CC_DisablePDUGroup_CIOM_oCabSubnet_Tx_5060f83a (BswMActionListItem): BswMAbortOnFail=false, BswMActionListItemIndex=0, BswMActionListItemRef=BswMModeControl/CC_DisablePDUGroup_CIOM_oCabSubnet_Tx_5060f83a
        CC_DisablePDUGroup_CIOM_oCabSubnet_Tx_5060f83a (BswMAction)
          BswMAvailableActions
            BswMPduGroupSwitch: BswMPduGroupSwitchReinit=false, BswMDisabledPduGroupRef=CIOM_oCabSubnet_Tx_5060f83a
        CC_AL_CN_CabSubnet_9ea693f1_TX_EnableNoinit (BswMActionList): BswMActionListExecution=BSWM_TRIGGER
          CC_EnablePDUGroup_CIOM_oCabSubnet_Tx_5060f83a (BswMActionListItem): BswMAbortOnFail=false, BswMActionListItemIndex=0, BswMActionListItemRef=BswMModeControl/CC_EnablePDUGroup_CIOM_oCabSubnet_Tx_5060f83a
        CC_EnablePDUGroup_CIOM_oCabSubnet_Tx_5060f83a (BswMAction)
          BswMAvailableActions
            BswMPduGroupSwitch: BswMPduGroupSwitchReinit=false, BswMEnabledPduGroupRef=CIOM_oCabSubnet_Tx_5060f83a
        CC_AL_CN_Backbone2_78967e2c_TX_Disable (BswMActionList): BswMActionListExecution=BSWM_TRIGGER
          CC_DisablePDUGroup_CIOM_oBackbone2_Tx_1838e3b2 (BswMActionListItem): BswMAbortOnFail=false, BswMActionListItemIndex=0, BswMActionListItemRef=BswMModeControl/CC_DisablePDUGroup_CIOM_oBackbone2_Tx_1838e3b2
        CC_DisablePDUGroup_CIOM_oBackbone2_Tx_1838e3b2 (BswMAction)
          BswMAvailableActions
            BswMPduGroupSwitch: BswMPduGroupSwitchReinit=false, BswMDisabledPduGroupRef=CIOM_oBackbone2_Tx_1838e3b2
        CC_AL_CN_Backbone2_78967e2c_TX_EnableNoinit (BswMActionList): BswMActionListExecution=BSWM_TRIGGER
          CC_EnablePDUGroup_CIOM_oBackbone2_Tx_1838e3b2 (BswMActionListItem): BswMAbortOnFail=false, BswMActionListItemIndex=0, BswMActionListItemRef=BswMModeControl/CC_EnablePDUGroup_CIOM_oBackbone2_Tx_1838e3b2
        CC_EnablePDUGroup_CIOM_oBackbone2_Tx_1838e3b2 (BswMAction)
          BswMAvailableActions
            BswMPduGroupSwitch: BswMPduGroupSwitchReinit=false, BswMEnabledPduGroupRef=CIOM_oBackbone2_Tx_1838e3b2
        CC_AL_LIN2_ScheduleTable_to_Table_E (BswMActionList): BswMActionListExecution=BSWM_TRIGGER
          LinSM_ScheduleRequest_Table_e_dbb68a08 (BswMActionListItem): BswMAbortOnFail=false, BswMActionListItemIndex=0, BswMActionListItemRef=BswMModeControl/LinSM_ScheduleRequest_Table_e_dbb68a08
          CC_DisablePDUGroup_CIOM_oCabSubnet_Rx_063a5fbc (BswMActionListItem): BswMAbortOnFail=false, BswMActionListItemIndex=1, BswMActionListItemRef=BswMModeControl/CC_DisablePDUGroup_CIOM_oCabSubnet_Rx_063a5fbc
        CC_DisablePDUGroup_CIOM_oCabSubnet_Rx_063a5fbc (BswMAction)
          BswMAvailableActions
            BswMPduGroupSwitch: BswMPduGroupSwitchReinit=false, BswMDisabledPduGroupRef=CIOM_oCabSubnet_Rx_063a5fbc
        CC_AL_CN_CabSubnet_9ea693f1_RX_EnableNoinit (BswMActionList): BswMActionListExecution=BSWM_TRIGGER
          CC_EnablePDUGroup_CIOM_oCabSubnet_Rx_063a5fbc (BswMActionListItem): BswMAbortOnFail=false, BswMActionListItemIndex=0, BswMActionListItemRef=BswMModeControl/CC_EnablePDUGroup_CIOM_oCabSubnet_Rx_063a5fbc
        CC_EnablePDUGroup_CIOM_oCabSubnet_Rx_063a5fbc (BswMAction)
          BswMAvailableActions
            BswMPduGroupSwitch: BswMPduGroupSwitchReinit=false, BswMEnabledPduGroupRef=CIOM_oCabSubnet_Rx_063a5fbc
        CC_AL_LIN5_ScheduleTable_to_Table2 (BswMActionList): BswMActionListExecution=BSWM_TRIGGER
          3 x BswMActionListItem, all with BswMAbortOnFail=false:
            LinSM_ScheduleRequest_Table_2_aa1a2032: BswMActionListItemIndex=0, BswMActionListItemRef=BswMModeControl/LinSM_ScheduleRequest_Table_2_aa1a2032
            CC_DisablePDUGroup_CIOM_oLIN03_Tx_99f717c2: BswMActionListItemIndex=1, BswMActionListItemRef=BswMModeControl/CC_DisablePDUGroup_CIOM_oLIN03_Tx_99f717c2
            CC_DisablePDUGroup_CIOM_oLIN03_Rx_cfadb044: BswMActionListItemIndex=2, BswMActionListItemRef=BswMModeControl/CC_DisablePDUGroup_CIOM_oLIN03_Rx_cfadb044
        CC_DisablePDUGroup_CIOM_oLIN03_Tx_99f717c2 (BswMAction)
          BswMAvailableActions
            BswMPduGroupSwitch: BswMPduGroupSwitchReinit=false, BswMDisabledPduGroupRef=CIOM_oLIN03_Tx_99f717c2
        CC_DisablePDUGroup_CIOM_oLIN03_Rx_cfadb044 (BswMAction)
          BswMAvailableActions
            BswMPduGroupSwitch: BswMPduGroupSwitchReinit=false, BswMDisabledPduGroupRef=CIOM_oLIN03_Rx_cfadb044
        CC_AL_CN_LIN03_b5d0f665_Enable (BswMActionList): BswMActionListExecution=BSWM_TRIGGER
          CC_EnablePDUGroup_CIOM_oLIN03_Tx_99f717c2 (BswMActionListItem): BswMAbortOnFail=false, BswMActionListItemIndex=0, BswMActionListItemRef=BswMModeControl/CC_EnablePDUGroup_CIOM_oLIN03_Tx_99f717c2
          CC_EnablePDUGroup_CIOM_oLIN03_Rx_cfadb044 (BswMActionListItem): BswMAbortOnFail=false, BswMActionListItemIndex=1, BswMActionListItemRef=BswMModeControl/CC_EnablePDUGroup_CIOM_oLIN03_Rx_cfadb044
        CC_EnablePDUGroup_CIOM_oLIN03_Tx_99f717c2 (BswMAction)
          BswMAvailableActions
            BswMPduGroupSwitch: BswMPduGroupSwitchReinit=false, BswMEnabledPduGroupRef=CIOM_oLIN03_Tx_99f717c2
        CC_EnablePDUGroup_CIOM_oLIN03_Rx_cfadb044 (BswMAction)
          BswMAvailableActions
            BswMPduGroupSwitch: BswMPduGroupSwitchReinit=false, BswMEnabledPduGroupRef=CIOM_oLIN03_Rx_cfadb044
        CC_AL_CN_LIN01_5bde9749_Disable (BswMActionList): BswMActionListExecution=BSWM_TRIGGER
          CC_DisablePDUGroup_CIOM_oLIN01_Tx_33fedf49 (BswMActionListItem): BswMAbortOnFail=false, BswMActionListItemIndex=0, BswMActionListItemRef=BswMModeControl/CC_DisablePDUGroup_CIOM_oLIN01_Tx_33fedf49
          CC_DisablePDUGroup_CIOM_oLIN01_Rx_65a478cf (BswMActionListItem): BswMAbortOnFail=false, BswMActionListItemIndex=1, BswMActionListItemRef=BswMModeControl/CC_DisablePDUGroup_CIOM_oLIN01_Rx_65a478cf
        CC_DisablePDUGroup_CIOM_oLIN01_Tx_33fedf49 (BswMAction)
          BswMAvailableActions
            BswMPduGroupSwitch: BswMPduGroupSwitchReinit=false, BswMDisabledPduGroupRef=CIOM_oLIN01_Tx_33fedf49
        CC_DisablePDUGroup_CIOM_oLIN01_Rx_65a478cf (BswMAction)
          BswMAvailableActions
            BswMPduGroupSwitch: BswMPduGroupSwitchReinit=false, BswMDisabledPduGroupRef=CIOM_oLIN01_Rx_65a478cf
        CC_AL_CN_LIN01_5bde9749_Enable (BswMActionList): BswMActionListExecution=BSWM_TRIGGER
          CC_EnablePDUGroup_CIOM_oLIN01_Tx_33fedf49 (BswMActionListItem): BswMAbortOnFail=false, BswMActionListItemIndex=0, BswMActionListItemRef=BswMModeControl/CC_EnablePDUGroup_CIOM_oLIN01_Tx_33fedf49
          CC_EnablePDUGroup_CIOM_oLIN01_Rx_65a478cf (BswMActionListItem): BswMAbortOnFail=false, BswMActionListItemIndex=1, BswMActionListItemRef=BswMModeControl/CC_EnablePDUGroup_CIOM_oLIN01_Rx_65a478cf
        CC_EnablePDUGroup_CIOM_oLIN01_Tx_33fedf49 (BswMAction)
          BswMAvailableActions
            BswMPduGroupSwitch: BswMPduGroupSwitchReinit=false, BswMEnabledPduGroupRef=CIOM_oLIN01_Tx_33fedf49
        CC_EnablePDUGroup_CIOM_oLIN01_Rx_65a478cf (BswMAction)
          BswMAvailableActions
            BswMPduGroupSwitch: BswMPduGroupSwitchReinit=false, BswMEnabledPduGroupRef=CIOM_oLIN01_Rx_65a478cf
        CC_AL_CN_LIN04_2bb463c6_Disable (BswMActionList): BswMActionListExecution=BSWM_TRIGGER
          CC_DisablePDUGroup_CIOM_oLIN04_Tx_04202f7b (BswMActionListItem): BswMAbortOnFail=false, BswMActionListItemIndex=0, BswMActionListItemRef=BswMModeControl/CC_DisablePDUGroup_CIOM_oLIN04_Tx_04202f7b
          CC_DisablePDUGroup_CIOM_oLIN04_Rx_527a88fd (BswMActionListItem): BswMAbortOnFail=false, BswMActionListItemIndex=1, BswMActionListItemRef=BswMModeControl/CC_DisablePDUGroup_CIOM_oLIN04_Rx_527a88fd
        CC_DisablePDUGroup_CIOM_oLIN04_Tx_04202f7b (BswMAction)
          BswMAvailableActions
            BswMPduGroupSwitch: BswMPduGroupSwitchReinit=false, BswMDisabledPduGroupRef=CIOM_oLIN04_Tx_04202f7b
        CC_DisablePDUGroup_CIOM_oLIN04_Rx_527a88fd (BswMAction)
          BswMAvailableActions
            BswMPduGroupSwitch: BswMPduGroupSwitchReinit=false, BswMDisabledPduGroupRef=CIOM_oLIN04_Rx_527a88fd
        CC_AL_CN_LIN04_2bb463c6_Enable (BswMActionList): BswMActionListExecution=BSWM_TRIGGER
          CC_EnablePDUGroup_CIOM_oLIN04_Tx_04202f7b (BswMActionListItem): BswMAbortOnFail=false, BswMActionListItemIndex=0, BswMActionListItemRef=BswMModeControl/CC_EnablePDUGroup_CIOM_oLIN04_Tx_04202f7b
          CC_EnablePDUGroup_CIOM_oLIN04_Rx_527a88fd (BswMActionListItem): BswMAbortOnFail=false, BswMActionListItemIndex=1, BswMActionListItemRef=BswMModeControl/CC_EnablePDUGroup_CIOM_oLIN04_Rx_527a88fd
        CC_EnablePDUGroup_CIOM_oLIN04_Tx_04202f7b (BswMAction)
          BswMAvailableActions
            BswMPduGroupSwitch: BswMPduGroupSwitchReinit=false, BswMEnabledPduGroupRef=CIOM_oLIN04_Tx_04202f7b
        CC_EnablePDUGroup_CIOM_oLIN04_Rx_527a88fd (BswMAction)
          BswMAvailableActions
            BswMPduGroupSwitch: BswMPduGroupSwitchReinit=false, BswMEnabledPduGroupRef=CIOM_oLIN04_Rx_527a88fd
        CC_AL_CN_Backbone1J1939_0b1f4bae_RX_Disable (BswMActionList): BswMActionListExecution=BSWM_TRIGGER
          CC_DisablePDUGroup_CIOM_oBackbone1J1939_Rx_BC_405bc776 (BswMActionListItem): BswMAbortOnFail=false, BswMActionListItemIndex=0, BswMActionListItemRef=BswMModeControl/CC_DisablePDUGroup_CIOM_oBackbone1J1939_Rx_BC_405bc776
        CC_DisablePDUGroup_CIOM_oBackbone1J1939_Rx_BC_405bc776 (BswMAction)
          BswMAvailableActions
            BswMPduGroupSwitch: BswMPduGroupSwitchReinit=false, BswMDisabledPduGroupRef=CIOM_oBackbone1J1939_Rx_BC_405bc776
        CC_AL_LIN4_ScheduleTable_to_MasterReq_SlaveResp (BswMActionList): BswMActionListExecution=BSWM_TRIGGER
          CC_EnablePDUGroup_CIOM_oBackbone1J1939_Rx_BC_405bc776 (BswMActionListItem): BswMAbortOnFail=false, BswMActionListItemIndex=0, BswMActionListItemRef=BswMModeControl/CC_EnablePDUGroup_CIOM_oBackbone1J1939_Rx_BC_405bc776
        CC_EnablePDUGroup_CIOM_oBackbone1J1939_Rx_BC_405bc776 (BswMAction)
          BswMAvailableActions
            BswMPduGroupSwitch: BswMPduGroupSwitchReinit=false, BswMEnabledPduGroupRef=CIOM_oBackbone1J1939_Rx_BC_405bc776
        CC_AL_CN_Backbone1J1939_0b1f4bae_Disable_DM (BswMActionList): BswMActionListExecution=BSWM_TRIGGER
          CC_DisableDM_CIOM_oBackbone1J1939_Rx_BC_405bc776 (BswMActionListItem): BswMAbortOnFail=false, BswMActionListItemIndex=0, BswMActionListItemRef=BswMModeControl/CC_DisableDM_CIOM_oBackbone1J1939_Rx_BC_405bc776
        CC_DisableDM_CIOM_oBackbone1J1939_Rx_BC_405bc776 (BswMAction)
          BswMAvailableActions
            BswMDeadlineMonitoringControl: BswMDisabledDMPduGroupRef=CIOM_oBackbone1J1939_Rx_BC_405bc776
        CC_AL_CN_Backbone1J1939_0b1f4bae_Enable_DM (BswMActionList): BswMActionListExecution=BSWM_TRIGGER
          CC_EnableDM_CIOM_oBackbone1J1939_Rx_BC_405bc776 (BswMActionListItem): BswMAbortOnFail=false, BswMActionListItemIndex=0, BswMActionListItemRef=BswMModeControl/CC_EnableDM_CIOM_oBackbone1J1939_Rx_BC_405bc776
        3 x BswMAction:
          CC_EnableDM_CIOM_oBackbone1J1939_Rx_BC_405bc776
            BswMAvailableActions
              BswMDeadlineMonitoringControl: BswMEnabledDMPduGroupRef=CIOM_oBackbone1J1939_Rx_BC_405bc776
          CC_DisablePDUGroup_CIOM_oBackbone1J1939_Tx_0x31_BC_3782f500
            BswMAvailableActions
              BswMPduGroupSwitch: BswMPduGroupSwitchReinit=false, BswMDisabledPduGroupRef=CIOM_oBackbone1J1939_Tx_0x31_BC_3782f500
          CC_EnablePDUGroup_CIOM_oBackbone1J1939_Tx_0x31_BC_3782f500
            BswMAvailableActions
              BswMPduGroupSwitch: BswMPduGroupSwitchReinit=false, BswMEnabledPduGroupRef=CIOM_oBackbone1J1939_Tx_0x31_BC_3782f500
        CC_AL_CN_LIN00_2cd9a7df_Disable (BswMActionList): BswMActionListExecution=BSWM_TRIGGER
          CC_DisablePDUGroup_CIOM_oLIN00_Tx_8b42b82c (BswMActionListItem): BswMAbortOnFail=false, BswMActionListItemIndex=0, BswMActionListItemRef=BswMModeControl/CC_DisablePDUGroup_CIOM_oLIN00_Tx_8b42b82c
          CC_DisablePDUGroup_CIOM_oLIN00_Rx_dd181faa (BswMActionListItem): BswMAbortOnFail=false, BswMActionListItemIndex=1, BswMActionListItemRef=BswMModeControl/CC_DisablePDUGroup_CIOM_oLIN00_Rx_dd181faa
        CC_DisablePDUGroup_CIOM_oLIN00_Tx_8b42b82c (BswMAction)
          BswMAvailableActions
            BswMPduGroupSwitch: BswMPduGroupSwitchReinit=false, BswMDisabledPduGroupRef=CIOM_oLIN00_Tx_8b42b82c
        CC_DisablePDUGroup_CIOM_oLIN00_Rx_dd181faa (BswMAction)
          BswMAvailableActions
            BswMPduGroupSwitch: BswMPduGroupSwitchReinit=false, BswMDisabledPduGroupRef=CIOM_oLIN00_Rx_dd181faa
        CC_AL_CN_LIN00_2cd9a7df_Enable (BswMActionList): BswMActionListExecution=BSWM_TRIGGER
          CC_EnablePDUGroup_CIOM_oLIN00_Tx_8b42b82c (BswMActionListItem): BswMAbortOnFail=false, BswMActionListItemIndex=0, BswMActionListItemRef=BswMModeControl/CC_EnablePDUGroup_CIOM_oLIN00_Tx_8b42b82c
          CC_EnablePDUGroup_CIOM_oLIN00_Rx_dd181faa (BswMActionListItem): BswMAbortOnFail=false, BswMActionListItemIndex=1, BswMActionListItemRef=BswMModeControl/CC_EnablePDUGroup_CIOM_oLIN00_Rx_dd181faa
        CC_EnablePDUGroup_CIOM_oLIN00_Tx_8b42b82c (BswMAction)
          BswMAvailableActions
            BswMPduGroupSwitch: BswMPduGroupSwitchReinit=false, BswMEnabledPduGroupRef=CIOM_oLIN00_Tx_8b42b82c
        CC_EnablePDUGroup_CIOM_oLIN00_Rx_dd181faa (BswMAction)
          BswMAvailableActions
            BswMPduGroupSwitch: BswMPduGroupSwitchReinit=false, BswMEnabledPduGroupRef=CIOM_oLIN00_Rx_dd181faa
        ESH_AL_ExitRun (BswMActionList): BswMActionListExecution=BSWM_CONDITION
          4 x BswMActionListItem, all with BswMAbortOnFail=false:
            ESH_Action_EnterExclusiveArea: BswMActionListItemIndex=0, BswMActionListItemRef=BswMModeControl/ESH_Action_EnterExclusiveArea
            ESH_Action_ComMCheckPendingRequests: BswMActionListItemIndex=1, BswMActionListItemRef=BswMModeControl/ESH_Action_ComMCheckPendingRequests
            ESH_RunToPostRunNested: BswMActionListItemIndex=2, BswMActionListItemRef=BswMArbitration/ESH_RunToPostRunNested
            ESH_Action_ExitExclusiveArea: BswMActionListItemIndex=3, BswMActionListItemRef=BswMModeControl/ESH_Action_ExitExclusiveArea
        ESH_Action_EnterExclusiveArea (BswMAction)
          BswMAvailableActions
            BswMUserCallout: BswMUserCalloutFunction=SchM_Enter_BswM_BSWM_EXCLUSIVE_AREA_0(), BswMCreateCallout=false, BswMUserIncludeFile=SchM_BswM.h
        ESH_Action_ComMCheckPendingRequests (BswMAction)
          BswMAvailableActions
            BswMUserCallout:
              BswMUserCalloutFunction = ESH_ComM_CheckPendingRequests()
              BswMCreateCallout = true
              BswMUserCode = ComM_StateType CN_Backbone1J1939_0b1f4bae = COMM_NO_COM_NO_PENDING_REQUEST; ComM_StateType CN_LIN00_2cd9a7df = COMM_NO_COM_NO_PENDING_REQUEST; ComM_StateType CN_LIN02_c2d7c6f3 = COMM_NO_COM_NO_PENDING_REQUEST; ComM_StateType CN_LIN04_2bb463c6 = COMM_NO_COM_NO_PENDING_REQUEST; ComM_StateType CN_CabSubnet_9ea693f1 = COMM_NO_COM_NO_PENDING_REQUEST; ComM_StateType CN_LIN03_b5d0f665 = COMM_NO_COM_NO_PENDING_REQUEST; ComM_StateType CN_Backbone2_78967e2c = COMM_NO_COM_NO_PENDING_REQUEST; ComM_StateType CN_LIN01_5bde9749 = COMM_NO_COM_NO_PENDING_REQUEST; ComM_StateType CN_FMSNet_fce1aae5 = COMM_NO_COM_NO_PENDING_REQUEST; ComM_StateType CN_SecuritySubnet_e7a0ee54 = COMM_NO_COM_NO_PENDING_REQUEST; (void)ComM_GetState(ComMConf_ComMChannel_CN_Backbone1J1939_0b1f4bae, &CN_Backbone1J1939_0b1f4bae); /* SBSW_BSWM_FCTCALL_LOCALVAR */ (void)ComM_GetState(ComMConf_ComMChannel_CN_LIN00_2cd9a7df, &CN_LIN00_2cd9a7df); /* SBSW_BSWM_FCTCALL_LOCALVAR */ (void)ComM_GetState(ComMConf_ComMChannel_CN_LIN02_c2d7c6f3, &CN_LIN02_c2d7c6f3); /* SBSW_BSWM_FCTCALL_LOCALVAR */ (void)ComM_GetState(ComMConf_ComMChannel_CN_LIN04_2bb463c6, &CN_LIN04_2bb463c6); /* SBSW_BSWM_FCTCALL_LOCALVAR */ (void)ComM_GetState(ComMConf_ComMChannel_CN_CabSubnet_9ea693f1, &CN_CabSubnet_9ea693f1); /* SBSW_BSWM_FCTCALL_LOCALVAR */ (void)ComM_GetState(ComMConf_ComMChannel_CN_LIN03_b5d0f665, &CN_LIN03_b5d0f665); /* SBSW_BSWM_FCTCALL_LOCALVAR */ (void)ComM_GetState(ComMConf_ComMChannel_CN_Backbone2_78967e2c, &CN_Backbone2_78967e2c); /* SBSW_BSWM_FCTCALL_LOCALVAR */ (void)ComM_GetState(ComMConf_ComMChannel_CN_LIN01_5bde9749, &CN_LIN01_5bde9749); /* SBSW_BSWM_FCTCALL_LOCALVAR */ (void)ComM_GetState(ComMConf_ComMChannel_CN_FMSNet_fce1aae5, &CN_FMSNet_fce1aae5); /* SBSW_BSWM_FCTCALL_LOCALVAR */ (void)ComM_GetState(ComMConf_ComMChannel_CN_SecuritySubnet_e7a0ee54, &CN_SecuritySubnet_e7a0ee54); /* SBSW_BSWM_FCTCALL_LOCALVAR */ if((CN_Backbone1J1939_0b1f4bae != COMM_NO_COM_NO_PENDING_REQUEST) || (CN_LIN00_2cd9a7df != COMM_NO_COM_NO_PENDING_REQUEST) || (CN_LIN02_c2d7c6f3 != COMM_NO_COM_NO_PENDING_REQUEST) || (CN_LIN04_2bb463c6 != COMM_NO_COM_NO_PENDING_REQUEST) || (CN_CabSubnet_9ea693f1 != COMM_NO_COM_NO_PENDING_REQUEST) || (CN_LIN03_b5d0f665 != COMM_NO_COM_NO_PENDING_REQUEST) || (CN_Backbone2_78967e2c != COMM_NO_COM_NO_PENDING_REQUEST) || (CN_LIN01_5bde9749 != COMM_NO_COM_NO_PENDING_REQUEST) || (CN_FMSNet_fce1aae5 != COMM_NO_COM_NO_PENDING_REQUEST) || (CN_SecuritySubnet_e7a0ee54 != COMM_NO_COM_NO_PENDING_REQUEST)) { BswM_RequestMode(BSWM_GENERIC_ESH_ComMPendingRequests, BSWM_GENERICVALUE_ESH_ComMPendingRequests_ESH_COMM_PENDING_REQUEST); } else { BswM_RequestMode(BSWM_GENERIC_ESH_ComMPendingRequests, BSWM_GENERICVALUE_ESH_ComMPendingRequests_ESH_COMM_NO_REQUEST); }
        ESH_AL_RunToPostRun (BswMActionList): BswMActionListExecution=BSWM_CONDITION
          14 x BswMActionListItem, all with BswMAbortOnFail=false:
            ESH_Action_EcuMClearValidatedWakeupEvents: BswMActionListItemIndex=10, BswMActionListItemRef=BswMModeControl/ESH_Action_EcuMClearValidatedWakeupEvents
            ESH_Action_OnEnterPostRun: BswMActionListItemIndex=11, BswMActionListItemRef=BswMModeControl/ESH_Action_OnEnterPostRun
            ESH_Action_SwitchPostRun: BswMActionListItemIndex=12, BswMActionListItemRef=BswMModeControl/ESH_Action_SwitchPostRun
            ESH_Action_ESH_PostRun: BswMActionListItemIndex=13, BswMActionListItemRef=BswMModeControl/ESH_Action_ESH_PostRun
            ESH_Action_ComMDisallow_CN_Backbone2_78967e2c: BswMActionListItemIndex=6, BswMActionListItemRef=BswMModeControl/ESH_Action_ComMDisallow_CN_Backbone2_78967e2c
            ESH_Action_ComMDisallow_CN_Backbone1J1939_0b1f4bae: BswMActionListItemIndex=0, BswMActionListItemRef=BswMModeControl/ESH_Action_ComMDisallow_CN_Backbone1J1939_0b1f4bae
            ESH_Action_ComMDisallow_CN_LIN00_2cd9a7df: BswMActionListItemIndex=1, BswMActionListItemRef=BswMModeControl/ESH_Action_ComMDisallow_CN_LIN00_2cd9a7df
            ESH_Action_ComMDisallow_CN_LIN02_c2d7c6f3: BswMActionListItemIndex=2, BswMActionListItemRef=BswMModeControl/ESH_Action_ComMDisallow_CN_LIN02_c2d7c6f3
            ESH_Action_ComMDisallow_CN_LIN04_2bb463c6: BswMActionListItemIndex=3, BswMActionListItemRef=BswMModeControl/ESH_Action_ComMDisallow_CN_LIN04_2bb463c6
            ESH_Action_ComMDisallow_CN_CabSubnet_9ea693f1: BswMActionListItemIndex=4, BswMActionListItemRef=BswMModeControl/ESH_Action_ComMDisallow_CN_CabSubnet_9ea693f1
            ESH_Action_ComMDisallow_CN_LIN03_b5d0f665: BswMActionListItemIndex=5, BswMActionListItemRef=BswMModeControl/ESH_Action_ComMDisallow_CN_LIN03_b5d0f665
            ESH_Action_ComMDisallow_CN_LIN01_5bde9749: BswMActionListItemIndex=7, BswMActionListItemRef=BswMModeControl/ESH_Action_ComMDisallow_CN_LIN01_5bde9749
            ESH_Action_ComMDisallow_CN_FMSNet_fce1aae5: BswMActionListItemIndex=8, BswMActionListItemRef=BswMModeControl/ESH_Action_ComMDisallow_CN_FMSNet_fce1aae5
            ESH_Action_ComMDisallow_CN_SecuritySubnet_e7a0ee54: BswMActionListItemIndex=9, BswMActionListItemRef=BswMModeControl/ESH_Action_ComMDisallow_CN_SecuritySubnet_e7a0ee54
        3 x BswMAction:
          ESH_Action_EcuMClearValidatedWakeupEvents
            BswMAvailableActions
              BswMUserCallout: BswMUserCalloutFunction=EcuM_ClearValidatedWakeupEvent(ECUM_WKSOURCE_ALL_SOURCES), BswMCreateCallout=false, BswMUserIncludeFile=EcuM.h
          ESH_Action_OnEnterPostRun
            BswMAvailableActions
              BswMUserCallout: BswMUserCalloutFunction=BswM_ESH_OnEnterPostRun(), BswMCreateCallout=true
          ESH_Action_SwitchPostRun
            BswMAvailableActions
              BswMRteSwitch: BswMSwitchedMode=POSTRUN, BswMRteSwitchPortRef=ESH_ModeSwitch
        ESH_ModeSwitch (BswMSwitchPort): BswMModeSwitchInterfaceRef=BswM_MSI_ESH_Mode
        ESH_Action_ESH_PostRun (BswMAction)
          BswMAvailableActions
            BswMGenericModeSwitch: BswMGenericRequestRef=ESH_State, BswMGenericRequestModeRef=ESH_POST_RUN
        ESH_Action_ExitExclusiveArea (BswMAction)
          BswMAvailableActions
            BswMUserCallout: BswMUserCalloutFunction=SchM_Exit_BswM_BSWM_EXCLUSIVE_AREA_0(), BswMCreateCallout=false, BswMUserIncludeFile=SchM_BswM.h
        ESH_AL_WaitForNvMToShutdown (BswMActionList): BswMActionListExecution=BSWM_CONDITION
          3 x BswMActionListItem, all with BswMAbortOnFail=false:
            ESH_Action_WriteAllTimer_Stop: BswMActionListItemIndex=0, BswMActionListItemRef=BswMModeControl/ESH_Action_WriteAllTimer_Stop
            ESH_Action_OnEnterShutdown: BswMActionListItemIndex=1, BswMActionListItemRef=BswMModeControl/ESH_Action_OnEnterShutdown
            ESH_Action_EcuMGoToSelectedShutdownTarget: BswMActionListItemIndex=2, BswMActionListItemRef=BswMModeControl/ESH_Action_EcuMGoToSelectedShutdownTarget
        3 x BswMAction:
          ESH_Action_WriteAllTimer_Stop
            BswMAvailableActions
              BswMTimerControl: BswMTimerAction=BSWM_TIMER_STOP, BswMTimerValue=0, BswMTimerRef=ESH_NvM_WriteAllTimer
          ESH_Action_OnEnterShutdown
            BswMAvailableActions
              BswMUserCallout: BswMUserCalloutFunction=BswM_ESH_OnEnterShutdown(), BswMCreateCallout=true
          ESH_Action_EcuMGoToSelectedShutdownTarget
            BswMAvailableActions
              BswMUserCallout: BswMUserCalloutFunction=(void)EcuM_GoToSelectedShutdownTarget(), BswMCreateCallout=false, BswMUserIncludeFile=EcuM.h
        ESH_AL_WakeupToPrep (BswMActionList): BswMActionListExecution=BSWM_CONDITION
          3 x BswMActionListItem, all with BswMAbortOnFail=false:
            ESH_Action_OnEnterPrepShutdown: BswMActionListItemIndex=0, BswMActionListItemRef=BswMModeControl/ESH_Action_OnEnterPrepShutdown
            ESH_Action_SwitchShutdown: BswMActionListItemIndex=1, BswMActionListItemRef=BswMModeControl/ESH_Action_SwitchShutdown
            ESH_Action_ESH_PrepShutdown: BswMActionListItemIndex=2, BswMActionListItemRef=BswMModeControl/ESH_Action_ESH_PrepShutdown
        3 x BswMAction:
          ESH_Action_OnEnterPrepShutdown
            BswMAvailableActions
              BswMUserCallout: BswMUserCalloutFunction=BswM_ESH_OnEnterPrepShutdown(), BswMCreateCallout=true
          ESH_Action_SwitchShutdown
            BswMAvailableActions
              BswMRteSwitch: BswMSwitchedMode=SHUTDOWN, BswMRteSwitchPortRef=ESH_ModeSwitch
          ESH_Action_ESH_PrepShutdown
            BswMAvailableActions
              BswMGenericModeSwitch: BswMGenericRequestRef=ESH_State, BswMGenericRequestModeRef=ESH_PREP_SHUTDOWN
        ESH_AL_WaitForNvMWakeup (BswMActionList): BswMActionListExecution=BSWM_CONDITION
          6 x BswMActionListItem, all with BswMAbortOnFail=false:
            ESH_Action_WriteAllTimer_Stop: BswMActionListItemIndex=0, BswMActionListItemRef=BswMModeControl/ESH_Action_WriteAllTimer_Stop
            ESH_Action_CancelWriteAllTimer_Start: BswMActionListItemIndex=1, BswMActionListItemRef=BswMModeControl/ESH_Action_CancelWriteAllTimer_Start
            ESH_Action_CancelNvMWriteAll: BswMActionListItemIndex=2, BswMActionListItemRef=BswMModeControl/ESH_Action_CancelNvMWriteAll
            ESH_Action_OnEnterWakeup: BswMActionListItemIndex=3, BswMActionListItemRef=BswMModeControl/ESH_Action_OnEnterWakeup
            ESH_Action_SwitchWakeup: BswMActionListItemIndex=4, BswMActionListItemRef=BswMModeControl/ESH_Action_SwitchWakeup
            ESH_Action_ESH_Wakeup: BswMActionListItemIndex=5, BswMActionListItemRef=BswMModeControl/ESH_Action_ESH_Wakeup
        5 x BswMAction:
          ESH_Action_CancelWriteAllTimer_Start
            BswMAvailableActions
              BswMTimerControl: BswMTimerAction=BSWM_TIMER_START, BswMTimerValue=60, BswMTimerRef=ESH_NvM_CancelWriteAllTimer
          ESH_Action_CancelNvMWriteAll
            BswMAvailableActions
              BswMUserCallout: BswMUserCalloutFunction=NvM_CancelWriteAll(), BswMCreateCallout=false, BswMUserIncludeFile=NvM.h
          ESH_Action_OnEnterWakeup
            BswMAvailableActions
              BswMUserCallout: BswMUserCalloutFunction=BswM_ESH_OnEnterWakeup(), BswMCreateCallout=true
          ESH_Action_SwitchWakeup
            BswMAvailableActions
              BswMRteSwitch: BswMSwitchedMode=WAKEUP, BswMRteSwitchPortRef=ESH_ModeSwitch
          ESH_Action_ESH_Wakeup
            BswMAvailableActions
              BswMGenericModeSwitch: BswMGenericRequestRef=ESH_State, BswMGenericRequestModeRef=ESH_WAKEUP
        ESH_AL_WakeupToRun (BswMActionList): BswMActionListExecution=BSWM_CONDITION
          16 x BswMActionListItem, all with BswMAbortOnFail=false:
            ESH_Action_CancelWriteAllTimer_Stop: BswMActionListItemIndex=0, BswMActionListItemRef=BswMModeControl/ESH_Action_CancelWriteAllTimer_Stop
            ESH_DemInit: BswMActionListItemIndex=1, BswMActionListItemRef=BswMArbitration/ESH_DemInit
            ESH_Action_SelfRunRequestTimer_Start: BswMActionListItemIndex=12, BswMActionListItemRef=BswMModeControl/ESH_Action_SelfRunRequestTimer_Start
            ESH_Action_OnEnterRun: BswMActionListItemIndex=13, BswMActionListItemRef=BswMModeControl/ESH_Action_OnEnterRun
            ESH_Action_SwitchRun: BswMActionListItemIndex=14, BswMActionListItemRef=BswMModeControl/ESH_Action_SwitchRun
            ESH_Action_ESH_Run: BswMActionListItemIndex=15, BswMActionListItemRef=BswMModeControl/ESH_Action_ESH_Run
            ESH_Action_ComMAllow_CN_Backbone2_78967e2c: BswMActionListItemIndex=8, BswMActionListItemRef=BswMModeControl/ESH_Action_ComMAllow_CN_Backbone2_78967e2c
            ESH_Action_ComMAllow_CN_Backbone1J1939_0b1f4bae: BswMActionListItemIndex=2, BswMActionListItemRef=BswMModeControl/ESH_Action_ComMAllow_CN_Backbone1J1939_0b1f4bae
            ESH_Action_ComMAllow_CN_LIN00_2cd9a7df: BswMActionListItemIndex=3, BswMActionListItemRef=BswMModeControl/ESH_Action_ComMAllow_CN_LIN00_2cd9a7df
            ESH_Action_ComMAllow_CN_LIN02_c2d7c6f3: BswMActionListItemIndex=4, BswMActionListItemRef=BswMModeControl/ESH_Action_ComMAllow_CN_LIN02_c2d7c6f3
            ESH_Action_ComMAllow_CN_LIN04_2bb463c6: BswMActionListItemIndex=5, BswMActionListItemRef=BswMModeControl/ESH_Action_ComMAllow_CN_LIN04_2bb463c6
            ESH_Action_ComMAllow_CN_CabSubnet_9ea693f1: BswMActionListItemIndex=6, BswMActionListItemRef=BswMModeControl/ESH_Action_ComMAllow_CN_CabSubnet_9ea693f1
            ESH_Action_ComMAllow_CN_LIN03_b5d0f665: BswMActionListItemIndex=7, BswMActionListItemRef=BswMModeControl/ESH_Action_ComMAllow_CN_LIN03_b5d0f665
            ESH_Action_ComMAllow_CN_LIN01_5bde9749: BswMActionListItemIndex=9, BswMActionListItemRef=BswMModeControl/ESH_Action_ComMAllow_CN_LIN01_5bde9749
            ESH_Action_ComMAllow_CN_FMSNet_fce1aae5: BswMActionListItemIndex=10, BswMActionListItemRef=BswMModeControl/ESH_Action_ComMAllow_CN_FMSNet_fce1aae5
            ESH_Action_ComMAllow_CN_SecuritySubnet_e7a0ee54: BswMActionListItemIndex=11, BswMActionListItemRef=BswMModeControl/ESH_Action_ComMAllow_CN_SecuritySubnet_e7a0ee54
        ESH_Action_CancelWriteAllTimer_Stop (BswMAction)
          BswMAvailableActions
            BswMTimerControl: BswMTimerAction=BSWM_TIMER_STOP, BswMTimerValue=0, BswMTimerRef=ESH_NvM_CancelWriteAllTimer
        ESH_AL_DemInit (BswMActionList): BswMActionListExecution=BSWM_CONDITION
          ESH_Action_DemInit (BswMActionListItem): BswMAbortOnFail=false, BswMActionListItemIndex=0, BswMActionListItemRef=BswMModeControl/ESH_Action_DemInit
          ESH_Action_DemInitialized (BswMActionListItem): BswMAbortOnFail=false, BswMActionListItemIndex=1, BswMActionListItemRef=BswMModeControl/ESH_Action_DemInitialized
        6 x BswMAction:
          ESH_Action_DemInit
            BswMAvailableActions
              BswMUserCallout: BswMUserCalloutFunction=Dem_Init(EcuM_GlobalPBConfig_Ptr->CfgPtr_Dem_Init), BswMCreateCallout=false, BswMUserIncludeFile=Dem.h
          ESH_Action_DemInitialized
            BswMAvailableActions
              BswMGenericModeSwitch: BswMGenericRequestRef=ESH_DemInitStatus, BswMGenericRequestModeRef=DEM_INITIALIZED
          ESH_Action_SelfRunRequestTimer_Start
            BswMAvailableActions
              BswMTimerControl: BswMTimerAction=BSWM_TIMER_START, BswMTimerValue=10, BswMTimerRef=ESH_SelfRunRequestTimer
          ESH_Action_OnEnterRun
            BswMAvailableActions
              BswMUserCallout: BswMUserCalloutFunction=BswM_ESH_OnEnterRun(), BswMCreateCallout=true
          ESH_Action_SwitchRun
            BswMAvailableActions
              BswMRteSwitch: BswMSwitchedMode=RUN, BswMRteSwitchPortRef=ESH_ModeSwitch
          ESH_Action_ESH_Run
            BswMAvailableActions
              BswMGenericModeSwitch: BswMGenericRequestRef=ESH_State, BswMGenericRequestModeRef=ESH_RUN
        ESH_AL_InitToWakeup (BswMActionList): BswMActionListExecution=BSWM_CONDITION
          3 x BswMActionListItem, all with BswMAbortOnFail=false:
            ESH_Action_OnEnterWakeup: BswMActionListItemIndex=0, BswMActionListItemRef=BswMModeControl/ESH_Action_OnEnterWakeup
            ESH_Action_SwitchWakeup: BswMActionListItemIndex=1, BswMActionListItemRef=BswMModeControl/ESH_Action_SwitchWakeup
            ESH_Action_ESH_Wakeup: BswMActionListItemIndex=2, BswMActionListItemRef=BswMModeControl/ESH_Action_ESH_Wakeup
        ESH_AL_PostRunToPrepShutdown (BswMActionList): BswMActionListExecution=BSWM_CONDITION
          5 x BswMActionListItem, all with BswMAbortOnFail=false:
            ESH_Action_DemShutdown: BswMActionListItemIndex=0, BswMActionListItemRef=BswMModeControl/ESH_Action_DemShutdown
            ESH_Action_DemNotInitialized: BswMActionListItemIndex=1, BswMActionListItemRef=BswMModeControl/ESH_Action_DemNotInitialized
            ESH_Action_OnEnterPrepShutdown: BswMActionListItemIndex=2, BswMActionListItemRef=BswMModeControl/ESH_Action_OnEnterPrepShutdown
            ESH_Action_SwitchShutdown: BswMActionListItemIndex=3, BswMActionListItemRef=BswMModeControl/ESH_Action_SwitchShutdown
            ESH_Action_ESH_PrepShutdown: BswMActionListItemIndex=4, BswMActionListItemRef=BswMModeControl/ESH_Action_ESH_PrepShutdown
        ESH_Action_DemShutdown (BswMAction)
          BswMAvailableActions
            BswMUserCallout: BswMUserCalloutFunction=Dem_Shutdown(), BswMCreateCallout=false, BswMUserIncludeFile=Dem.h
        ESH_Action_DemNotInitialized (BswMAction)
          BswMAvailableActions
            BswMGenericModeSwitch: BswMGenericRequestRef=ESH_DemInitStatus, BswMGenericRequestModeRef=DEM_NOT_INITIALIZED
        4 x BswMActionList, all with BswMActionListExecution=BSWM_CONDITION:
          ESH_AL_ESH_PostRunToPrepCheck
            ESH_PostRunToPrepNested (BswMActionListItem): BswMAbortOnFail=false, BswMActionListItemIndex=0, BswMActionListItemRef=BswMArbitration/ESH_PostRunToPrepNested
          ESH_AL_PostRunToRun
            14 x BswMActionListItem, all with BswMAbortOnFail=false:
              ESH_Action_SelfRunRequestTimer_Start: BswMActionListItemIndex=10, BswMActionListItemRef=BswMModeControl/ESH_Action_SelfRunRequestTimer_Start
              ESH_Action_OnEnterRun: BswMActionListItemIndex=11, BswMActionListItemRef=BswMModeControl/ESH_Action_OnEnterRun
              ESH_Action_SwitchRun: BswMActionListItemIndex=12, BswMActionListItemRef=BswMModeControl/ESH_Action_SwitchRun
              ESH_Action_ESH_Run: BswMActionListItemIndex=13, BswMActionListItemRef=BswMModeControl/ESH_Action_ESH_Run
              ESH_Action_ComMAllow_CN_Backbone2_78967e2c: BswMActionListItemIndex=6, BswMActionListItemRef=BswMModeControl/ESH_Action_ComMAllow_CN_Backbone2_78967e2c
              ESH_Action_ComMAllow_CN_Backbone1J1939_0b1f4bae: BswMActionListItemIndex=0, BswMActionListItemRef=BswMModeControl/ESH_Action_ComMAllow_CN_Backbone1J1939_0b1f4bae
              ESH_Action_ComMAllow_CN_LIN00_2cd9a7df: BswMActionListItemIndex=1, BswMActionListItemRef=BswMModeControl/ESH_Action_ComMAllow_CN_LIN00_2cd9a7df
              ESH_Action_ComMAllow_CN_LIN02_c2d7c6f3: BswMActionListItemIndex=2, BswMActionListItemRef=BswMModeControl/ESH_Action_ComMAllow_CN_LIN02_c2d7c6f3
              ESH_Action_ComMAllow_CN_LIN04_2bb463c6: BswMActionListItemIndex=3, BswMActionListItemRef=BswMModeControl/ESH_Action_ComMAllow_CN_LIN04_2bb463c6
              ESH_Action_ComMAllow_CN_CabSubnet_9ea693f1: BswMActionListItemIndex=4, BswMActionListItemRef=BswMModeControl/ESH_Action_ComMAllow_CN_CabSubnet_9ea693f1
              ESH_Action_ComMAllow_CN_LIN03_b5d0f665: BswMActionListItemIndex=5, BswMActionListItemRef=BswMModeControl/ESH_Action_ComMAllow_CN_LIN03_b5d0f665
              ESH_Action_ComMAllow_CN_LIN01_5bde9749: BswMActionListItemIndex=7, BswMActionListItemRef=BswMModeControl/ESH_Action_ComMAllow_CN_LIN01_5bde9749
              ESH_Action_ComMAllow_CN_FMSNet_fce1aae5: BswMActionListItemIndex=8, BswMActionListItemRef=BswMModeControl/ESH_Action_ComMAllow_CN_FMSNet_fce1aae5
              ESH_Action_ComMAllow_CN_SecuritySubnet_e7a0ee54: BswMActionListItemIndex=9, BswMActionListItemRef=BswMModeControl/ESH_Action_ComMAllow_CN_SecuritySubnet_e7a0ee54
          ESH_AL_ExitPostRun
            4 x BswMActionListItem, all with BswMAbortOnFail=false:
              ESH_Action_EnterExclusiveArea: BswMActionListItemIndex=0, BswMActionListItemRef=BswMModeControl/ESH_Action_EnterExclusiveArea
              ESH_Action_ComMCheckPendingRequests: BswMActionListItemIndex=1, BswMActionListItemRef=BswMModeControl/ESH_Action_ComMCheckPendingRequests
              ESH_PostRunNested: BswMActionListItemIndex=2, BswMActionListItemRef=BswMArbitration/ESH_PostRunNested
              ESH_Action_ExitExclusiveArea: BswMActionListItemIndex=3, BswMActionListItemRef=BswMModeControl/ESH_Action_ExitExclusiveArea
          ESH_AL_PrepShutdownToWaitForNvM
            5 x BswMActionListItem, all with BswMAbortOnFail=false:
              ESH_Action_WriteAllTimer_Start: BswMActionListItemIndex=0, BswMActionListItemRef=BswMModeControl/ESH_Action_WriteAllTimer_Start
              ESH_Action_NvMWriteAll: BswMActionListItemIndex=1, BswMActionListItemRef=BswMModeControl/ESH_Action_NvMWriteAll
              ESH_Action_ComMCheckPendingRequests: BswMActionListItemIndex=2, BswMActionListItemRef=BswMModeControl/ESH_Action_ComMCheckPendingRequests
              ESH_Action_OnEnterWaitForNvm: BswMActionListItemIndex=3, BswMActionListItemRef=BswMModeControl/ESH_Action_OnEnterWaitForNvm
              ESH_Action_ESH_WaitForNvm: BswMActionListItemIndex=4, BswMActionListItemRef=BswMModeControl/ESH_Action_ESH_WaitForNvm
        4 x BswMAction:
          ESH_Action_WriteAllTimer_Start
            BswMAvailableActions
              BswMTimerControl: BswMTimerAction=BSWM_TIMER_START, BswMTimerValue=60, BswMTimerRef=ESH_NvM_WriteAllTimer
          ESH_Action_NvMWriteAll
            BswMAvailableActions
              BswMUserCallout: BswMUserCalloutFunction=NvM_WriteAll(), BswMCreateCallout=false, BswMUserIncludeFile=NvM.h
          ESH_Action_OnEnterWaitForNvm
            BswMAvailableActions
              BswMUserCallout: BswMUserCalloutFunction=BswM_ESH_OnEnterWaitForNvm(), BswMCreateCallout=true
          ESH_Action_ESH_WaitForNvm
            BswMAvailableActions
              BswMGenericModeSwitch: BswMGenericRequestRef=ESH_State, BswMGenericRequestModeRef=ESH_WAIT_FOR_NVM
        INIT_AL_Initialize (BswMActionList): BswMActionListExecution=BSWM_CONDITION
          45 x BswMActionListItem, all with BswMAbortOnFail=false:
            INIT_Action_Can_Init: BswMActionListItemIndex=0, BswMActionListItemRef=BswMModeControl/INIT_Action_Can_Init
            INIT_Action_Lin_Init: BswMActionListItemIndex=1, BswMActionListItemRef=BswMModeControl/INIT_Action_Lin_Init
            INIT_Action_CanIf_Init: BswMActionListItemIndex=2, BswMActionListItemRef=BswMModeControl/INIT_Action_CanIf_Init
            INIT_Action_Fee_Init: BswMActionListItemIndex=3, BswMActionListItemRef=BswMModeControl/INIT_Action_Fee_Init
            INIT_Action_LinIf_Init: BswMActionListItemIndex=4, BswMActionListItemRef=BswMModeControl/INIT_Action_LinIf_Init
            INIT_Action_Com_Init: BswMActionListItemIndex=5, BswMActionListItemRef=BswMModeControl/INIT_Action_Com_Init
            INIT_Action_PduR_Init: BswMActionListItemIndex=6, BswMActionListItemRef=BswMModeControl/INIT_Action_PduR_Init
            INIT_Action_CanSM_Init: BswMActionListItemIndex=7, BswMActionListItemRef=BswMModeControl/INIT_Action_CanSM_Init
            INIT_Action_LinSM_Init: BswMActionListItemIndex=8, BswMActionListItemRef=BswMModeControl/INIT_Action_LinSM_Init
            INIT_Action_CanNm_Init: BswMActionListItemIndex=9, BswMActionListItemRef=BswMModeControl/INIT_Action_CanNm_Init
            INIT_Action_J1939Rm_Init: BswMActionListItemIndex=10, BswMActionListItemRef=BswMModeControl/INIT_Action_J1939Rm_Init
            INIT_Action_Nm_Init: BswMActionListItemIndex=11, BswMActionListItemRef=BswMModeControl/INIT_Action_Nm_Init
            INIT_Action_CanTp_Init: BswMActionListItemIndex=12, BswMActionListItemRef=BswMModeControl/INIT_Action_CanTp_Init
            INIT_Action_J1939Tp_Init: BswMActionListItemIndex=13, BswMActionListItemRef=BswMModeControl/INIT_Action_J1939Tp_Init
            INIT_Action_LinTp_Init: BswMActionListItemIndex=14, BswMActionListItemRef=BswMModeControl/INIT_Action_LinTp_Init
            INIT_Action_Issm_Init: BswMActionListItemIndex=15, BswMActionListItemRef=BswMModeControl/INIT_Action_Issm_Init
            INIT_Action_NvM_Init: BswMActionListItemIndex=16, BswMActionListItemRef=BswMModeControl/INIT_Action_NvM_Init
            INIT_Action_NvMReadAll: BswMActionListItemIndex=17, BswMActionListItemRef=BswMModeControl/INIT_Action_NvMReadAll
            INIT_Action_EnableInterrupts: BswMActionListItemIndex=18, BswMActionListItemRef=BswMModeControl/INIT_Action_EnableInterrupts
            INIT_Action_ComM_Init: BswMActionListItemIndex=19, BswMActionListItemRef=BswMModeControl/INIT_Action_ComM_Init
            INIT_Action_Dcm_Init: BswMActionListItemIndex=20, BswMActionListItemRef=BswMModeControl/INIT_Action_Dcm_Init
            INIT_Action_Dem_Init: BswMActionListItemIndex=21, BswMActionListItemRef=BswMModeControl/INIT_Action_Dem_Init
            INIT_Action_J1939Nm_Init: BswMActionListItemIndex=22, BswMActionListItemRef=BswMModeControl/INIT_Action_J1939Nm_Init
            INIT_Action_RteStart: BswMActionListItemIndex=44, BswMActionListItemRef=BswMModeControl/INIT_Action_RteStart
            BSWM_FULL_COM_CN_LIN02_a8147687: BswMActionListItemIndex=26, BswMActionListItemRef=BswMModeControl/BSWM_FULL_COM_CN_LIN02_a8147687
            BSWM_FULL_COM_CN_LIN00_ace1a6ba: BswMActionListItemIndex=24, BswMActionListItemRef=BswMModeControl/BSWM_FULL_COM_CN_LIN00_ace1a6ba
            BSWM_FULL_COM_CN_LIN04_a50a06c0: BswMActionListItemIndex=28, BswMActionListItemRef=BswMModeControl/BSWM_FULL_COM_CN_LIN04_a50a06c0
            BSWM_FULL_COM_CN_LIN01_4323cd84: BswMActionListItemIndex=25, BswMActionListItemRef=BswMModeControl/BSWM_FULL_COM_CN_LIN01_4323cd84
            BswMActionListItem_002: BswMActionListItemIndex=23, BswMActionListItemRef=BswMModeControl/INIT_Action_Issm_Init
            BSWM_FULL_COM_CN_LIN03_47d61db9: BswMActionListItemIndex=27, BswMActionListItemRef=BswMModeControl/BSWM_FULL_COM_CN_LIN03_47d61db9
            BSWM_FULL_COM_CN_Backbone2_3f947ba3: BswMActionListItemIndex=35, BswMActionListItemRef=BswMModeControl/BSWM_FULL_COM_CN_Backbone2_3f947ba3
            ALLOW_COM_CN_LIN00_2cd9a7df: BswMActionListItemIndex=29, BswMActionListItemRef=BswMModeControl/ALLOW_COM_CN_LIN00_2cd9a7df
            BSWM_FULL_COM_CN_Backbone1J1939_2a22de3d: BswMActionListItemIndex=34, BswMActionListItemRef=BswMModeControl/BSWM_FULL_COM_CN_Backbone1J1939_2a22de3d
            BSWM_FULL_COM_CN_SecuritySubnet_7cec9a61: BswMActionListItemIndex=36, BswMActionListItemRef=BswMModeControl/BSWM_FULL_COM_CN_SecuritySubnet_7cec9a61
            BSWM_FULL_COM_CN_CabSubnet_aa77b0b0: BswMActionListItemIndex=37, BswMActionListItemRef=BswMModeControl/BSWM_FULL_COM_CN_CabSubnet_aa77b0b0
            BSWM_FULL_COM_CN_FMSNet_05490e3d: BswMActionListItemIndex=38, BswMActionListItemRef=BswMModeControl/BSWM_FULL_COM_CN_FMSNet_05490e3d
            ALLOW_COM_CN_LIN02_c2d7c6f3: BswMActionListItemIndex=31, BswMActionListItemRef=BswMModeControl/ALLOW_COM_CN_LIN02_c2d7c6f3
            ALLOW_COM_CN_LIN04_2bb463c6: BswMActionListItemIndex=33, BswMActionListItemRef=BswMModeControl/ALLOW_COM_CN_LIN04_2bb463c6
            ALLOW_COM_CN_LIN03_b5d0f665: BswMActionListItemIndex=32, BswMActionListItemRef=BswMModeControl/ALLOW_COM_CN_LIN03_b5d0f665
            ALLOW_COM_CN_LIN01_5bde9749: BswMActionListItemIndex=30, BswMActionListItemRef=BswMModeControl/ALLOW_COM_CN_LIN01_5bde9749
            ALLOW_COM_CN_Backbone1J1939_0b1f4bae: BswMActionListItemIndex=39, BswMActionListItemRef=BswMModeControl/ALLOW_COM_CN_Backbone1J1939_0b1f4bae
            ALLOW_COM_CN_CabSubnet_9ea693f1: BswMActionListItemIndex=41, BswMActionListItemRef=BswMModeControl/ALLOW_COM_CN_CabSubnet_9ea693f1
            ALLOW_COM_CN_Backbone2_78967e2c: BswMActionListItemIndex=40, BswMActionListItemRef=BswMModeControl/ALLOW_COM_CN_Backbone2_78967e2c
            ALLOW_COM_CN_FMSNet_fce1aae5: BswMActionListItemIndex=43, BswMActionListItemRef=BswMModeControl/ALLOW_COM_CN_FMSNet_fce1aae5
            ALLOW_COM_CN_SecuritySubnet_e7a0ee54: BswMActionListItemIndex=42, BswMActionListItemRef=BswMModeControl/ALLOW_COM_CN_SecuritySubnet_e7a0ee54
        35 x BswMAction:
          INIT_Action_Can_Init
            BswMAvailableActions
              BswMUserCallout: BswMUserCalloutFunction=Can_Init(Can_Config_Ptr), BswMCreateCallout=false, BswMUserIncludeFile=Can.h
          INIT_Action_Lin_Init
            BswMAvailableActions
              BswMUserCallout: BswMUserCalloutFunction=Lin_Init(Lin_Config_Ptr), BswMCreateCallout=false, BswMUserIncludeFile=Lin.h
          INIT_Action_CanIf_Init
            BswMAvailableActions
              BswMUserCallout: BswMUserCalloutFunction=CanIf_Init(CanIf_Config_Ptr), BswMCreateCallout=false, BswMUserIncludeFile=CanIf.h
          INIT_Action_Fee_Init
            BswMAvailableActions
              BswMUserCallout: BswMUserCalloutFunction=Fee_Init(), BswMCreateCallout=false, BswMUserIncludeFile=Fee.h
          INIT_Action_LinIf_Init
            BswMAvailableActions
              BswMUserCallout: BswMUserCalloutFunction=LinIf_Init(LinIf_Config_Ptr), BswMCreateCallout=false, BswMUserIncludeFile=LinIf.h
          INIT_Action_Com_Init
            BswMAvailableActions
              BswMUserCallout: BswMUserCalloutFunction=Com_Init(Com_Config_Ptr), BswMCreateCallout=false, BswMUserIncludeFile=Com.h
          INIT_Action_PduR_Init
            BswMAvailableActions
              BswMUserCallout: BswMUserCalloutFunction=PduR_Init(PduR_Config_Ptr), BswMCreateCallout=false, BswMUserIncludeFile=PduR.h
          INIT_Action_CanSM_Init
            BswMAvailableActions
              BswMUserCallout: BswMUserCalloutFunction=CanSM_Init(CanSM_Config_Ptr), BswMCreateCallout=false, BswMUserIncludeFile=CanSM_EcuM.h
          INIT_Action_LinSM_Init
            BswMAvailableActions
              BswMUserCallout: BswMUserCalloutFunction=LinSM_Init(LinSM_Config_Ptr), BswMCreateCallout=false, BswMUserIncludeFile=LinSM.h
          INIT_Action_CanNm_Init
            BswMAvailableActions
              BswMUserCallout: BswMUserCalloutFunction=CanNm_Init(CanNm_Config_Ptr), BswMCreateCallout=false, BswMUserIncludeFile=CanNm.h
          INIT_Action_J1939Rm_Init
            BswMAvailableActions
              BswMUserCallout: BswMUserCalloutFunction=J1939Rm_Init(J1939Rm_Config_Ptr), BswMCreateCallout=false, BswMUserIncludeFile=J1939Rm.h
          INIT_Action_Nm_Init
            BswMAvailableActions
              BswMUserCallout: BswMUserCalloutFunction=Nm_Init(), BswMCreateCallout=false, BswMUserIncludeFile=Nm.h
          INIT_Action_CanTp_Init
            BswMAvailableActions
              BswMUserCallout: BswMUserCalloutFunction=CanTp_Init(CanTp_Config_Ptr), BswMCreateCallout=false, BswMUserIncludeFile=CanTp.h
          INIT_Action_J1939Tp_Init
            BswMAvailableActions
              BswMUserCallout: BswMUserCalloutFunction=J1939Tp_Init(J1939Tp_Config_Ptr), BswMCreateCallout=false, BswMUserIncludeFile=J1939Tp.h
          INIT_Action_LinTp_Init
            BswMAvailableActions
              BswMUserCallout: BswMUserCalloutFunction=LinTp_Init(LinTp_Config_Ptr), BswMCreateCallout=false, BswMUserIncludeFile=LinIf.h
          INIT_Action_Issm_Init
            BswMAvailableActions
              BswMUserCallout: BswMUserCalloutFunction=Issm_Init(Issm_Config_Ptr), BswMCreateCallout=false, BswMUserIncludeFile=Issm.h
          INIT_Action_NvM_Init
            BswMAvailableActions
              BswMUserCallout: BswMUserCalloutFunction=NvM_Init(), BswMCreateCallout=false, BswMUserIncludeFile=NvM.h
          INIT_Action_NvMReadAll
            BswMAvailableActions
              BswMUserCallout: BswMUserCalloutFunction=BswM_INIT_NvMReadAll(), BswMCreateCallout=true, BswMUserCode=
          INIT_Action_EnableInterrupts
            BswMAvailableActions
              BswMUserCallout:
                BswMUserCalloutFunction = BswM_AL_SetProgrammableInterrupts()
                BswMCreateCallout = true
                BswMUserCode = uint32 i; for (i = 0; i < OS_ISRID_COUNT; i++) { Os_EnableInterruptSource(i, FALSE); }
          INIT_Action_ComM_Init
            BswMAvailableActions
              BswMUserCallout: BswMUserCalloutFunction=ComM_Init(), BswMCreateCallout=false, BswMUserIncludeFile=ComM.h
          INIT_Action_Dcm_Init
            BswMAvailableActions
              BswMUserCallout: BswMUserCalloutFunction=Dcm_Init(NULL_PTR), BswMCreateCallout=false, BswMUserIncludeFile=Dcm.h
          INIT_Action_Dem_Init
            BswMAvailableActions
              BswMUserCallout: BswMUserCalloutFunction=Dem_Init(EcuM_GlobalPBConfig_Ptr->CfgPtr_Dem_Init), BswMCreateCallout=false, BswMUserIncludeFile=Dem.h
          INIT_Action_J1939Nm_Init
            BswMAvailableActions
              BswMUserCallout: BswMUserCalloutFunction=J1939Nm_Init(J1939Nm_Config_Ptr), BswMCreateCallout=false, BswMUserIncludeFile=J1939Nm.h
          INIT_Action_RteStart
            BswMAvailableActions
              BswMUserCallout: BswMUserCalloutFunction=(void)Rte_Start(), BswMCreateCallout=false, BswMUserIncludeFile=Rte_Main.h
          CC_LinSchdeduleSwitch_CHNL_8e3d5be2_Table0_df24d2a0
            BswMAvailableActions
              BswMLinScheduleSwitch: BswMLinScheduleRef=Table0_df24d2a0
          CC_LinSchdeduleSwitch_CHNL_45618847_Table_1_2abffe93
            BswMAvailableActions
              BswMLinScheduleSwitch: BswMLinScheduleRef=Table_1_2abffe93
          CC_LinSchdeduleSwitch_CHNL_08a9294c_Table_2_52d86b84
            BswMAvailableActions
              BswMLinScheduleSwitch: BswMLinScheduleRef=Table_2_52d86b84
          CC_LinSchdeduleSwitch_CHNL_c3f5fae9_Table_e_3ad84ea5
            BswMAvailableActions
              BswMLinScheduleSwitch: BswMLinScheduleRef=Table_e_3ad84ea5
          CC_LinSchdeduleSwitch_CHNL_def0ca51_CHNL_def0ca51_faa54df8
            BswMAvailableActions
              BswMLinScheduleSwitch: BswMLinScheduleRef=CHNL_def0ca51_faa54df8
          CC_DisablePDUGroup_CIOM_oFMSNet_Tx_0x0F_BC_89b46e88
            BswMAvailableActions
              BswMPduGroupSwitch: BswMPduGroupSwitchReinit=false, BswMDisabledPduGroupRef=CIOM_oFMSNet_Tx_0x0F_BC_89b46e88
          CC_DisablePDUGroup_CIOM_oFMSNet_Tx_0x31_BC_38fc8c7d
            BswMAvailableActions
              BswMPduGroupSwitch: BswMPduGroupSwitchReinit=false, BswMDisabledPduGroupRef=CIOM_oFMSNet_Tx_0x31_BC_38fc8c7d
          CC_DisablePDUGroup_CIOM_oFMSNet_Tx_0x10_BC_fa80b878
            BswMAvailableActions
              BswMPduGroupSwitch: BswMPduGroupSwitchReinit=false, BswMDisabledPduGroupRef=CIOM_oFMSNet_Tx_0x10_BC_fa80b878
          CC_EnablePDUGroup_CIOM_oFMSNet_Tx_0x0F_BC_89b46e88
            BswMAvailableActions
              BswMPduGroupSwitch: BswMPduGroupSwitchReinit=false, BswMEnabledPduGroupRef=CIOM_oFMSNet_Tx_0x0F_BC_89b46e88
          CC_EnablePDUGroup_CIOM_oFMSNet_Tx_0x31_BC_38fc8c7d
            BswMAvailableActions
              BswMPduGroupSwitch: BswMPduGroupSwitchReinit=false, BswMEnabledPduGroupRef=CIOM_oFMSNet_Tx_0x31_BC_38fc8c7d
          CC_EnablePDUGroup_CIOM_oFMSNet_Tx_0x10_BC_fa80b878
            BswMAvailableActions
              BswMPduGroupSwitch: BswMPduGroupSwitchReinit=false, BswMEnabledPduGroupRef=CIOM_oFMSNet_Tx_0x10_BC_fa80b878
        CC_AL_CN_FMSNet_fce1aae5_RX_Disable (BswMActionList): BswMActionListExecution=BSWM_TRIGGER
          CC_DisablePDUGroup_CIOM_oFMSNet_Rx_BC_dd2c1510 (BswMActionListItem): BswMAbortOnFail=false, BswMActionListItemIndex=0, BswMActionListItemRef=BswMModeControl/CC_DisablePDUGroup_CIOM_oFMSNet_Rx_BC_dd2c1510
        CC_DisablePDUGroup_CIOM_oFMSNet_Rx_BC_dd2c1510 (BswMAction)
          BswMAvailableActions
            BswMPduGroupSwitch: BswMPduGroupSwitchReinit=false, BswMDisabledPduGroupRef=CIOM_oFMSNet_Rx_BC_dd2c1510
        CC_AL_CN_FMSNet_fce1aae5_RX_EnableNoinit (BswMActionList): BswMActionListExecution=BSWM_TRIGGER
          CC_EnablePDUGroup_CIOM_oFMSNet_Rx_BC_dd2c1510 (BswMActionListItem): BswMAbortOnFail=false, BswMActionListItemIndex=0, BswMActionListItemRef=BswMModeControl/CC_EnablePDUGroup_CIOM_oFMSNet_Rx_BC_dd2c1510
        CC_EnablePDUGroup_CIOM_oFMSNet_Rx_BC_dd2c1510 (BswMAction)
          BswMAvailableActions
            BswMPduGroupSwitch: BswMPduGroupSwitchReinit=false, BswMEnabledPduGroupRef=CIOM_oFMSNet_Rx_BC_dd2c1510
        CC_AL_CN_FMSNet_fce1aae5_Disable_DM (BswMActionList): BswMActionListExecution=BSWM_TRIGGER
          CC_DisableDM_CIOM_oFMSNet_Rx_BC_dd2c1510 (BswMActionListItem): BswMAbortOnFail=false, BswMActionListItemIndex=0, BswMActionListItemRef=BswMModeControl/CC_DisableDM_CIOM_oFMSNet_Rx_BC_dd2c1510
        CC_DisableDM_CIOM_oFMSNet_Rx_BC_dd2c1510 (BswMAction)
          BswMAvailableActions
            BswMDeadlineMonitoringControl: BswMDisabledDMPduGroupRef=CIOM_oFMSNet_Rx_BC_dd2c1510
        CC_AL_CN_FMSNet_fce1aae5_Enable_DM (BswMActionList): BswMActionListExecution=BSWM_TRIGGER
          CC_EnableDM_CIOM_oFMSNet_Rx_BC_dd2c1510 (BswMActionListItem): BswMAbortOnFail=false, BswMActionListItemIndex=0, BswMActionListItemRef=BswMModeControl/CC_EnableDM_CIOM_oFMSNet_Rx_BC_dd2c1510
        CC_EnableDM_CIOM_oFMSNet_Rx_BC_dd2c1510 (BswMAction)
          BswMAvailableActions
            BswMDeadlineMonitoringControl: BswMEnabledDMPduGroupRef=CIOM_oFMSNet_Rx_BC_dd2c1510
        4 x BswMActionList, all with BswMActionListExecution=BSWM_TRIGGER:
          CC_AL_CN_Backbone1J1939_0b1f4bae_CIOM_4d5cd289_TX_Disable
            CC_DisablePDUGroup_CIOM_oBackbone1J1939_Tx_0x31_BC_3782f500 (BswMActionListItem):
              BswMAbortOnFail = false
              BswMActionListItemIndex = 0
              BswMActionListItemRef = BswMModeControl/CC_DisablePDUGroup_CIOM_oBackbone1J1939_Tx_0x31_BC_3782f500
          CC_AL_CN_Backbone1J1939_0b1f4bae_CIOM_4d5cd289_TX_EnableNoinit
            CC_EnablePDUGroup_CIOM_oBackbone1J1939_Tx_0x31_BC_3782f500 (BswMActionListItem):
              BswMAbortOnFail = false
              BswMActionListItemIndex = 0
              BswMActionListItemRef = BswMModeControl/CC_EnablePDUGroup_CIOM_oBackbone1J1939_Tx_0x31_BC_3782f500
          CC_AL_CN_FMSNet_fce1aae5_CIOM_4d5cd289_TX_Disable
            CC_DisablePDUGroup_CIOM_oFMSNet_Tx_0x31_BC_38fc8c7d (BswMActionListItem): BswMAbortOnFail=false, BswMActionListItemIndex=0, BswMActionListItemRef=BswMModeControl/CC_DisablePDUGroup_CIOM_oFMSNet_Tx_0x31_BC_38fc8c7d
            CC_DisablePDUGroup_CIOM_oFMSNet_Tx_0x10_BC_fa80b878 (BswMActionListItem): BswMAbortOnFail=false, BswMActionListItemIndex=1, BswMActionListItemRef=BswMModeControl/CC_DisablePDUGroup_CIOM_oFMSNet_Tx_0x10_BC_fa80b878
          CC_AL_CN_FMSNet_fce1aae5_CIOM_4d5cd289_TX_EnableNoinit
            CC_EnablePDUGroup_CIOM_oFMSNet_Tx_0x31_BC_38fc8c7d (BswMActionListItem): BswMAbortOnFail=false, BswMActionListItemIndex=0, BswMActionListItemRef=BswMModeControl/CC_EnablePDUGroup_CIOM_oFMSNet_Tx_0x31_BC_38fc8c7d
            CC_EnablePDUGroup_CIOM_oFMSNet_Tx_0x10_BC_fa80b878 (BswMActionListItem): BswMAbortOnFail=false, BswMActionListItemIndex=1, BswMActionListItemRef=BswMModeControl/CC_EnablePDUGroup_CIOM_oFMSNet_Tx_0x10_BC_fa80b878
        7 x BswMAction:
          LinSM_ScheduleRequest_Table_1_LIN3
            BswMAvailableActions
              BswMLinScheduleSwitch: BswMLinScheduleRef=Table_1_cbd13a3e
          LinSM_ScheduleRequest_Table_2_LIN3
            BswMAvailableActions
              BswMLinScheduleSwitch: BswMLinScheduleRef=Table_2_52d86b84
          LinSM_ScheduleRequest_Table_e_LIN3
            BswMAvailableActions
              BswMLinScheduleSwitch: BswMLinScheduleRef=Table_e_a7d7afd3
          LinSM_ScheduleRequest_MasterReq_SlaveResp_Table_1_LIN3
            BswMAvailableActions
              BswMLinScheduleSwitch: BswMLinScheduleRef=MasterReq_SlaveResp_Table_1_631128e5
          LinSM_ScheduleRequest_MasterReq_SlaveResp_Table_2_LIN3
            BswMAvailableActions
              BswMLinScheduleSwitch: BswMLinScheduleRef=MasterReq_SlaveResp_Table_2_fa18795f
          LinSM_ScheduleRequest_MasterReq_SlaveResp_LIN3
            BswMAvailableActions
              BswMLinScheduleSwitch: BswMLinScheduleRef=MasterReq_SlaveResp_1692e5d6
          LinSM_ScheduleRequest_CHNL_LIN3
            BswMAvailableActions
              BswMLinScheduleSwitch: BswMLinScheduleRef=CHNL_08a9294c_f4be7c2c
        7 x BswMActionList, all with BswMActionListExecution=BSWM_TRIGGER:
          CC_AL_LIN3_ScheduleTable_to_Table1
            LinSM_ScheduleRequest_Table_1_cbd13a3e (BswMActionListItem): BswMAbortOnFail=false, BswMActionListItemIndex=0, BswMActionListItemRef=BswMModeControl/LinSM_ScheduleRequest_Table_1_cbd13a3e
          CC_AL_LIN3_ScheduleTable_to_NULL
            LinSM_ScheduleRequest_CHNL_LIN3 (BswMActionListItem): BswMAbortOnFail=false, BswMActionListItemIndex=0, BswMActionListItemRef=BswMModeControl/LinSM_ScheduleRequest_CHNL_LIN3
          CC_AL_LIN3_ScheduleTable_to_Table2
            LinSM_ScheduleRequest_Table_2_LIN3 (BswMActionListItem): BswMAbortOnFail=false, BswMActionListItemIndex=0, BswMActionListItemRef=BswMModeControl/LinSM_ScheduleRequest_Table_2_LIN3
          CC_AL_LIN3_ScheduleTable_to_Table_E
            LinSM_ScheduleRequest_Table_e_LIN3 (BswMActionListItem): BswMAbortOnFail=false, BswMActionListItemIndex=0, BswMActionListItemRef=BswMModeControl/LinSM_ScheduleRequest_Table_e_LIN3
          CC_AL_LIN3_ScheduleTable_to_MasterReq_SlaveResp
            LinSM_ScheduleRequest_MasterReq_SlaveResp_LIN3 (BswMActionListItem): BswMAbortOnFail=false, BswMActionListItemIndex=0, BswMActionListItemRef=BswMModeControl/LinSM_ScheduleRequest_MasterReq_SlaveResp_LIN3
          CC_AL_LIN3_ScheduleTable_to_MasterReq_SlaveResp_Table_1
            LinSM_ScheduleRequest_MasterReq_SlaveResp_Table_1_LIN3 (BswMActionListItem): BswMAbortOnFail=false, BswMActionListItemIndex=0, BswMActionListItemRef=BswMModeControl/LinSM_ScheduleRequest_MasterReq_SlaveResp_Table_1_LIN3
          CC_AL_LIN3_ScheduleTable_to_MasterReq_SlaveResp_Table_2
            LinSM_ScheduleRequest_MasterReq_SlaveResp_Table_2_LIN3 (BswMActionListItem): BswMAbortOnFail=false, BswMActionListItemIndex=0, BswMActionListItemRef=BswMModeControl/LinSM_ScheduleRequest_MasterReq_SlaveResp_Table_2_LIN3
        BSWM_FULL_COM_CN_LIN02_a8147687 (BswMAction)
          BswMAvailableActions
            BswMComMModeSwitch: BswMComMRequestedMode=BSWM_FULL_COM, BswMComMUserRef=CN_LIN02_a8147687
        26 x BswMActionList, all with BswMActionListExecution=BSWM_TRIGGER:
          CC_AL_LIN1_ScheduleTable_to_MasterReq_SlaveResp
            LinSM_ScheduleRequest_MasterReq_SlaveResp_03d8aeb9 (BswMActionListItem): BswMAbortOnFail=false, BswMActionListItemIndex=0, BswMActionListItemRef=BswMModeControl/LinSM_ScheduleRequest_MasterReq_SlaveResp_03d8aeb9
          CC_AL_LIN2_ScheduleTable_to_MasterReq_SlaveResp
            LinSM_ScheduleRequest_MasterReq_SlaveResp_e4c5082e (BswMActionListItem): BswMAbortOnFail=false, BswMActionListItemIndex=0, BswMActionListItemRef=BswMModeControl/LinSM_ScheduleRequest_MasterReq_SlaveResp_e4c5082e
          CC_AL_LIN1_ScheduleTable_to_Table2
            LinSM_ScheduleRequest_Table_2_b3b6af29 (BswMActionListItem): BswMAbortOnFail=false, BswMActionListItemIndex=0, BswMActionListItemRef=BswMModeControl/LinSM_ScheduleRequest_Table_2_b3b6af29
          CC_AL_CN_LIN03_b5d0f665_Disable
          CC_AL_CN_Backbone2_78967e2c_Disable_DM
          CC_AL_CN_Backbone2_78967e2c_Enable_DM
          CC_AL_CN_Backbone1J1939_0b1f4bae_RX_EnableNoinit
          CC_AL_LIN5_ScheduleTable_to_Table_E
            LinSM_ScheduleRequest_Table_e_5f15e465 (BswMActionListItem): BswMAbortOnFail=false, BswMActionListItemIndex=0, BswMActionListItemRef=BswMModeControl/LinSM_ScheduleRequest_Table_e_5f15e465
          CC_AL_LIN4_ScheduleTable_to_Table_E
            LinSM_ScheduleRequest_Table_e_3ad84ea5 (BswMActionListItem): BswMAbortOnFail=false, BswMActionListItemIndex=0, BswMActionListItemRef=BswMModeControl/LinSM_ScheduleRequest_Table_e_3ad84ea5
          CC_AL_LIN1_ScheduleTable_to_Table_E
            LinSM_ScheduleRequest_Table_e_46b96b7e (BswMActionListItem): BswMAbortOnFail=false, BswMActionListItemIndex=0, BswMActionListItemRef=BswMModeControl/LinSM_ScheduleRequest_Table_e_46b96b7e
          CC_AL_LIN4_ScheduleTable_to_Table2
            LinSM_ScheduleRequest_Table_2_cfd78af2 (BswMActionListItem): BswMAbortOnFail=false, BswMActionListItemIndex=0, BswMActionListItemRef=BswMModeControl/LinSM_ScheduleRequest_Table_2_cfd78af2
          CC_AL_LIN5_ScheduleTable_to_Table1
            LinSM_ScheduleRequest_Table_1_33137188 (BswMActionListItem): BswMAbortOnFail=false, BswMActionListItemIndex=0, BswMActionListItemRef=BswMModeControl/LinSM_ScheduleRequest_Table_1_33137188
          CC_AL_LIN4_ScheduleTable_to_Table1
            LinSM_ScheduleRequest_Table_1_56dedb48 (BswMActionListItem): BswMAbortOnFail=false, BswMActionListItemIndex=0, BswMActionListItemRef=BswMModeControl/LinSM_ScheduleRequest_Table_1_56dedb48
          CC_AL_LIN2_ScheduleTable_to_Table0
            LinSM_ScheduleRequest_Table0_df24d2a0 (BswMActionListItem): BswMAbortOnFail=false, BswMActionListItemIndex=0, BswMActionListItemRef=BswMModeControl/LinSM_ScheduleRequest_Table0_df24d2a0
          CC_AL_LIN1_ScheduleTable_to_Table1
            LinSM_ScheduleRequest_Table_1_2abffe93 (BswMActionListItem): BswMAbortOnFail=false, BswMActionListItemIndex=0, BswMActionListItemRef=BswMModeControl/LinSM_ScheduleRequest_Table_1_2abffe93
          CC_AL_LIN5_ScheduleTable_to_NULL
            LinSM_ScheduleRequest_CHNL_def0ca51_faa54df8 (BswMActionListItem): BswMAbortOnFail=false, BswMActionListItemIndex=0, BswMActionListItemRef=BswMModeControl/LinSM_ScheduleRequest_CHNL_def0ca51_faa54df8
          CC_AL_LIN4_ScheduleTable_to_NULL
            LinSM_ScheduleRequest_CHNL_c3f5fae9_fb3b3248 (BswMActionListItem): BswMAbortOnFail=false, BswMActionListItemIndex=0, BswMActionListItemRef=BswMModeControl/LinSM_ScheduleRequest_CHNL_c3f5fae9_fb3b3248
          CC_AL_LIN2_ScheduleTable_to_NULL
            LinSM_ScheduleRequest_CHNL_8e3d5be2_a66eb9f7 (BswMActionListItem): BswMAbortOnFail=false, BswMActionListItemIndex=0, BswMActionListItemRef=BswMModeControl/LinSM_ScheduleRequest_CHNL_8e3d5be2_a66eb9f7
          CC_AL_LIN1_ScheduleTable_to_NULL
            LinSM_ScheduleRequest_CHNL_45618847_32a17f26 (BswMActionListItem): BswMAbortOnFail=false, BswMActionListItemIndex=0, BswMActionListItemRef=BswMModeControl/LinSM_ScheduleRequest_CHNL_45618847_32a17f26
          CC_AL_LIN5_ScheduleTable_to_MasterReq_SlaveResp_Table_2
            LinSM_ScheduleRequest_MasterReq_SlaveResp_Table_2_21159feb (BswMActionListItem):
              BswMAbortOnFail = false
              BswMActionListItemIndex = 0
              BswMActionListItemRef = BswMModeControl/LinSM_ScheduleRequest_MasterReq_SlaveResp_Table_2_21159feb
          CC_AL_LIN4_ScheduleTable_to_MasterReq_SlaveResp_Table_2
            LinSM_ScheduleRequest_MasterReq_SlaveResp_Table_2_de9a2869 (BswMActionListItem):
              BswMAbortOnFail = false
              BswMActionListItemIndex = 0
              BswMActionListItemRef = BswMModeControl/LinSM_ScheduleRequest_MasterReq_SlaveResp_Table_2_de9a2869
          CC_AL_LIN1_ScheduleTable_to_MasterReq_SlaveResp_Table_2
            LinSM_ScheduleRequest_MasterReq_SlaveResp_Table_2_b31cdb33 (BswMActionListItem):
              BswMAbortOnFail = false
              BswMActionListItemIndex = 0
              BswMActionListItemRef = BswMModeControl/LinSM_ScheduleRequest_MasterReq_SlaveResp_Table_2_b31cdb33
          CC_AL_LIN2_ScheduleTable_to_MasterReq_SlaveResp_Table_0
            LinSM_ScheduleRequest_MasterReq_SlaveResp_Table0_9e3481d6 (BswMActionListItem):
              BswMAbortOnFail = false
              BswMActionListItemIndex = 0
              BswMActionListItemRef = BswMModeControl/LinSM_ScheduleRequest_MasterReq_SlaveResp_Table0_9e3481d6
          CC_AL_LIN5_ScheduleTable_to_MasterReq_SlaveResp_Table_1
            LinSM_ScheduleRequest_MasterReq_SlaveResp_Table_1_b81cce51 (BswMActionListItem):
              BswMAbortOnFail = false
              BswMActionListItemIndex = 0
              BswMActionListItemRef = BswMModeControl/LinSM_ScheduleRequest_MasterReq_SlaveResp_Table_1_b81cce51
          CC_AL_LIN4_ScheduleTable_to_MasterReq_SlaveResp_Table_1
            LinSM_ScheduleRequest_MasterReq_SlaveResp_Table_1_479379d3 (BswMActionListItem):
              BswMAbortOnFail = false
              BswMActionListItemIndex = 0
              BswMActionListItemRef = BswMModeControl/LinSM_ScheduleRequest_MasterReq_SlaveResp_Table_1_479379d3
          CC_AL_CN_CabSubnet_9ea693f1_RX_Disable
        32 x BswMAction:
          BSWM_FULL_COM_CN_LIN00_ace1a6ba
            BswMAvailableActions
              BswMComMModeSwitch: BswMComMRequestedMode=BSWM_FULL_COM, BswMComMUserRef=CN_LIN00_ace1a6ba
          BSWM_FULL_COM_CN_LIN04_a50a06c0
            BswMAvailableActions
              BswMComMModeSwitch: BswMComMRequestedMode=BSWM_FULL_COM, BswMComMUserRef=CN_LIN04_a50a06c0
          BSWM_FULL_COM_CN_LIN01_4323cd84
            BswMAvailableActions
              BswMComMModeSwitch: BswMComMRequestedMode=BSWM_FULL_COM, BswMComMUserRef=CN_LIN01_4323cd84
          BSWM_FULL_COM_CN_LIN03_47d61db9
            BswMAvailableActions
              BswMComMModeSwitch: BswMComMRequestedMode=BSWM_FULL_COM, BswMComMUserRef=CN_LIN03_47d61db9
          LinSM_ScheduleRequest_CHNL_45618847_32a17f26
            BswMAvailableActions
              BswMLinScheduleSwitch: BswMLinScheduleRef=CHNL_45618847_32a17f26
          LinSM_ScheduleRequest_Table_1_2abffe93
            BswMAvailableActions
              BswMLinScheduleSwitch: BswMLinScheduleRef=Table_1_2abffe93
          LinSM_ScheduleRequest_Table_2_b3b6af29
            BswMAvailableActions
              BswMLinScheduleSwitch: BswMLinScheduleRef=Table_2_b3b6af29
          LinSM_ScheduleRequest_Table_e_46b96b7e
            BswMAvailableActions
              BswMLinScheduleSwitch: BswMLinScheduleRef=Table_e_46b96b7e
          LinSM_ScheduleRequest_MasterReq_SlaveResp_03d8aeb9
            BswMAvailableActions
              BswMLinScheduleSwitch: BswMLinScheduleRef=MasterReq_SlaveResp_03d8aeb9
          LinSM_ScheduleRequest_MasterReq_SlaveResp_Table_2_b31cdb33
            BswMAvailableActions
              BswMLinScheduleSwitch: BswMLinScheduleRef=MasterReq_SlaveResp_Table_2_b31cdb33
          LinSM_ScheduleRequest_CHNL_8e3d5be2_a66eb9f7
            BswMAvailableActions
              BswMLinScheduleSwitch: BswMLinScheduleRef=CHNL_8e3d5be2_a66eb9f7
          LinSM_ScheduleRequest_Table0_df24d2a0
            BswMAvailableActions
              BswMLinScheduleSwitch: BswMLinScheduleRef=Table0_df24d2a0
          LinSM_ScheduleRequest_MasterReq_SlaveResp_e4c5082e
            BswMAvailableActions
              BswMLinScheduleSwitch: BswMLinScheduleRef=MasterReq_SlaveResp_e4c5082e
          LinSM_ScheduleRequest_MasterReq_SlaveResp_Table0_9e3481d6
            BswMAvailableActions
              BswMLinScheduleSwitch: BswMLinScheduleRef=MasterReq_SlaveResp_Table0_9e3481d6
          LinSM_ScheduleRequest_CHNL_c3f5fae9_fb3b3248
            BswMAvailableActions
              BswMLinScheduleSwitch: BswMLinScheduleRef=CHNL_c3f5fae9_fb3b3248
          LinSM_ScheduleRequest_Table_1_56dedb48
            BswMAvailableActions
              BswMLinScheduleSwitch: BswMLinScheduleRef=Table_1_56dedb48
          LinSM_ScheduleRequest_Table_2_cfd78af2
            BswMAvailableActions
              BswMLinScheduleSwitch: BswMLinScheduleRef=Table_2_cfd78af2
          LinSM_ScheduleRequest_Table_e_3ad84ea5
            BswMAvailableActions
              BswMLinScheduleSwitch: BswMLinScheduleRef=Table_e_3ad84ea5
          LinSM_ScheduleRequest_MasterReq_SlaveResp_Table_1_479379d3
            BswMAvailableActions
              BswMLinScheduleSwitch: BswMLinScheduleRef=MasterReq_SlaveResp_Table_1_479379d3
          LinSM_ScheduleRequest_MasterReq_SlaveResp_Table_2_de9a2869
            BswMAvailableActions
              BswMLinScheduleSwitch: BswMLinScheduleRef=MasterReq_SlaveResp_Table_2_de9a2869
          LinSM_ScheduleRequest_CHNL_def0ca51_faa54df8
            BswMAvailableActions
              BswMLinScheduleSwitch: BswMLinScheduleRef=CHNL_def0ca51_faa54df8
          LinSM_ScheduleRequest_Table_1_33137188
            BswMAvailableActions
              BswMLinScheduleSwitch: BswMLinScheduleRef=Table_1_33137188
          LinSM_ScheduleRequest_Table_e_5f15e465
            BswMAvailableActions
              BswMLinScheduleSwitch: BswMLinScheduleRef=Table_e_5f15e465
          LinSM_ScheduleRequest_MasterReq_SlaveResp_Table_1_b81cce51
            BswMAvailableActions
              BswMLinScheduleSwitch: BswMLinScheduleRef=MasterReq_SlaveResp_Table_1_b81cce51
          LinSM_ScheduleRequest_MasterReq_SlaveResp_Table_2_21159feb
            BswMAvailableActions
              BswMLinScheduleSwitch: BswMLinScheduleRef=MasterReq_SlaveResp_Table_2_21159feb
          LinSM_ScheduleRequest_MasterReq_SlaveResp_Table_1_2a158a89
            BswMAvailableActions
              BswMLinScheduleSwitch: BswMLinScheduleRef=MasterReq_SlaveResp_Table_1_2a158a89
          LinSM_ScheduleRequest_Table_e_dbb68a08
            BswMAvailableActions
              BswMLinScheduleSwitch: BswMLinScheduleRef=Table_e_dbb68a08
          LinSM_ScheduleRequest_Table_1_cbd13a3e
            BswMAvailableActions
              BswMLinScheduleSwitch: BswMLinScheduleRef=Table_1_cbd13a3e
          LinSM_ScheduleRequest_MasterReq_SlaveResp_f18f4341
            BswMAvailableActions
              BswMLinScheduleSwitch: BswMLinScheduleRef=MasterReq_SlaveResp_f18f4341
          LinSM_ScheduleRequest_MasterReq_SlaveResp_294c3867
            BswMAvailableActions
              BswMLinScheduleSwitch: BswMLinScheduleRef=MasterReq_SlaveResp_294c3867
          LinSM_ScheduleRequest_Table_2_aa1a2032
            BswMAvailableActions
              BswMLinScheduleSwitch: BswMLinScheduleRef=Table_2_aa1a2032
          BLOCK_COM_CN_Backbone2_78967e2c
            BswMAvailableActions
              BswMComMAllowCom: BswMComAllowed=true, BswMComMAllowChannelRef=CN_Backbone2_78967e2c
        CC_AL_CN_FMSNet_fce1aae5_TX_Disable (BswMActionList): BswMActionListExecution=BSWM_TRIGGER
          CC_DisablePDUGroup_CIOM_oFMSNet_Tx_0x0F_BC_89b46e88 (BswMActionListItem): BswMAbortOnFail=false, BswMActionListItemIndex=0, BswMActionListItemRef=BswMModeControl/CC_DisablePDUGroup_CIOM_oFMSNet_Tx_0x0F_BC_89b46e88
        CC_AL_CN_FMSNet_fce1aae5_TX_EnableNoinit (BswMActionList): BswMActionListExecution=BSWM_TRIGGER
          CC_EnablePDUGroup_CIOM_oFMSNet_Tx_0x0F_BC_89b46e88 (BswMActionListItem): BswMAbortOnFail=false, BswMActionListItemIndex=0, BswMActionListItemRef=BswMModeControl/CC_EnablePDUGroup_CIOM_oFMSNet_Tx_0x0F_BC_89b46e88
        41 x BswMAction:
          BLOCK_COM_CN_Backbone2_78967e2c_001
            BswMAvailableActions
              BswMComMAllowCom: BswMComAllowed=true, BswMComMAllowChannelRef=CN_Backbone2_78967e2c
          ESH_Action_ComMDisallow_CN_Backbone2_78967e2c
            BswMAvailableActions
              BswMComMAllowCom: BswMComAllowed=false, BswMComMAllowChannelRef=CN_Backbone2_78967e2c
          ESH_Action_ComMAllow_CN_Backbone2_78967e2c
            BswMAvailableActions
              BswMComMAllowCom: BswMComAllowed=true, BswMComMAllowChannelRef=CN_Backbone2_78967e2c
          BSWM_FULL_COM_CN_Backbone2_3f947ba3
            BswMAvailableActions
              BswMComMModeSwitch: BswMComMRequestedMode=BSWM_FULL_COM, BswMComMUserRef=CN_Backbone2_3f947ba3
          ALLOW_COM_CN_LIN00_2cd9a7df
            BswMAvailableActions
              BswMComMAllowCom: BswMComAllowed=true, BswMComMAllowChannelRef=CN_LIN00_2cd9a7df
          ENABLE_CIOM_oLIN00_Tx_8b42b82c
            BswMAvailableActions
              BswMPduGroupSwitch: BswMPduGroupSwitchReinit=true, BswMEnabledPduGroupRef=CIOM_oLIN00_Tx_8b42b82c
          BSWM_FULL_COM_CN_Backbone1J1939_2a22de3d
            BswMAvailableActions
              BswMComMModeSwitch: BswMComMRequestedMode=BSWM_FULL_COM, BswMComMUserRef=CN_Backbone1J1939_2a22de3d
          BSWM_FULL_COM_CN_SecuritySubnet_7cec9a61
            BswMAvailableActions
              BswMComMModeSwitch: BswMComMRequestedMode=BSWM_FULL_COM, BswMComMUserRef=CN_SecuritySubnet_7cec9a61
          BSWM_FULL_COM_CN_CabSubnet_aa77b0b0
            BswMAvailableActions
              BswMComMModeSwitch: BswMComMRequestedMode=BSWM_FULL_COM, BswMComMUserRef=CN_CabSubnet_aa77b0b0
          BSWM_FULL_COM_CN_FMSNet_05490e3d
            BswMAvailableActions
              BswMComMModeSwitch: BswMComMRequestedMode=BSWM_FULL_COM, BswMComMUserRef=CN_FMSNet_05490e3d
          BLOCK_COM_CN_Backbone1J1939_0b1f4bae
            BswMAvailableActions
              BswMComMAllowCom: BswMComAllowed=true, BswMComMAllowChannelRef=CN_Backbone1J1939_0b1f4bae
          BLOCK_COM_CN_CabSubnet_9ea693f1
            BswMAvailableActions
              BswMComMAllowCom: BswMComAllowed=true, BswMComMAllowChannelRef=CN_CabSubnet_9ea693f1
          BLOCK_COM_CN_FMSNet_fce1aae5
            BswMAvailableActions
              BswMComMAllowCom: BswMComAllowed=true, BswMComMAllowChannelRef=CN_FMSNet_fce1aae5
          BLOCK_COM_CN_SecuritySubnet_e7a0ee54
            BswMAvailableActions
              BswMComMAllowCom: BswMComAllowed=true, BswMComMAllowChannelRef=CN_SecuritySubnet_e7a0ee54
          ALLOW_COM_CN_LIN02_c2d7c6f3
            BswMAvailableActions
              BswMComMAllowCom: BswMComAllowed=true, BswMComMAllowChannelRef=CN_LIN02_c2d7c6f3
          ALLOW_COM_CN_LIN04_2bb463c6
            BswMAvailableActions
              BswMComMAllowCom: BswMComAllowed=true, BswMComMAllowChannelRef=CN_LIN04_2bb463c6
          ALLOW_COM_CN_LIN03_b5d0f665
            BswMAvailableActions
              BswMComMAllowCom: BswMComAllowed=true, BswMComMAllowChannelRef=CN_LIN03_b5d0f665
          ALLOW_COM_CN_LIN01_5bde9749
            BswMAvailableActions
              BswMComMAllowCom: BswMComAllowed=true, BswMComMAllowChannelRef=CN_LIN01_5bde9749
          ESH_Action_ComMDisallow_CN_Backbone1J1939_0b1f4bae
            BswMAvailableActions
              BswMComMAllowCom: BswMComAllowed=false, BswMComMAllowChannelRef=CN_Backbone1J1939_0b1f4bae
          ESH_Action_ComMDisallow_CN_LIN00_2cd9a7df
            BswMAvailableActions
              BswMComMAllowCom: BswMComAllowed=false, BswMComMAllowChannelRef=CN_LIN00_2cd9a7df
          ESH_Action_ComMDisallow_CN_LIN02_c2d7c6f3
            BswMAvailableActions
              BswMComMAllowCom: BswMComAllowed=false, BswMComMAllowChannelRef=CN_LIN02_c2d7c6f3
          ESH_Action_ComMDisallow_CN_LIN04_2bb463c6
            BswMAvailableActions
              BswMComMAllowCom: BswMComAllowed=false, BswMComMAllowChannelRef=CN_LIN04_2bb463c6
          ESH_Action_ComMDisallow_CN_CabSubnet_9ea693f1
            BswMAvailableActions
              BswMComMAllowCom: BswMComAllowed=false, BswMComMAllowChannelRef=CN_CabSubnet_9ea693f1
          ESH_Action_ComMDisallow_CN_LIN03_b5d0f665
            BswMAvailableActions
              BswMComMAllowCom: BswMComAllowed=false, BswMComMAllowChannelRef=CN_LIN03_b5d0f665
          ESH_Action_ComMDisallow_CN_LIN01_5bde9749
            BswMAvailableActions
              BswMComMAllowCom: BswMComAllowed=false, BswMComMAllowChannelRef=CN_LIN01_5bde9749
          ESH_Action_ComMDisallow_CN_FMSNet_fce1aae5
            BswMAvailableActions
              BswMComMAllowCom: BswMComAllowed=false, BswMComMAllowChannelRef=CN_FMSNet_fce1aae5
          ESH_Action_ComMDisallow_CN_SecuritySubnet_e7a0ee54
            BswMAvailableActions
              BswMComMAllowCom: BswMComAllowed=false, BswMComMAllowChannelRef=CN_SecuritySubnet_e7a0ee54
          ESH_Action_ComMAllow_CN_Backbone1J1939_0b1f4bae
            BswMAvailableActions
              BswMComMAllowCom: BswMComAllowed=true, BswMComMAllowChannelRef=CN_Backbone1J1939_0b1f4bae
          ESH_Action_ComMAllow_CN_LIN00_2cd9a7df
            BswMAvailableActions
              BswMComMAllowCom: BswMComAllowed=true, BswMComMAllowChannelRef=CN_LIN00_2cd9a7df
          ESH_Action_ComMAllow_CN_LIN02_c2d7c6f3
            BswMAvailableActions
              BswMComMAllowCom: BswMComAllowed=true, BswMComMAllowChannelRef=CN_LIN02_c2d7c6f3
          ESH_Action_ComMAllow_CN_LIN04_2bb463c6
            BswMAvailableActions
              BswMComMAllowCom: BswMComAllowed=true, BswMComMAllowChannelRef=CN_LIN04_2bb463c6
          ESH_Action_ComMAllow_CN_CabSubnet_9ea693f1
            BswMAvailableActions
              BswMComMAllowCom: BswMComAllowed=true, BswMComMAllowChannelRef=CN_CabSubnet_9ea693f1
          ESH_Action_ComMAllow_CN_LIN03_b5d0f665
            BswMAvailableActions
              BswMComMAllowCom: BswMComAllowed=true, BswMComMAllowChannelRef=CN_LIN03_b5d0f665
          ESH_Action_ComMAllow_CN_LIN01_5bde9749
            BswMAvailableActions
              BswMComMAllowCom: BswMComAllowed=true, BswMComMAllowChannelRef=CN_LIN01_5bde9749
          ESH_Action_ComMAllow_CN_FMSNet_fce1aae5
            BswMAvailableActions
              BswMComMAllowCom: BswMComAllowed=true, BswMComMAllowChannelRef=CN_FMSNet_fce1aae5
          ESH_Action_ComMAllow_CN_SecuritySubnet_e7a0ee54
            BswMAvailableActions
              BswMComMAllowCom: BswMComAllowed=true, BswMComMAllowChannelRef=CN_SecuritySubnet_e7a0ee54
          ALLOW_COM_CN_Backbone1J1939_0b1f4bae
            BswMAvailableActions
              BswMComMAllowCom: BswMComAllowed=true, BswMComMAllowChannelRef=CN_Backbone1J1939_0b1f4bae
          ALLOW_COM_CN_CabSubnet_9ea693f1
            BswMAvailableActions
              BswMComMAllowCom: BswMComAllowed=true, BswMComMAllowChannelRef=CN_CabSubnet_9ea693f1
          ALLOW_COM_CN_Backbone2_78967e2c
            BswMAvailableActions
              BswMComMAllowCom: BswMComAllowed=true, BswMComMAllowChannelRef=CN_Backbone2_78967e2c
          ALLOW_COM_CN_FMSNet_fce1aae5
            BswMAvailableActions
              BswMComMAllowCom: BswMComAllowed=true, BswMComMAllowChannelRef=CN_FMSNet_fce1aae5
          ALLOW_COM_CN_SecuritySubnet_e7a0ee54
            BswMAvailableActions
              BswMComMAllowCom: BswMComAllowed=true, BswMComMAllowChannelRef=CN_SecuritySubnet_e7a0ee54
      BswMDataTypeMappingSets: BswMDataTypeMappingSetRef=BswMMappingSet
      7 x BswMRteModeDclGroup:
        ESH_Mode: BswMInitMode=STARTUP
          5 x BswMRteMode:
            STARTUP: BswMModePhysicalValue=0
            RUN: BswMModePhysicalValue=1
            POSTRUN: BswMModePhysicalValue=2
            WAKEUP: BswMModePhysicalValue=3
            SHUTDOWN: BswMModePhysicalValue=4
        ESH_RunRequest: BswMInitMode=RELEASED
          RELEASED (BswMRteMode): BswMModePhysicalValue=0
          REQUESTED (BswMRteMode): BswMModePhysicalValue=1
        BswMRteMDG_LIN3Schedule: BswMInitMode=LIN3_NULL
          7 x BswMRteMode:
            LIN3_NULL: BswMModePhysicalValue=0
            LIN3_TABLE1: BswMModePhysicalValue=1
            LIN3_TABLE2: BswMModePhysicalValue=2
            LIN3_TABLE_E: BswMModePhysicalValue=3
            LIN3_MasterReq_SlaveResp_Table1: BswMModePhysicalValue=4
            LIN3_MasterReq_SlaveResp_Table2: BswMModePhysicalValue=5
            LIN3_MasterReq_SlaveResp: BswMModePhysicalValue=6
        BswMRteMDG_LIN1Schedule: BswMInitMode=LIN1_NULL
          7 x BswMRteMode:
            LIN1_Table1: BswMModePhysicalValue=1
            LIN1_Table2: BswMModePhysicalValue=2
            LIN1_Table_E: BswMModePhysicalValue=3
            LIN1_MasterReq_SlaveResp_Table1: BswMModePhysicalValue=4
            LIN1_MasterReq_SlaveResp_Table2: BswMModePhysicalValue=5
            LIN1_NULL: BswMModePhysicalValue=0
            LIN1_MasterReq_SlaveResp: BswMModePhysicalValue=6
        BswMRteMDG_LIN2Schedule: BswMInitMode=LIN2_NULL
          5 x BswMRteMode:
            LIN2_NULL: BswMModePhysicalValue=0
            LIN2_TABLE0: BswMModePhysicalValue=1
            LIN2_TABLE_E: BswMModePhysicalValue=2
            LIN2_MasterReq_SlaveResp_TABLE0: BswMModePhysicalValue=3
            LIN2_MasterReq_SlaveResp: BswMModePhysicalValue=4
        BswMRteMDG_LIN4Schedule: BswMInitMode=LIN4_NULL
          7 x BswMRteMode:
            LIN4_NULL: BswMModePhysicalValue=0
            LIN4_MasterReq_SlaveResp_Table1: BswMModePhysicalValue=4
            LIN4_TABLE1: BswMModePhysicalValue=1
            LIN4_TABLE2: BswMModePhysicalValue=2
            LIN4_TABLE_E: BswMModePhysicalValue=3
            LIN4_MasterReq_SlaveResp_Table2: BswMModePhysicalValue=5
            LIN4_MasterReq_SlaveResp: BswMModePhysicalValue=6
        BswMRteMDG_LIN5Schedule: BswMInitMode=LIN5_NULL
          7 x BswMRteMode:
            LIN5_NULL: BswMModePhysicalValue=0
            LIN5_TABLE1: BswMModePhysicalValue=1
            LIN5_MasterReq_SlaveResp_Table1: BswMModePhysicalValue=4
            LIN5_MasterReq_SlaveResp_Table2: BswMModePhysicalValue=5
            LIN5_MasterReq_SlaveResp: BswMModePhysicalValue=6
            LIN5_TABLE2: BswMModePhysicalValue=2
            LIN5_TABLE_E: BswMModePhysicalValue=3
