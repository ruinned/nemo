AUTOSAR XML (schema 4-2-1)
package /ActiveEcuC
  module config IoHwAb: implementation-config-variant=VARIANT-PRE-COMPILE, module-description=IoHwAb_Impl
    IoHwAbDatatypes
      9 x IoHwAbBaseType:
        float64: IoHwAbBaseDataType=IOHWAB_FLOAT64
        float32: IoHwAbBaseDataType=IOHWAB_FLOAT32
        sint32: IoHwAbBaseDataType=IOHWAB_SINT32
        sint16: IoHwAbBaseDataType=IOHWAB_SINT16
        sint8: IoHwAbBaseDataType=IOHWAB_SINT8
        uint32: IoHwAbBaseDataType=IOHWAB_UINT32
        uint16: IoHwAbBaseDataType=IOHWAB_UINT16
        uint8: IoHwAbBaseDataType=IOHWAB_UINT8
        boolean: IoHwAbBaseDataType=IOHWAB_BOOL
      IoHwAbImplementationTypes
        4 x IoHwAbTypeReference:
          VGTT_EcuPinVoltage_0V2: IoHwAbTypeReferenceTypeRef=uint8
          VGTT_ScimAdiPinsState: IoHwAbTypeReferenceTypeRef=uint16
          VGTT_EcuPinDiagStatus: IoHwAbTypeReferenceTypeRef=uint8
          VGTT_EcuPinVoltage_0V2_UI16: IoHwAbTypeReferenceTypeRef=uint16
    IoHwAbGeneral:
      IoHwAbDevErrorDetect = true
      IoHwAbVersionInfoApi = false
      IoHwAbUseInitFunction = true
      IoHwAbCfgIncludeList = Dio.h
      IoHwAbCfgIncludeList = Pwm.h
      IoHwAbCfgIncludeList = Adc.h
      IoHwAbCfgIncludeList = Spi.h
      IoHwAbCfgIncludeList = Icu.h
    8 x IoHwAbCSPortInterface, all with IoHwAbTemplate=IoHwAb_Template_None:
      FSC_OperationalMode_I
        VbatInterface_P (IoHwAbOperation)
        IoHwAbApplicationError: IoHwAbErrorCode=1
        FSC_OperationalMode (IoHwAbOperation)
      VbatInterface_I
        VbatInterface_P (IoHwAbOperation)
        IoHwAbApplicationError: IoHwAbErrorCode=1
        6 x IoHwAbOperation:
          FSC_OperationalMode
          DobhsCtrlInterface_P_{1..3}
          DobhsCtrlInterface_P_5
          DobhsCtrlInterface_P_4
      DobhsCtrlInterface_I
        GetDobhsPinState (IoHwAbOperation)
          4 x IoHwAbOperationArgument, all with IoHwAbArgDirection=IOHWAB_OUT:
            IsDoActivated: IoHwAbOperationArgumentPosition=0, IoHwAbArgTypeRef=boolean
            DoPinVoltage: IoHwAbOperationArgumentPosition=1, IoHwAbArgTypeRef=uint16
            BatteryVoltage: IoHwAbOperationArgumentPosition=2, IoHwAbArgTypeRef=uint16
            DiagStatus: IoHwAbOperationArgumentPosition=3, IoHwAbArgTypeRef=VGTT_EcuPinDiagStatus
        IoHwAbApplicationError: IoHwAbErrorCode=1
        SetDobhsActive (IoHwAbOperation)
          Activation (IoHwAbOperationArgument): IoHwAbArgDirection=IOHWAB_IN, IoHwAbOperationArgumentPosition=0, IoHwAbArgTypeRef=boolean
      AdiInterface_I
        GetAdiPinState (IoHwAbOperation)
          3 x IoHwAbOperationArgument:
            AdiPinRef: IoHwAbArgDirection=IOHWAB_IN, IoHwAbOperationArgumentPosition=0, IoHwAbArgTypeRef=uint8
            AdiPinVoltage: IoHwAbArgDirection=IOHWAB_OUT, IoHwAbOperationArgumentPosition=1, IoHwAbArgTypeRef=uint16
            LivingPullUpVoltage: IoHwAbArgDirection=IOHWAB_OUT, IoHwAbOperationArgumentPosition=2, IoHwAbArgTypeRef=VGTT_EcuPinVoltage_0V2
        IoHwAbApplicationError: IoHwAbErrorCode=1
        3 x IoHwAbOperation:
          GetAdiPinStateAll
            VoltageOnAdiPins (IoHwAbOperationArgument): IoHwAbArgDirection=IOHWAB_OUT, IoHwAbOperationArgumentPosition=0, IoHwAbArgTypeRef=VGTT_ScimAdiPinsState
            LivingPullUpVoltage (IoHwAbOperationArgument): IoHwAbArgDirection=IOHWAB_OUT, IoHwAbOperationArgumentPosition=1, IoHwAbArgTypeRef=VGTT_EcuPinVoltage_0V2
          GetPullUpState
            4 x IoHwAbOperationArgument, all with IoHwAbArgDirection=IOHWAB_OUT, IoHwAbArgTypeRef=VGTT_EcuPinVoltage_0V2:
              PullUpVoltage_Parked: IoHwAbOperationArgumentPosition=1
              PullUpVoltage_Living: IoHwAbOperationArgumentPosition=0
              PullUpVoltage_DAI1: IoHwAbOperationArgumentPosition=2
              PullUpVoltage_DAI2: IoHwAbOperationArgumentPosition=3
          SetPullUp
            3 x IoHwAbOperationArgument, all with IoHwAbArgDirection=IOHWAB_IN, IoHwAbArgTypeRef=boolean:
              ActivateLivingPullUp: IoHwAbOperationArgumentPosition=0
              ActivateParkedPullUp: IoHwAbOperationArgumentPosition=1
              ActivateDAIPullUp: IoHwAbOperationArgumentPosition=2
      DowhsInterface_I
        GetDoPinStateOne (IoHwAbOperation)
          7 x IoHwAbOperationArgument:
            DoPinRef: IoHwAbArgDirection=IOHWAB_IN, IoHwAbOperationArgumentPosition=0, IoHwAbArgTypeRef=uint8
            IsDoActivated: IoHwAbArgDirection=IOHWAB_OUT, IoHwAbOperationArgumentPosition=1, IoHwAbArgTypeRef=boolean
            DoPinVoltage: IoHwAbArgDirection=IOHWAB_OUT, IoHwAbOperationArgumentPosition=2, IoHwAbArgTypeRef=uint16
            BatteryVoltage: IoHwAbArgDirection=IOHWAB_OUT, IoHwAbOperationArgumentPosition=3, IoHwAbArgTypeRef=uint16
            DutyCycle: IoHwAbArgDirection=IOHWAB_OUT, IoHwAbOperationArgumentPosition=4, IoHwAbArgTypeRef=uint8
            DiagStatus: IoHwAbArgDirection=IOHWAB_OUT, IoHwAbOperationArgumentPosition=6, IoHwAbArgTypeRef=VGTT_EcuPinDiagStatus
            Period: IoHwAbArgDirection=IOHWAB_OUT, IoHwAbOperationArgumentPosition=5, IoHwAbArgTypeRef=uint16
        IoHwAbApplicationError: IoHwAbErrorCode=1
        SetDowActive (IoHwAbOperation)
          3 x IoHwAbOperationArgument, all with IoHwAbArgDirection=IOHWAB_IN:
            OutputId: IoHwAbOperationArgumentPosition=0, IoHwAbArgTypeRef=uint8
            Period: IoHwAbOperationArgumentPosition=1, IoHwAbArgTypeRef=uint16
            DutyCycle: IoHwAbOperationArgumentPosition=2, IoHwAbArgTypeRef=uint8
      Do12VInterface_I
        GetDo12VPinsState (IoHwAbOperation)
          6 x IoHwAbOperationArgument:
            SelectParkedOrLivingPin: IoHwAbArgDirection=IOHWAB_IN, IoHwAbOperationArgumentPosition=0, IoHwAbArgTypeRef=uint8
            IsDo12VActivated: IoHwAbArgDirection=IOHWAB_OUT, IoHwAbOperationArgumentPosition=1, IoHwAbArgTypeRef=boolean
            Do12VPinVoltage: IoHwAbArgDirection=IOHWAB_OUT, IoHwAbOperationArgumentPosition=2, IoHwAbArgTypeRef=VGTT_EcuPinVoltage_0V2
            BatteryVoltage: IoHwAbArgDirection=IOHWAB_OUT, IoHwAbOperationArgumentPosition=3, IoHwAbArgTypeRef=uint16
            DcdcRefVoltage: IoHwAbArgDirection=IOHWAB_OUT, IoHwAbOperationArgumentPosition=4, IoHwAbArgTypeRef=VGTT_EcuPinVoltage_0V2
            DiagStatus: IoHwAbArgDirection=IOHWAB_OUT, IoHwAbOperationArgumentPosition=5, IoHwAbArgTypeRef=VGTT_EcuPinDiagStatus
        IoHwAbApplicationError: IoHwAbErrorCode=1
        3 x IoHwAbOperation:
          SetDcdc12VActive
            Activation (IoHwAbOperationArgument): IoHwAbArgDirection=IOHWAB_IN, IoHwAbOperationArgumentPosition=0, IoHwAbArgTypeRef=boolean
          SetDo12VLivingActive
            Activation (IoHwAbOperationArgument): IoHwAbArgDirection=IOHWAB_IN, IoHwAbOperationArgumentPosition=0, IoHwAbArgTypeRef=boolean
          SetDo12VParkedActive
            Activation (IoHwAbOperationArgument): IoHwAbArgDirection=IOHWAB_IN, IoHwAbOperationArgumentPosition=0, IoHwAbArgTypeRef=boolean
      DobhsDiagInterface_I
        IoHwAbOperation
        IoHwAbApplicationError: IoHwAbErrorCode=1
      DowlsInterface_I
        GetDoPinStateOne (IoHwAbOperation)
          7 x IoHwAbOperationArgument:
            DoPinRef: IoHwAbArgDirection=IOHWAB_IN, IoHwAbOperationArgumentPosition=0, IoHwAbArgTypeRef=uint8
            IsDoActivated: IoHwAbArgDirection=IOHWAB_OUT, IoHwAbOperationArgumentPosition=1, IoHwAbArgTypeRef=boolean
            DoPinVoltage: IoHwAbArgDirection=IOHWAB_OUT, IoHwAbOperationArgumentPosition=2, IoHwAbArgTypeRef=uint16
            BatteryVoltage: IoHwAbArgDirection=IOHWAB_OUT, IoHwAbOperationArgumentPosition=3, IoHwAbArgTypeRef=uint16
            DutyCycle: IoHwAbArgDirection=IOHWAB_OUT, IoHwAbOperationArgumentPosition=4, IoHwAbArgTypeRef=uint8
            DiagStatus: IoHwAbArgDirection=IOHWAB_OUT, IoHwAbOperationArgumentPosition=6, IoHwAbArgTypeRef=VGTT_EcuPinDiagStatus
            Period: IoHwAbArgDirection=IOHWAB_OUT, IoHwAbOperationArgumentPosition=5, IoHwAbArgTypeRef=uint16
        IoHwAbApplicationError: IoHwAbErrorCode=1
        SetDowlsActive (IoHwAbOperation)
          3 x IoHwAbOperationArgument, all with IoHwAbArgDirection=IOHWAB_IN:
            OutputId: IoHwAbOperationArgumentPosition=0, IoHwAbArgTypeRef=uint8
            Period: IoHwAbOperationArgumentPosition=1, IoHwAbArgTypeRef=uint16
            DutyCycle: IoHwAbOperationArgumentPosition=2, IoHwAbArgTypeRef=sint8
    8 x IoHwAbCSPortPrototype, all with IoHwAbCSDirection=IOHWAB_SERVER:
      AdInterfaces_P: IoHwAbCSPortInterfaceRef=AdiInterface_I
      Do12VInterface_P: IoHwAbCSPortInterfaceRef=Do12VInterface_I
      DobhsCtrlInterface_P_{2..4}: IoHwAbCSPortInterfaceRef=DobhsCtrlInterface_I
      DobhsCtrlInterface_P_1: IoHwAbCSPortInterfaceRef=DobhsCtrlInterface_I
      DowhsInterfaces_P_1: IoHwAbCSPortInterfaceRef=DowhsInterface_I
      DowlsInterface_P_1: IoHwAbCSPortInterfaceRef=DowlsInterface_I
    REIoHwAb_10ms (IoHwAbRunnable): IoHwAbTriggerPeriod=10, IoHwAbTimebase=IoHwAbMSec
    Icu_I (IoHwAbCSPortInterface): IoHwAbTemplate=IoHwAb_Template_None
      IcuEnableNotification (IoHwAbOperation)
      IoHwAbApplicationError: IoHwAbErrorCode=1
      3 x IoHwAbOperation:
        IcuEnableEdgeDetection
        IcuDisableEdgeDetection
        IcuDisableNotification
    LficICU_P (IoHwAbCSPortPrototype): IoHwAbCSDirection=IOHWAB_SERVER, IoHwAbCSPortInterfaceRef=Icu_I
    RficICU_P (IoHwAbCSPortPrototype): IoHwAbCSDirection=IOHWAB_SERVER, IoHwAbCSPortInterfaceRef=Icu_I
    Dio_I (IoHwAbCSPortInterface): IoHwAbTemplate=IoHwAb_Template_None
      Read (IoHwAbOperation)
        ReadValue (IoHwAbOperationArgument): IoHwAbArgDirection=IOHWAB_OUT, IoHwAbOperationArgumentPosition=0, IoHwAbArgTypeRef=uint8
      IoHwAbApplicationError: IoHwAbErrorCode=1
      Write (IoHwAbOperation)
        SetValue (IoHwAbOperationArgument): IoHwAbArgDirection=IOHWAB_IN, IoHwAbOperationArgumentPosition=0, IoHwAbArgTypeRef=uint8
    5 x IoHwAbCSPortPrototype, all with IoHwAbCSDirection=IOHWAB_SERVER:
      LficNRESDio_P: IoHwAbCSPortInterfaceRef=Dio_I
      RficNRESDio_P: IoHwAbCSPortInterfaceRef=Dio_I
      DowhsInterfaces_P_2: IoHwAbCSPortInterfaceRef=DowhsInterface_I
      DowlsInterface_P_2: IoHwAbCSPortInterfaceRef=DowlsInterface_I
      DowlsInterface_P_3: IoHwAbCSPortInterfaceRef=DowlsInterface_I
