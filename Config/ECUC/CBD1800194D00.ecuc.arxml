AUTOSAR XML (schema 4-2-1)
package /ActiveEcuC
  ecuc value collection ActiveEcuC: ecu-extract=SYSTEM
    ecuc-values:
      Com
      Rte
      Os
      LinSM
      ComM
      EcuC
      LinTp
      LinIf
      CanIf
      Lin
      Can
      J1939Tp
      Det
      J1939Nm
      PduR
      J1939Rm
      CanSM
      BswM
      Nm
      Fls
      EcuM
      Dem
      Issm
      Dcm
      CanTp
      CanNm
      vDem42
      NvM
      MemIf
      Crc
      Fee
      Cdd
      Resource
      Icu
      Wdg
      Base
      Mcl
      Spi
      CanTrcv
      IoHwAb
      Dio
      Pwm
      Port
      Adc
      Gpt
      Mcu
      Brs
