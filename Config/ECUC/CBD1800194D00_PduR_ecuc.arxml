[part 1 of 2: package /ActiveEcuC]
AUTOSAR XML (schema 4-2-1)
package /ActiveEcuC
  module config PduR: implementation-config-variant=VARIANT-PRE-COMPILE, module-description=PduR_Impl
    PduRGeneral:
      PduRDevErrorDetect = false
      PduRVersionInfoApi = false
      PduRMetaDataSupport = false
      PduRPduCallback = false
      PduRSwitching = false
      PduRSafeBswChecks = false
      PduREnableDeferredTransmission = false
      PduREnableDeferredReception = false
      PduRGeneration:
        PduROutOfBoundsWriteProtectionStrategy = NONE
        PduROutOfBoundsWriteSanitizer = false
        PduROutOfBoundsReadSanitizer = false
        PduRNumericalDataTypeMinimizationStrategy = WITH_CAST
        PduRReduceConstantData2Define = false
        PduRBoolDataInArrayOfStructStrategy = BITMASKING
        PduRDeduplicateIndirectedData = true
        PduRDataDeduplicationStrategy = WITH_CAST
        PduRReduceBoolDataByNegationThreshold = 2
        PduRReduceBoolDataByNumericalComparisonThreshold = 2
        PduRReduceBoolDataByNumericalRelationThreshold = 2
        PduRReduceBoolDataByNumericalOperandStrategy = WITH_ANY_VALUE
        PduRReduceNumericalDataByOffsetThreshold = 2
        PduRReduceNumericalDataByArraySubtractionThreshold = 2
        PduRReduceDataByStreaming = false
        PduRShortSymbols = false
        PduRInterfacesForDeactivatedData = false
        PduRReferringKeysInComments = false
    PduRRoutingTables: PduRConfigurationId=0
      PduRRoutingTable
        463 x PduRRoutingPath:
          EEC2_X_EMS_oBackbone1J1939_7659ee10_Rx: PduRRoutingPathCommunicationType=COMMUNICATION_INTERFACE
            PduRSrcPdu_995d31c8 (PduRSrcPdu): PduRSourcePduHandleId=65, PduRSrcPduDirection=RECEIVE, PduRSrcPduRef=EEC2_X_EMS_oBackbone1J1939_7659ee10_Rx, PduRSrcPduPduRBswModulesRef=CanIf
            EEC2_X_EMS_oBackbone1J1939_7659ee10_Rx_995d31c8_Rx (PduRDestPdu):
              PduRDestPduHandleId = 58
              PduRDestPduDirection = RECEIVE
              PduRDestPduRoutingType = API_FORWARDING
              PduRDestPduDataProcessing = IMMEDIATE
              PduRPduLengthHandlingStrategy = UNUSED
              PduRTransmissionConfirmation = false
              PduRDestPduRef = EEC2_X_EMS_oBackbone1J1939_265b5fc2_Rx
              PduRDestPduPduRBswModulesRef = Com
          LECMBasic2CIOM_L1_oLIN00_efdd1437_Rx: PduRRoutingPathCommunicationType=COMMUNICATION_INTERFACE
            LECMBasic2CIOM_L1_oLIN00_efdd1437_Rx_7332fc25_Rx (PduRDestPdu):
              PduRDestPduHandleId = 116
              PduRDestPduDirection = RECEIVE
              PduRDestPduRoutingType = API_FORWARDING
              PduRDestPduDataProcessing = IMMEDIATE
              PduRPduLengthHandlingStrategy = UNUSED
              PduRTransmissionConfirmation = false
              PduRDestPduRef = LECMBasic2CIOM_L1_oLIN00_da4f3dd9_Rx
              PduRDestPduPduRBswModulesRef = Com
            PduRSrcPdu_7332fc25 (PduRSrcPdu): PduRSourcePduHandleId=123, PduRSrcPduDirection=RECEIVE, PduRSrcPduRef=LECMBasic2CIOM_L1_oLIN00_efdd1437_Rx, PduRSrcPduPduRBswModulesRef=LinIf
          VMCU_BB1_01P_oBackbone1J1939_73c9d3c7_Rx: PduRRoutingPathCommunicationType=COMMUNICATION_INTERFACE
            VMCU_BB1_01P_oBackbone1J1939_73c9d3c7_Rx_dae9aba0_Rx (PduRDestPdu):
              PduRDestPduHandleId = 134
              PduRDestPduDirection = RECEIVE
              PduRDestPduRoutingType = API_FORWARDING
              PduRDestPduDataProcessing = IMMEDIATE
              PduRPduLengthHandlingStrategy = UNUSED
              PduRTransmissionConfirmation = false
              PduRDestPduRef = VMCU_BB1_01P_oBackbone1J1939_f5234d42_Rx
              PduRDestPduPduRBswModulesRef = Com
            PduRSrcPdu_dae9aba0 (PduRSrcPdu): PduRSourcePduHandleId=141, PduRSrcPduDirection=RECEIVE, PduRSrcPduRef=VMCU_BB1_01P_oBackbone1J1939_73c9d3c7_Rx, PduRSrcPduPduRBswModulesRef=CanIf
          EBS_BB1_01P_oBackbone1J1939_06650efd_Rx: PduRRoutingPathCommunicationType=COMMUNICATION_INTERFACE
            EBS_BB1_01P_oBackbone1J1939_06650efd_Rx_3c266640_Rx (PduRDestPdu):
              PduRDestPduHandleId = 54
              PduRDestPduDirection = RECEIVE
              PduRDestPduRoutingType = API_FORWARDING
              PduRDestPduDataProcessing = IMMEDIATE
              PduRPduLengthHandlingStrategy = UNUSED
              PduRTransmissionConfirmation = false
              PduRDestPduRef = EBS_BB1_01P_oBackbone1J1939_ce636b4a_Rx
              PduRDestPduPduRBswModulesRef = Com
            PduRSrcPdu_3c266640 (PduRSrcPdu): PduRSourcePduHandleId=61, PduRSrcPduDirection=RECEIVE, PduRSrcPduRef=EBS_BB1_01P_oBackbone1J1939_06650efd_Rx, PduRSrcPduPduRBswModulesRef=CanIf
          LECM2toCIOM_FR2_L1_oLIN00_a88c28c4_Rx: PduRRoutingPathCommunicationType=COMMUNICATION_INTERFACE
            PduRSrcPdu_786aa0cd (PduRSrcPdu): PduRSourcePduHandleId=121, PduRSrcPduDirection=RECEIVE, PduRSrcPduRef=LECM2toCIOM_FR2_L1_oLIN00_a88c28c4_Rx, PduRSrcPduPduRBswModulesRef=LinIf
            LECM2toCIOM_FR2_L1_oLIN00_a88c28c4_Rx_786aa0cd_Rx (PduRDestPdu):
              PduRDestPduHandleId = 114
              PduRDestPduDirection = RECEIVE
              PduRDestPduRoutingType = API_FORWARDING
              PduRDestPduDataProcessing = IMMEDIATE
              PduRPduLengthHandlingStrategy = UNUSED
              PduRTransmissionConfirmation = false
              PduRDestPduRef = LECM2toCIOM_FR2_L1_oLIN00_a529f1ee_Rx
              PduRDestPduPduRBswModulesRef = Com
          MasterReq_LECM2_oLIN00_670141b5_Tx: PduRRoutingPathCommunicationType=TRANSPORT_PROTOCOL
            MasterReq_LECM2_oLIN00_85a61f49_Tx (PduRDestPdu):
              PduRDestPduHandleId = 69
              PduRDestPduDirection = TRANSMIT
              PduRDestPduRoutingType = API_FORWARDING
              PduRDestPduDataProcessing = IMMEDIATE
              PduRPduLengthHandlingStrategy = UNUSED
              PduRDestPduRef = MasterReq_LECM2_oLIN00_85a61f49_Tx
              PduRDestPduPduRBswModulesRef = LinTp
            PduRSrcPdu_8fec9c64 (PduRSrcPdu): PduRSourcePduHandleId=162, PduRSrcPduDirection=TRANSMIT, PduRSrcPduRef=MasterReq_LECM2_oLIN00_670141b5_Tx, PduRSrcPduPduRBswModulesRef=Cdd
          EEC1_X_EMS_oBackbone1J1939_cdd2f3bf_Rx: PduRRoutingPathCommunicationType=COMMUNICATION_INTERFACE
            EEC1_X_EMS_oBackbone1J1939_cdd2f3bf_Rx_25a1aa73_Rx (PduRDestPdu):
              PduRDestPduHandleId = 57
              PduRDestPduDirection = RECEIVE
              PduRDestPduRoutingType = API_FORWARDING
              PduRDestPduDataProcessing = IMMEDIATE
              PduRPduLengthHandlingStrategy = UNUSED
              PduRTransmissionConfirmation = false
              PduRDestPduRef = EEC1_X_EMS_oBackbone1J1939_50be66ff_Rx
              PduRDestPduPduRBswModulesRef = Com
            PduRSrcPdu_25a1aa73 (PduRSrcPdu): PduRSourcePduHandleId=64, PduRSrcPduDirection=RECEIVE, PduRSrcPduRef=EEC1_X_EMS_oBackbone1J1939_cdd2f3bf_Rx, PduRSrcPduPduRBswModulesRef=CanIf
          MasterReq_FSP2_L1_oLIN00_b405eb2b_Tx: PduRRoutingPathCommunicationType=TRANSPORT_PROTOCOL
            PduRSrcPdu_991b9435 (PduRSrcPdu): PduRSourcePduHandleId=155, PduRSrcPduDirection=TRANSMIT, PduRSrcPduRef=MasterReq_FSP2_L1_oLIN00_b405eb2b_Tx, PduRSrcPduPduRBswModulesRef=Cdd
            MasterReq_FSP2_L1_oLIN00_158ba8e3_Tx (PduRDestPdu):
              PduRDestPduHandleId = 62
              PduRDestPduDirection = TRANSMIT
              PduRDestPduRoutingType = API_FORWARDING
              PduRDestPduDataProcessing = IMMEDIATE
              PduRPduLengthHandlingStrategy = UNUSED
              PduRDestPduRef = MasterReq_FSP2_L1_oLIN00_158ba8e3_Tx
              PduRDestPduPduRBswModulesRef = LinTp
          FMS1_X_HMIIOM_oBackbone1J1939_496422f1_Rx: PduRRoutingPathCommunicationType=COMMUNICATION_INTERFACE
            FMS1_X_HMIIOM_oBackbone1J1939_496422f1_Rx_5c4fad53_Rx (PduRDestPdu):
              PduRDestPduHandleId = 70
              PduRDestPduDirection = RECEIVE
              PduRDestPduRoutingType = API_FORWARDING
              PduRDestPduDataProcessing = IMMEDIATE
              PduRPduLengthHandlingStrategy = UNUSED
              PduRTransmissionConfirmation = false
              PduRDestPduRef = FMS1_X_HMIIOM_oBackbone1J1939_69e6dd44_Rx
              PduRDestPduPduRBswModulesRef = Com
            PduRSrcPdu_5c4fad53 (PduRSrcPdu): PduRSourcePduHandleId=77, PduRSrcPduDirection=RECEIVE, PduRSrcPduRef=FMS1_X_HMIIOM_oBackbone1J1939_496422f1_Rx, PduRSrcPduPduRBswModulesRef=CanIf
          ERC1_X_RECU_oBackbone1J1939_d09c878a_Rx: PduRRoutingPathCommunicationType=COMMUNICATION_INTERFACE
            ERC1_X_RECU_oBackbone1J1939_d09c878a_Rx_740336e5_Rx (PduRDestPdu):
              PduRDestPduHandleId = 68
              PduRDestPduDirection = RECEIVE
              PduRDestPduRoutingType = API_FORWARDING
              PduRDestPduDataProcessing = IMMEDIATE
              PduRPduLengthHandlingStrategy = UNUSED
              PduRTransmissionConfirmation = false
              PduRDestPduRef = ERC1_X_RECU_oBackbone1J1939_5afd0b6e_Rx
              PduRDestPduPduRBswModulesRef = Com
            PduRSrcPdu_740336e5 (PduRSrcPdu): PduRSourcePduHandleId=75, PduRSrcPduDirection=RECEIVE, PduRSrcPduRef=ERC1_X_RECU_oBackbone1J1939_d09c878a_Rx, PduRSrcPduPduRBswModulesRef=CanIf
          FSP1_SwitchDetResp_L1_oLIN00_a6b440c8_Rx: PduRRoutingPathCommunicationType=COMMUNICATION_INTERFACE
            PduRSrcPdu_7615762b (PduRSrcPdu): PduRSourcePduHandleId=83, PduRSrcPduDirection=RECEIVE, PduRSrcPduRef=FSP1_SwitchDetResp_L1_oLIN00_a6b440c8_Rx, PduRSrcPduPduRBswModulesRef=LinIf
            FSP1_SwitchDetResp_L1_oLIN00_a6b440c8_Rx_7615762b_Rx (PduRDestPdu):
              PduRDestPduHandleId = 76
              PduRDestPduDirection = RECEIVE
              PduRDestPduRoutingType = API_FORWARDING
              PduRDestPduDataProcessing = IMMEDIATE
              PduRPduLengthHandlingStrategy = UNUSED
              PduRTransmissionConfirmation = false
              PduRDestPduRef = FSP1_SwitchDetResp_L1_oLIN00_db048333_Rx
              PduRDestPduPduRBswModulesRef = Com
          MasterReq_oLIN00_4a2bb011_Tx: PduRRoutingPathCommunicationType=TRANSPORT_PROTOCOL
            MasterReq_oLIN00_3234fe1b_Tx (PduRDestPdu):
              PduRDestPduHandleId = 73
              PduRDestPduDirection = TRANSMIT
              PduRDestPduRoutingType = API_FORWARDING
              PduRDestPduDataProcessing = IMMEDIATE
              PduRPduLengthHandlingStrategy = UNUSED
              PduRDestPduRef = MasterReq_oLIN00_3234fe1b_Tx
              PduRDestPduPduRBswModulesRef = LinTp
            PduRSrcPdu_927d3065 (PduRSrcPdu): PduRSourcePduHandleId=166, PduRSrcPduDirection=TRANSMIT, PduRSrcPduRef=MasterReq_oLIN00_4a2bb011_Tx, PduRSrcPduPduRBswModulesRef=Cdd
          ACM_BB1_01P_oBackbone1J1939_b0278a49_Rx: PduRRoutingPathCommunicationType=COMMUNICATION_INTERFACE
            PduRSrcPdu_bb6c3932 (PduRSrcPdu): PduRSourcePduHandleId=0, PduRSrcPduDirection=RECEIVE, PduRSrcPduRef=ACM_BB1_01P_oBackbone1J1939_b0278a49_Rx, PduRSrcPduPduRBswModulesRef=CanIf
            ACM_BB1_01P_oBackbone1J1939_b0278a49_Rx_bb6c3932_Rx (PduRDestPdu):
              PduRDestPduHandleId = 0
              PduRDestPduDirection = RECEIVE
              PduRDestPduRoutingType = API_FORWARDING
              PduRDestPduDataProcessing = IMMEDIATE
              PduRPduLengthHandlingStrategy = UNUSED
              PduRTransmissionConfirmation = false
              PduRDestPduRef = ACM_BB1_01P_oBackbone1J1939_57f87ee7_Rx
              PduRDestPduPduRBswModulesRef = Com
          DI_X_TACHO_oBackbone1J1939_6121ec8b_Rx: PduRRoutingPathCommunicationType=TRANSPORT_PROTOCOL
            PduRSrcPdu_408ae78e (PduRSrcPdu): PduRSourcePduHandleId=54, PduRSrcPduDirection=RECEIVE, PduRSrcPduRef=DI_X_TACHO_oBackbone1J1939_6121ec8b_Rx, PduRSrcPduPduRBswModulesRef=J1939Tp
            DI_X_TACHO_oBackbone1J1939_6121ec8b_Rx_408ae78e_Rx (PduRDestPdu):
              PduRDestPduHandleId = 8
              PduRDestPduDirection = RECEIVE
              PduRDestPduRoutingType = API_FORWARDING
              PduRDestPduDataProcessing = IMMEDIATE
              PduRPduLengthHandlingStrategy = UNUSED
              PduRDestPduRef = DI_X_TACHO_oBackbone1J1939_0dca0ef5_Rx
              PduRDestPduPduRBswModulesRef = Com
          EBC2_X_EBS_oBackbone1J1939_b4e68954_Rx: PduRRoutingPathCommunicationType=COMMUNICATION_INTERFACE
            EBC2_X_EBS_oBackbone1J1939_b4e68954_Rx_c5f96cc3_Rx (PduRDestPdu):
              PduRDestPduHandleId = 52
              PduRDestPduDirection = RECEIVE
              PduRDestPduRoutingType = API_FORWARDING
              PduRDestPduDataProcessing = IMMEDIATE
              PduRPduLengthHandlingStrategy = UNUSED
              PduRTransmissionConfirmation = false
              PduRDestPduRef = EBC2_X_EBS_oBackbone1J1939_1e740702_Rx
              PduRDestPduPduRBswModulesRef = Com
            PduRSrcPdu_c5f96cc3 (PduRSrcPdu): PduRSourcePduHandleId=59, PduRSrcPduDirection=RECEIVE, PduRSrcPduRef=EBC2_X_EBS_oBackbone1J1939_b4e68954_Rx, PduRSrcPduPduRBswModulesRef=CanIf
          MasterReq_LECMBasic_oLIN00_16bdebb7_Tx: PduRRoutingPathCommunicationType=TRANSPORT_PROTOCOL
            MasterReq_LECMBasic_oLIN00_33465f21_Tx (PduRDestPdu):
              PduRDestPduHandleId = 70
              PduRDestPduDirection = TRANSMIT
              PduRDestPduRoutingType = API_FORWARDING
              PduRDestPduDataProcessing = IMMEDIATE
              PduRPduLengthHandlingStrategy = UNUSED
              PduRDestPduRef = MasterReq_LECMBasic_oLIN00_33465f21_Tx
              PduRDestPduPduRBswModulesRef = LinTp
            PduRSrcPdu_47b56dbe (PduRSrcPdu): PduRSourcePduHandleId=163, PduRSrcPduDirection=TRANSMIT, PduRSrcPduRef=MasterReq_LECMBasic_oLIN00_16bdebb7_Tx, PduRSrcPduPduRBswModulesRef=Cdd
          ERC1_X_EMSRet_oBackbone1J1939_63f95975_Rx: PduRRoutingPathCommunicationType=COMMUNICATION_INTERFACE
            ERC1_X_EMSRet_oBackbone1J1939_63f95975_Rx_42e414fe_Rx (PduRDestPdu):
              PduRDestPduHandleId = 67
              PduRDestPduDirection = RECEIVE
              PduRDestPduRoutingType = API_FORWARDING
              PduRDestPduDataProcessing = IMMEDIATE
              PduRPduLengthHandlingStrategy = UNUSED
              PduRTransmissionConfirmation = false
              PduRDestPduRef = ERC1_X_EMSRet_oBackbone1J1939_6b48ff0e_Rx
              PduRDestPduPduRBswModulesRef = Com
            PduRSrcPdu_42e414fe (PduRSrcPdu): PduRSourcePduHandleId=74, PduRSrcPduDirection=RECEIVE, PduRSrcPduRef=ERC1_X_EMSRet_oBackbone1J1939_63f95975_Rx, PduRSrcPduPduRBswModulesRef=CanIf
          CIOMtoSlaves2_FR2_L1_oLIN00_46403e14_Tx: PduRRoutingPathCommunicationType=COMMUNICATION_INTERFACE
            CIOMtoSlaves2_FR2_L1_oLIN00_a56bd28e_Tx (PduRDestPdu):
              PduRDestPduHandleId = 65
              PduRDestPduDirection = TRANSMIT
              PduRDestPduRoutingType = API_FORWARDING
              PduRDestPduDataProcessing = IMMEDIATE
              PduRPduLengthHandlingStrategy = UNUSED
              PduRDestPduDataProvision = PDUR_TRIGGERTRANSMIT
              PduRTransmissionConfirmation = false
              PduRDestPduRef = CIOMtoSlaves2_FR2_L1_oLIN00_a56bd28e_Tx
              PduRDestPduPduRBswModulesRef = LinIf
            PduRSrcPdu_692170b2 (PduRSrcPdu): PduRSourcePduHandleId=83, PduRSrcPduDirection=TRANSMIT, PduRSrcPduRef=CIOMtoSlaves2_FR2_L1_oLIN00_46403e14_Tx, PduRSrcPduPduRBswModulesRef=Com
          SlaveResp_LECM2_oLIN00_71931b12_Rx: PduRRoutingPathCommunicationType=TRANSPORT_PROTOCOL
            SlaveResp_LECM2_oLIN00_71931b12_Rx_8389a02c_Rx (PduRDestPdu):
              PduRDestPduHandleId = 38
              PduRDestPduDirection = RECEIVE
              PduRDestPduRoutingType = API_FORWARDING
              PduRDestPduDataProcessing = IMMEDIATE
              PduRPduLengthHandlingStrategy = UNUSED
              PduRDestPduRef = SlaveResp_LECM2_oLIN00_2afc07d8_Rx
              PduRDestPduPduRBswModulesRef = Cdd
            PduRSrcPdu_8389a02c (PduRSrcPdu): PduRSourcePduHandleId=83, PduRSrcPduDirection=RECEIVE, PduRSrcPduRef=SlaveResp_LECM2_oLIN00_71931b12_Rx, PduRSrcPduPduRBswModulesRef=LinTp
          VDC1_X_EBS_oBackbone1J1939_e351e41c_Rx: PduRRoutingPathCommunicationType=COMMUNICATION_INTERFACE
            VDC1_X_EBS_oBackbone1J1939_e351e41c_Rx_ec0493f7_Rx (PduRDestPdu):
              PduRDestPduHandleId = 131
              PduRDestPduDirection = RECEIVE
              PduRDestPduRoutingType = API_FORWARDING
              PduRDestPduDataProcessing = IMMEDIATE
              PduRPduLengthHandlingStrategy = UNUSED
              PduRTransmissionConfirmation = false
              PduRDestPduRef = VDC1_X_EBS_oBackbone1J1939_5b4fe419_Rx
              PduRDestPduPduRBswModulesRef = Com
            PduRSrcPdu_ec0493f7 (PduRSrcPdu): PduRSourcePduHandleId=138, PduRSrcPduDirection=RECEIVE, PduRSrcPduRef=VDC1_X_EBS_oBackbone1J1939_e351e41c_Rx, PduRSrcPduPduRBswModulesRef=CanIf
          EBS_BB1_05P_oBackbone1J1939_ef101786_Rx: PduRRoutingPathCommunicationType=COMMUNICATION_INTERFACE
            EBS_BB1_05P_oBackbone1J1939_ef101786_Rx_50cf6a28_Rx (PduRDestPdu):
              PduRDestPduHandleId = 56
              PduRDestPduDirection = RECEIVE
              PduRDestPduRoutingType = API_FORWARDING
              PduRDestPduDataProcessing = IMMEDIATE
              PduRPduLengthHandlingStrategy = UNUSED
              PduRTransmissionConfirmation = false
              PduRDestPduRef = EBS_BB1_05P_oBackbone1J1939_c5cbbc4c_Rx
              PduRDestPduPduRBswModulesRef = Com
            PduRSrcPdu_50cf6a28 (PduRSrcPdu): PduRSourcePduHandleId=63, PduRSrcPduDirection=RECEIVE, PduRSrcPduRef=EBS_BB1_05P_oBackbone1J1939_ef101786_Rx, PduRSrcPduPduRBswModulesRef=CanIf
          FSP2_Frame_L1_oLIN00_b95ec9fd_Rx: PduRRoutingPathCommunicationType=COMMUNICATION_INTERFACE
            FSP2_Frame_L1_oLIN00_b95ec9fd_Rx_3e9ce6c9_Rx (PduRDestPdu):
              PduRDestPduHandleId = 81
              PduRDestPduDirection = RECEIVE
              PduRDestPduRoutingType = API_FORWARDING
              PduRDestPduDataProcessing = IMMEDIATE
              PduRPduLengthHandlingStrategy = UNUSED
              PduRTransmissionConfirmation = false
              PduRDestPduRef = FSP2_Frame_L1_oLIN00_2d9c2057_Rx
              PduRDestPduPduRBswModulesRef = Com
            PduRSrcPdu_3e9ce6c9 (PduRSrcPdu): PduRSourcePduHandleId=88, PduRSrcPduDirection=RECEIVE, PduRSrcPduRef=FSP2_Frame_L1_oLIN00_b95ec9fd_Rx, PduRSrcPduPduRBswModulesRef=LinIf
          Backlight_FuncInd_L1_oLIN00_6273f3b1_Tx: PduRRoutingPathCommunicationType=COMMUNICATION_INTERFACE
            Backlight_FuncInd_L1_oLIN00_841aab0e_Tx (PduRDestPdu):
              PduRDestPduHandleId = 8
              PduRDestPduDirection = TRANSMIT
              PduRDestPduRoutingType = API_FORWARDING
              PduRDestPduDataProcessing = IMMEDIATE
              PduRPduLengthHandlingStrategy = UNUSED
              PduRDestPduDataProvision = PDUR_TRIGGERTRANSMIT
              PduRTransmissionConfirmation = true
              PduRDestPduRef = Backlight_FuncInd_L1_oLIN00_841aab0e_Tx
              PduRDestPduPduRBswModulesRef = LinIf
            PduRSrcPdu_ba427217 (PduRSrcPdu): PduRSourcePduHandleId=6, PduRSrcPduDirection=TRANSMIT, PduRSrcPduRef=Backlight_FuncInd_L1_oLIN00_6273f3b1_Tx, PduRSrcPduPduRBswModulesRef=Com
          SlaveResp_FSP2_L1_oLIN00_4ba91c50_Rx: PduRRoutingPathCommunicationType=TRANSPORT_PROTOCOL
            PduRSrcPdu_f7959d8f (PduRSrcPdu): PduRSourcePduHandleId=76, PduRSrcPduDirection=RECEIVE, PduRSrcPduRef=SlaveResp_FSP2_L1_oLIN00_4ba91c50_Rx, PduRSrcPduPduRBswModulesRef=LinTp
            SlaveResp_FSP2_L1_oLIN00_4ba91c50_Rx_f7959d8f_Rx (PduRDestPdu):
              PduRDestPduHandleId = 31
              PduRDestPduDirection = RECEIVE
              PduRDestPduRoutingType = API_FORWARDING
              PduRDestPduDataProcessing = IMMEDIATE
              PduRPduLengthHandlingStrategy = UNUSED
              PduRDestPduRef = SlaveResp_FSP2_L1_oLIN00_fbe95799_Rx
              PduRDestPduPduRBswModulesRef = Cdd
          CIOMtoSlaves1_L1_oLIN00_8b7527bd_Tx: PduRRoutingPathCommunicationType=COMMUNICATION_INTERFACE
            PduRSrcPdu_1f9a8949 (PduRSrcPdu): PduRSourcePduHandleId=80, PduRSrcPduDirection=TRANSMIT, PduRSrcPduRef=CIOMtoSlaves1_L1_oLIN00_8b7527bd_Tx, PduRSrcPduPduRBswModulesRef=Com
            CIOMtoSlaves1_L1_oLIN00_09e24f2a_Tx (PduRDestPdu):
              PduRDestPduHandleId = 62
              PduRDestPduDirection = TRANSMIT
              PduRDestPduRoutingType = API_FORWARDING
              PduRDestPduDataProcessing = IMMEDIATE
              PduRPduLengthHandlingStrategy = UNUSED
              PduRDestPduDataProvision = PDUR_TRIGGERTRANSMIT
              PduRTransmissionConfirmation = true
              PduRDestPduRef = CIOMtoSlaves1_L1_oLIN00_09e24f2a_Tx
              PduRDestPduPduRBswModulesRef = LinIf
          MasterReq_FSP1_L1_oLIN00_2de78d2a_Tx: PduRRoutingPathCommunicationType=TRANSPORT_PROTOCOL
            MasterReq_FSP1_L1_oLIN00_e7dc451b_Tx (PduRDestPdu):
              PduRDestPduHandleId = 57
              PduRDestPduDirection = TRANSMIT
              PduRDestPduRoutingType = API_FORWARDING
              PduRDestPduDataProcessing = IMMEDIATE
              PduRPduLengthHandlingStrategy = UNUSED
              PduRDestPduRef = MasterReq_FSP1_L1_oLIN00_e7dc451b_Tx
              PduRDestPduPduRBswModulesRef = LinTp
            PduRSrcPdu_d25a31a4 (PduRSrcPdu): PduRSourcePduHandleId=150, PduRSrcPduDirection=TRANSMIT, PduRSrcPduRef=MasterReq_FSP1_L1_oLIN00_2de78d2a_Tx, PduRSrcPduPduRBswModulesRef=Cdd
          VDC2_X_EBS_oBackbone1J1939_58daf9b3_Rx: PduRRoutingPathCommunicationType=COMMUNICATION_INTERFACE
            PduRSrcPdu_ee4e9e34 (PduRSrcPdu): PduRSourcePduHandleId=139, PduRSrcPduDirection=RECEIVE, PduRSrcPduRef=VDC2_X_EBS_oBackbone1J1939_58daf9b3_Rx, PduRSrcPduPduRBswModulesRef=CanIf
            VDC2_X_EBS_oBackbone1J1939_58daf9b3_Rx_ee4e9e34_Rx (PduRDestPdu):
              PduRDestPduHandleId = 132
              PduRDestPduDirection = RECEIVE
              PduRDestPduRoutingType = API_FORWARDING
              PduRDestPduDataProcessing = IMMEDIATE
              PduRPduLengthHandlingStrategy = UNUSED
              PduRTransmissionConfirmation = false
              PduRDestPduRef = VDC2_X_EBS_oBackbone1J1939_2daadd24_Rx
              PduRDestPduPduRBswModulesRef = Com
          CCVS_X_VMCU_oBackbone1J1939_dd344e88_Rx: PduRRoutingPathCommunicationType=COMMUNICATION_INTERFACE
            CCVS_X_VMCU_oBackbone1J1939_dd344e88_Rx_2b017bd1_Rx (PduRDestPdu):
              PduRDestPduHandleId = 30
              PduRDestPduDirection = RECEIVE
              PduRDestPduRoutingType = API_FORWARDING
              PduRDestPduDataProcessing = IMMEDIATE
              PduRPduLengthHandlingStrategy = UNUSED
              PduRTransmissionConfirmation = false
              PduRDestPduRef = CCVS_X_VMCU_oBackbone1J1939_ebb768c1_Rx
              PduRDestPduPduRBswModulesRef = Com
            PduRSrcPdu_2b017bd1 (PduRSrcPdu): PduRSourcePduHandleId=30, PduRSrcPduDirection=RECEIVE, PduRSrcPduRef=CCVS_X_VMCU_oBackbone1J1939_dd344e88_Rx, PduRSrcPduPduRBswModulesRef=CanIf
          MasterReq_ILCP1_oLIN00_57efaae5_Tx: PduRRoutingPathCommunicationType=TRANSPORT_PROTOCOL
            PduRSrcPdu_811e958b (PduRSrcPdu): PduRSourcePduHandleId=160, PduRSrcPduDirection=TRANSMIT, PduRSrcPduRef=MasterReq_ILCP1_oLIN00_57efaae5_Tx, PduRSrcPduPduRBswModulesRef=Cdd
            MasterReq_ILCP1_oLIN00_0bff65a0_Tx (PduRDestPdu):
              PduRDestPduHandleId = 67
              PduRDestPduDirection = TRANSMIT
              PduRDestPduRoutingType = API_FORWARDING
              PduRDestPduDataProcessing = IMMEDIATE
              PduRPduLengthHandlingStrategy = UNUSED
              PduRDestPduRef = MasterReq_ILCP1_oLIN00_0bff65a0_Tx
              PduRDestPduPduRBswModulesRef = LinTp
          EBS_BB1_02P_oBackbone1J1939_3e5e858e_Rx: PduRRoutingPathCommunicationType=COMMUNICATION_INTERFACE
            EBS_BB1_02P_oBackbone1J1939_3e5e858e_Rx_df13874e_Rx (PduRDestPdu):
              PduRDestPduHandleId = 55
              PduRDestPduDirection = RECEIVE
              PduRDestPduRoutingType = API_FORWARDING
              PduRDestPduDataProcessing = IMMEDIATE
              PduRPduLengthHandlingStrategy = UNUSED
              PduRTransmissionConfirmation = false
              PduRDestPduRef = EBS_BB1_02P_oBackbone1J1939_24e5b628_Rx
              PduRDestPduPduRBswModulesRef = Com
            PduRSrcPdu_df13874e (PduRSrcPdu): PduRSourcePduHandleId=62, PduRSrcPduDirection=RECEIVE, PduRSrcPduRef=EBS_BB1_02P_oBackbone1J1939_3e5e858e_Rx, PduRSrcPduPduRBswModulesRef=CanIf
          ET1_X_EMS_oBackbone1J1939_2b7be601_Rx: PduRRoutingPathCommunicationType=COMMUNICATION_INTERFACE
            ET1_X_EMS_oBackbone1J1939_2b7be601_Rx_89ee5878_Rx (PduRDestPdu):
              PduRDestPduHandleId = 69
              PduRDestPduDirection = RECEIVE
              PduRDestPduRoutingType = API_FORWARDING
              PduRDestPduDataProcessing = IMMEDIATE
              PduRPduLengthHandlingStrategy = UNUSED
              PduRTransmissionConfirmation = false
              PduRDestPduRef = ET1_X_EMS_oBackbone1J1939_b4e1bda2_Rx
              PduRDestPduPduRBswModulesRef = Com
            PduRSrcPdu_89ee5878 (PduRSrcPdu): PduRSourcePduHandleId=76, PduRSrcPduDirection=RECEIVE, PduRSrcPduRef=ET1_X_EMS_oBackbone1J1939_2b7be601_Rx, PduRSrcPduPduRBswModulesRef=CanIf
          AMB_X_VMCU_oBackbone1J1939_52549913_Rx: PduRRoutingPathCommunicationType=COMMUNICATION_INTERFACE
            PduRSrcPdu_00ee91b2 (PduRSrcPdu): PduRSourcePduHandleId=2, PduRSrcPduDirection=RECEIVE, PduRSrcPduRef=AMB_X_VMCU_oBackbone1J1939_52549913_Rx, PduRSrcPduPduRBswModulesRef=CanIf
            AMB_X_VMCU_oBackbone1J1939_52549913_Rx_00ee91b2_Rx (PduRDestPdu):
              PduRDestPduHandleId = 2
              PduRDestPduDirection = RECEIVE
              PduRDestPduRoutingType = API_FORWARDING
              PduRDestPduDataProcessing = IMMEDIATE
              PduRPduLengthHandlingStrategy = UNUSED
              PduRTransmissionConfirmation = false
              PduRDestPduRef = AMB_X_VMCU_oBackbone1J1939_7e62cfad_Rx
              PduRDestPduPduRBswModulesRef = Com
          VDHR_X_VMCU_oBackbone1J1939_27498c2c_Rx: PduRRoutingPathCommunicationType=COMMUNICATION_INTERFACE
            PduRSrcPdu_44121a6e (PduRSrcPdu): PduRSourcePduHandleId=140, PduRSrcPduDirection=RECEIVE, PduRSrcPduRef=VDHR_X_VMCU_oBackbone1J1939_27498c2c_Rx, PduRSrcPduPduRBswModulesRef=CanIf
            VDHR_X_VMCU_oBackbone1J1939_27498c2c_Rx_44121a6e_Rx (PduRDestPdu):
              PduRDestPduHandleId = 133
              PduRDestPduDirection = RECEIVE
              PduRDestPduRoutingType = API_FORWARDING
              PduRDestPduDataProcessing = IMMEDIATE
              PduRPduLengthHandlingStrategy = UNUSED
              PduRTransmissionConfirmation = false
              PduRDestPduRef = VDHR_X_VMCU_oBackbone1J1939_fc2f75ee_Rx
              PduRDestPduPduRBswModulesRef = Com
          CVW_X_EBS_oBackbone1J1939_7745bc8f_Rx: PduRRoutingPathCommunicationType=COMMUNICATION_INTERFACE
            PduRSrcPdu_41192726 (PduRSrcPdu): PduRSourcePduHandleId=38, PduRSrcPduDirection=RECEIVE, PduRSrcPduRef=CVW_X_EBS_oBackbone1J1939_7745bc8f_Rx, PduRSrcPduPduRBswModulesRef=CanIf
            CVW_X_EBS_oBackbone1J1939_7745bc8f_Rx_41192726_Rx (PduRDestPdu):
              PduRDestPduHandleId = 31
              PduRDestPduDirection = RECEIVE
              PduRDestPduRoutingType = API_FORWARDING
              PduRDestPduDataProcessing = IMMEDIATE
              PduRPduLengthHandlingStrategy = UNUSED
              PduRTransmissionConfirmation = false
              PduRDestPduRef = CVW_X_EBS_oBackbone1J1939_1a9bdeb1_Rx
              PduRDestPduPduRBswModulesRef = Com
          SlaveResp_ILCP1_oLIN00_ffca61fb_Rx: PduRRoutingPathCommunicationType=TRANSPORT_PROTOCOL
            SlaveResp_ILCP1_oLIN00_ffca61fb_Rx_a0f8dbfb_Rx (PduRDestPdu):
              PduRDestPduHandleId = 36
              PduRDestPduDirection = RECEIVE
              PduRDestPduRoutingType = API_FORWARDING
              PduRDestPduDataProcessing = IMMEDIATE
              PduRPduLengthHandlingStrategy = UNUSED
              PduRDestPduRef = SlaveResp_ILCP1_oLIN00_1a12ec88_Rx
              PduRDestPduPduRBswModulesRef = Cdd
            PduRSrcPdu_a0f8dbfb (PduRSrcPdu): PduRSourcePduHandleId=81, PduRSrcPduDirection=RECEIVE, PduRSrcPduRef=SlaveResp_ILCP1_oLIN00_ffca61fb_Rx, PduRSrcPduPduRBswModulesRef=LinTp
          LECM2toCIOM_FR3_L1_oLIN00_4f918e53_Rx: PduRRoutingPathCommunicationType=COMMUNICATION_INTERFACE
            LECM2toCIOM_FR3_L1_oLIN00_4f918e53_Rx_73b12bc9_Rx (PduRDestPdu):
              PduRDestPduHandleId = 115
              PduRDestPduDirection = RECEIVE
              PduRDestPduRoutingType = API_FORWARDING
              PduRDestPduDataProcessing = IMMEDIATE
              PduRPduLengthHandlingStrategy = UNUSED
              PduRTransmissionConfirmation = false
              PduRDestPduRef = LECM2toCIOM_FR3_L1_oLIN00_64a72e2e_Rx
              PduRDestPduPduRBswModulesRef = Com
            PduRSrcPdu_73b12bc9 (PduRSrcPdu): PduRSourcePduHandleId=122, PduRSrcPduDirection=RECEIVE, PduRSrcPduRef=LECM2toCIOM_FR3_L1_oLIN00_4f918e53_Rx, PduRSrcPduPduRBswModulesRef=LinIf
          LECM2toCIOM_FR1_L1_oLIN00_5adbc53c_Rx: PduRRoutingPathCommunicationType=COMMUNICATION_INTERFACE
            PduRSrcPdu_8cd02125 (PduRSrcPdu): PduRSourcePduHandleId=120, PduRSrcPduDirection=RECEIVE, PduRSrcPduRef=LECM2toCIOM_FR1_L1_oLIN00_5adbc53c_Rx, PduRSrcPduPduRBswModulesRef=LinIf
            LECM2toCIOM_FR1_L1_oLIN00_5adbc53c_Rx_8cd02125_Rx (PduRDestPdu):
              PduRDestPduHandleId = 113
              PduRDestPduDirection = RECEIVE
              PduRDestPduRoutingType = API_FORWARDING
              PduRDestPduDataProcessing = IMMEDIATE
              PduRPduLengthHandlingStrategy = UNUSED
              PduRTransmissionConfirmation = false
              PduRDestPduRef = LECM2toCIOM_FR1_L1_oLIN00_3ccb97ef_Rx
              PduRDestPduPduRBswModulesRef = Com
          SlaveResp_LECMBasic_oLIN00_30a28bed_Rx: PduRRoutingPathCommunicationType=TRANSPORT_PROTOCOL
            PduRSrcPdu_3b8e8c69 (PduRSrcPdu): PduRSourcePduHandleId=84, PduRSrcPduDirection=RECEIVE, PduRSrcPduRef=SlaveResp_LECMBasic_oLIN00_30a28bed_Rx, PduRSrcPduPduRBswModulesRef=LinTp
            SlaveResp_LECMBasic_oLIN00_30a28bed_Rx_3b8e8c69_Rx (PduRDestPdu):
              PduRDestPduHandleId = 39
              PduRDestPduDirection = RECEIVE
              PduRDestPduRoutingType = API_FORWARDING
              PduRDestPduDataProcessing = IMMEDIATE
              PduRPduLengthHandlingStrategy = UNUSED
              PduRDestPduRef = SlaveResp_LECMBasic_oLIN00_029997c6_Rx
              PduRDestPduPduRBswModulesRef = Cdd
          CIOMtoSlaves2_FR1_L1_oLIN00_dfa25815_Tx: PduRRoutingPathCommunicationType=COMMUNICATION_INTERFACE
            PduRSrcPdu_cff258d1 (PduRSrcPdu): PduRSourcePduHandleId=82, PduRSrcPduDirection=TRANSMIT, PduRSrcPduRef=CIOMtoSlaves2_FR1_L1_oLIN00_dfa25815_Tx, PduRSrcPduPduRBswModulesRef=Com
            CIOMtoSlaves2_FR1_L1_oLIN00_573c3f76_Tx (PduRDestPdu):
              PduRDestPduHandleId = 64
              PduRDestPduDirection = TRANSMIT
              PduRDestPduRoutingType = API_FORWARDING
              PduRDestPduDataProcessing = IMMEDIATE
              PduRPduLengthHandlingStrategy = UNUSED
              PduRDestPduDataProvision = PDUR_TRIGGERTRANSMIT
              PduRTransmissionConfirmation = false
              PduRDestPduRef = CIOMtoSlaves2_FR1_L1_oLIN00_573c3f76_Tx
              PduRDestPduPduRBswModulesRef = LinIf
          VMCU_BB1_03P_oBackbone1J1939_eacbdc5a_Rx: PduRRoutingPathCommunicationType=COMMUNICATION_INTERFACE
            VMCU_BB1_03P_oBackbone1J1939_eacbdc5a_Rx_62ecd252_Rx (PduRDestPdu):
              PduRDestPduHandleId = 135
              PduRDestPduDirection = RECEIVE
              PduRDestPduRoutingType = API_FORWARDING
              PduRDestPduDataProcessing = IMMEDIATE
              PduRPduLengthHandlingStrategy = UNUSED
              PduRTransmissionConfirmation = false
              PduRDestPduRef = VMCU_BB1_03P_oBackbone1J1939_f0f726c1_Rx
              PduRDestPduPduRBswModulesRef = Com
            PduRSrcPdu_62ecd252 (PduRSrcPdu): PduRSourcePduHandleId=142, PduRSrcPduDirection=RECEIVE, PduRSrcPduRef=VMCU_BB1_03P_oBackbone1J1939_eacbdc5a_Rx, PduRSrcPduPduRBswModulesRef=CanIf
          CIOMtoSlaves2_FR3_L1_oLIN00_87cee1d4_Tx: PduRRoutingPathCommunicationType=COMMUNICATION_INTERFACE
            CIOMtoSlaves2_FR3_L1_oLIN00_42767419_Tx (PduRDestPdu):
              PduRDestPduHandleId = 66
              PduRDestPduDirection = TRANSMIT
              PduRDestPduRoutingType = API_FORWARDING
              PduRDestPduDataProcessing = IMMEDIATE
              PduRPduLengthHandlingStrategy = UNUSED
              PduRDestPduDataProvision = PDUR_TRIGGERTRANSMIT
              PduRTransmissionConfirmation = false
              PduRDestPduRef = CIOMtoSlaves2_FR3_L1_oLIN00_42767419_Tx
              PduRDestPduPduRBswModulesRef = LinIf
            PduRSrcPdu_3b966455 (PduRSrcPdu): PduRSourcePduHandleId=84, PduRSrcPduDirection=TRANSMIT, PduRSrcPduRef=CIOMtoSlaves2_FR3_L1_oLIN00_87cee1d4_Tx, PduRSrcPduPduRBswModulesRef=Com
          FSP1_Frame_L1_oLIN00_7041c142_Rx: PduRRoutingPathCommunicationType=COMMUNICATION_INTERFACE
            FSP1_Frame_L1_oLIN00_7041c142_Rx_e89970ce_Rx (PduRDestPdu):
              PduRDestPduHandleId = 71
              PduRDestPduDirection = RECEIVE
              PduRDestPduRoutingType = API_FORWARDING
              PduRDestPduDataProcessing = IMMEDIATE
              PduRPduLengthHandlingStrategy = UNUSED
              PduRTransmissionConfirmation = false
              PduRDestPduRef = FSP1_Frame_L1_oLIN00_7e067bd3_Rx
              PduRDestPduPduRBswModulesRef = Com
            PduRSrcPdu_e89970ce (PduRSrcPdu): PduRSourcePduHandleId=78, PduRSrcPduDirection=RECEIVE, PduRSrcPduRef=FSP1_Frame_L1_oLIN00_7041c142_Rx, PduRSrcPduPduRBswModulesRef=LinIf
          CIOM_BB1_01P_oBackbone1J1939_83fef105_Tx: PduRRoutingPathCommunicationType=COMMUNICATION_INTERFACE
            CIOM_BB1_01P_oBackbone1J1939_6c85c28e_Tx (PduRDestPdu):
              PduRDestPduHandleId = 14
              PduRDestPduDirection = TRANSMIT
              PduRDestPduRoutingType = API_FORWARDING
              PduRDestPduDataProcessing = IMMEDIATE
              PduRPduLengthHandlingStrategy = UNUSED
              PduRDestPduDataProvision = PDUR_DIRECT
              PduRTransmissionConfirmation = false
              PduRDestPduRef = CIOM_BB1_01P_oBackbone1J1939_6c85c28e_Tx
              PduRDestPduPduRBswModulesRef = CanIf
            PduRSrcPdu_60849a09 (PduRSrcPdu): PduRSourcePduHandleId=12, PduRSrcPduDirection=TRANSMIT, PduRSrcPduRef=CIOM_BB1_01P_oBackbone1J1939_83fef105_Tx, PduRSrcPduPduRBswModulesRef=Com
          TCO1_X_TACHO_oBackbone1J1939_3f1c366d_Rx: PduRRoutingPathCommunicationType=COMMUNICATION_INTERFACE
            TCO1_X_TACHO_oBackbone1J1939_3f1c366d_Rx_2b492f9e_Rx (PduRDestPdu):
              PduRDestPduHandleId = 127
              PduRDestPduDirection = RECEIVE
              PduRDestPduRoutingType = API_FORWARDING
              PduRDestPduDataProcessing = IMMEDIATE
              PduRPduLengthHandlingStrategy = UNUSED
              PduRTransmissionConfirmation = false
              PduRDestPduRef = TCO1_X_TACHO_oBackbone1J1939_9ce49b57_Rx
              PduRDestPduPduRBswModulesRef = Com
            PduRSrcPdu_2b492f9e (PduRSrcPdu): PduRSourcePduHandleId=134, PduRSrcPduDirection=RECEIVE, PduRSrcPduRef=TCO1_X_TACHO_oBackbone1J1939_3f1c366d_Rx, PduRSrcPduPduRBswModulesRef=CanIf
          EBC1_X_EBS_oBackbone1J1939_0f6d94fb_Rx: PduRRoutingPathCommunicationType=COMMUNICATION_INTERFACE
            EBC1_X_EBS_oBackbone1J1939_0f6d94fb_Rx_04f9144d_Rx (PduRDestPdu):
              PduRDestPduHandleId = 51
              PduRDestPduDirection = RECEIVE
              PduRDestPduRoutingType = API_FORWARDING
              PduRDestPduDataProcessing = IMMEDIATE
              PduRPduLengthHandlingStrategy = UNUSED
              PduRTransmissionConfirmation = false
              PduRDestPduRef = EBC1_X_EBS_oBackbone1J1939_68913e3f_Rx
              PduRDestPduPduRBswModulesRef = Com
            PduRSrcPdu_04f9144d (PduRSrcPdu): PduRSourcePduHandleId=58, PduRSrcPduDirection=RECEIVE, PduRSrcPduRef=EBC1_X_EBS_oBackbone1J1939_0f6d94fb_Rx, PduRSrcPduPduRBswModulesRef=CanIf
          PropTCO2_X_TACHO_oBackbone1J1939_4169b979_Rx: PduRRoutingPathCommunicationType=TRANSPORT_PROTOCOL
            PropTCO2_X_TACHO_oBackbone1J1939_4169b979_Rx_9d957b7c_Rx (PduRDestPdu):
              PduRDestPduHandleId = 21
              PduRDestPduDirection = RECEIVE
              PduRDestPduRoutingType = API_FORWARDING
              PduRDestPduDataProcessing = IMMEDIATE
              PduRPduLengthHandlingStrategy = UNUSED
              PduRDestPduRef = PropTCO2_X_TACHO_oBackbone1J1939_d2ebdcdb_Rx
              PduRDestPduPduRBswModulesRef = Com
            PduRSrcPdu_9d957b7c (PduRSrcPdu):
              PduRSourcePduHandleId = 66
              PduRSrcPduDirection = RECEIVE
              PduRSrcPduRef = PropTCO2_X_TACHO_oBackbone1J1939_4169b979_Rx
              PduRSrcPduPduRBswModulesRef = J1939Tp
          SlaveResp_FSP1_L1_oLIN00_b9fef1a8_Rx: PduRRoutingPathCommunicationType=TRANSPORT_PROTOCOL
            PduRSrcPdu_99747a0b (PduRSrcPdu): PduRSourcePduHandleId=71, PduRSrcPduDirection=RECEIVE, PduRSrcPduRef=SlaveResp_FSP1_L1_oLIN00_b9fef1a8_Rx, PduRSrcPduPduRBswModulesRef=LinTp
            SlaveResp_FSP1_L1_oLIN00_b9fef1a8_Rx_99747a0b_Rx (PduRDestPdu):
              PduRDestPduHandleId = 26
              PduRDestPduDirection = RECEIVE
              PduRDestPduRoutingType = API_FORWARDING
              PduRDestPduDataProcessing = IMMEDIATE
              PduRPduLengthHandlingStrategy = UNUSED
              PduRDestPduRef = SlaveResp_FSP1_L1_oLIN00_620b3198_Rx
              PduRDestPduPduRBswModulesRef = Cdd
          EBC5_X_EBS_oBackbone1J1939_71f8bf2e_Rx: PduRRoutingPathCommunicationType=COMMUNICATION_INTERFACE
            PduRSrcPdu_be9b2da1 (PduRSrcPdu): PduRSourcePduHandleId=60, PduRSrcPduDirection=RECEIVE, PduRSrcPduRef=EBC5_X_EBS_oBackbone1J1939_71f8bf2e_Rx, PduRSrcPduPduRBswModulesRef=CanIf
            EBC5_X_EBS_oBackbone1J1939_71f8bf2e_Rx_be9b2da1_Rx (PduRDestPdu):
              PduRDestPduHandleId = 53
              PduRDestPduDirection = RECEIVE
              PduRDestPduRoutingType = API_FORWARDING
              PduRDestPduDataProcessing = IMMEDIATE
              PduRPduLengthHandlingStrategy = UNUSED
              PduRTransmissionConfirmation = false
              PduRDestPduRef = EBC5_X_EBS_oBackbone1J1939_68cd9fac_Rx
              PduRDestPduPduRBswModulesRef = Com
          FSP2_SwitchDetResp_L1_oLIN00_8c08f040_Rx: PduRRoutingPathCommunicationType=COMMUNICATION_INTERFACE
            FSP2_SwitchDetResp_L1_oLIN00_8c08f040_Rx_807c58f3_Rx (PduRDestPdu):
              PduRDestPduHandleId = 84
              PduRDestPduDirection = RECEIVE
              PduRDestPduRoutingType = API_FORWARDING
              PduRDestPduDataProcessing = IMMEDIATE
              PduRPduLengthHandlingStrategy = UNUSED
              PduRTransmissionConfirmation = false
              PduRDestPduRef = FSP2_SwitchDetResp_L1_oLIN00_eee93560_Rx
              PduRDestPduPduRBswModulesRef = Com
            PduRSrcPdu_807c58f3 (PduRSrcPdu): PduRSourcePduHandleId=91, PduRSrcPduDirection=RECEIVE, PduRSrcPduRef=FSP2_SwitchDetResp_L1_oLIN00_8c08f040_Rx, PduRSrcPduPduRBswModulesRef=LinIf
          FSP_1_2_Req_L1_oLIN00_6846650e_Tx: PduRRoutingPathCommunicationType=COMMUNICATION_INTERFACE
            PduRSrcPdu_061b4d4d (PduRSrcPdu): PduRSourcePduHandleId=136, PduRSrcPduDirection=TRANSMIT, PduRSrcPduRef=FSP_1_2_Req_L1_oLIN00_6846650e_Tx, PduRSrcPduPduRBswModulesRef=Com
            FSP_1_2_Req_L1_oLIN00_bfd0179c_Tx (PduRDestPdu):
              PduRDestPduHandleId = 122
              PduRDestPduDirection = TRANSMIT
              PduRDestPduRoutingType = API_FORWARDING
              PduRDestPduDataProcessing = IMMEDIATE
              PduRPduLengthHandlingStrategy = UNUSED
              PduRDestPduDataProvision = PDUR_TRIGGERTRANSMIT
              PduRTransmissionConfirmation = true
              PduRDestPduRef = FSP_1_2_Req_L1_oLIN00_bfd0179c_Tx
              PduRDestPduPduRBswModulesRef = LinIf
          TD_X_HMIIOM_oBackbone1J1939_5060289e_Rx: PduRRoutingPathCommunicationType=COMMUNICATION_INTERFACE
            PduRSrcPdu_69dcd8e6 (PduRSrcPdu): PduRSourcePduHandleId=136, PduRSrcPduDirection=RECEIVE, PduRSrcPduRef=TD_X_HMIIOM_oBackbone1J1939_5060289e_Rx, PduRSrcPduPduRBswModulesRef=CanIf
            TD_X_HMIIOM_oBackbone1J1939_5060289e_Rx_69dcd8e6_Rx (PduRDestPdu):
              PduRDestPduHandleId = 129
              PduRDestPduDirection = RECEIVE
              PduRDestPduRoutingType = API_FORWARDING
              PduRDestPduDataProcessing = IMMEDIATE
              PduRPduLengthHandlingStrategy = UNUSED
              PduRTransmissionConfirmation = false
              PduRDestPduRef = TD_X_HMIIOM_oBackbone1J1939_221848c4_Rx
              PduRDestPduPduRBswModulesRef = Com
          AIR1_X_VMCU_oBackbone1J1939_276eaeb8_Rx: PduRRoutingPathCommunicationType=COMMUNICATION_INTERFACE
            PduRSrcPdu_66b8580e (PduRSrcPdu): PduRSourcePduHandleId=1, PduRSrcPduDirection=RECEIVE, PduRSrcPduRef=AIR1_X_VMCU_oBackbone1J1939_276eaeb8_Rx, PduRSrcPduPduRBswModulesRef=CanIf
            AIR1_X_VMCU_oBackbone1J1939_276eaeb8_Rx_66b8580e_Rx (PduRDestPdu):
              PduRDestPduHandleId = 1
              PduRDestPduDirection = RECEIVE
              PduRDestPduRoutingType = API_FORWARDING
              PduRDestPduDataProcessing = IMMEDIATE
              PduRPduLengthHandlingStrategy = UNUSED
              PduRTransmissionConfirmation = false
              PduRDestPduRef = AIR1_X_VMCU_oBackbone1J1939_8c40baab_Rx
              PduRDestPduPduRBswModulesRef = Com
          LFE_X_EMS_oBackbone1J1939_8a36c848_Rx: PduRRoutingPathCommunicationType=COMMUNICATION_INTERFACE
            LFE_X_EMS_oBackbone1J1939_8a36c848_Rx_2d2f558b_Rx (PduRDestPdu):
              PduRDestPduHandleId = 117
              PduRDestPduDirection = RECEIVE
              PduRDestPduRoutingType = API_FORWARDING
              PduRDestPduDataProcessing = IMMEDIATE
              PduRPduLengthHandlingStrategy = UNUSED
              PduRTransmissionConfirmation = false
              PduRDestPduRef = LFE_X_EMS_oBackbone1J1939_9d303f5e_Rx
              PduRDestPduPduRBswModulesRef = Com
            PduRSrcPdu_2d2f558b (PduRSrcPdu): PduRSourcePduHandleId=124, PduRSrcPduDirection=RECEIVE, PduRSrcPduRef=LFE_X_EMS_oBackbone1J1939_8a36c848_Rx, PduRSrcPduPduRBswModulesRef=CanIf
          HRLFC_X_EMS_oBackbone1J1939_04c7cc2f_Rx: PduRRoutingPathCommunicationType=COMMUNICATION_INTERFACE
            HRLFC_X_EMS_oBackbone1J1939_04c7cc2f_Rx_1a2533ca_Rx (PduRDestPdu):
              PduRDestPduHandleId = 103
              PduRDestPduDirection = RECEIVE
              PduRDestPduRoutingType = API_FORWARDING
              PduRDestPduDataProcessing = IMMEDIATE
              PduRPduLengthHandlingStrategy = UNUSED
              PduRTransmissionConfirmation = false
              PduRDestPduRef = HRLFC_X_EMS_oBackbone1J1939_e671f1b7_Rx
              PduRDestPduPduRBswModulesRef = Com
            PduRSrcPdu_1a2533ca (PduRSrcPdu): PduRSourcePduHandleId=110, PduRSrcPduDirection=RECEIVE, PduRSrcPduRef=HRLFC_X_EMS_oBackbone1J1939_04c7cc2f_Rx, PduRSrcPduPduRBswModulesRef=CanIf
          ILCP1toCIOM_L1_oLIN00_dd00be4f_Rx: PduRRoutingPathCommunicationType=COMMUNICATION_INTERFACE
            PduRSrcPdu_c4212af7 (PduRSrcPdu): PduRSourcePduHandleId=114, PduRSrcPduDirection=RECEIVE, PduRSrcPduRef=ILCP1toCIOM_L1_oLIN00_dd00be4f_Rx, PduRSrcPduPduRBswModulesRef=LinIf
            ILCP1toCIOM_L1_oLIN00_dd00be4f_Rx_c4212af7_Rx (PduRDestPdu):
              PduRDestPduHandleId = 107
              PduRDestPduDirection = RECEIVE
              PduRDestPduRoutingType = API_FORWARDING
              PduRDestPduDataProcessing = IMMEDIATE
              PduRPduLengthHandlingStrategy = UNUSED
              PduRTransmissionConfirmation = false
              PduRDestPduRef = ILCP1toCIOM_L1_oLIN00_0eedb06b_Rx
              PduRDestPduPduRBswModulesRef = Com
          PduRRoutingPath: PduRRoutingPathCommunicationType=COMMUNICATION_INTERFACE
            PduRDestPdu:
              PduRDestPduHandleId = 3
              PduRDestPduDirection = TRANSMIT
              PduRDestPduRoutingType = API_FORWARDING
              PduRDestPduDataProcessing = IMMEDIATE
              PduRPduLengthHandlingStrategy = UNUSED
              PduRTransmissionConfirmation = true
              PduRDestPduDataProvision = PDUR_DIRECT
              PduRDestPduRef = AckmTxPdu_Backbone1J1939_54966c1b
              PduRDestPduPduRBswModulesRef = CanIf
            PduRSrcPdu: PduRSourcePduHandleId=173, PduRSrcPduDirection=TRANSMIT, PduRSrcPduRef=AckmTxPdu_Backbone1J1939_54966c1b, PduRSrcPduPduRBswModulesRef=J1939Rm
          PduRRoutingPath_001: PduRRoutingPathCommunicationType=COMMUNICATION_INTERFACE
            PduRDestPdu_1 (PduRDestPdu):
              PduRDestPduHandleId = 120
              PduRDestPduDirection = RECEIVE
              PduRDestPduRoutingType = API_FORWARDING
              PduRDestPduDataProcessing = IMMEDIATE
              PduRPduLengthHandlingStrategy = UNUSED
              PduRTransmissionConfirmation = false
              PduRDestPduRef = RqstRxPdu_Backbone1J1939_54966c1b
              PduRDestPduPduRBswModulesRef = J1939Rm
            PduRSrcPdu_1 (PduRSrcPdu): PduRSourcePduHandleId=126, PduRSrcPduDirection=RECEIVE, PduRSrcPduRef=RqstRxPdu_Backbone1J1939_54966c1b, PduRSrcPduPduRBswModulesRef=CanIf
          Backlight_FuncInd_L5_oLIN04_e1543952_Tx: PduRRoutingPathCommunicationType=COMMUNICATION_INTERFACE
            Backlight_FuncInd_L5_oLIN04_571a8203_Tx (PduRDestPdu):
              PduRDestPduHandleId = 12
              PduRDestPduDirection = TRANSMIT
              PduRDestPduRoutingType = API_FORWARDING
              PduRDestPduDataProcessing = IMMEDIATE
              PduRPduLengthHandlingStrategy = UNUSED
              PduRTransmissionConfirmation = false
              PduRDestPduDataProvision = PDUR_TRIGGERTRANSMIT
              PduRDestPduRef = Backlight_FuncInd_L5_oLIN04_571a8203_Tx
              PduRDestPduPduRBswModulesRef = LinIf
            PduRSrcPdu_52be8b22 (PduRSrcPdu): PduRSourcePduHandleId=10, PduRSrcPduDirection=TRANSMIT, PduRSrcPduRef=Backlight_FuncInd_L5_oLIN04_e1543952_Tx, PduRSrcPduPduRBswModulesRef=Com
          SlaveResp_ELCP2_oLIN03_9a2d0041_Rx: PduRRoutingPathCommunicationType=TRANSPORT_PROTOCOL
            PduRSrcPdu_1e24ebac (PduRSrcPdu): PduRSourcePduHandleId=70, PduRSrcPduDirection=RECEIVE, PduRSrcPduRef=SlaveResp_ELCP2_oLIN03_9a2d0041_Rx, PduRSrcPduPduRBswModulesRef=LinTp
            SlaveResp_ELCP2_oLIN03_9a2d0041_Rx_1e24ebac_Rx (PduRDestPdu):
              PduRDestPduHandleId = 25
              PduRDestPduDirection = RECEIVE
              PduRDestPduRoutingType = API_FORWARDING
              PduRDestPduDataProcessing = IMMEDIATE
              PduRPduLengthHandlingStrategy = UNUSED
              PduRDestPduRef = SlaveResp_ELCP2_oLIN03_089ef750_Rx
              PduRDestPduPduRBswModulesRef = Cdd
          CCFWtoCIOM_L4_oLIN03_65063ac5_Rx: PduRRoutingPathCommunicationType=COMMUNICATION_INTERFACE
            PduRSrcPdu_c27f66fb (PduRSrcPdu): PduRSourcePduHandleId=24, PduRSrcPduDirection=RECEIVE, PduRSrcPduRef=CCFWtoCIOM_L4_oLIN03_65063ac5_Rx, PduRSrcPduPduRBswModulesRef=LinIf
            CCFWtoCIOM_L4_oLIN03_65063ac5_Rx_c27f66fb_Rx (PduRDestPdu):
              PduRDestPduHandleId = 24
              PduRDestPduDirection = RECEIVE
              PduRDestPduRoutingType = API_FORWARDING
              PduRDestPduDataProcessing = IMMEDIATE
              PduRPduLengthHandlingStrategy = UNUSED
              PduRTransmissionConfirmation = false
              PduRDestPduRef = CCFWtoCIOM_L4_oLIN03_c78ba01d_Rx
              PduRDestPduPduRBswModulesRef = Com
          AnmMsg_CIOM_CabSubnet_oCabSubnet_ce34173b_Tx: PduRRoutingPathCommunicationType=COMMUNICATION_INTERFACE
            AnmMsg_CIOM_CabSubnet_oCabSubnet_05b67d33_Tx (PduRDestPdu):
              PduRDestPduHandleId = 6
              PduRDestPduDirection = TRANSMIT
              PduRDestPduRoutingType = API_FORWARDING
              PduRDestPduDataProcessing = IMMEDIATE
              PduRPduLengthHandlingStrategy = UNUSED
              PduRDestPduDataProvision = PDUR_DIRECT
              PduRTransmissionConfirmation = false
              PduRDestPduRef = AnmMsg_CIOM_CabSubnet_oCabSubnet_05b67d33_Tx
              PduRDestPduPduRBswModulesRef = CanIf
            PduRSrcPdu_146f13b5 (PduRSrcPdu): PduRSourcePduHandleId=4, PduRSrcPduDirection=TRANSMIT, PduRSrcPduRef=AnmMsg_CIOM_CabSubnet_oCabSubnet_ce34173b_Tx, PduRSrcPduPduRBswModulesRef=Com
          FSP2_Frame_L2_oLIN01_16d451c7_Rx: PduRRoutingPathCommunicationType=COMMUNICATION_INTERFACE
            FSP2_Frame_L2_oLIN01_16d451c7_Rx_1d5f459f_Rx (PduRDestPdu):
              PduRDestPduHandleId = 82
              PduRDestPduDirection = RECEIVE
              PduRDestPduRoutingType = API_FORWARDING
              PduRDestPduDataProcessing = IMMEDIATE
              PduRPduLengthHandlingStrategy = UNUSED
              PduRTransmissionConfirmation = false
              PduRDestPduRef = FSP2_Frame_L2_oLIN01_d4141722_Rx
              PduRDestPduPduRBswModulesRef = Com
            PduRSrcPdu_1d5f459f (PduRSrcPdu): PduRSourcePduHandleId=89, PduRSrcPduDirection=RECEIVE, PduRSrcPduRef=FSP2_Frame_L2_oLIN01_16d451c7_Rx, PduRSrcPduPduRBswModulesRef=LinIf
          VMCU_BB2_74P_oBackbone2_df2392a0_Rx: PduRRoutingPathCommunicationType=COMMUNICATION_INTERFACE
            PduRSrcPdu_fc4f7394 (PduRSrcPdu): PduRSourcePduHandleId=159, PduRSrcPduDirection=RECEIVE, PduRSrcPduRef=VMCU_BB2_74P_oBackbone2_df2392a0_Rx, PduRSrcPduPduRBswModulesRef=CanIf
            VMCU_BB2_74P_oBackbone2_df2392a0_Rx_fc4f7394_Rx (PduRDestPdu):
              PduRDestPduHandleId = 152
              PduRDestPduDirection = RECEIVE
              PduRDestPduRoutingType = API_FORWARDING
              PduRDestPduDataProcessing = IMMEDIATE
              PduRPduLengthHandlingStrategy = UNUSED
              PduRTransmissionConfirmation = false
              PduRDestPduRef = VMCU_BB2_74P_oBackbone2_f23cc219_Rx
              PduRDestPduPduRBswModulesRef = Com
          Alarm_Sec_03S_oSecuritySubnet_4eba2ad4_Rx: PduRRoutingPathCommunicationType=TRANSPORT_PROTOCOL
            Alarm_Sec_03S_oSecuritySubnet_4eba2ad4_Rx_304197c1_Rx (PduRDestPdu):
              PduRDestPduHandleId = 0
              PduRDestPduDirection = RECEIVE
              PduRDestPduRoutingType = API_FORWARDING
              PduRDestPduDataProcessing = IMMEDIATE
              PduRPduLengthHandlingStrategy = UNUSED
              PduRDestPduRef = Alarm_Sec_03S_oSecuritySubnet_7f4118ec_Rx
              PduRDestPduPduRBswModulesRef = Com
            PduRSrcPdu_304197c1 (PduRSrcPdu): PduRSourcePduHandleId=0, PduRSrcPduDirection=RECEIVE, PduRSrcPduRef=Alarm_Sec_03S_oSecuritySubnet_4eba2ad4_Rx, PduRSrcPduPduRBswModulesRef=CanTp
          DiagFaultStat_PDM_Sec_oSecuritySubnet_7823c535_Rx: PduRRoutingPathCommunicationType=COMMUNICATION_INTERFACE
            PduRSrcPdu_2c5c2c9c (PduRSrcPdu):
              PduRSourcePduHandleId = 55
              PduRSrcPduDirection = RECEIVE
              PduRSrcPduRef = DiagFaultStat_PDM_Sec_oSecuritySubnet_7823c535_Rx
              PduRSrcPduPduRBswModulesRef = CanIf
            DiagFaultStat_PDM_Sec_oSecuritySubnet_7823c535_Rx_2c5c2c9c_Rx (PduRDestPdu):
              PduRDestPduHandleId = 48
              PduRDestPduDirection = RECEIVE
              PduRDestPduRoutingType = API_FORWARDING
              PduRDestPduDataProcessing = IMMEDIATE
              PduRPduLengthHandlingStrategy = UNUSED
              PduRTransmissionConfirmation = false
              PduRDestPduRef = DiagFaultStat_PDM_Sec_oSecuritySubnet_c777a720_Rx
              PduRDestPduPduRBswModulesRef = Com
          CIOM_10268b4b_Rx: PduRRoutingPathCommunicationType=TRANSPORT_PROTOCOL
            PduRSrcPdu_d9d30309 (PduRSrcPdu):
              PduRSourcePduHandleId = 32
              PduRSrcPduDirection = RECEIVE
              PduRSrcPduRef = PhysDiagRespMsg_F2_A2_Cab_oCabSubnet_b8616c85_Rx
              PduRSrcPduPduRBswModulesRef = CanTp
            CIOM_948b4abd_Tx (PduRDestPdu):
              PduRDestPduHandleId = 93
              PduRDestPduDirection = TRANSMIT
              PduRDestPduRoutingType = GATEWAY_ROUTING
              PduRDestPduDataProcessing = IMMEDIATE
              PduRPduLengthHandlingStrategy = UNUSED
              PduRDestPduQueueDepth = 4
              PduRTpThreshold = 1
              PduRDestPduRef = PhysDiagRespMsg_F2_A2_BB2_oBackbone2_3cccad73_Tx
              PduRDestPduPduRBswModulesRef = CanTp
          CIOM_BB2_25P_oBackbone2_27e35ba0_Tx: PduRRoutingPathCommunicationType=COMMUNICATION_INTERFACE
            PduRSrcPdu_0a421c29 (PduRSrcPdu): PduRSourcePduHandleId=26, PduRSrcPduDirection=TRANSMIT, PduRSrcPduRef=CIOM_BB2_25P_oBackbone2_27e35ba0_Tx, PduRSrcPduPduRBswModulesRef=Com
            CIOM_BB2_25P_oBackbone2_0e98c475_Tx (PduRDestPdu):
              PduRDestPduHandleId = 26
              PduRDestPduDirection = TRANSMIT
              PduRDestPduRoutingType = API_FORWARDING
              PduRDestPduDataProcessing = IMMEDIATE
              PduRPduLengthHandlingStrategy = UNUSED
              PduRDestPduDataProvision = PDUR_DIRECT
              PduRTransmissionConfirmation = false
              PduRDestPduRef = CIOM_BB2_25P_oBackbone2_0e98c475_Tx
              PduRDestPduPduRBswModulesRef = CanIf
          AnmMsg_ECUspare1_Backbone2_oBackbone2_00fe11e7_Rx: PduRRoutingPathCommunicationType=COMMUNICATION_INTERFACE
            AnmMsg_ECUspare1_Backbone2_oBackbone2_00fe11e7_Rx_06ff8b63_Rx (PduRDestPdu):
              PduRDestPduHandleId = 9
              PduRDestPduDirection = RECEIVE
              PduRDestPduRoutingType = API_FORWARDING
              PduRDestPduDataProcessing = IMMEDIATE
              PduRPduLengthHandlingStrategy = UNUSED
              PduRTransmissionConfirmation = false
              PduRDestPduRef = AnmMsg_ECUspare1_Backbone2_oBackbone2_90f829ea_Rx
              PduRDestPduPduRBswModulesRef = Com
            PduRSrcPdu_06ff8b63 (PduRSrcPdu):
              PduRSourcePduHandleId = 9
              PduRSrcPduDirection = RECEIVE
              PduRSrcPduRef = AnmMsg_ECUspare1_Backbone2_oBackbone2_00fe11e7_Rx
              PduRSrcPduPduRBswModulesRef = CanIf
          CIOM_Cab_11S_oCabSubnet_50a73c3b_Tx: PduRRoutingPathCommunicationType=TRANSPORT_PROTOCOL
            PduRSrcPdu_f4695c57 (PduRSrcPdu): PduRSourcePduHandleId=44, PduRSrcPduDirection=TRANSMIT, PduRSrcPduRef=CIOM_Cab_11S_oCabSubnet_50a73c3b_Tx, PduRSrcPduPduRBswModulesRef=Com
            CIOM_Cab_11S_oCabSubnet_c1389abd_Tx (PduRDestPdu):
              PduRDestPduHandleId = 5
              PduRDestPduDirection = TRANSMIT
              PduRDestPduRoutingType = API_FORWARDING
              PduRDestPduDataProcessing = IMMEDIATE
              PduRPduLengthHandlingStrategy = UNUSED
              PduRDestPduRef = CIOM_Cab_11S_oCabSubnet_c1389abd_Tx
              PduRDestPduPduRBswModulesRef = CanTp
          CIOM_92617c5f_Rx: PduRRoutingPathCommunicationType=TRANSPORT_PROTOCOL
            CIOM_16ccbda9_Tx (PduRDestPdu):
              PduRDestPduHandleId = 23
              PduRDestPduDirection = TRANSMIT
              PduRDestPduRoutingType = GATEWAY_ROUTING
              PduRDestPduDataProcessing = IMMEDIATE
              PduRPduLengthHandlingStrategy = UNUSED
              PduRDestPduQueueDepth = 4
              PduRTpThreshold = 1
              PduRDestPduRef = DiagReqMsgIntHMIIOM_98_F3_Cab_oCabSubnet_4bc610a1_Tx
              PduRDestPduPduRBswModulesRef = CanTp
            PduRSrcPdu_bfda77cf (PduRSrcPdu):
              PduRSourcePduHandleId = 34
              PduRSrcPduDirection = RECEIVE
              PduRSrcPduRef = DiagReqMsgIntHMIIOM_98_F3_BB2_oBackbone2_cf6bd157_Rx
              PduRSrcPduPduRBswModulesRef = CanTp
          DDM_Sec_01P_oSecuritySubnet_d2cc7529_Rx: PduRRoutingPathCommunicationType=COMMUNICATION_INTERFACE
            DDM_Sec_01P_oSecuritySubnet_d2cc7529_Rx_68f2dfe0_Rx (PduRDestPdu):
              PduRDestPduHandleId = 33
              PduRDestPduDirection = RECEIVE
              PduRDestPduRoutingType = API_FORWARDING
              PduRDestPduDataProcessing = IMMEDIATE
              PduRPduLengthHandlingStrategy = UNUSED
              PduRTransmissionConfirmation = false
              PduRDestPduRef = DDM_Sec_01P_oSecuritySubnet_40cf4e44_Rx
              PduRDestPduPduRBswModulesRef = Com
            PduRSrcPdu_68f2dfe0 (PduRSrcPdu): PduRSourcePduHandleId=40, PduRSrcPduDirection=RECEIVE, PduRSrcPduRef=DDM_Sec_01P_oSecuritySubnet_d2cc7529_Rx, PduRSrcPduPduRBswModulesRef=CanIf
          HMIIOM_BB2_08P_oBackbone2_184f4853_Rx: PduRRoutingPathCommunicationType=COMMUNICATION_INTERFACE
            HMIIOM_BB2_08P_oBackbone2_184f4853_Rx_284127f9_Rx (PduRDestPdu):
              PduRDestPduHandleId = 94
              PduRDestPduDirection = RECEIVE
              PduRDestPduRoutingType = API_FORWARDING
              PduRDestPduDataProcessing = IMMEDIATE
              PduRPduLengthHandlingStrategy = UNUSED
              PduRTransmissionConfirmation = false
              PduRDestPduRef = HMIIOM_BB2_08P_oBackbone2_ec19901e_Rx
              PduRDestPduPduRBswModulesRef = Com
            PduRSrcPdu_284127f9 (PduRSrcPdu): PduRSourcePduHandleId=101, PduRSrcPduDirection=RECEIVE, PduRSrcPduRef=HMIIOM_BB2_08P_oBackbone2_184f4853_Rx, PduRSrcPduPduRBswModulesRef=CanIf
          CIOM_d63e5ea1_Rx: PduRRoutingPathCommunicationType=TRANSPORT_PROTOCOL
            3 x PduRDestPdu, all with PduRDestPduDataProcessing=IMMEDIATE, PduRPduLengthHandlingStrategy=UNUSED:
              CIOM_52939f57_Tx: PduRDestPduHandleId=51, PduRDestPduDirection=TRANSMIT, PduRDestPduRoutingType=GATEWAY_ROUTING, PduRDestPduQueueDepth=2, PduRTpThreshold=7, PduRDestPduRef=IntTesterTGW2FuncDiagMsg_Cab_oCabSubnet_302595ad_Tx, PduRDestPduPduRBswModulesRef=CanTp
              CIOM_9aa9598b_Tx: PduRDestPduHandleId=52, PduRDestPduDirection=TRANSMIT, PduRDestPduRoutingType=GATEWAY_ROUTING, PduRDestPduQueueDepth=2, PduRTpThreshold=7, PduRDestPduRef=IntTesterTGW2FuncDiagMsg_Sec_oSecuritySubnet_04594da9_Tx, PduRDestPduPduRBswModulesRef=CanTp
              CIOM_d63e5ea1_Rx_446f53c1_Rx: PduRDestPduHandleId=17, PduRDestPduDirection=RECEIVE, PduRDestPduRoutingType=API_FORWARDING, PduRDestPduRef=IntTesterTGW2FuncDiagMsg_BB2_oBackbone2_5e7bda8e_Rx, PduRDestPduPduRBswModulesRef=Dcm
            PduRSrcPdu_446f53c1 (PduRSrcPdu):
              PduRSourcePduHandleId = 47
              PduRSrcPduDirection = RECEIVE
              PduRSrcPduRef = IntTesterTGW2FuncDiagMsg_BB2_oBackbone2_b488545b_Rx
              PduRSrcPduPduRBswModulesRef = CanTp
          HMIIOM_BB2_24P_oBackbone2_e73447cb_Rx: PduRRoutingPathCommunicationType=COMMUNICATION_INTERFACE
            HMIIOM_BB2_24P_oBackbone2_e73447cb_Rx_950739fa_Rx (PduRDestPdu):
              PduRDestPduHandleId = 98
              PduRDestPduDirection = RECEIVE
              PduRDestPduRoutingType = API_FORWARDING
              PduRDestPduDataProcessing = IMMEDIATE
              PduRPduLengthHandlingStrategy = UNUSED
              PduRTransmissionConfirmation = false
              PduRDestPduRef = HMIIOM_BB2_24P_oBackbone2_97cded48_Rx
              PduRDestPduPduRBswModulesRef = Com
            PduRSrcPdu_950739fa (PduRSrcPdu): PduRSourcePduHandleId=105, PduRSrcPduDirection=RECEIVE, PduRSrcPduRef=HMIIOM_BB2_24P_oBackbone2_e73447cb_Rx, PduRSrcPduPduRBswModulesRef=CanIf
          CIOM_Cab_02P_oCabSubnet_07fc6373_Tx: PduRRoutingPathCommunicationType=COMMUNICATION_INTERFACE
            CIOM_Cab_02P_oCabSubnet_2dfd3b82_Tx (PduRDestPdu):
              PduRDestPduHandleId = 34
              PduRDestPduDirection = TRANSMIT
              PduRDestPduRoutingType = API_FORWARDING
              PduRDestPduDataProcessing = IMMEDIATE
              PduRPduLengthHandlingStrategy = UNUSED
              PduRDestPduDataProvision = PDUR_DIRECT
              PduRTransmissionConfirmation = false
              PduRDestPduRef = CIOM_Cab_02P_oCabSubnet_2dfd3b82_Tx
              PduRDestPduPduRBswModulesRef = CanIf
            PduRSrcPdu_80862b22 (PduRSrcPdu): PduRSourcePduHandleId=35, PduRSrcPduDirection=TRANSMIT, PduRSrcPduRef=CIOM_Cab_02P_oCabSubnet_07fc6373_Tx, PduRSrcPduPduRBswModulesRef=Com
          FSP2_SwitchDetResp_L2_oLIN01_2382687a_Rx: PduRRoutingPathCommunicationType=COMMUNICATION_INTERFACE
            PduRSrcPdu_7877d56d (PduRSrcPdu): PduRSourcePduHandleId=92, PduRSrcPduDirection=RECEIVE, PduRSrcPduRef=FSP2_SwitchDetResp_L2_oLIN01_2382687a_Rx, PduRSrcPduPduRBswModulesRef=LinIf
            FSP2_SwitchDetResp_L2_oLIN01_2382687a_Rx_7877d56d_Rx (PduRDestPdu):
              PduRDestPduHandleId = 85
              PduRDestPduDirection = RECEIVE
              PduRDestPduRoutingType = API_FORWARDING
              PduRDestPduDataProcessing = IMMEDIATE
              PduRPduLengthHandlingStrategy = UNUSED
              PduRTransmissionConfirmation = false
              PduRDestPduRef = FSP2_SwitchDetResp_L2_oLIN01_17610215_Rx
              PduRDestPduPduRBswModulesRef = Com
          AnmMsg_CIOM_SecuritySubnet_oSecuritySubnet_1ca8dd7a_Tx: PduRRoutingPathCommunicationType=COMMUNICATION_INTERFACE
            PduRSrcPdu_d8682d70 (PduRSrcPdu):
              PduRSourcePduHandleId = 5
              PduRSrcPduDirection = TRANSMIT
              PduRSrcPduRef = AnmMsg_CIOM_SecuritySubnet_oSecuritySubnet_1ca8dd7a_Tx
              PduRSrcPduPduRBswModulesRef = Com
            AnmMsg_CIOM_SecuritySubnet_oSecuritySubnet_e244ca05_Tx (PduRDestPdu):
              PduRDestPduHandleId = 7
              PduRDestPduDirection = TRANSMIT
              PduRDestPduRoutingType = API_FORWARDING
              PduRDestPduDataProcessing = IMMEDIATE
              PduRPduLengthHandlingStrategy = UNUSED
              PduRDestPduDataProvision = PDUR_DIRECT
              PduRTransmissionConfirmation = false
              PduRDestPduRef = AnmMsg_CIOM_SecuritySubnet_oSecuritySubnet_e244ca05_Tx
              PduRDestPduPduRBswModulesRef = CanIf
          FSP3_SwitchDetResp_L2_oLIN01_8cc6fa3d_Rx: PduRRoutingPathCommunicationType=COMMUNICATION_INTERFACE
            FSP3_SwitchDetResp_L2_oLIN01_8cc6fa3d_Rx_1d7b2b95_Rx (PduRDestPdu):
              PduRDestPduHandleId = 88
              PduRDestPduDirection = RECEIVE
              PduRDestPduRoutingType = API_FORWARDING
              PduRDestPduDataProcessing = IMMEDIATE
              PduRPduLengthHandlingStrategy = UNUSED
              PduRTransmissionConfirmation = false
              PduRDestPduRef = FSP3_SwitchDetResp_L2_oLIN01_b2ea921b_Rx
              PduRDestPduPduRBswModulesRef = Com
            PduRSrcPdu_1d7b2b95 (PduRSrcPdu): PduRSourcePduHandleId=95, PduRSrcPduDirection=RECEIVE, PduRSrcPduRef=FSP3_SwitchDetResp_L2_oLIN01_8cc6fa3d_Rx, PduRSrcPduPduRBswModulesRef=LinIf
          SlaveResp_FSP3_L2_oLIN01_033e22fd_Rx: PduRRoutingPathCommunicationType=TRANSPORT_PROTOCOL
            SlaveResp_FSP3_L2_oLIN01_033e22fd_Rx_6b1d1eb8_Rx (PduRDestPdu):
              PduRDestPduHandleId = 34
              PduRDestPduDirection = RECEIVE
              PduRDestPduRoutingType = API_FORWARDING
              PduRDestPduDataProcessing = IMMEDIATE
              PduRPduLengthHandlingStrategy = UNUSED
              PduRDestPduRef = SlaveResp_FSP3_L2_oLIN01_c3efbf2c_Rx
              PduRDestPduPduRBswModulesRef = Cdd
            PduRSrcPdu_6b1d1eb8 (PduRSrcPdu): PduRSourcePduHandleId=79, PduRSrcPduDirection=RECEIVE, PduRSrcPduRef=SlaveResp_FSP3_L2_oLIN01_033e22fd_Rx, PduRSrcPduPduRBswModulesRef=LinTp
          EMS_BB2_06P_oBackbone2_fc9fee72_Rx: PduRRoutingPathCommunicationType=COMMUNICATION_INTERFACE
            EMS_BB2_06P_oBackbone2_fc9fee72_Rx_2a8059b0_Rx (PduRDestPdu):
              PduRDestPduHandleId = 64
              PduRDestPduDirection = RECEIVE
              PduRDestPduRoutingType = API_FORWARDING
              PduRDestPduDataProcessing = IMMEDIATE
              PduRPduLengthHandlingStrategy = UNUSED
              PduRTransmissionConfirmation = false
              PduRDestPduRef = EMS_BB2_06P_oBackbone2_a0e2fac3_Rx
              PduRDestPduPduRBswModulesRef = Com
            PduRSrcPdu_2a8059b0 (PduRSrcPdu): PduRSourcePduHandleId=71, PduRSrcPduDirection=RECEIVE, PduRSrcPduRef=EMS_BB2_06P_oBackbone2_fc9fee72_Rx, PduRSrcPduPduRBswModulesRef=CanIf
          VMCU_BB2_73P_oBackbone2_67b68035_Rx: PduRRoutingPathCommunicationType=COMMUNICATION_INTERFACE
            VMCU_BB2_73P_oBackbone2_67b68035_Rx_e01b8f9b_Rx (PduRDestPdu):
              PduRDestPduHandleId = 151
              PduRDestPduDirection = RECEIVE
              PduRDestPduRoutingType = API_FORWARDING
              PduRDestPduDataProcessing = IMMEDIATE
              PduRPduLengthHandlingStrategy = UNUSED
              PduRTransmissionConfirmation = false
              PduRDestPduRef = VMCU_BB2_73P_oBackbone2_8f4fc441_Rx
              PduRDestPduPduRBswModulesRef = Com
            PduRSrcPdu_e01b8f9b (PduRSrcPdu): PduRSourcePduHandleId=158, PduRSrcPduDirection=RECEIVE, PduRSrcPduRef=VMCU_BB2_73P_oBackbone2_67b68035_Rx, PduRSrcPduPduRBswModulesRef=CanIf
          CIOM_Cab_34P_oCabSubnet_db789975_Tx: PduRRoutingPathCommunicationType=TRANSPORT_PROTOCOL
            PduRSrcPdu_918dff20 (PduRSrcPdu): PduRSourcePduHandleId=67, PduRSrcPduDirection=TRANSMIT, PduRSrcPduRef=CIOM_Cab_34P_oCabSubnet_db789975_Tx, PduRSrcPduPduRBswModulesRef=Com
            CIOM_Cab_34P_oCabSubnet_3fa59da8_Tx (PduRDestPdu):
              PduRDestPduHandleId = 11
              PduRDestPduDirection = TRANSMIT
              PduRDestPduRoutingType = API_FORWARDING
              PduRDestPduDataProcessing = IMMEDIATE
              PduRPduLengthHandlingStrategy = UNUSED
              PduRDestPduRef = CIOM_Cab_34P_oCabSubnet_3fa59da8_Tx
              PduRDestPduPduRBswModulesRef = CanTp
          FSP_3_4_Req_L2_oLIN01_6708164e_Tx: PduRRoutingPathCommunicationType=COMMUNICATION_INTERFACE
            FSP_3_4_Req_L2_oLIN01_a1ddc883_Tx (PduRDestPdu):
              PduRDestPduHandleId = 127
              PduRDestPduDirection = TRANSMIT
              PduRDestPduRoutingType = API_FORWARDING
              PduRDestPduDataProcessing = IMMEDIATE
              PduRPduLengthHandlingStrategy = UNUSED
              PduRTransmissionConfirmation = false
              PduRDestPduDataProvision = PDUR_TRIGGERTRANSMIT
              PduRDestPduRef = FSP_3_4_Req_L2_oLIN01_a1ddc883_Tx
              PduRDestPduPduRBswModulesRef = LinIf
            PduRSrcPdu_01acc4de (PduRSrcPdu): PduRSourcePduHandleId=141, PduRSrcPduDirection=TRANSMIT, PduRSrcPduRef=FSP_3_4_Req_L2_oLIN01_6708164e_Tx, PduRSrcPduPduRBswModulesRef=Com
          CIOM_Cab_03P_oCabSubnet_da6abaf6_Tx: PduRRoutingPathCommunicationType=COMMUNICATION_INTERFACE
            PduRSrcPdu_cd66d79f (PduRSrcPdu): PduRSourcePduHandleId=36, PduRSrcPduDirection=TRANSMIT, PduRSrcPduRef=CIOM_Cab_03P_oCabSubnet_da6abaf6_Tx, PduRSrcPduPduRBswModulesRef=Com
            CIOM_Cab_03P_oCabSubnet_dc273e28_Tx (PduRDestPdu):
              PduRDestPduHandleId = 35
              PduRDestPduDirection = TRANSMIT
              PduRDestPduRoutingType = API_FORWARDING
              PduRDestPduDataProcessing = IMMEDIATE
              PduRPduLengthHandlingStrategy = UNUSED
              PduRDestPduDataProvision = PDUR_DIRECT
              PduRTransmissionConfirmation = false
              PduRDestPduRef = CIOM_Cab_03P_oCabSubnet_dc273e28_Tx
              PduRDestPduPduRBswModulesRef = CanIf
          HMIIOM_BB2_35S_oBackbone2_3334ebe1_Rx: PduRRoutingPathCommunicationType=TRANSPORT_PROTOCOL
            HMIIOM_BB2_35S_oBackbone2_3334ebe1_Rx_99763ffd_Rx (PduRDestPdu):
              PduRDestPduHandleId = 15
              PduRDestPduDirection = RECEIVE
              PduRDestPduRoutingType = API_FORWARDING
              PduRDestPduDataProcessing = IMMEDIATE
              PduRPduLengthHandlingStrategy = UNUSED
              PduRDestPduRef = HMIIOM_BB2_35S_oBackbone2_a0ca074b_Rx
              PduRDestPduPduRBswModulesRef = Com
            PduRSrcPdu_99763ffd (PduRSrcPdu): PduRSourcePduHandleId=61, PduRSrcPduDirection=RECEIVE, PduRSrcPduRef=HMIIOM_BB2_35S_oBackbone2_3334ebe1_Rx, PduRSrcPduPduRBswModulesRef=CanTp
          CIOM_25db97e6_Rx: PduRRoutingPathCommunicationType=TRANSPORT_PROTOCOL
            PduRSrcPdu_cd1487f2 (PduRSrcPdu):
              PduRSourcePduHandleId = 18
              PduRSrcPduDirection = RECEIVE
              PduRSrcPduRef = PhysDiagRespMsg_F2_98_Cab_oCabSubnet_8d9c7028_Rx
              PduRSrcPduPduRBswModulesRef = CanTp
            CIOM_a1765610_Tx (PduRDestPdu):
              PduRDestPduHandleId = 90
              PduRDestPduDirection = TRANSMIT
              PduRDestPduRoutingType = GATEWAY_ROUTING
              PduRDestPduDataProcessing = IMMEDIATE
              PduRPduLengthHandlingStrategy = UNUSED
              PduRDestPduQueueDepth = 4
              PduRTpThreshold = 1
              PduRDestPduRef = PhysDiagRespMsg_F2_98_BB2_oBackbone2_0931b1de_Tx
              PduRDestPduPduRBswModulesRef = CanTp
          CIOM_BB2_02P_oBackbone2_bbfe9955_Tx: PduRRoutingPathCommunicationType=COMMUNICATION_INTERFACE
            CIOM_BB2_02P_oBackbone2_dbe8f706_Tx (PduRDestPdu):
              PduRDestPduHandleId = 16
              PduRDestPduDirection = TRANSMIT
              PduRDestPduRoutingType = API_FORWARDING
              PduRDestPduDataProcessing = IMMEDIATE
              PduRPduLengthHandlingStrategy = UNUSED
              PduRDestPduDataProvision = PDUR_DIRECT
              PduRTransmissionConfirmation = false
              PduRDestPduRef = CIOM_BB2_02P_oBackbone2_dbe8f706_Tx
              PduRDestPduPduRBswModulesRef = CanIf
            PduRSrcPdu_07bbf63b (PduRSrcPdu): PduRSourcePduHandleId=14, PduRSrcPduDirection=TRANSMIT, PduRSrcPduRef=CIOM_BB2_02P_oBackbone2_bbfe9955_Tx, PduRSrcPduPduRBswModulesRef=Com
          CIOM_BB2_29P_oBackbone2_bd59e25b_Tx: PduRRoutingPathCommunicationType=COMMUNICATION_INTERFACE
            PduRSrcPdu_973737d6 (PduRSrcPdu): PduRSourcePduHandleId=30, PduRSrcPduDirection=TRANSMIT, PduRSrcPduRef=CIOM_BB2_29P_oBackbone2_bd59e25b_Tx, PduRSrcPduPduRBswModulesRef=Com
            CIOM_BB2_29P_oBackbone2_9c06ea0b_Tx (PduRDestPdu):
              PduRDestPduHandleId = 30
              PduRDestPduDirection = TRANSMIT
              PduRDestPduRoutingType = API_FORWARDING
              PduRDestPduDataProcessing = IMMEDIATE
              PduRPduLengthHandlingStrategy = UNUSED
              PduRDestPduDataProvision = PDUR_DIRECT
              PduRTransmissionConfirmation = false
              PduRDestPduRef = CIOM_BB2_29P_oBackbone2_9c06ea0b_Tx
              PduRDestPduPduRBswModulesRef = CanIf
          ILCP2toCIOM_L4_oLIN03_3ff118ff_Rx: PduRRoutingPathCommunicationType=COMMUNICATION_INTERFACE
            ILCP2toCIOM_L4_oLIN03_3ff118ff_Rx_8f05a91a_Rx (PduRDestPdu):
              PduRDestPduHandleId = 108
              PduRDestPduDirection = RECEIVE
              PduRDestPduRoutingType = API_FORWARDING
              PduRDestPduDataProcessing = IMMEDIATE
              PduRPduLengthHandlingStrategy = UNUSED
              PduRTransmissionConfirmation = false
              PduRDestPduRef = ILCP2toCIOM_L4_oLIN03_8c9eb431_Rx
              PduRDestPduPduRBswModulesRef = Com
            PduRSrcPdu_8f05a91a (PduRSrcPdu): PduRSourcePduHandleId=115, PduRSrcPduDirection=RECEIVE, PduRSrcPduRef=ILCP2toCIOM_L4_oLIN03_3ff118ff_Rx, PduRSrcPduPduRBswModulesRef=LinIf
          CIOM_Cab_12P_oCabSubnet_9af38205_Tx: PduRRoutingPathCommunicationType=COMMUNICATION_INTERFACE
            PduRSrcPdu_f1d29dcd (PduRSrcPdu): PduRSourcePduHandleId=45, PduRSrcPduDirection=TRANSMIT, PduRSrcPduRef=CIOM_Cab_12P_oCabSubnet_9af38205_Tx, PduRSrcPduPduRBswModulesRef=Com
            CIOM_Cab_12P_oCabSubnet_1b0fab71_Tx (PduRDestPdu):
              PduRDestPduHandleId = 41
              PduRDestPduDirection = TRANSMIT
              PduRDestPduRoutingType = API_FORWARDING
              PduRDestPduDataProcessing = IMMEDIATE
              PduRPduLengthHandlingStrategy = UNUSED
              PduRDestPduDataProvision = PDUR_DIRECT
              PduRTransmissionConfirmation = false
              PduRDestPduRef = CIOM_Cab_12P_oCabSubnet_1b0fab71_Tx
              PduRDestPduPduRBswModulesRef = CanIf
          CIOM_BB2_27S_oBackbone2_30213c1b_Tx: PduRRoutingPathCommunicationType=COMMUNICATION_INTERFACE
            CIOM_BB2_27S_oBackbone2_2575f013_Tx (PduRDestPdu):
              PduRDestPduHandleId = 28
              PduRDestPduDirection = TRANSMIT
              PduRDestPduRoutingType = API_FORWARDING
              PduRDestPduDataProcessing = IMMEDIATE
              PduRPduLengthHandlingStrategy = UNUSED
              PduRTransmissionConfirmation = true
              PduRDestPduDataProvision = PDUR_DIRECT
              PduRDestPduRef = CIOM_BB2_27S_oBackbone2_2575f013_Tx
              PduRDestPduPduRBswModulesRef = CanIf
            PduRSrcPdu_44e5925a (PduRSrcPdu): PduRSourcePduHandleId=28, PduRSrcPduDirection=TRANSMIT, PduRSrcPduRef=CIOM_BB2_27S_oBackbone2_30213c1b_Tx, PduRSrcPduPduRBswModulesRef=Com
          CIOM_c64ce1f8_Rx: PduRRoutingPathCommunicationType=TRANSPORT_PROTOCOL
            CIOM_6e041ac5_Tx (PduRDestPdu):
              PduRDestPduHandleId = 42
              PduRDestPduDirection = TRANSMIT
              PduRDestPduRoutingType = GATEWAY_ROUTING
              PduRDestPduDataProcessing = IMMEDIATE
              PduRPduLengthHandlingStrategy = UNUSED
              PduRDestPduQueueDepth = 4
              PduRTpThreshold = 1
              PduRDestPduRef = DiagRespMsgIntHMIIOM_F3_C0_BB2_oBackbone2_6082985a_Tx
              PduRDestPduPduRBswModulesRef = CanTp
            PduRSrcPdu_b4b812c0 (PduRSrcPdu):
              PduRSourcePduHandleId = 42
              PduRSrcPduDirection = RECEIVE
              PduRSrcPduRef = DiagRespMsgIntHMIIOM_F3_C0_Sec_oSecuritySubnet_7b24ed55_Rx
              PduRSrcPduPduRBswModulesRef = CanTp
          DiagFaultStat_LECM_BB2_oBackbone2_ceffe314_Tx: PduRRoutingPathCommunicationType=COMMUNICATION_INTERFACE
            DiagFaultStat_LECM_BB2_oBackbone2_b8766ffd_Tx (PduRDestPdu):
              PduRDestPduHandleId = 102
              PduRDestPduDirection = TRANSMIT
              PduRDestPduRoutingType = API_FORWARDING
              PduRDestPduDataProcessing = IMMEDIATE
              PduRPduLengthHandlingStrategy = UNUSED
              PduRTransmissionConfirmation = true
              PduRDestPduDataProvision = PDUR_DIRECT
              PduRDestPduRef = DiagFaultStat_LECM_BB2_oBackbone2_b8766ffd_Tx
              PduRDestPduPduRBswModulesRef = CanIf
            PduRSrcPdu_77877d8c (PduRSrcPdu):
              PduRSourcePduHandleId = 121
              PduRSrcPduDirection = TRANSMIT
              PduRSrcPduRef = DiagFaultStat_LECM_BB2_oBackbone2_ceffe314_Tx
              PduRSrcPduPduRBswModulesRef = Com
          CIOM_BB2_10P_oBackbone2_46adcd68_Tx: PduRRoutingPathCommunicationType=COMMUNICATION_INTERFACE
            CIOM_BB2_10P_oBackbone2_d5df6ae0_Tx (PduRDestPdu):
              PduRDestPduHandleId = 22
              PduRDestPduDirection = TRANSMIT
              PduRDestPduRoutingType = API_FORWARDING
              PduRDestPduDataProcessing = IMMEDIATE
              PduRPduLengthHandlingStrategy = UNUSED
              PduRDestPduDataProvision = PDUR_DIRECT
              PduRTransmissionConfirmation = false
              PduRDestPduRef = CIOM_BB2_10P_oBackbone2_d5df6ae0_Tx
              PduRDestPduPduRBswModulesRef = CanIf
            PduRSrcPdu_7a80252e (PduRSrcPdu): PduRSourcePduHandleId=20, PduRSrcPduDirection=TRANSMIT, PduRSrcPduRef=CIOM_BB2_10P_oBackbone2_46adcd68_Tx, PduRSrcPduPduRBswModulesRef=Com
          CIOM_Cab_21P_oCabSubnet_5b58cb10_Tx: PduRRoutingPathCommunicationType=COMMUNICATION_INTERFACE
            PduRSrcPdu_e612e27f (PduRSrcPdu): PduRSourcePduHandleId=54, PduRSrcPduDirection=TRANSMIT, PduRSrcPduRef=CIOM_Cab_21P_oCabSubnet_5b58cb10_Tx, PduRSrcPduPduRBswModulesRef=Com
            CIOM_Cab_21P_oCabSubnet_890712db_Tx (PduRDestPdu):
              PduRDestPduHandleId = 48
              PduRDestPduDirection = TRANSMIT
              PduRDestPduRoutingType = API_FORWARDING
              PduRDestPduDataProcessing = IMMEDIATE
              PduRPduLengthHandlingStrategy = UNUSED
              PduRDestPduDataProvision = PDUR_DIRECT
              PduRTransmissionConfirmation = false
              PduRDestPduRef = CIOM_Cab_21P_oCabSubnet_890712db_Tx
              PduRDestPduPduRBswModulesRef = CanIf
          CIOM_Cab_01P_oCabSubnet_ba360fbd_Tx: PduRRoutingPathCommunicationType=COMMUNICATION_INTERFACE
            CIOM_Cab_01P_oCabSubnet_e4e2333d_Tx (PduRDestPdu):
              PduRDestPduHandleId = 33
              PduRDestPduDirection = TRANSMIT
              PduRDestPduRoutingType = API_FORWARDING
              PduRDestPduDataProcessing = IMMEDIATE
              PduRPduLengthHandlingStrategy = UNUSED
              PduRDestPduDataProvision = PDUR_DIRECT
              PduRTransmissionConfirmation = false
              PduRDestPduRef = CIOM_Cab_01P_oCabSubnet_e4e2333d_Tx
              PduRDestPduPduRBswModulesRef = CanIf
            PduRSrcPdu_9d0a2dde (PduRSrcPdu): PduRSourcePduHandleId=34, PduRSrcPduDirection=TRANSMIT, PduRSrcPduRef=CIOM_Cab_01P_oCabSubnet_ba360fbd_Tx, PduRSrcPduPduRBswModulesRef=Com
          MasterReq_FSP1_L4_oLIN03_fc0ed2f4_Tx: PduRRoutingPathCommunicationType=TRANSPORT_PROTOCOL
            MasterReq_FSP1_L4_oLIN03_cc32eb14_Tx (PduRDestPdu):
              PduRDestPduHandleId = 60
              PduRDestPduDirection = TRANSMIT
              PduRDestPduRoutingType = API_FORWARDING
              PduRDestPduDataProcessing = IMMEDIATE
              PduRPduLengthHandlingStrategy = UNUSED
              PduRDestPduRef = MasterReq_FSP1_L4_oLIN03_cc32eb14_Tx
              PduRDestPduPduRBswModulesRef = LinTp
            PduRSrcPdu_4e85369a (PduRSrcPdu): PduRSourcePduHandleId=153, PduRSrcPduDirection=TRANSMIT, PduRSrcPduRef=MasterReq_FSP1_L4_oLIN03_fc0ed2f4_Tx, PduRSrcPduPduRBswModulesRef=Cdd
          CIOM_6155e124_Rx: PduRRoutingPathCommunicationType=TRANSPORT_PROTOCOL
            CIOM_e5f820d2_Tx (PduRDestPdu):
              PduRDestPduHandleId = 86
              PduRDestPduDirection = TRANSMIT
              PduRDestPduRoutingType = GATEWAY_ROUTING
              PduRDestPduDataProcessing = IMMEDIATE
              PduRPduLengthHandlingStrategy = UNUSED
              PduRDestPduQueueDepth = 4
              PduRTpThreshold = 1
              PduRDestPduRef = PhysDiagRespMsg_F1_53_BB2_oBackbone2_4dbfc71c_Tx
              PduRDestPduPduRBswModulesRef = CanTp
            PduRSrcPdu_5cfa406e (PduRSrcPdu):
              PduRSourcePduHandleId = 29
              PduRSrcPduDirection = RECEIVE
              PduRSrcPduRef = PhysDiagRespMsg_F1_53_Cab_oCabSubnet_c91206ea_Rx
              PduRSrcPduPduRBswModulesRef = CanTp
          MasterReq_DLFW_oLIN03_40053787_Tx: PduRRoutingPathCommunicationType=TRANSPORT_PROTOCOL
            PduRSrcPdu_415f4d5f (PduRSrcPdu): PduRSourcePduHandleId=147, PduRSrcPduDirection=TRANSMIT, PduRSrcPduRef=MasterReq_DLFW_oLIN03_40053787_Tx, PduRSrcPduPduRBswModulesRef=Cdd
            MasterReq_DLFW_oLIN03_c633fea1_Tx (PduRDestPdu):
              PduRDestPduHandleId = 54
              PduRDestPduDirection = TRANSMIT
              PduRDestPduRoutingType = API_FORWARDING
              PduRDestPduDataProcessing = IMMEDIATE
              PduRPduLengthHandlingStrategy = UNUSED
              PduRDestPduRef = MasterReq_DLFW_oLIN03_c633fea1_Tx
              PduRDestPduPduRBswModulesRef = LinTp
          MasterReq_FSP2_L3_oLIN02_182e8d7a_Tx: PduRRoutingPathCommunicationType=TRANSPORT_PROTOCOL
            PduRSrcPdu_fd379ced (PduRSrcPdu): PduRSourcePduHandleId=157, PduRSrcPduDirection=TRANSMIT, PduRSrcPduRef=MasterReq_FSP2_L3_oLIN02_182e8d7a_Tx, PduRSrcPduPduRBswModulesRef=Cdd
            MasterReq_FSP2_L3_oLIN02_91b33f45_Tx (PduRDestPdu):
              PduRDestPduHandleId = 64
              PduRDestPduDirection = TRANSMIT
              PduRDestPduRoutingType = API_FORWARDING
              PduRDestPduDataProcessing = IMMEDIATE
              PduRPduLengthHandlingStrategy = UNUSED
              PduRDestPduRef = MasterReq_FSP2_L3_oLIN02_91b33f45_Tx
              PduRDestPduPduRBswModulesRef = LinTp
          CIOM_Cab_24P_oCabSubnet_46777803_Tx: PduRRoutingPathCommunicationType=COMMUNICATION_INTERFACE
            PduRSrcPdu_6bd99b39 (PduRSrcPdu): PduRSourcePduHandleId=57, PduRSrcPduDirection=TRANSMIT, PduRSrcPduRef=CIOM_Cab_24P_oCabSubnet_46777803_Tx, PduRSrcPduPduRBswModulesRef=Com
            CIOM_Cab_24P_oCabSubnet_09570d5b_Tx (PduRDestPdu):
              PduRDestPduHandleId = 51
              PduRDestPduDirection = TRANSMIT
              PduRDestPduRoutingType = API_FORWARDING
              PduRDestPduDataProcessing = IMMEDIATE
              PduRPduLengthHandlingStrategy = UNUSED
              PduRDestPduDataProvision = PDUR_DIRECT
              PduRTransmissionConfirmation = false
              PduRDestPduRef = CIOM_Cab_24P_oCabSubnet_09570d5b_Tx
              PduRDestPduPduRBswModulesRef = CanIf
          CIOM_Cab_28S_oCabSubnet_ab531308_Tx: PduRRoutingPathCommunicationType=COMMUNICATION_INTERFACE
            PduRSrcPdu_29cdd88d (PduRSrcPdu): PduRSourcePduHandleId=61, PduRSrcPduDirection=TRANSMIT, PduRSrcPduRef=CIOM_Cab_28S_oCabSubnet_ab531308_Tx, PduRSrcPduPduRBswModulesRef=Com
            CIOM_Cab_28S_oCabSubnet_88e11a56_Tx (PduRDestPdu):
              PduRDestPduHandleId = 54
              PduRDestPduDirection = TRANSMIT
              PduRDestPduRoutingType = API_FORWARDING
              PduRDestPduDataProcessing = IMMEDIATE
              PduRPduLengthHandlingStrategy = UNUSED
              PduRTransmissionConfirmation = true
              PduRDestPduDataProvision = PDUR_DIRECT
              PduRDestPduRef = CIOM_Cab_28S_oCabSubnet_88e11a56_Tx
              PduRDestPduPduRBswModulesRef = CanIf
          CIOM_998995a8_Rx: PduRRoutingPathCommunicationType=TRANSPORT_PROTOCOL
            CIOM_325e35fa_Tx (PduRDestPdu):
              PduRDestPduHandleId = 83
              PduRDestPduDirection = TRANSMIT
              PduRDestPduRoutingType = GATEWAY_ROUTING
              PduRDestPduDataProcessing = IMMEDIATE
              PduRPduLengthHandlingStrategy = UNUSED
              PduRDestPduQueueDepth = 4
              PduRTpThreshold = 1
              PduRDestPduRef = PhysDiagReqMsg_A1_F2_Sec_oSecuritySubnet_bfad192c_Tx
              PduRDestPduPduRBswModulesRef = CanTp
            PduRSrcPdu_30b4cd32 (PduRSrcPdu):
              PduRSourcePduHandleId = 35
              PduRSrcPduDirection = RECEIVE
              PduRSrcPduRef = PhysDiagReqMsg_A1_F2_BB2_oBackbone2_b9b10e05_Rx
              PduRSrcPduPduRBswModulesRef = CanTp
          CIOM_2b5261c2_Rx: PduRRoutingPathCommunicationType=TRANSPORT_PROTOCOL
            CIOM_d31c0716_Tx (PduRDestPdu):
              PduRDestPduHandleId = 25
              PduRDestPduDirection = TRANSMIT
              PduRDestPduRoutingType = GATEWAY_ROUTING
              PduRDestPduDataProcessing = IMMEDIATE
              PduRPduLengthHandlingStrategy = UNUSED
              PduRDestPduQueueDepth = 4
              PduRTpThreshold = 1
              PduRDestPduRef = DiagReqMsgIntHMIIOM_A1_F3_Sec_oSecuritySubnet_06e2b6e6_Tx
              PduRDestPduPduRBswModulesRef = CanTp
            PduRSrcPdu_86e04d33 (PduRSrcPdu):
              PduRSourcePduHandleId = 5
              PduRSrcPduDirection = RECEIVE
              PduRSrcPduRef = DiagReqMsgIntHMIIOM_A1_F3_BB2_oBackbone2_7658ccca_Rx
              PduRSrcPduPduRBswModulesRef = CanTp
          Backlight_FuncInd_L2_oLIN01_9bfbc4c4_Tx: PduRRoutingPathCommunicationType=COMMUNICATION_INTERFACE
            PduRSrcPdu_5bb7f426 (PduRSrcPdu): PduRSourcePduHandleId=7, PduRSrcPduDirection=TRANSMIT, PduRSrcPduRef=Backlight_FuncInd_L2_oLIN01_9bfbc4c4_Tx, PduRSrcPduPduRBswModulesRef=Com
            Backlight_FuncInd_L2_oLIN01_2b903334_Tx (PduRDestPdu):
              PduRDestPduHandleId = 9
              PduRDestPduDirection = TRANSMIT
              PduRDestPduRoutingType = API_FORWARDING
              PduRDestPduDataProcessing = IMMEDIATE
              PduRPduLengthHandlingStrategy = UNUSED
              PduRDestPduDataProvision = PDUR_TRIGGERTRANSMIT
              PduRTransmissionConfirmation = false
              PduRDestPduRef = Backlight_FuncInd_L2_oLIN01_2b903334_Tx
              PduRDestPduPduRBswModulesRef = LinIf
          CIOM_ff516e86_Rx: PduRRoutingPathCommunicationType=TRANSPORT_PROTOCOL
            CIOM_7bfcaf70_Tx (PduRDestPdu):
              PduRDestPduHandleId = 49
              PduRDestPduDirection = TRANSMIT
              PduRDestPduRoutingType = GATEWAY_ROUTING
              PduRDestPduDataProcessing = IMMEDIATE
              PduRPduLengthHandlingStrategy = UNUSED
              PduRDestPduQueueDepth = 4
              PduRTpThreshold = 1
              PduRDestPduRef = DiagRespMsgIntTGW2_F4_A2_BB2_oBackbone2_194aa58a_Tx
              PduRDestPduPduRBswModulesRef = CanTp
            PduRSrcPdu_9e5d6760 (PduRSrcPdu):
              PduRSourcePduHandleId = 50
              PduRSrcPduDirection = RECEIVE
              PduRSrcPduRef = DiagRespMsgIntTGW2_F4_A2_Cab_oCabSubnet_9de7647c_Rx
              PduRSrcPduPduRBswModulesRef = CanTp
          AnmMsg_PDM_SecuritySubnet_oSecuritySubnet_412a9e12_Rx: PduRRoutingPathCommunicationType=COMMUNICATION_INTERFACE
            AnmMsg_PDM_SecuritySubnet_oSecuritySubnet_412a9e12_Rx_c2f29ed3_Rx (PduRDestPdu):
              PduRDestPduHandleId = 16
              PduRDestPduDirection = RECEIVE
              PduRDestPduRoutingType = API_FORWARDING
              PduRDestPduDataProcessing = IMMEDIATE
              PduRPduLengthHandlingStrategy = UNUSED
              PduRTransmissionConfirmation = false
              PduRDestPduRef = AnmMsg_PDM_SecuritySubnet_oSecuritySubnet_7215ae09_Rx
              PduRDestPduPduRBswModulesRef = Com
            PduRSrcPdu_c2f29ed3 (PduRSrcPdu):
              PduRSourcePduHandleId = 16
              PduRSrcPduDirection = RECEIVE
              PduRSrcPduRef = AnmMsg_PDM_SecuritySubnet_oSecuritySubnet_412a9e12_Rx
              PduRSrcPduPduRBswModulesRef = CanIf
          LECM1_Cab_05S_oCabSubnet_d0b8bedb_Rx: PduRRoutingPathCommunicationType=COMMUNICATION_INTERFACE
            PduRSrcPdu_3319cd54 (PduRSrcPdu): PduRSourcePduHandleId=119, PduRSrcPduDirection=RECEIVE, PduRSrcPduRef=LECM1_Cab_05S_oCabSubnet_d0b8bedb_Rx, PduRSrcPduPduRBswModulesRef=CanIf
            LECM1_Cab_05S_oCabSubnet_d0b8bedb_Rx_3319cd54_Rx (PduRDestPdu):
              PduRDestPduHandleId = 112
              PduRDestPduDirection = RECEIVE
              PduRDestPduRoutingType = API_FORWARDING
              PduRDestPduDataProcessing = IMMEDIATE
              PduRPduLengthHandlingStrategy = UNUSED
              PduRTransmissionConfirmation = false
              PduRDestPduRef = LECM1_Cab_05S_oCabSubnet_daa8d626_Rx
              PduRDestPduPduRBswModulesRef = Com
          ERC1_x_RECUFMS_oFMSNet_64a06015_Tx: PduRRoutingPathCommunicationType=COMMUNICATION_INTERFACE
            PduRSrcPdu_aedbbc7e (PduRSrcPdu): PduRSourcePduHandleId=132, PduRSrcPduDirection=TRANSMIT, PduRSrcPduRef=ERC1_x_RECUFMS_oFMSNet_64a06015_Tx, PduRSrcPduPduRBswModulesRef=Com
            ERC1_x_RECUFMS_oFMSNet_f10a8a51_Tx (PduRDestPdu):
              PduRDestPduHandleId = 118
              PduRDestPduDirection = TRANSMIT
              PduRDestPduRoutingType = API_FORWARDING
              PduRDestPduDataProcessing = IMMEDIATE
              PduRPduLengthHandlingStrategy = UNUSED
              PduRTransmissionConfirmation = false
              PduRDestPduDataProvision = PDUR_DIRECT
              PduRDestPduRef = ERC1_x_RECUFMS_oFMSNet_f10a8a51_Tx
              PduRDestPduPduRBswModulesRef = CanIf
          CIOM_d6c6f93e_Rx: PduRRoutingPathCommunicationType=TRANSPORT_PROTOCOL
            CIOM_ce2129ca_Tx (PduRDestPdu):
              PduRDestPduHandleId = 50
              PduRDestPduDirection = TRANSMIT
              PduRDestPduRoutingType = GATEWAY_ROUTING
              PduRDestPduDataProcessing = IMMEDIATE
              PduRPduLengthHandlingStrategy = UNUSED
              PduRDestPduQueueDepth = 4
              PduRTpThreshold = 1
              PduRDestPduRef = DiagRespMsgIntTGW2_F4_C0_BB2_oBackbone2_ac972330_Tx
              PduRDestPduPduRBswModulesRef = CanTp
            PduRSrcPdu_8259d96a (PduRSrcPdu):
              PduRSourcePduHandleId = 45
              PduRSrcPduDirection = RECEIVE
              PduRSrcPduRef = DiagRespMsgIntTGW2_F4_C0_Sec_oSecuritySubnet_4836ed1c_Rx
              PduRSrcPduPduRBswModulesRef = CanTp
          CIOM_BB2_06P_oBackbone2_7b47f3c3_Tx: PduRRoutingPathCommunicationType=COMMUNICATION_INTERFACE
            PduRSrcPdu_58768f62 (PduRSrcPdu): PduRSourcePduHandleId=18, PduRSrcPduDirection=TRANSMIT, PduRSrcPduRef=CIOM_BB2_06P_oBackbone2_7b47f3c3_Tx, PduRSrcPduPduRBswModulesRef=Com
            CIOM_BB2_06P_oBackbone2_aa62ed2c_Tx (PduRDestPdu):
              PduRDestPduHandleId = 20
              PduRDestPduDirection = TRANSMIT
              PduRDestPduRoutingType = API_FORWARDING
              PduRDestPduDataProcessing = IMMEDIATE
              PduRPduLengthHandlingStrategy = UNUSED
              PduRDestPduDataProvision = PDUR_DIRECT
              PduRTransmissionConfirmation = false
              PduRDestPduRef = CIOM_BB2_06P_oBackbone2_aa62ed2c_Tx
              PduRDestPduPduRBswModulesRef = CanIf
          MasterReq_oLIN04_4d467408_Tx: PduRRoutingPathCommunicationType=TRANSPORT_PROTOCOL
            PduRSrcPdu_bc8ff73d (PduRSrcPdu): PduRSourcePduHandleId=170, PduRSrcPduDirection=TRANSMIT, PduRSrcPduRef=MasterReq_oLIN04_4d467408_Tx, PduRSrcPduPduRBswModulesRef=Cdd
            MasterReq_oLIN04_e1687685_Tx (PduRDestPdu):
              PduRDestPduHandleId = 77
              PduRDestPduDirection = TRANSMIT
              PduRDestPduRoutingType = API_FORWARDING
              PduRDestPduDataProcessing = IMMEDIATE
              PduRPduLengthHandlingStrategy = UNUSED
              PduRDestPduRef = MasterReq_oLIN04_e1687685_Tx
              PduRDestPduPduRBswModulesRef = LinTp
          DI_X_CIOMFMS_oFMSNet_0e37c3a0_Tx: PduRRoutingPathCommunicationType=TRANSPORT_PROTOCOL
            PduRSrcPdu_bcf724a3 (PduRSrcPdu): PduRSourcePduHandleId=90, PduRSrcPduDirection=TRANSMIT, PduRSrcPduRef=DI_X_CIOMFMS_oFMSNet_0e37c3a0_Tx, PduRSrcPduPduRBswModulesRef=Com
            DI_X_CIOMFMS_oFMSNet_45299e3a_Tx (PduRDestPdu):
              PduRDestPduHandleId = 20
              PduRDestPduDirection = TRANSMIT
              PduRDestPduRoutingType = API_FORWARDING
              PduRDestPduDataProcessing = IMMEDIATE
              PduRPduLengthHandlingStrategy = UNUSED
              PduRDestPduRef = DI_X_CIOMFMS_oFMSNet_45299e3a_Tx
              PduRDestPduPduRBswModulesRef = J1939Tp
          MasterReq_oLIN02_a425d13d_Tx: PduRRoutingPathCommunicationType=TRANSPORT_PROTOCOL
            PduRSrcPdu_d58909f4 (PduRSrcPdu): PduRSourcePduHandleId=168, PduRSrcPduDirection=TRANSMIT, PduRSrcPduRef=MasterReq_oLIN02_a425d13d_Tx, PduRSrcPduPduRBswModulesRef=Cdd
            MasterReq_oLIN02_5b9aba54_Tx (PduRDestPdu):
              PduRDestPduHandleId = 75
              PduRDestPduDirection = TRANSMIT
              PduRDestPduRoutingType = API_FORWARDING
              PduRDestPduDataProcessing = IMMEDIATE
              PduRPduLengthHandlingStrategy = UNUSED
              PduRDestPduRef = MasterReq_oLIN02_5b9aba54_Tx
              PduRDestPduPduRBswModulesRef = LinTp
          AnmMsg_BBM_Backbone2_oBackbone2_03be1070_Rx: PduRRoutingPathCommunicationType=COMMUNICATION_INTERFACE
            AnmMsg_BBM_Backbone2_oBackbone2_03be1070_Rx_dafcbadc_Rx (PduRDestPdu):
              PduRDestPduHandleId = 5
              PduRDestPduDirection = RECEIVE
              PduRDestPduRoutingType = API_FORWARDING
              PduRDestPduDataProcessing = IMMEDIATE
              PduRPduLengthHandlingStrategy = UNUSED
              PduRTransmissionConfirmation = false
              PduRDestPduRef = AnmMsg_BBM_Backbone2_oBackbone2_bca080bd_Rx
              PduRDestPduPduRBswModulesRef = Com
            PduRSrcPdu_dafcbadc (PduRSrcPdu): PduRSourcePduHandleId=5, PduRSrcPduDirection=RECEIVE, PduRSrcPduRef=AnmMsg_BBM_Backbone2_oBackbone2_03be1070_Rx, PduRSrcPduPduRBswModulesRef=CanIf
          DiagFaultStat_PDM_BB2_oBackbone2_798e0781_Tx: PduRRoutingPathCommunicationType=COMMUNICATION_INTERFACE
            DiagFaultStat_PDM_BB2_oBackbone2_fea9ad98_Tx (PduRDestPdu):
              PduRDestPduHandleId = 103
              PduRDestPduDirection = TRANSMIT
              PduRDestPduRoutingType = API_FORWARDING
              PduRDestPduDataProcessing = IMMEDIATE
              PduRPduLengthHandlingStrategy = UNUSED
              PduRTransmissionConfirmation = true
              PduRDestPduDataProvision = PDUR_DIRECT
              PduRDestPduRef = DiagFaultStat_PDM_BB2_oBackbone2_fea9ad98_Tx
              PduRDestPduPduRBswModulesRef = CanIf
            PduRSrcPdu_e918ef53 (PduRSrcPdu):
              PduRSourcePduHandleId = 122
              PduRSrcPduDirection = TRANSMIT
              PduRSrcPduRef = DiagFaultStat_PDM_BB2_oBackbone2_798e0781_Tx
              PduRSrcPduPduRBswModulesRef = Com
          HMIIOM_BB2_38P_oBackbone2_4358f946_Rx: PduRRoutingPathCommunicationType=COMMUNICATION_INTERFACE
            PduRSrcPdu_71de9aba (PduRSrcPdu): PduRSourcePduHandleId=108, PduRSrcPduDirection=RECEIVE, PduRSrcPduRef=HMIIOM_BB2_38P_oBackbone2_4358f946_Rx, PduRSrcPduPduRBswModulesRef=CanIf
            HMIIOM_BB2_38P_oBackbone2_4358f946_Rx_71de9aba_Rx (PduRDestPdu):
              PduRDestPduHandleId = 101
              PduRDestPduDirection = RECEIVE
              PduRDestPduRoutingType = API_FORWARDING
              PduRDestPduDataProcessing = IMMEDIATE
              PduRPduLengthHandlingStrategy = UNUSED
              PduRTransmissionConfirmation = false
              PduRDestPduRef = HMIIOM_BB2_38P_oBackbone2_9078b5c5_Rx
              PduRDestPduPduRBswModulesRef = Com
          DiagFaultStat_WRCS_BB2_oBackbone2_7e62dd7b_Tx: PduRRoutingPathCommunicationType=COMMUNICATION_INTERFACE
            DiagFaultStat_WRCS_BB2_oBackbone2_e82bcc3e_Tx (PduRDestPdu):
              PduRDestPduHandleId = 105
              PduRDestPduDirection = TRANSMIT
              PduRDestPduRoutingType = API_FORWARDING
              PduRDestPduDataProcessing = IMMEDIATE
              PduRPduLengthHandlingStrategy = UNUSED
              PduRTransmissionConfirmation = true
              PduRDestPduDataProvision = PDUR_DIRECT
              PduRDestPduRef = DiagFaultStat_WRCS_BB2_oBackbone2_e82bcc3e_Tx
              PduRDestPduPduRBswModulesRef = CanIf
            PduRSrcPdu_96efa9e2 (PduRSrcPdu):
              PduRSourcePduHandleId = 124
              PduRSrcPduDirection = TRANSMIT
              PduRSrcPduRef = DiagFaultStat_WRCS_BB2_oBackbone2_7e62dd7b_Tx
              PduRSrcPduPduRBswModulesRef = Com
          HMIIOM_BB2_20S_oBackbone2_85966492_Rx: PduRRoutingPathCommunicationType=TRANSPORT_PROTOCOL
            HMIIOM_BB2_20S_oBackbone2_85966492_Rx_fed5ac9b_Rx (PduRDestPdu):
              PduRDestPduHandleId = 14
              PduRDestPduDirection = RECEIVE
              PduRDestPduRoutingType = API_FORWARDING
              PduRDestPduDataProcessing = IMMEDIATE
              PduRPduLengthHandlingStrategy = UNUSED
              PduRDestPduRef = HMIIOM_BB2_20S_oBackbone2_20ea552e_Rx
              PduRDestPduPduRBswModulesRef = Com
            PduRSrcPdu_fed5ac9b (PduRSrcPdu): PduRSourcePduHandleId=60, PduRSrcPduDirection=RECEIVE, PduRSrcPduRef=HMIIOM_BB2_20S_oBackbone2_85966492_Rx, PduRSrcPduPduRBswModulesRef=CanTp
          WRCS_Cab_02P_oCabSubnet_bfa65d2b_Rx: PduRRoutingPathCommunicationType=COMMUNICATION_INTERFACE
            PduRSrcPdu_3253ad4f (PduRSrcPdu): PduRSourcePduHandleId=186, PduRSrcPduDirection=RECEIVE, PduRSrcPduRef=WRCS_Cab_02P_oCabSubnet_bfa65d2b_Rx, PduRSrcPduPduRBswModulesRef=CanIf
            WRCS_Cab_02P_oCabSubnet_bfa65d2b_Rx_3253ad4f_Rx (PduRDestPdu):
              PduRDestPduHandleId = 179
              PduRDestPduDirection = RECEIVE
              PduRDestPduRoutingType = API_FORWARDING
              PduRDestPduDataProcessing = IMMEDIATE
              PduRPduLengthHandlingStrategy = UNUSED
              PduRTransmissionConfirmation = false
              PduRDestPduRef = WRCS_Cab_02P_oCabSubnet_e12b6822_Rx
              PduRDestPduPduRBswModulesRef = Com
          CIOM_37098640_Rx: PduRRoutingPathCommunicationType=TRANSPORT_PROTOCOL
            PduRSrcPdu_62ae1653 (PduRSrcPdu):
              PduRSourcePduHandleId = 37
              PduRSrcPduDirection = RECEIVE
              PduRSrcPduRef = PhysDiagRespMsg_F2_26_Cab_oCabSubnet_9f4e618e_Rx
              PduRSrcPduPduRBswModulesRef = CanTp
            CIOM_b3a447b6_Tx (PduRDestPdu):
              PduRDestPduHandleId = 87
              PduRDestPduDirection = TRANSMIT
              PduRDestPduRoutingType = GATEWAY_ROUTING
              PduRDestPduDataProcessing = IMMEDIATE
              PduRPduLengthHandlingStrategy = UNUSED
              PduRDestPduQueueDepth = 4
              PduRTpThreshold = 1
              PduRDestPduRef = PhysDiagRespMsg_F2_26_BB2_oBackbone2_1be3a078_Tx
              PduRDestPduPduRBswModulesRef = CanTp
          MasterReq_FSP1_L3_oLIN02_81cceb7b_Tx: PduRRoutingPathCommunicationType=TRANSPORT_PROTOCOL
            MasterReq_FSP1_L3_oLIN02_63e4d2bd_Tx (PduRDestPdu):
              PduRDestPduHandleId = 59
              PduRDestPduDirection = TRANSMIT
              PduRDestPduRoutingType = API_FORWARDING
              PduRDestPduDataProcessing = IMMEDIATE
              PduRPduLengthHandlingStrategy = UNUSED
              PduRDestPduRef = MasterReq_FSP1_L3_oLIN02_63e4d2bd_Tx
              PduRDestPduPduRBswModulesRef = LinTp
            PduRSrcPdu_292228a9 (PduRSrcPdu): PduRSourcePduHandleId=152, PduRSrcPduDirection=TRANSMIT, PduRSrcPduRef=MasterReq_FSP1_L3_oLIN02_81cceb7b_Tx, PduRSrcPduPduRBswModulesRef=Cdd
          MasterReq_TCP_oLIN02_4b422897_Tx: PduRRoutingPathCommunicationType=TRANSPORT_PROTOCOL
            PduRSrcPdu_5862727a (PduRSrcPdu): PduRSourcePduHandleId=165, PduRSrcPduDirection=TRANSMIT, PduRSrcPduRef=MasterReq_TCP_oLIN02_4b422897_Tx, PduRSrcPduPduRBswModulesRef=Cdd
            MasterReq_TCP_oLIN02_741cea1f_Tx (PduRDestPdu):
              PduRDestPduHandleId = 72
              PduRDestPduDirection = TRANSMIT
              PduRDestPduRoutingType = API_FORWARDING
              PduRDestPduDataProcessing = IMMEDIATE
              PduRPduLengthHandlingStrategy = UNUSED
              PduRDestPduRef = MasterReq_TCP_oLIN02_741cea1f_Tx
              PduRDestPduPduRBswModulesRef = LinTp
          FSP4_Frame_L2_oLIN01_5f9b46f8_Rx: PduRRoutingPathCommunicationType=COMMUNICATION_INTERFACE
            FSP4_Frame_L2_oLIN01_5f9b46f8_Rx_be569886_Rx (PduRDestPdu):
              PduRDestPduHandleId = 89
              PduRDestPduDirection = RECEIVE
              PduRDestPduRoutingType = API_FORWARDING
              PduRDestPduDataProcessing = IMMEDIATE
              PduRPduLengthHandlingStrategy = UNUSED
              PduRTransmissionConfirmation = false
              PduRDestPduRef = FSP4_Frame_L2_oLIN01_7320a02a_Rx
              PduRDestPduPduRBswModulesRef = Com
            PduRSrcPdu_be569886 (PduRSrcPdu): PduRSourcePduHandleId=96, PduRSrcPduDirection=RECEIVE, PduRSrcPduRef=FSP4_Frame_L2_oLIN01_5f9b46f8_Rx, PduRSrcPduPduRBswModulesRef=LinIf
          EMS_BB2_08P_oBackbone2_56c4cd19_Rx: PduRRoutingPathCommunicationType=COMMUNICATION_INTERFACE
            EMS_BB2_08P_oBackbone2_56c4cd19_Rx_d383fbe5_Rx (PduRDestPdu):
              PduRDestPduHandleId = 65
              PduRDestPduDirection = RECEIVE
              PduRDestPduRoutingType = API_FORWARDING
              PduRDestPduDataProcessing = IMMEDIATE
              PduRPduLengthHandlingStrategy = UNUSED
              PduRTransmissionConfirmation = false
              PduRDestPduRef = EMS_BB2_08P_oBackbone2_5a04f673_Rx
              PduRDestPduPduRBswModulesRef = Com
            PduRSrcPdu_d383fbe5 (PduRSrcPdu): PduRSourcePduHandleId=72, PduRSrcPduDirection=RECEIVE, PduRSrcPduRef=EMS_BB2_08P_oBackbone2_56c4cd19_Rx, PduRSrcPduPduRBswModulesRef=CanIf
          MasterReq_CCFW_oLIN03_98357989_Tx: PduRRoutingPathCommunicationType=TRANSPORT_PROTOCOL
            MasterReq_CCFW_oLIN03_fcabea98_Tx (PduRDestPdu):
              PduRDestPduHandleId = 53
              PduRDestPduDirection = TRANSMIT
              PduRDestPduRoutingType = API_FORWARDING
              PduRDestPduDataProcessing = IMMEDIATE
              PduRPduLengthHandlingStrategy = UNUSED
              PduRDestPduRef = MasterReq_CCFW_oLIN03_fcabea98_Tx
              PduRDestPduPduRBswModulesRef = LinTp
            PduRSrcPdu_2428ced7 (PduRSrcPdu): PduRSourcePduHandleId=146, PduRSrcPduDirection=TRANSMIT, PduRSrcPduRef=MasterReq_CCFW_oLIN03_98357989_Tx, PduRSrcPduPduRBswModulesRef=Cdd
          CIOM_6a397096_Rx: PduRRoutingPathCommunicationType=TRANSPORT_PROTOCOL
            PduRSrcPdu_63947842 (PduRSrcPdu):
              PduRSourcePduHandleId = 10
              PduRSrcPduDirection = RECEIVE
              PduRSrcPduRef = DiagReqMsgIntTGW2_98_F4_BB2_oBackbone2_012e55ca_Rx
              PduRSrcPduPduRBswModulesRef = CanTp
            CIOM_ee94b160_Tx (PduRDestPdu):
              PduRDestPduHandleId = 30
              PduRDestPduDirection = TRANSMIT
              PduRDestPduRoutingType = GATEWAY_ROUTING
              PduRDestPduDataProcessing = IMMEDIATE
              PduRPduLengthHandlingStrategy = UNUSED
              PduRDestPduQueueDepth = 4
              PduRTpThreshold = 1
              PduRDestPduRef = DiagReqMsgIntTGW2_98_F4_Cab_oCabSubnet_8583943c_Tx
              PduRDestPduPduRBswModulesRef = CanTp
          VMCU_BB2_55P_oBackbone2_431cb6ec_Rx: PduRRoutingPathCommunicationType=COMMUNICATION_INTERFACE
            VMCU_BB2_55P_oBackbone2_431cb6ec_Rx_91dd0e09_Rx (PduRDestPdu):
              PduRDestPduHandleId = 149
              PduRDestPduDirection = RECEIVE
              PduRDestPduRoutingType = API_FORWARDING
              PduRDestPduDataProcessing = IMMEDIATE
              PduRPduLengthHandlingStrategy = UNUSED
              PduRTransmissionConfirmation = false
              PduRDestPduRef = VMCU_BB2_55P_oBackbone2_cec4df31_Rx
              PduRDestPduPduRBswModulesRef = Com
            PduRSrcPdu_91dd0e09 (PduRSrcPdu): PduRSourcePduHandleId=156, PduRSrcPduDirection=RECEIVE, PduRSrcPduRef=VMCU_BB2_55P_oBackbone2_431cb6ec_Rx, PduRSrcPduPduRBswModulesRef=CanIf
          AnmMsg_Alarm_SecuritySubnet_oSecuritySubnet_9d33373d_Rx: PduRRoutingPathCommunicationType=COMMUNICATION_INTERFACE
            AnmMsg_Alarm_SecuritySubnet_oSecuritySubnet_9d33373d_Rx_59c455d2_Rx (PduRDestPdu):
              PduRDestPduHandleId = 4
              PduRDestPduDirection = RECEIVE
              PduRDestPduRoutingType = API_FORWARDING
              PduRDestPduDataProcessing = IMMEDIATE
              PduRPduLengthHandlingStrategy = UNUSED
              PduRTransmissionConfirmation = false
              PduRDestPduRef = AnmMsg_Alarm_SecuritySubnet_oSecuritySubnet_142a14f5_Rx
              PduRDestPduPduRBswModulesRef = Com
            PduRSrcPdu_59c455d2 (PduRSrcPdu):
              PduRSourcePduHandleId = 4
              PduRSrcPduDirection = RECEIVE
              PduRSrcPduRef = AnmMsg_Alarm_SecuritySubnet_oSecuritySubnet_9d33373d_Rx
              PduRSrcPduPduRBswModulesRef = CanIf
          MasterReq_FSP3_L2_oLIN01_8c03039e_Tx: PduRRoutingPathCommunicationType=TRANSPORT_PROTOCOL
            PduRSrcPdu_2bd9ef52 (PduRSrcPdu): PduRSourcePduHandleId=158, PduRSrcPduDirection=TRANSMIT, PduRSrcPduRef=MasterReq_FSP3_L2_oLIN01_8c03039e_Tx, PduRSrcPduPduRBswModulesRef=Cdd
            MasterReq_FSP3_L2_oLIN01_5d1c964e_Tx (PduRDestPdu):
              PduRDestPduHandleId = 65
              PduRDestPduDirection = TRANSMIT
              PduRDestPduRoutingType = API_FORWARDING
              PduRDestPduDataProcessing = IMMEDIATE
              PduRPduLengthHandlingStrategy = UNUSED
              PduRDestPduRef = MasterReq_FSP3_L2_oLIN01_5d1c964e_Tx
              PduRDestPduPduRBswModulesRef = LinTp
          VMCU_BB2_02P_oBackbone2_16b17746_Rx: PduRRoutingPathCommunicationType=COMMUNICATION_INTERFACE
            PduRSrcPdu_1ab720b8 (PduRSrcPdu): PduRSourcePduHandleId=144, PduRSrcPduDirection=RECEIVE, PduRSrcPduRef=VMCU_BB2_02P_oBackbone2_16b17746_Rx, PduRSrcPduPduRBswModulesRef=CanIf
            VMCU_BB2_02P_oBackbone2_16b17746_Rx_1ab720b8_Rx (PduRDestPdu):
              PduRDestPduHandleId = 137
              PduRDestPduDirection = RECEIVE
              PduRDestPduRoutingType = API_FORWARDING
              PduRDestPduDataProcessing = IMMEDIATE
              PduRPduLengthHandlingStrategy = UNUSED
              PduRTransmissionConfirmation = false
              PduRDestPduRef = VMCU_BB2_02P_oBackbone2_3714b704_Rx
              PduRDestPduPduRBswModulesRef = Com
          TECU_BB2_01P_oBackbone2_6bd4ec68_Rx: PduRRoutingPathCommunicationType=COMMUNICATION_INTERFACE
            TECU_BB2_01P_oBackbone2_6bd4ec68_Rx_8f00e2b8_Rx (PduRDestPdu):
              PduRDestPduHandleId = 130
              PduRDestPduDirection = RECEIVE
              PduRDestPduRoutingType = API_FORWARDING
              PduRDestPduDataProcessing = IMMEDIATE
              PduRPduLengthHandlingStrategy = UNUSED
              PduRTransmissionConfirmation = false
              PduRDestPduRef = TECU_BB2_01P_oBackbone2_de0b2e23_Rx
              PduRDestPduPduRBswModulesRef = Com
            PduRSrcPdu_8f00e2b8 (PduRSrcPdu): PduRSourcePduHandleId=137, PduRSrcPduDirection=RECEIVE, PduRSrcPduRef=TECU_BB2_01P_oBackbone2_6bd4ec68_Rx, PduRSrcPduPduRBswModulesRef=CanIf
          CIOM_Cab_20S_oCabSubnet_f150c065_Tx: PduRRoutingPathCommunicationType=TRANSPORT_PROTOCOL
            PduRSrcPdu_bfa5c35c (PduRSrcPdu): PduRSourcePduHandleId=53, PduRSrcPduDirection=TRANSMIT, PduRSrcPduRef=CIOM_Cab_20S_oCabSubnet_f150c065_Tx, PduRSrcPduPduRBswModulesRef=Com
            CIOM_Cab_20S_oCabSubnet_6bf52e02_Tx (PduRDestPdu):
              PduRDestPduHandleId = 7
              PduRDestPduDirection = TRANSMIT
              PduRDestPduRoutingType = API_FORWARDING
              PduRDestPduDataProcessing = IMMEDIATE
              PduRPduLengthHandlingStrategy = UNUSED
              PduRDestPduRef = CIOM_Cab_20S_oCabSubnet_6bf52e02_Tx
              PduRDestPduPduRBswModulesRef = CanTp
          DiagRespMsgIntHMIIOM_F3_40_BB2_oBackbone2_af2ada4c_Tx: PduRRoutingPathCommunicationType=TRANSPORT_PROTOCOL
            DiagRespMsgIntHMIIOM_F3_40_BB2_oBackbone2_f7679e64_Tx (PduRDestPdu):
              PduRDestPduHandleId = 36
              PduRDestPduDirection = TRANSMIT
              PduRDestPduRoutingType = API_FORWARDING
              PduRDestPduDataProcessing = IMMEDIATE
              PduRPduLengthHandlingStrategy = UNUSED
              PduRDestPduRef = DiagRespMsgIntHMIIOM_F3_40_BB2_oBackbone2_f7679e64_Tx
              PduRDestPduPduRBswModulesRef = CanTp
            PduRSrcPdu_3ec0669e (PduRSrcPdu):
              PduRSourcePduHandleId = 125
              PduRSrcPduDirection = TRANSMIT
              PduRSrcPduRef = DiagRespMsgIntHMIIOM_F3_40_BB2_oBackbone2_af2ada4c_Tx
              PduRSrcPduPduRBswModulesRef = Dcm
          DiagReqMsgIntTGW2_40_F4_BB2_oBackbone2_0048db9b_Rx: PduRRoutingPathCommunicationType=TRANSPORT_PROTOCOL
            PduRSrcPdu_59f7faf1 (PduRSrcPdu):
              PduRSourcePduHandleId = 56
              PduRSrcPduDirection = RECEIVE
              PduRSrcPduRef = DiagReqMsgIntTGW2_40_F4_BB2_oBackbone2_0048db9b_Rx
              PduRSrcPduPduRBswModulesRef = CanTp
            DiagReqMsgIntTGW2_40_F4_BB2_oBackbone2_0048db9b_Rx_59f7faf1_Rx (PduRDestPdu):
              PduRDestPduHandleId = 10
              PduRDestPduDirection = RECEIVE
              PduRDestPduRoutingType = API_FORWARDING
              PduRDestPduDataProcessing = IMMEDIATE
              PduRPduLengthHandlingStrategy = UNUSED
              PduRDestPduRef = DiagReqMsgIntTGW2_40_F4_BB2_oBackbone2_8112e50d_Rx
              PduRDestPduPduRBswModulesRef = Dcm
          CIOM_Sec_09S_oSecuritySubnet_070c3f0c_Tx: PduRRoutingPathCommunicationType=TRANSPORT_PROTOCOL
            CIOM_Sec_09S_oSecuritySubnet_9aeecef3_Tx (PduRDestPdu):
              PduRDestPduHandleId = 16
              PduRDestPduDirection = TRANSMIT
              PduRDestPduRoutingType = API_FORWARDING
              PduRDestPduDataProcessing = IMMEDIATE
              PduRPduLengthHandlingStrategy = UNUSED
              PduRDestPduRef = CIOM_Sec_09S_oSecuritySubnet_9aeecef3_Tx
              PduRDestPduPduRBswModulesRef = CanTp
            PduRSrcPdu_dbfd746c (PduRSrcPdu): PduRSourcePduHandleId=76, PduRSrcPduDirection=TRANSMIT, PduRSrcPduRef=CIOM_Sec_09S_oSecuritySubnet_070c3f0c_Tx, PduRSrcPduPduRBswModulesRef=Com
          DiagFaultStat_Alarm_BB2_oBackbone2_ed9b4dd9_Tx: PduRRoutingPathCommunicationType=COMMUNICATION_INTERFACE
            DiagFaultStat_Alarm_BB2_oBackbone2_8c5e38cc_Tx (PduRDestPdu):
              PduRDestPduHandleId = 98
              PduRDestPduDirection = TRANSMIT
              PduRDestPduRoutingType = API_FORWARDING
              PduRDestPduDataProcessing = IMMEDIATE
              PduRPduLengthHandlingStrategy = UNUSED
              PduRTransmissionConfirmation = true
              PduRDestPduDataProvision = PDUR_DIRECT
              PduRDestPduRef = DiagFaultStat_Alarm_BB2_oBackbone2_8c5e38cc_Tx
              PduRDestPduPduRBswModulesRef = CanIf
            PduRSrcPdu_13dbaa10 (PduRSrcPdu):
              PduRSourcePduHandleId = 117
              PduRSrcPduDirection = TRANSMIT
              PduRSrcPduRef = DiagFaultStat_Alarm_BB2_oBackbone2_ed9b4dd9_Tx
              PduRSrcPduPduRBswModulesRef = Com
          AnmMsg_LECM1_CabSubnet_oCabSubnet_aef1a94e_Rx: PduRRoutingPathCommunicationType=COMMUNICATION_INTERFACE
            PduRSrcPdu_93860a26 (PduRSrcPdu):
              PduRSourcePduHandleId = 15
              PduRSrcPduDirection = RECEIVE
              PduRSrcPduRef = AnmMsg_LECM1_CabSubnet_oCabSubnet_aef1a94e_Rx
              PduRSrcPduPduRBswModulesRef = CanIf
            AnmMsg_LECM1_CabSubnet_oCabSubnet_aef1a94e_Rx_93860a26_Rx (PduRDestPdu):
              PduRDestPduHandleId = 15
              PduRDestPduDirection = RECEIVE
              PduRDestPduRoutingType = API_FORWARDING
              PduRDestPduDataProcessing = IMMEDIATE
              PduRPduLengthHandlingStrategy = UNUSED
              PduRTransmissionConfirmation = false
              PduRDestPduRef = AnmMsg_LECM1_CabSubnet_oCabSubnet_10e92ec5_Rx
              PduRDestPduPduRBswModulesRef = Com
          LECM1_Cab_03S_oCabSubnet_99f7a9e4_Rx: PduRRoutingPathCommunicationType=COMMUNICATION_INTERFACE
            LECM1_Cab_03S_oCabSubnet_99f7a9e4_Rx_0a93f264_Rx (PduRDestPdu):
              PduRDestPduHandleId = 110
              PduRDestPduDirection = RECEIVE
              PduRDestPduRoutingType = API_FORWARDING
              PduRDestPduDataProcessing = IMMEDIATE
              PduRPduLengthHandlingStrategy = UNUSED
              PduRTransmissionConfirmation = false
              PduRDestPduRef = LECM1_Cab_03S_oCabSubnet_7a4d09fb_Rx
              PduRDestPduPduRBswModulesRef = Com
            PduRSrcPdu_0a93f264 (PduRSrcPdu): PduRSourcePduHandleId=117, PduRSrcPduDirection=RECEIVE, PduRSrcPduRef=LECM1_Cab_03S_oCabSubnet_99f7a9e4_Rx, PduRSrcPduPduRBswModulesRef=CanIf
          CIOM_Cab_25S_oCabSubnet_ec7f7376_Tx: PduRRoutingPathCommunicationType=TRANSPORT_PROTOCOL
            PduRSrcPdu_06f4c24e (PduRSrcPdu): PduRSourcePduHandleId=58, PduRSrcPduDirection=TRANSMIT, PduRSrcPduRef=CIOM_Cab_25S_oCabSubnet_ec7f7376_Tx, PduRSrcPduPduRBswModulesRef=Com
            CIOM_Cab_25S_oCabSubnet_eba53182_Tx (PduRDestPdu):
              PduRDestPduHandleId = 8
              PduRDestPduDirection = TRANSMIT
              PduRDestPduRoutingType = API_FORWARDING
              PduRDestPduDataProcessing = IMMEDIATE
              PduRPduLengthHandlingStrategy = UNUSED
              PduRDestPduRef = CIOM_Cab_25S_oCabSubnet_eba53182_Tx
              PduRDestPduPduRBswModulesRef = CanTp
          CCM_Cab_04P_oCabSubnet_568d6123_Rx: PduRRoutingPathCommunicationType=COMMUNICATION_INTERFACE
            PduRSrcPdu_24a721a5 (PduRSrcPdu): PduRSourcePduHandleId=26, PduRSrcPduDirection=RECEIVE, PduRSrcPduRef=CCM_Cab_04P_oCabSubnet_568d6123_Rx, PduRSrcPduPduRBswModulesRef=CanIf
            CCM_Cab_04P_oCabSubnet_568d6123_Rx_24a721a5_Rx (PduRDestPdu):
              PduRDestPduHandleId = 26
              PduRDestPduDirection = RECEIVE
              PduRDestPduRoutingType = API_FORWARDING
              PduRDestPduDataProcessing = IMMEDIATE
              PduRPduLengthHandlingStrategy = UNUSED
              PduRTransmissionConfirmation = false
              PduRDestPduRef = CCM_Cab_04P_oCabSubnet_24bc03dc_Rx
              PduRDestPduPduRBswModulesRef = Com
          CIOM_BB2_26S_oBackbone2_edb7e59e_Tx: PduRRoutingPathCommunicationType=COMMUNICATION_INTERFACE
            CIOM_BB2_26S_oBackbone2_d4aff5b9_Tx (PduRDestPdu):
              PduRDestPduHandleId = 27
              PduRDestPduDirection = TRANSMIT
              PduRDestPduRoutingType = API_FORWARDING
              PduRDestPduDataProcessing = IMMEDIATE
              PduRPduLengthHandlingStrategy = UNUSED
              PduRTransmissionConfirmation = true
              PduRDestPduDataProvision = PDUR_DIRECT
              PduRDestPduRef = CIOM_BB2_26S_oBackbone2_d4aff5b9_Tx
              PduRDestPduPduRBswModulesRef = CanIf
            PduRSrcPdu_42d23fef (PduRSrcPdu): PduRSourcePduHandleId=27, PduRSrcPduDirection=TRANSMIT, PduRSrcPduRef=CIOM_BB2_26S_oBackbone2_edb7e59e_Tx, PduRSrcPduPduRBswModulesRef=Com
          HMIIOM_BB2_01P_oBackbone2_0a8179ad_Rx: PduRRoutingPathCommunicationType=COMMUNICATION_INTERFACE
            PduRSrcPdu_fd64c8e1 (PduRSrcPdu): PduRSourcePduHandleId=98, PduRSrcPduDirection=RECEIVE, PduRSrcPduRef=HMIIOM_BB2_01P_oBackbone2_0a8179ad_Rx, PduRSrcPduPduRBswModulesRef=CanIf
            HMIIOM_BB2_01P_oBackbone2_0a8179ad_Rx_fd64c8e1_Rx (PduRDestPdu):
              PduRDestPduHandleId = 91
              PduRDestPduDirection = RECEIVE
              PduRDestPduRoutingType = API_FORWARDING
              PduRDestPduDataProcessing = IMMEDIATE
              PduRPduLengthHandlingStrategy = UNUSED
              PduRTransmissionConfirmation = false
              PduRDestPduRef = HMIIOM_BB2_01P_oBackbone2_6b8c9af6_Rx
              PduRDestPduPduRBswModulesRef = Com
          CIOM_Sec_03P_oSecuritySubnet_4613a107_Tx: PduRRoutingPathCommunicationType=COMMUNICATION_INTERFACE
            CIOM_Sec_03P_oSecuritySubnet_e93e427b_Tx (PduRDestPdu):
              PduRDestPduHandleId = 60
              PduRDestPduDirection = TRANSMIT
              PduRDestPduRoutingType = API_FORWARDING
              PduRDestPduDataProcessing = IMMEDIATE
              PduRPduLengthHandlingStrategy = UNUSED
              PduRDestPduDataProvision = PDUR_DIRECT
              PduRTransmissionConfirmation = false
              PduRDestPduRef = CIOM_Sec_03P_oSecuritySubnet_e93e427b_Tx
              PduRDestPduPduRBswModulesRef = CanIf
            PduRSrcPdu_c2aa600c (PduRSrcPdu): PduRSourcePduHandleId=70, PduRSrcPduDirection=TRANSMIT, PduRSrcPduRef=CIOM_Sec_03P_oSecuritySubnet_4613a107_Tx, PduRSrcPduPduRBswModulesRef=Com
          CIOM_Cab_15P_oCabSubnet_e780845d_Tx: PduRRoutingPathCommunicationType=COMMUNICATION_INTERFACE
            PduRSrcPdu_a03b4124 (PduRSrcPdu): PduRSourcePduHandleId=48, PduRSrcPduDirection=TRANSMIT, PduRSrcPduRef=CIOM_Cab_15P_oCabSubnet_e780845d_Tx, PduRSrcPduPduRBswModulesRef=Com
            CIOM_Cab_15P_oCabSubnet_a39ab9e4_Tx (PduRDestPdu):
              PduRDestPduHandleId = 43
              PduRDestPduDirection = TRANSMIT
              PduRDestPduRoutingType = API_FORWARDING
              PduRDestPduDataProcessing = IMMEDIATE
              PduRPduLengthHandlingStrategy = UNUSED
              PduRDestPduDataProvision = PDUR_DIRECT
              PduRTransmissionConfirmation = false
              PduRDestPduRef = CIOM_Cab_15P_oCabSubnet_a39ab9e4_Tx
              PduRDestPduPduRBswModulesRef = CanIf
          CIOMtoSlaves2_L4_oLIN03_c37e1e62_Tx: PduRRoutingPathCommunicationType=COMMUNICATION_INTERFACE
            PduRSrcPdu_f40bc261 (PduRSrcPdu): PduRSourcePduHandleId=85, PduRSrcPduDirection=TRANSMIT, PduRSrcPduRef=CIOMtoSlaves2_L4_oLIN03_c37e1e62_Tx, PduRSrcPduPduRBswModulesRef=Com
            CIOMtoSlaves2_L4_oLIN03_d05b0cdd_Tx (PduRDestPdu):
              PduRDestPduHandleId = 67
              PduRDestPduDirection = TRANSMIT
              PduRDestPduRoutingType = API_FORWARDING
              PduRDestPduDataProcessing = IMMEDIATE
              PduRPduLengthHandlingStrategy = UNUSED
              PduRDestPduDataProvision = PDUR_TRIGGERTRANSMIT
              PduRTransmissionConfirmation = false
              PduRDestPduRef = CIOMtoSlaves2_L4_oLIN03_d05b0cdd_Tx
              PduRDestPduPduRBswModulesRef = LinIf
          SRS_Cab_06P_oCabSubnet_393002bd_Rx: PduRRoutingPathCommunicationType=COMMUNICATION_INTERFACE
            SRS_Cab_06P_oCabSubnet_393002bd_Rx_08468df3_Rx (PduRDestPdu):
              PduRDestPduHandleId = 126
              PduRDestPduDirection = RECEIVE
              PduRDestPduRoutingType = API_FORWARDING
              PduRDestPduDataProcessing = IMMEDIATE
              PduRPduLengthHandlingStrategy = UNUSED
              PduRTransmissionConfirmation = false
              PduRDestPduRef = SRS_Cab_06P_oCabSubnet_c0178de6_Rx
              PduRDestPduPduRBswModulesRef = Com
            PduRSrcPdu_08468df3 (PduRSrcPdu): PduRSourcePduHandleId=133, PduRSrcPduDirection=RECEIVE, PduRSrcPduRef=SRS_Cab_06P_oCabSubnet_393002bd_Rx, PduRSrcPduPduRBswModulesRef=CanIf
          RCECStoCIOM_L5_oLIN04_1ccecc00_Rx: PduRRoutingPathCommunicationType=COMMUNICATION_INTERFACE
            PduRSrcPdu_5d6ab1b6 (PduRSrcPdu): PduRSourcePduHandleId=128, PduRSrcPduDirection=RECEIVE, PduRSrcPduRef=RCECStoCIOM_L5_oLIN04_1ccecc00_Rx, PduRSrcPduPduRBswModulesRef=LinIf
            RCECStoCIOM_L5_oLIN04_1ccecc00_Rx_5d6ab1b6_Rx (PduRDestPdu):
              PduRDestPduHandleId = 119
              PduRDestPduDirection = RECEIVE
              PduRDestPduRoutingType = API_FORWARDING
              PduRDestPduDataProcessing = IMMEDIATE
              PduRPduLengthHandlingStrategy = UNUSED
              PduRTransmissionConfirmation = false
              PduRDestPduRef = RCECStoCIOM_L5_oLIN04_1a7dde70_Rx
              PduRDestPduPduRBswModulesRef = Com
          VMCU_BB2_80P_oBackbone2_4291fb8a_Rx: PduRRoutingPathCommunicationType=COMMUNICATION_INTERFACE
            VMCU_BB2_80P_oBackbone2_4291fb8a_Rx_1d885997_Rx (PduRDestPdu):
              PduRDestPduHandleId = 153
              PduRDestPduDirection = RECEIVE
              PduRDestPduRoutingType = API_FORWARDING
              PduRDestPduDataProcessing = IMMEDIATE
              PduRPduLengthHandlingStrategy = UNUSED
              PduRTransmissionConfirmation = false
              PduRDestPduRef = VMCU_BB2_80P_oBackbone2_64111c79_Rx
              PduRDestPduPduRBswModulesRef = Com
            PduRSrcPdu_1d885997 (PduRSrcPdu): PduRSourcePduHandleId=160, PduRSrcPduDirection=RECEIVE, PduRSrcPduRef=VMCU_BB2_80P_oBackbone2_4291fb8a_Rx, PduRSrcPduPduRBswModulesRef=CanIf
          CIOM_Cab_07P_oCabSubnet_1ad3d060_Tx: PduRRoutingPathCommunicationType=COMMUNICATION_INTERFACE
            PduRSrcPdu_cdef0f36 (PduRSrcPdu): PduRSourcePduHandleId=40, PduRSrcPduDirection=TRANSMIT, PduRSrcPduRef=CIOM_Cab_07P_oCabSubnet_1ad3d060_Tx, PduRSrcPduPduRBswModulesRef=Com
            CIOM_Cab_07P_oCabSubnet_adad2402_Tx (PduRDestPdu):
              PduRDestPduHandleId = 37
              PduRDestPduDirection = TRANSMIT
              PduRDestPduRoutingType = API_FORWARDING
              PduRDestPduDataProcessing = IMMEDIATE
              PduRPduLengthHandlingStrategy = UNUSED
              PduRDestPduDataProvision = PDUR_DIRECT
              PduRTransmissionConfirmation = false
              PduRDestPduRef = CIOM_Cab_07P_oCabSubnet_adad2402_Tx
              PduRDestPduPduRBswModulesRef = CanIf
          SlaveResp_FSP1_L3_oLIN02_3dc6660e_Rx: PduRRoutingPathCommunicationType=TRANSPORT_PROTOCOL
            PduRSrcPdu_55c6efb1 (PduRSrcPdu): PduRSourcePduHandleId=73, PduRSrcPduDirection=RECEIVE, PduRSrcPduRef=SlaveResp_FSP1_L3_oLIN02_3dc6660e_Rx, PduRSrcPduPduRBswModulesRef=LinTp
            SlaveResp_FSP1_L3_oLIN02_3dc6660e_Rx_55c6efb1_Rx (PduRDestPdu):
              PduRDestPduHandleId = 28
              PduRDestPduDirection = RECEIVE
              PduRDestPduRoutingType = API_FORWARDING
              PduRDestPduDataProcessing = IMMEDIATE
              PduRPduLengthHandlingStrategy = UNUSED
              PduRDestPduRef = SlaveResp_FSP1_L3_oLIN02_ce2057c9_Rx
              PduRDestPduPduRBswModulesRef = Cdd
          FSP1_SwitchDetResp_L2_oLIN01_093ed8f2_Rx: PduRRoutingPathCommunicationType=COMMUNICATION_INTERFACE
            FSP1_SwitchDetResp_L2_oLIN01_093ed8f2_Rx_d86f19ae_Rx (PduRDestPdu):
              PduRDestPduHandleId = 77
              PduRDestPduDirection = RECEIVE
              PduRDestPduRoutingType = API_FORWARDING
              PduRDestPduDataProcessing = IMMEDIATE
              PduRPduLengthHandlingStrategy = UNUSED
              PduRTransmissionConfirmation = false
              PduRDestPduRef = FSP1_SwitchDetResp_L2_oLIN01_228cb446_Rx
              PduRDestPduPduRBswModulesRef = Com
            PduRSrcPdu_d86f19ae (PduRSrcPdu): PduRSourcePduHandleId=84, PduRSrcPduDirection=RECEIVE, PduRSrcPduRef=FSP1_SwitchDetResp_L2_oLIN01_093ed8f2_Rx, PduRSrcPduPduRBswModulesRef=LinIf
          AIR1_X_CIOMFMS_oFMSNet_c1c93f86_Tx: PduRRoutingPathCommunicationType=COMMUNICATION_INTERFACE
            PduRSrcPdu_942ead34 (PduRSrcPdu): PduRSourcePduHandleId=0, PduRSrcPduDirection=TRANSMIT, PduRSrcPduRef=AIR1_X_CIOMFMS_oFMSNet_c1c93f86_Tx, PduRSrcPduPduRBswModulesRef=Com
            AIR1_X_CIOMFMS_oFMSNet_94b967fe_Tx (PduRDestPdu):
              PduRDestPduHandleId = 0
              PduRDestPduDirection = TRANSMIT
              PduRDestPduRoutingType = API_FORWARDING
              PduRDestPduDataProcessing = IMMEDIATE
              PduRPduLengthHandlingStrategy = UNUSED
              PduRDestPduDataProvision = PDUR_DIRECT
              PduRTransmissionConfirmation = false
              PduRDestPduRef = AIR1_X_CIOMFMS_oFMSNet_94b967fe_Tx
              PduRDestPduPduRBswModulesRef = CanIf
          MasterReq_oLIN01_3d2c8087_Tx: PduRRoutingPathCommunicationType=TRANSPORT_PROTOCOL
            MasterReq_oLIN01_eb5b5f1c_Tx (PduRDestPdu):
              PduRDestPduHandleId = 74
              PduRDestPduDirection = TRANSMIT
              PduRDestPduRoutingType = API_FORWARDING
              PduRDestPduDataProcessing = IMMEDIATE
              PduRPduLengthHandlingStrategy = UNUSED
              PduRDestPduRef = MasterReq_oLIN01_eb5b5f1c_Tx
              PduRDestPduPduRBswModulesRef = LinTp
            PduRSrcPdu_e38dbced (PduRSrcPdu): PduRSourcePduHandleId=167, PduRSrcPduDirection=TRANSMIT, PduRSrcPduRef=MasterReq_oLIN01_3d2c8087_Tx, PduRSrcPduPduRBswModulesRef=Cdd
          CIOM_66ba61a5_Rx: PduRRoutingPathCommunicationType=TRANSPORT_PROTOCOL
            CIOM_e217a053_Tx (PduRDestPdu):
              PduRDestPduHandleId = 26
              PduRDestPduDirection = TRANSMIT
              PduRDestPduRoutingType = GATEWAY_ROUTING
              PduRDestPduDataProcessing = IMMEDIATE
              PduRPduLengthHandlingStrategy = UNUSED
              PduRDestPduQueueDepth = 4
              PduRTpThreshold = 1
              PduRDestPduRef = DiagReqMsgIntHMIIOM_A2_F3_Cab_oCabSubnet_bf1d0d5b_Tx
              PduRDestPduPduRBswModulesRef = CanTp
            PduRSrcPdu_ac4babc0 (PduRSrcPdu):
              PduRSourcePduHandleId = 21
              PduRSrcPduDirection = RECEIVE
              PduRSrcPduRef = DiagReqMsgIntHMIIOM_A2_F3_BB2_oBackbone2_3bb0ccad_Rx
              PduRSrcPduPduRBswModulesRef = CanTp
          CIOM_Cab_29S_oCabSubnet_76c5ca8d_Tx: PduRRoutingPathCommunicationType=TRANSPORT_PROTOCOL
            PduRSrcPdu_2f32e214 (PduRSrcPdu): PduRSourcePduHandleId=62, PduRSrcPduDirection=TRANSMIT, PduRSrcPduRef=CIOM_Cab_29S_oCabSubnet_76c5ca8d_Tx, PduRSrcPduPduRBswModulesRef=Com
            CIOM_Cab_29S_oCabSubnet_793b1ffc_Tx (PduRDestPdu):
              PduRDestPduHandleId = 9
              PduRDestPduDirection = TRANSMIT
              PduRDestPduRoutingType = API_FORWARDING
              PduRDestPduDataProcessing = IMMEDIATE
              PduRPduLengthHandlingStrategy = UNUSED
              PduRDestPduRef = CIOM_Cab_29S_oCabSubnet_793b1ffc_Tx
              PduRDestPduPduRBswModulesRef = CanTp
          VMCU_BB2_34S_oBackbone2_17c1e81f_Rx: PduRRoutingPathCommunicationType=TRANSPORT_PROTOCOL
            VMCU_BB2_34S_oBackbone2_17c1e81f_Rx_656dbd2a_Rx (PduRDestPdu):
              PduRDestPduHandleId = 47
              PduRDestPduDirection = RECEIVE
              PduRDestPduRoutingType = API_FORWARDING
              PduRDestPduDataProcessing = IMMEDIATE
              PduRPduLengthHandlingStrategy = UNUSED
              PduRDestPduRef = VMCU_BB2_34S_oBackbone2_9c0e9ff2_Rx
              PduRDestPduPduRBswModulesRef = Com
            PduRSrcPdu_656dbd2a (PduRSrcPdu): PduRSourcePduHandleId=91, PduRSrcPduDirection=RECEIVE, PduRSrcPduRef=VMCU_BB2_34S_oBackbone2_17c1e81f_Rx, PduRSrcPduPduRBswModulesRef=CanTp
          VMCU_BB2_53P_oBackbone2_0a53a1d3_Rx: PduRRoutingPathCommunicationType=COMMUNICATION_INTERFACE
            PduRSrcPdu_2574e9a5 (PduRSrcPdu): PduRSourcePduHandleId=154, PduRSrcPduDirection=RECEIVE, PduRSrcPduRef=VMCU_BB2_53P_oBackbone2_0a53a1d3_Rx, PduRSrcPduPduRBswModulesRef=CanIf
            VMCU_BB2_53P_oBackbone2_0a53a1d3_Rx_2574e9a5_Rx (PduRDestPdu):
              PduRDestPduHandleId = 147
              PduRDestPduDirection = RECEIVE
              PduRDestPduRoutingType = API_FORWARDING
              PduRDestPduDataProcessing = IMMEDIATE
              PduRPduLengthHandlingStrategy = UNUSED
              PduRTransmissionConfirmation = false
              PduRDestPduRef = VMCU_BB2_53P_oBackbone2_6e2100ec_Rx
              PduRDestPduPduRBswModulesRef = Com
          CIOM_a96e33b3_Rx: PduRRoutingPathCommunicationType=TRANSPORT_PROTOCOL
            PduRSrcPdu_da0a8dca (PduRSrcPdu):
              PduRSourcePduHandleId = 39
              PduRSrcPduDirection = RECEIVE
              PduRSrcPduRef = PhysDiagReqMsg_53_F1_BB2_oBackbone2_8956a81e_Rx
              PduRSrcPduPduRBswModulesRef = CanTp
            CIOM_2dc3f245_Tx (PduRDestPdu):
              PduRDestPduHandleId = 79
              PduRDestPduDirection = TRANSMIT
              PduRDestPduRoutingType = GATEWAY_ROUTING
              PduRDestPduDataProcessing = IMMEDIATE
              PduRPduLengthHandlingStrategy = UNUSED
              PduRDestPduQueueDepth = 4
              PduRTpThreshold = 1
              PduRDestPduRef = PhysDiagReqMsg_53_F1_Cab_oCabSubnet_0dfb69e8_Tx
              PduRDestPduPduRBswModulesRef = CanTp
          LFC_X_CIOMFMS_oFMSNet_a4d1166f_Tx: PduRRoutingPathCommunicationType=COMMUNICATION_INTERFACE
            PduRSrcPdu_42404c3c (PduRSrcPdu): PduRSourcePduHandleId=144, PduRSrcPduDirection=TRANSMIT, PduRSrcPduRef=LFC_X_CIOMFMS_oFMSNet_a4d1166f_Tx, PduRSrcPduPduRBswModulesRef=Com
            LFC_X_CIOMFMS_oFMSNet_94fe6bb5_Tx (PduRDestPdu):
              PduRDestPduHandleId = 130
              PduRDestPduDirection = TRANSMIT
              PduRDestPduRoutingType = API_FORWARDING
              PduRDestPduDataProcessing = IMMEDIATE
              PduRPduLengthHandlingStrategy = UNUSED
              PduRTransmissionConfirmation = false
              PduRDestPduDataProvision = PDUR_DIRECT
              PduRDestPduRef = LFC_X_CIOMFMS_oFMSNet_94fe6bb5_Tx
              PduRDestPduPduRBswModulesRef = CanIf
          VMCU_BB2_07P_oBackbone2_96e168c6_Rx: PduRRoutingPathCommunicationType=COMMUNICATION_INTERFACE
            VMCU_BB2_07P_oBackbone2_96e168c6_Rx_4731dc7b_Rx (PduRDestPdu):
              PduRDestPduHandleId = 141
              PduRDestPduDirection = RECEIVE
              PduRDestPduRoutingType = API_FORWARDING
              PduRDestPduDataProcessing = IMMEDIATE
              PduRPduLengthHandlingStrategy = UNUSED
              PduRTransmissionConfirmation = false
              PduRDestPduRef = VMCU_BB2_07P_oBackbone2_2a3b0417_Rx
              PduRDestPduPduRBswModulesRef = Com
            PduRSrcPdu_4731dc7b (PduRSrcPdu): PduRSourcePduHandleId=148, PduRSrcPduDirection=RECEIVE, PduRSrcPduRef=VMCU_BB2_07P_oBackbone2_96e168c6_Rx, PduRSrcPduPduRBswModulesRef=CanIf
          LFE_X_CIOMFMS_oFMSNet_390d1d7c_Tx: PduRRoutingPathCommunicationType=COMMUNICATION_INTERFACE
            LFE_X_CIOMFMS_oFMSNet_582911c6_Tx (PduRDestPdu):
              PduRDestPduHandleId = 131
              PduRDestPduDirection = TRANSMIT
              PduRDestPduRoutingType = API_FORWARDING
              PduRDestPduDataProcessing = IMMEDIATE
              PduRPduLengthHandlingStrategy = UNUSED
              PduRDestPduDataProvision = PDUR_DIRECT
              PduRTransmissionConfirmation = false
              PduRDestPduRef = LFE_X_CIOMFMS_oFMSNet_582911c6_Tx
              PduRDestPduPduRBswModulesRef = CanIf
            PduRSrcPdu_c8bc4c29 (PduRSrcPdu): PduRSourcePduHandleId=145, PduRSrcPduDirection=TRANSMIT, PduRSrcPduRef=LFE_X_CIOMFMS_oFMSNet_390d1d7c_Tx, PduRSrcPduPduRBswModulesRef=Com
          CIOMtoSlaves_L5_oLIN04_f05bf497_Tx: PduRRoutingPathCommunicationType=COMMUNICATION_INTERFACE
            PduRSrcPdu_5fe91aff (PduRSrcPdu): PduRSourcePduHandleId=86, PduRSrcPduDirection=TRANSMIT, PduRSrcPduRef=CIOMtoSlaves_L5_oLIN04_f05bf497_Tx, PduRSrcPduPduRBswModulesRef=Com
            CIOMtoSlaves_L5_oLIN04_251caba0_Tx (PduRDestPdu):
              PduRDestPduHandleId = 68
              PduRDestPduDirection = TRANSMIT
              PduRDestPduRoutingType = API_FORWARDING
              PduRDestPduDataProcessing = IMMEDIATE
              PduRPduLengthHandlingStrategy = UNUSED
              PduRDestPduDataProvision = PDUR_TRIGGERTRANSMIT
              PduRTransmissionConfirmation = false
              PduRDestPduRef = CIOMtoSlaves_L5_oLIN04_251caba0_Tx
              PduRDestPduPduRBswModulesRef = LinIf
          DiagFaultStat_DDM_Sec_oSecuritySubnet_279347f5_Rx: PduRRoutingPathCommunicationType=COMMUNICATION_INTERFACE
            DiagFaultStat_DDM_Sec_oSecuritySubnet_279347f5_Rx_b27c64ee_Rx (PduRDestPdu):
              PduRDestPduHandleId = 46
              PduRDestPduDirection = RECEIVE
              PduRDestPduRoutingType = API_FORWARDING
              PduRDestPduDataProcessing = IMMEDIATE
              PduRPduLengthHandlingStrategy = UNUSED
              PduRTransmissionConfirmation = false
              PduRDestPduRef = DiagFaultStat_DDM_Sec_oSecuritySubnet_c65980ff_Rx
              PduRDestPduPduRBswModulesRef = Com
            PduRSrcPdu_b27c64ee (PduRSrcPdu):
              PduRSourcePduHandleId = 53
              PduRSrcPduDirection = RECEIVE
              PduRSrcPduRef = DiagFaultStat_DDM_Sec_oSecuritySubnet_279347f5_Rx
              PduRSrcPduPduRBswModulesRef = CanIf
          DACU_BB2_02P_oBackbone2_a741c3bf_Rx: PduRRoutingPathCommunicationType=COMMUNICATION_INTERFACE
            DACU_BB2_02P_oBackbone2_a741c3bf_Rx_da0bb296_Rx (PduRDestPdu):
              PduRDestPduHandleId = 32
              PduRDestPduDirection = RECEIVE
              PduRDestPduRoutingType = API_FORWARDING
              PduRDestPduDataProcessing = IMMEDIATE
              PduRPduLengthHandlingStrategy = UNUSED
              PduRTransmissionConfirmation = false
              PduRDestPduRef = DACU_BB2_02P_oBackbone2_3e1257a1_Rx
              PduRDestPduPduRBswModulesRef = Com
            PduRSrcPdu_da0bb296 (PduRSrcPdu): PduRSourcePduHandleId=39, PduRSrcPduDirection=RECEIVE, PduRSrcPduRef=DACU_BB2_02P_oBackbone2_a741c3bf_Rx, PduRSrcPduPduRBswModulesRef=CanIf
          CIOM_Cab_23P_oCabSubnet_3b047e5b_Tx: PduRRoutingPathCommunicationType=COMMUNICATION_INTERFACE
            PduRSrcPdu_dde2c294 (PduRSrcPdu): PduRSourcePduHandleId=56, PduRSrcPduDirection=TRANSMIT, PduRSrcPduRef=CIOM_Cab_23P_oCabSubnet_3b047e5b_Tx, PduRSrcPduPduRBswModulesRef=Com
            CIOM_Cab_23P_oCabSubnet_b1c21fce_Tx (PduRDestPdu):
              PduRDestPduHandleId = 50
              PduRDestPduDirection = TRANSMIT
              PduRDestPduRoutingType = API_FORWARDING
              PduRDestPduDataProcessing = IMMEDIATE
              PduRPduLengthHandlingStrategy = UNUSED
              PduRDestPduDataProvision = PDUR_DIRECT
              PduRTransmissionConfirmation = false
              PduRDestPduRef = CIOM_Cab_23P_oCabSubnet_b1c21fce_Tx
              PduRDestPduPduRBswModulesRef = CanIf
          TCPtoMaster_oLIN02_30042c71_Rx: PduRRoutingPathCommunicationType=COMMUNICATION_INTERFACE
            TCPtoMaster_oLIN02_30042c71_Rx_93b09a1a_Rx (PduRDestPdu):
              PduRDestPduHandleId = 128
              PduRDestPduDirection = RECEIVE
              PduRDestPduRoutingType = API_FORWARDING
              PduRDestPduDataProcessing = IMMEDIATE
              PduRPduLengthHandlingStrategy = UNUSED
              PduRTransmissionConfirmation = false
              PduRDestPduRef = TCPtoMaster_oLIN02_0421b227_Rx
              PduRDestPduPduRBswModulesRef = Com
            PduRSrcPdu_93b09a1a (PduRSrcPdu): PduRSourcePduHandleId=135, PduRSrcPduDirection=RECEIVE, PduRSrcPduRef=TCPtoMaster_oLIN02_30042c71_Rx, PduRSrcPduPduRBswModulesRef=LinIf
          VMCU_BB2_08P_oBackbone2_cd604e07_Rx: PduRRoutingPathCommunicationType=COMMUNICATION_INTERFACE
            PduRSrcPdu_e56fc5e2 (PduRSrcPdu): PduRSourcePduHandleId=149, PduRSrcPduDirection=RECEIVE, PduRSrcPduRef=VMCU_BB2_08P_oBackbone2_cd604e07_Rx, PduRSrcPduPduRBswModulesRef=CanIf
            VMCU_BB2_08P_oBackbone2_cd604e07_Rx_e56fc5e2_Rx (PduRDestPdu):
              PduRDestPduHandleId = 142
              PduRDestPduDirection = RECEIVE
              PduRDestPduRoutingType = API_FORWARDING
              PduRDestPduDataProcessing = IMMEDIATE
              PduRPduLengthHandlingStrategy = UNUSED
              PduRTransmissionConfirmation = false
              PduRDestPduRef = VMCU_BB2_08P_oBackbone2_0d4bd122_Rx
              PduRDestPduPduRBswModulesRef = Com
          TECU_BB2_05S_oBackbone2_0976cf31_Rx: PduRRoutingPathCommunicationType=TRANSPORT_PROTOCOL
            TECU_BB2_05S_oBackbone2_0976cf31_Rx_0aeda82a_Rx (PduRDestPdu):
              PduRDestPduHandleId = 42
              PduRDestPduDirection = RECEIVE
              PduRDestPduRoutingType = API_FORWARDING
              PduRDestPduDataProcessing = IMMEDIATE
              PduRPduLengthHandlingStrategy = UNUSED
              PduRDestPduRef = TECU_BB2_05S_oBackbone2_692c9645_Rx
              PduRDestPduPduRBswModulesRef = Com
            PduRSrcPdu_0aeda82a (PduRSrcPdu): PduRSourcePduHandleId=87, PduRSrcPduDirection=RECEIVE, PduRSrcPduRef=TECU_BB2_05S_oBackbone2_0976cf31_Rx, PduRSrcPduPduRBswModulesRef=CanTp
          CCVS_X_CIOMFMS_oFMSNet_7f7a8999_Tx: PduRRoutingPathCommunicationType=COMMUNICATION_INTERFACE
            CCVS_X_CIOMFMS_oFMSNet_559ff1c7_Tx (PduRDestPdu):
              PduRDestPduHandleId = 13
              PduRDestPduDirection = TRANSMIT
              PduRDestPduRoutingType = API_FORWARDING
              PduRDestPduDataProcessing = IMMEDIATE
              PduRPduLengthHandlingStrategy = UNUSED
              PduRTransmissionConfirmation = false
              PduRDestPduDataProvision = PDUR_DIRECT
              PduRDestPduRef = CCVS_X_CIOMFMS_oFMSNet_559ff1c7_Tx
              PduRDestPduPduRBswModulesRef = CanIf
            PduRSrcPdu_18f55cec (PduRSrcPdu): PduRSourcePduHandleId=11, PduRSrcPduDirection=TRANSMIT, PduRSrcPduRef=CCVS_X_CIOMFMS_oFMSNet_7f7a8999_Tx, PduRSrcPduPduRBswModulesRef=Com
          ET1_X_CIOMFMS_oFMSNet_388be6e9_Tx: PduRRoutingPathCommunicationType=COMMUNICATION_INTERFACE
            PduRSrcPdu_8888e39c (PduRSrcPdu): PduRSourcePduHandleId=133, PduRSrcPduDirection=TRANSMIT, PduRSrcPduRef=ET1_X_CIOMFMS_oFMSNet_388be6e9_Tx, PduRSrcPduPduRBswModulesRef=Com
            ET1_X_CIOMFMS_oFMSNet_a8a2ee82_Tx (PduRDestPdu):
              PduRDestPduHandleId = 119
              PduRDestPduDirection = TRANSMIT
              PduRDestPduRoutingType = API_FORWARDING
              PduRDestPduDataProcessing = IMMEDIATE
              PduRPduLengthHandlingStrategy = UNUSED
              PduRDestPduDataProvision = PDUR_DIRECT
              PduRTransmissionConfirmation = false
              PduRDestPduRef = ET1_X_CIOMFMS_oFMSNet_a8a2ee82_Tx
              PduRDestPduPduRBswModulesRef = CanIf
          HMIIOM_BB2_39P_oBackbone2_b282fcec_Rx: PduRRoutingPathCommunicationType=COMMUNICATION_INTERFACE
            HMIIOM_BB2_39P_oBackbone2_b282fcec_Rx_9fa6bf08_Rx (PduRDestPdu):
              PduRDestPduHandleId = 102
              PduRDestPduDirection = RECEIVE
              PduRDestPduRoutingType = API_FORWARDING
              PduRDestPduDataProcessing = IMMEDIATE
              PduRPduLengthHandlingStrategy = UNUSED
              PduRTransmissionConfirmation = false
              PduRDestPduRef = HMIIOM_BB2_39P_oBackbone2_4dee6c40_Rx
              PduRDestPduPduRBswModulesRef = Com
            PduRSrcPdu_9fa6bf08 (PduRSrcPdu): PduRSourcePduHandleId=109, PduRSrcPduDirection=RECEIVE, PduRSrcPduRef=HMIIOM_BB2_39P_oBackbone2_b282fcec_Rx, PduRSrcPduPduRBswModulesRef=CanIf
          CIOM_d46195cf_Rx: PduRRoutingPathCommunicationType=TRANSPORT_PROTOCOL
            CIOM_50cc5439_Tx (PduRDestPdu):
              PduRDestPduHandleId = 84
              PduRDestPduDirection = TRANSMIT
              PduRDestPduRoutingType = GATEWAY_ROUTING
              PduRDestPduDataProcessing = IMMEDIATE
              PduRPduLengthHandlingStrategy = UNUSED
              PduRDestPduQueueDepth = 4
              PduRTpThreshold = 1
              PduRDestPduRef = PhysDiagReqMsg_A2_F2_Cab_oCabSubnet_70f4cf94_Tx
              PduRDestPduPduRBswModulesRef = CanTp
            PduRSrcPdu_3c553d77 (PduRSrcPdu):
              PduRSourcePduHandleId = 49
              PduRSrcPduDirection = RECEIVE
              PduRSrcPduRef = PhysDiagReqMsg_A2_F2_BB2_oBackbone2_f4590e62_Rx
              PduRSrcPduPduRBswModulesRef = CanTp
          SlaveResp_FSP2_L2_oLIN01_e423846a_Rx: PduRRoutingPathCommunicationType=TRANSPORT_PROTOCOL
            PduRSrcPdu_e28df3db (PduRSrcPdu): PduRSourcePduHandleId=77, PduRSrcPduDirection=RECEIVE, PduRSrcPduRef=SlaveResp_FSP2_L2_oLIN01_e423846a_Rx, PduRSrcPduPduRBswModulesRef=LinTp
            SlaveResp_FSP2_L2_oLIN01_e423846a_Rx_e28df3db_Rx (PduRDestPdu):
              PduRDestPduHandleId = 32
              PduRDestPduDirection = RECEIVE
              PduRDestPduRoutingType = API_FORWARDING
              PduRDestPduDataProcessing = IMMEDIATE
              PduRPduLengthHandlingStrategy = UNUSED
              PduRDestPduRef = SlaveResp_FSP2_L2_oLIN01_026160ec_Rx
              PduRDestPduPduRBswModulesRef = Cdd
          CIOM_85d628ec_Rx: PduRRoutingPathCommunicationType=TRANSPORT_PROTOCOL
            CIOM_85d628ec_Rx_f1553bf5_Rx (PduRDestPdu):
              PduRDestPduHandleId = 44
              PduRDestPduDirection = RECEIVE
              PduRDestPduRoutingType = API_FORWARDING
              PduRDestPduDataProcessing = IMMEDIATE
              PduRPduLengthHandlingStrategy = UNUSED
              PduRDestPduRef = TesterFuncDiagMsg_BB2_oBackbone2_7fc3ea4b_Rx
              PduRDestPduPduRBswModulesRef = Dcm
            PduRSrcPdu_f1553bf5 (PduRSrcPdu):
              PduRSourcePduHandleId = 22
              PduRSrcPduDirection = RECEIVE
              PduRSrcPduRef = TesterFuncDiagMsg_BB2_oBackbone2_f2c7ccac_Rx
              PduRSrcPduPduRBswModulesRef = CanTp
            CIOM_305ca23a_Tx (PduRDestPdu):
              PduRDestPduHandleId = 96
              PduRDestPduDirection = TRANSMIT
              PduRDestPduRoutingType = GATEWAY_ROUTING
              PduRDestPduDataProcessing = IMMEDIATE
              PduRPduLengthHandlingStrategy = UNUSED
              PduRDestPduQueueDepth = 4
              PduRTpThreshold = 7
              PduRDestPduRef = TesterFuncDiagMsg_Sec_oSecuritySubnet_50e2aa6d_Tx
              PduRDestPduPduRBswModulesRef = CanTp
            CIOM_017be91a_Tx (PduRDestPdu):
              PduRDestPduHandleId = 95
              PduRDestPduDirection = TRANSMIT
              PduRDestPduRoutingType = GATEWAY_ROUTING
              PduRDestPduDataProcessing = IMMEDIATE
              PduRPduLengthHandlingStrategy = UNUSED
              PduRDestPduQueueDepth = 4
              PduRTpThreshold = 7
              PduRDestPduRef = TesterFuncDiagMsg_Cab_oCabSubnet_766a0d5a_Tx
              PduRDestPduPduRBswModulesRef = CanTp
          Backlight_FuncInd_L3_oLIN02_ce5895e0_Tx: PduRRoutingPathCommunicationType=COMMUNICATION_INTERFACE
            Backlight_FuncInd_L3_oLIN02_00223ca8_Tx (PduRDestPdu):
              PduRDestPduHandleId = 10
              PduRDestPduDirection = TRANSMIT
              PduRDestPduRoutingType = API_FORWARDING
              PduRDestPduDataProcessing = IMMEDIATE
              PduRPduLengthHandlingStrategy = UNUSED
              PduRDestPduDataProvision = PDUR_TRIGGERTRANSMIT
              PduRTransmissionConfirmation = false
              PduRDestPduRef = Backlight_FuncInd_L3_oLIN02_00223ca8_Tx
              PduRDestPduPduRBswModulesRef = LinIf
            PduRSrcPdu_3835a861 (PduRSrcPdu): PduRSourcePduHandleId=8, PduRSrcPduDirection=TRANSMIT, PduRSrcPduRef=Backlight_FuncInd_L3_oLIN02_ce5895e0_Tx, PduRSrcPduPduRBswModulesRef=Com
          DiagFaultStat_SRS_Cab_oCabSubnet_418c5993_Rx: PduRRoutingPathCommunicationType=COMMUNICATION_INTERFACE
            PduRSrcPdu_7803fcd2 (PduRSrcPdu):
              PduRSourcePduHandleId = 56
              PduRSrcPduDirection = RECEIVE
              PduRSrcPduRef = DiagFaultStat_SRS_Cab_oCabSubnet_418c5993_Rx
              PduRSrcPduPduRBswModulesRef = CanIf
            DiagFaultStat_SRS_Cab_oCabSubnet_418c5993_Rx_7803fcd2_Rx (PduRDestPdu):
              PduRDestPduHandleId = 49
              PduRDestPduDirection = RECEIVE
              PduRDestPduRoutingType = API_FORWARDING
              PduRDestPduDataProcessing = IMMEDIATE
              PduRPduLengthHandlingStrategy = UNUSED
              PduRTransmissionConfirmation = false
              PduRDestPduRef = DiagFaultStat_SRS_Cab_oCabSubnet_ac384d3f_Rx
              PduRDestPduPduRBswModulesRef = Com
          DiagReqMsgIntHMIIOM_40_F3_BB2_oBackbone2_ce0d5f06_Rx: PduRRoutingPathCommunicationType=TRANSPORT_PROTOCOL
            PduRSrcPdu_8771577a (PduRSrcPdu):
              PduRSourcePduHandleId = 55
              PduRSrcPduDirection = RECEIVE
              PduRSrcPduRef = DiagReqMsgIntHMIIOM_40_F3_BB2_oBackbone2_ce0d5f06_Rx
              PduRSrcPduPduRBswModulesRef = CanTp
            DiagReqMsgIntHMIIOM_40_F3_BB2_oBackbone2_ce0d5f06_Rx_8771577a_Rx (PduRDestPdu):
              PduRDestPduHandleId = 9
              PduRDestPduDirection = RECEIVE
              PduRDestPduRoutingType = API_FORWARDING
              PduRDestPduDataProcessing = IMMEDIATE
              PduRPduLengthHandlingStrategy = UNUSED
              PduRDestPduRef = DiagReqMsgIntHMIIOM_40_F3_BB2_oBackbone2_7ba98dfb_Rx
              PduRDestPduPduRBswModulesRef = Dcm
          CIOM_Cab_08P_oCabSubnet_3da30555_Tx: PduRRoutingPathCommunicationType=COMMUNICATION_INTERFACE
            PduRSrcPdu_2c4f8116 (PduRSrcPdu): PduRSourcePduHandleId=41, PduRSrcPduDirection=TRANSMIT, PduRSrcPduRef=CIOM_Cab_08P_oCabSubnet_3da30555_Tx, PduRSrcPduPduRBswModulesRef=Com
            CIOM_Cab_08P_oCabSubnet_f62c02c3_Tx (PduRDestPdu):
              PduRDestPduHandleId = 38
              PduRDestPduDirection = TRANSMIT
              PduRDestPduRoutingType = API_FORWARDING
              PduRDestPduDataProcessing = IMMEDIATE
              PduRPduLengthHandlingStrategy = UNUSED
              PduRDestPduDataProvision = PDUR_DIRECT
              PduRTransmissionConfirmation = false
              PduRDestPduRef = CIOM_Cab_08P_oCabSubnet_f62c02c3_Tx
              PduRDestPduPduRBswModulesRef = CanIf
          AnmMsg_CCM_CabSubnet_oCabSubnet_2f78a729_Rx: PduRRoutingPathCommunicationType=COMMUNICATION_INTERFACE
            PduRSrcPdu_824648ca (PduRSrcPdu): PduRSourcePduHandleId=6, PduRSrcPduDirection=RECEIVE, PduRSrcPduRef=AnmMsg_CCM_CabSubnet_oCabSubnet_2f78a729_Rx, PduRSrcPduPduRBswModulesRef=CanIf
            AnmMsg_CCM_CabSubnet_oCabSubnet_2f78a729_Rx_824648ca_Rx (PduRDestPdu):
              PduRDestPduHandleId = 6
              PduRDestPduDirection = RECEIVE
              PduRDestPduRoutingType = API_FORWARDING
              PduRDestPduDataProcessing = IMMEDIATE
              PduRPduLengthHandlingStrategy = UNUSED
              PduRTransmissionConfirmation = false
              PduRDestPduRef = AnmMsg_CCM_CabSubnet_oCabSubnet_2d9f2dda_Rx
              PduRDestPduPduRBswModulesRef = Com
          CIOM_2955ce18_Rx: PduRRoutingPathCommunicationType=TRANSPORT_PROTOCOL
            PduRSrcPdu_064dc9ab (PduRSrcPdu):
              PduRSourcePduHandleId = 28
              PduRSrcPduDirection = RECEIVE
              PduRSrcPduRef = DiagRespMsgIntTGW2_F4_A0_Sec_oSecuritySubnet_b7a5da3a_Rx
              PduRSrcPduPduRBswModulesRef = CanTp
            CIOM_3fb186a1_Tx (PduRDestPdu):
              PduRDestPduHandleId = 47
              PduRDestPduDirection = TRANSMIT
              PduRDestPduRoutingType = GATEWAY_ROUTING
              PduRDestPduDataProcessing = IMMEDIATE
              PduRPduLengthHandlingStrategy = UNUSED
              PduRDestPduQueueDepth = 4
              PduRTpThreshold = 1
              PduRDestPduRef = DiagRespMsgIntTGW2_F4_A0_BB2_oBackbone2_5d078c5b_Tx
              PduRDestPduPduRBswModulesRef = CanTp
          CIOM_683ef509_Rx: PduRRoutingPathCommunicationType=TRANSPORT_PROTOCOL
            PduRSrcPdu_a40032de (PduRSrcPdu):
              PduRSourcePduHandleId = 25
              PduRSrcPduDirection = RECEIVE
              PduRSrcPduRef = DiagReqMsgIntTGW2_53_F4_BB2_oBackbone2_0329d055_Rx
              PduRSrcPduPduRBswModulesRef = CanTp
            CIOM_ec9334ff_Tx (PduRDestPdu):
              PduRDestPduHandleId = 29
              PduRDestPduDirection = TRANSMIT
              PduRDestPduRoutingType = GATEWAY_ROUTING
              PduRDestPduDataProcessing = IMMEDIATE
              PduRPduLengthHandlingStrategy = UNUSED
              PduRDestPduQueueDepth = 4
              PduRTpThreshold = 1
              PduRDestPduRef = DiagReqMsgIntTGW2_53_F4_Cab_oCabSubnet_878411a3_Tx
              PduRDestPduPduRBswModulesRef = CanTp
          CIOM_5f745d89_Rx: PduRRoutingPathCommunicationType=TRANSPORT_PROTOCOL
            CIOM_dbd99c7f_Tx (PduRDestPdu):
              PduRDestPduHandleId = 41
              PduRDestPduDirection = TRANSMIT
              PduRDestPduRoutingType = GATEWAY_ROUTING
              PduRDestPduDataProcessing = IMMEDIATE
              PduRPduLengthHandlingStrategy = UNUSED
              PduRDestPduQueueDepth = 4
              PduRTpThreshold = 1
              PduRDestPduRef = DiagRespMsgIntHMIIOM_F3_A2_BB2_oBackbone2_d55f1ee0_Tx
              PduRDestPduPduRBswModulesRef = CanTp
            PduRSrcPdu_bbc023c9 (PduRSrcPdu):
              PduRSourcePduHandleId = 9
              PduRSrcPduDirection = RECEIVE
              PduRSrcPduRef = DiagRespMsgIntHMIIOM_F3_A2_Cab_oCabSubnet_51f2df16_Rx
              PduRSrcPduPduRBswModulesRef = CanTp
          CIOM_Sec_02P_oSecuritySubnet_a94117e6_Tx: PduRRoutingPathCommunicationType=COMMUNICATION_INTERFACE
            PduRSrcPdu_b359c6a9 (PduRSrcPdu): PduRSourcePduHandleId=69, PduRSrcPduDirection=TRANSMIT, PduRSrcPduRef=CIOM_Sec_02P_oSecuritySubnet_a94117e6_Tx, PduRSrcPduPduRBswModulesRef=Com
            CIOM_Sec_02P_oSecuritySubnet_4807c695_Tx (PduRDestPdu):
              PduRDestPduHandleId = 59
              PduRDestPduDirection = TRANSMIT
              PduRDestPduRoutingType = API_FORWARDING
              PduRDestPduDataProcessing = IMMEDIATE
              PduRPduLengthHandlingStrategy = UNUSED
              PduRDestPduDataProvision = PDUR_DIRECT
              PduRTransmissionConfirmation = false
              PduRDestPduRef = CIOM_Sec_02P_oSecuritySubnet_4807c695_Tx
              PduRDestPduPduRBswModulesRef = CanIf
          AnmMsg_ECUspare6_CabSubnet_oCabSubnet_3fe72d0f_Rx: PduRRoutingPathCommunicationType=COMMUNICATION_INTERFACE
            AnmMsg_ECUspare6_CabSubnet_oCabSubnet_3fe72d0f_Rx_6c24f169_Rx (PduRDestPdu):
              PduRDestPduHandleId = 12
              PduRDestPduDirection = RECEIVE
              PduRDestPduRoutingType = API_FORWARDING
              PduRDestPduDataProcessing = IMMEDIATE
              PduRPduLengthHandlingStrategy = UNUSED
              PduRTransmissionConfirmation = false
              PduRDestPduRef = AnmMsg_ECUspare6_CabSubnet_oCabSubnet_7e48353e_Rx
              PduRDestPduPduRBswModulesRef = Com
            PduRSrcPdu_6c24f169 (PduRSrcPdu):
              PduRSourcePduHandleId = 12
              PduRSrcPduDirection = RECEIVE
              PduRSrcPduRef = AnmMsg_ECUspare6_CabSubnet_oCabSubnet_3fe72d0f_Rx
              PduRSrcPduPduRBswModulesRef = CanIf
          CIOM_9a49fe92_Rx: PduRRoutingPathCommunicationType=TRANSPORT_PROTOCOL
            CIOM_500aa266_Tx (PduRDestPdu):
              PduRDestPduHandleId = 40
              PduRDestPduDirection = TRANSMIT
              PduRDestPduRoutingType = GATEWAY_ROUTING
              PduRDestPduDataProcessing = IMMEDIATE
              PduRPduLengthHandlingStrategy = UNUSED
              PduRDestPduQueueDepth = 4
              PduRTpThreshold = 1
              PduRDestPduRef = DiagRespMsgIntHMIIOM_F3_A1_BB2_oBackbone2_5e8c20f9_Tx
              PduRDestPduPduRBswModulesRef = CanTp
            PduRSrcPdu_c28e0d5d (PduRSrcPdu):
              PduRSourcePduHandleId = 14
              PduRSrcPduDirection = RECEIVE
              PduRSrcPduRef = DiagRespMsgIntHMIIOM_F3_A1_Sec_oSecuritySubnet_2721f23f_Rx
              PduRSrcPduPduRBswModulesRef = CanTp
          HMIIOM_BB2_03P_oBackbone2_324474b8_Rx: PduRRoutingPathCommunicationType=COMMUNICATION_INTERFACE
            HMIIOM_BB2_03P_oBackbone2_324474b8_Rx_72f29192_Rx (PduRDestPdu):
              PduRDestPduHandleId = 92
              PduRDestPduDirection = RECEIVE
              PduRDestPduRoutingType = API_FORWARDING
              PduRDestPduDataProcessing = IMMEDIATE
              PduRPduLengthHandlingStrategy = UNUSED
              PduRTransmissionConfirmation = false
              PduRDestPduRef = HMIIOM_BB2_03P_oBackbone2_0bd02fbd_Rx
              PduRDestPduPduRBswModulesRef = Com
            PduRSrcPdu_72f29192 (PduRSrcPdu): PduRSourcePduHandleId=99, PduRSrcPduDirection=RECEIVE, PduRSrcPduRef=HMIIOM_BB2_03P_oBackbone2_324474b8_Rx, PduRSrcPduPduRBswModulesRef=CanIf
          VMCU_BB2_20P_oBackbone2_43915bb5_Rx: PduRRoutingPathCommunicationType=COMMUNICATION_INTERFACE
            PduRSrcPdu_96d8e8cf (PduRSrcPdu): PduRSourcePduHandleId=150, PduRSrcPduDirection=RECEIVE, PduRSrcPduRef=VMCU_BB2_20P_oBackbone2_43915bb5_Rx, PduRSrcPduPduRBswModulesRef=CanIf
            VMCU_BB2_20P_oBackbone2_43915bb5_Rx_96d8e8cf_Rx (PduRDestPdu):
              PduRDestPduHandleId = 143
              PduRDestPduDirection = RECEIVE
              PduRDestPduRoutingType = API_FORWARDING
              PduRDestPduDataProcessing = IMMEDIATE
              PduRPduLengthHandlingStrategy = UNUSED
              PduRTransmissionConfirmation = false
              PduRDestPduRef = VMCU_BB2_20P_oBackbone2_b626c6e2_Rx
              PduRDestPduPduRBswModulesRef = Com
          AnmMsg_TECU_Backbone2_oBackbone2_d3c774dc_Rx: PduRRoutingPathCommunicationType=COMMUNICATION_INTERFACE
            AnmMsg_TECU_Backbone2_oBackbone2_d3c774dc_Rx_0a3da473_Rx (PduRDestPdu):
              PduRDestPduHandleId = 18
              PduRDestPduDirection = RECEIVE
              PduRDestPduRoutingType = API_FORWARDING
              PduRDestPduDataProcessing = IMMEDIATE
              PduRPduLengthHandlingStrategy = UNUSED
              PduRTransmissionConfirmation = false
              PduRDestPduRef = AnmMsg_TECU_Backbone2_oBackbone2_7840c27c_Rx
              PduRDestPduPduRBswModulesRef = Com
            PduRSrcPdu_0a3da473 (PduRSrcPdu):
              PduRSourcePduHandleId = 18
              PduRSrcPduDirection = RECEIVE
              PduRSrcPduRef = AnmMsg_TECU_Backbone2_oBackbone2_d3c774dc_Rx
              PduRSrcPduPduRBswModulesRef = CanIf
          FSP1_SwitchDetResp_L5_oLIN04_75b469c5_Rx: PduRRoutingPathCommunicationType=COMMUNICATION_INTERFACE
            FSP1_SwitchDetResp_L5_oLIN04_75b469c5_Rx_c187c3bc_Rx (PduRDestPdu):
              PduRDestPduHandleId = 80
              PduRDestPduDirection = RECEIVE
              PduRDestPduRoutingType = API_FORWARDING
              PduRDestPduDataProcessing = IMMEDIATE
              PduRPduLengthHandlingStrategy = UNUSED
              PduRTransmissionConfirmation = false
              PduRDestPduRef = FSP1_SwitchDetResp_L5_oLIN04_582349d0_Rx
              PduRDestPduPduRBswModulesRef = Com
            PduRSrcPdu_c187c3bc (PduRSrcPdu): PduRSourcePduHandleId=87, PduRSrcPduDirection=RECEIVE, PduRSrcPduRef=FSP1_SwitchDetResp_L5_oLIN04_75b469c5_Rx, PduRSrcPduPduRBswModulesRef=LinIf
          FSP3_Frame_L2_oLIN01_e70e546d_Rx: PduRRoutingPathCommunicationType=COMMUNICATION_INTERFACE
            PduRSrcPdu_9649cb45 (PduRSrcPdu): PduRSourcePduHandleId=94, PduRSrcPduDirection=RECEIVE, PduRSrcPduRef=FSP3_Frame_L2_oLIN01_e70e546d_Rx, PduRSrcPduPduRBswModulesRef=LinIf
            FSP3_Frame_L2_oLIN01_e70e546d_Rx_9649cb45_Rx (PduRDestPdu):
              PduRDestPduHandleId = 87
              PduRDestPduDirection = RECEIVE
              PduRDestPduRoutingType = API_FORWARDING
              PduRDestPduDataProcessing = IMMEDIATE
              PduRPduLengthHandlingStrategy = UNUSED
              PduRTransmissionConfirmation = false
              PduRDestPduRef = FSP3_Frame_L2_oLIN01_53b2dc61_Rx
              PduRDestPduPduRBswModulesRef = Com
          CIOM_63ef3781_Rx: PduRRoutingPathCommunicationType=TRANSPORT_PROTOCOL
            CIOM_e742f677_Tx (PduRDestPdu):
              PduRDestPduHandleId = 37
              PduRDestPduDirection = TRANSMIT
              PduRDestPduRoutingType = GATEWAY_ROUTING
              PduRDestPduDataProcessing = IMMEDIATE
              PduRPduLengthHandlingStrategy = UNUSED
              PduRDestPduQueueDepth = 4
              PduRTpThreshold = 1
              PduRDestPduRef = DiagRespMsgIntHMIIOM_F3_53_BB2_oBackbone2_e9c474e8_Tx
              PduRDestPduPduRBswModulesRef = CanTp
            PduRSrcPdu_1ac6f203 (PduRSrcPdu):
              PduRSourcePduHandleId = 20
              PduRSrcPduDirection = RECEIVE
              PduRSrcPduRef = DiagRespMsgIntHMIIOM_F3_53_Cab_oCabSubnet_6d69b51e_Rx
              PduRSrcPduPduRBswModulesRef = CanTp
          EEC1_X_CIOMFMS_oFMSNet_2fc23128_Tx: PduRRoutingPathCommunicationType=COMMUNICATION_INTERFACE
            PduRSrcPdu_59fd94e4 (PduRSrcPdu): PduRSourcePduHandleId=128, PduRSrcPduDirection=TRANSMIT, PduRSrcPduRef=EEC1_X_CIOMFMS_oFMSNet_2fc23128_Tx, PduRSrcPduPduRBswModulesRef=Com
            EEC1_X_CIOMFMS_oFMSNet_09cdd7bd_Tx (PduRDestPdu):
              PduRDestPduHandleId = 114
              PduRDestPduDirection = TRANSMIT
              PduRDestPduRoutingType = API_FORWARDING
              PduRDestPduDataProcessing = IMMEDIATE
              PduRPduLengthHandlingStrategy = UNUSED
              PduRDestPduDataProvision = PDUR_DIRECT
              PduRTransmissionConfirmation = false
              PduRDestPduRef = EEC1_X_CIOMFMS_oFMSNet_09cdd7bd_Tx
              PduRDestPduPduRBswModulesRef = CanIf
          CIOM_8cc8c1be_Rx: PduRRoutingPathCommunicationType=TRANSPORT_PROTOCOL
            CIOM_08650048_Tx (PduRDestPdu):
              PduRDestPduHandleId = 28
              PduRDestPduDirection = TRANSMIT
              PduRDestPduRoutingType = GATEWAY_ROUTING
              PduRDestPduDataProcessing = IMMEDIATE
              PduRPduLengthHandlingStrategy = UNUSED
              PduRDestPduQueueDepth = 4
              PduRTpThreshold = 1
              PduRDestPduRef = DiagReqMsgIntTGW2_26_F4_Cab_oCabSubnet_63722514_Tx
              PduRDestPduPduRBswModulesRef = CanTp
            PduRSrcPdu_01528206 (PduRSrcPdu):
              PduRSourcePduHandleId = 13
              PduRSrcPduDirection = RECEIVE
              PduRSrcPduRef = DiagReqMsgIntTGW2_26_F4_BB2_oBackbone2_e7dfe4e2_Rx
              PduRSrcPduPduRBswModulesRef = CanTp
          MasterReq_RCECS_oLIN04_b46d7afd_Tx: PduRRoutingPathCommunicationType=TRANSPORT_PROTOCOL
            MasterReq_RCECS_oLIN04_dc3c974a_Tx (PduRDestPdu):
              PduRDestPduHandleId = 71
              PduRDestPduDirection = TRANSMIT
              PduRDestPduRoutingType = API_FORWARDING
              PduRDestPduDataProcessing = IMMEDIATE
              PduRPduLengthHandlingStrategy = UNUSED
              PduRDestPduRef = MasterReq_RCECS_oLIN04_dc3c974a_Tx
              PduRDestPduPduRBswModulesRef = LinTp
            PduRSrcPdu_a24245d0 (PduRSrcPdu): PduRSourcePduHandleId=164, PduRSrcPduDirection=TRANSMIT, PduRSrcPduRef=MasterReq_RCECS_oLIN04_b46d7afd_Tx, PduRSrcPduPduRBswModulesRef=Cdd
          CIOM_Sec_04P_oSecuritySubnet_a73dab63_Tx: PduRRoutingPathCommunicationType=COMMUNICATION_INTERFACE
            CIOM_Sec_04P_oSecuritySubnet_3870d073_Tx (PduRDestPdu):
              PduRDestPduHandleId = 61
              PduRDestPduDirection = TRANSMIT
              PduRDestPduRoutingType = API_FORWARDING
              PduRDestPduDataProcessing = IMMEDIATE
              PduRPduLengthHandlingStrategy = UNUSED
              PduRDestPduDataProvision = PDUR_DIRECT
              PduRTransmissionConfirmation = false
              PduRDestPduRef = CIOM_Sec_04P_oSecuritySubnet_3870d073_Tx
              PduRDestPduPduRBswModulesRef = CanIf
            PduRSrcPdu_6a8e199b (PduRSrcPdu): PduRSourcePduHandleId=71, PduRSrcPduDirection=TRANSMIT, PduRSrcPduRef=CIOM_Sec_04P_oSecuritySubnet_a73dab63_Tx, PduRSrcPduPduRBswModulesRef=Com
          SlaveResp_FSP1_L2_oLIN01_16746992_Rx: PduRRoutingPathCommunicationType=TRANSPORT_PROTOCOL
            SlaveResp_FSP1_L2_oLIN01_16746992_Rx_afe1a735_Rx (PduRDestPdu):
              PduRDestPduHandleId = 27
              PduRDestPduDirection = RECEIVE
              PduRDestPduRoutingType = API_FORWARDING
              PduRDestPduDataProcessing = IMMEDIATE
              PduRPduLengthHandlingStrategy = UNUSED
              PduRDestPduRef = SlaveResp_FSP1_L2_oLIN01_9b8306ed_Rx
              PduRDestPduPduRBswModulesRef = Cdd
            PduRSrcPdu_afe1a735 (PduRSrcPdu): PduRSourcePduHandleId=72, PduRSrcPduDirection=RECEIVE, PduRSrcPduRef=SlaveResp_FSP1_L2_oLIN01_16746992_Rx, PduRSrcPduPduRBswModulesRef=LinTp
          Alarm_Sec_07S_oSecuritySubnet_a7cf33af_Rx: PduRRoutingPathCommunicationType=TRANSPORT_PROTOCOL
            Alarm_Sec_07S_oSecuritySubnet_a7cf33af_Rx_26a1cbb9_Rx (PduRDestPdu):
              PduRDestPduHandleId = 2
              PduRDestPduDirection = RECEIVE
              PduRDestPduRoutingType = API_FORWARDING
              PduRDestPduDataProcessing = IMMEDIATE
              PduRPduLengthHandlingStrategy = UNUSED
              PduRDestPduRef = Alarm_Sec_07S_oSecuritySubnet_74e9cfea_Rx
              PduRDestPduPduRBswModulesRef = Com
            PduRSrcPdu_26a1cbb9 (PduRSrcPdu): PduRSourcePduHandleId=2, PduRSrcPduDirection=RECEIVE, PduRSrcPduRef=Alarm_Sec_07S_oSecuritySubnet_a7cf33af_Rx, PduRSrcPduPduRBswModulesRef=CanTp
          LECM1_Cab_02P_oCabSubnet_7b05953d_Rx: PduRRoutingPathCommunicationType=COMMUNICATION_INTERFACE
            LECM1_Cab_02P_oCabSubnet_7b05953d_Rx_bc4ff018_Rx (PduRDestPdu):
              PduRDestPduHandleId = 109
              PduRDestPduDirection = RECEIVE
              PduRDestPduRoutingType = API_FORWARDING
              PduRDestPduDataProcessing = IMMEDIATE
              PduRPduLengthHandlingStrategy = UNUSED
              PduRTransmissionConfirmation = false
              PduRDestPduRef = LECM1_Cab_02P_oCabSubnet_d045028e_Rx
              PduRDestPduPduRBswModulesRef = Com
            PduRSrcPdu_bc4ff018 (PduRSrcPdu): PduRSourcePduHandleId=116, PduRSrcPduDirection=RECEIVE, PduRSrcPduRef=LECM1_Cab_02P_oCabSubnet_7b05953d_Rx, PduRSrcPduPduRBswModulesRef=CanIf
          CIOM_1401684a_Rx: PduRRoutingPathCommunicationType=TRANSPORT_PROTOCOL
            PduRSrcPdu_1b947dce (PduRSrcPdu):
              PduRSourcePduHandleId = 36
              PduRSrcPduDirection = RECEIVE
              PduRSrcPduRef = PhysDiagReqMsg_A0_F2_BB2_oBackbone2_3439f3e7_Rx
              PduRSrcPduPduRBswModulesRef = CanTp
            CIOM_0fefd926_Tx (PduRDestPdu):
              PduRDestPduHandleId = 82
              PduRDestPduDirection = TRANSMIT
              PduRDestPduRoutingType = GATEWAY_ROUTING
              PduRDestPduDataProcessing = IMMEDIATE
              PduRPduLengthHandlingStrategy = UNUSED
              PduRDestPduQueueDepth = 4
              PduRTpThreshold = 1
              PduRDestPduRef = PhysDiagReqMsg_A0_F2_Sec_oSecuritySubnet_821cf5f0_Tx
              PduRDestPduPduRBswModulesRef = CanTp
          AnmMsg_VMCU_Backbone2_oBackbone2_d29bb903_Rx: PduRRoutingPathCommunicationType=COMMUNICATION_INTERFACE
            AnmMsg_VMCU_Backbone2_oBackbone2_d29bb903_Rx_7e99d331_Rx (PduRDestPdu):
              PduRDestPduHandleId = 19
              PduRDestPduDirection = RECEIVE
              PduRDestPduRoutingType = API_FORWARDING
              PduRDestPduDataProcessing = IMMEDIATE
              PduRPduLengthHandlingStrategy = UNUSED
              PduRTransmissionConfirmation = false
              PduRDestPduRef = AnmMsg_VMCU_Backbone2_oBackbone2_3a2bd89f_Rx
              PduRDestPduPduRBswModulesRef = Com
            PduRSrcPdu_7e99d331 (PduRSrcPdu):
              PduRSourcePduHandleId = 19
              PduRSrcPduDirection = RECEIVE
              PduRSrcPduRef = AnmMsg_VMCU_Backbone2_oBackbone2_d29bb903_Rx
              PduRSrcPduPduRBswModulesRef = CanIf
          CIOM_Cab_06P_oCabSubnet_c74509e5_Tx: PduRRoutingPathCommunicationType=COMMUNICATION_INTERFACE
            PduRSrcPdu_f0799c66 (PduRSrcPdu): PduRSourcePduHandleId=39, PduRSrcPduDirection=TRANSMIT, PduRSrcPduRef=CIOM_Cab_06P_oCabSubnet_c74509e5_Tx, PduRSrcPduPduRBswModulesRef=Com
            CIOM_Cab_06P_oCabSubnet_5c7721a8_Tx (PduRDestPdu):
              PduRDestPduHandleId = 36
              PduRDestPduDirection = TRANSMIT
              PduRDestPduRoutingType = API_FORWARDING
              PduRDestPduDataProcessing = IMMEDIATE
              PduRPduLengthHandlingStrategy = UNUSED
              PduRDestPduDataProvision = PDUR_DIRECT
              PduRTransmissionConfirmation = false
              PduRDestPduRef = CIOM_Cab_06P_oCabSubnet_5c7721a8_Tx
              PduRDestPduPduRBswModulesRef = CanIf
          VMCU_BB2_51P_oBackbone2_3296acc6_Rx: PduRRoutingPathCommunicationType=COMMUNICATION_INTERFACE
            VMCU_BB2_51P_oBackbone2_3296acc6_Rx_14bfec1c_Rx (PduRDestPdu):
              PduRDestPduHandleId = 145
              PduRDestPduDirection = RECEIVE
              PduRDestPduRoutingType = API_FORWARDING
              PduRDestPduDataProcessing = IMMEDIATE
              PduRPduLengthHandlingStrategy = UNUSED
              PduRTransmissionConfirmation = false
              PduRDestPduRef = VMCU_BB2_51P_oBackbone2_0e7db5a7_Rx
              PduRDestPduPduRBswModulesRef = Com
            PduRSrcPdu_14bfec1c (PduRSrcPdu): PduRSourcePduHandleId=152, PduRSrcPduDirection=RECEIVE, PduRSrcPduRef=VMCU_BB2_51P_oBackbone2_3296acc6_Rx, PduRSrcPduPduRBswModulesRef=CanIf
          FSP2_Frame_L3_oLIN02_3d665e5b_Rx: PduRRoutingPathCommunicationType=COMMUNICATION_INTERFACE
            FSP2_Frame_L3_oLIN02_3d665e5b_Rx_e2611c34_Rx (PduRDestPdu):
              PduRDestPduHandleId = 83
              PduRDestPduDirection = RECEIVE
              PduRDestPduRoutingType = API_FORWARDING
              PduRDestPduDataProcessing = IMMEDIATE
              PduRPduLengthHandlingStrategy = UNUSED
              PduRTransmissionConfirmation = false
              PduRDestPduRef = FSP2_Frame_L3_oLIN02_81b74606_Rx
              PduRDestPduPduRBswModulesRef = Com
            PduRSrcPdu_e2611c34 (PduRSrcPdu): PduRSourcePduHandleId=90, PduRSrcPduDirection=RECEIVE, PduRSrcPduRef=FSP2_Frame_L3_oLIN02_3d665e5b_Rx, PduRSrcPduPduRBswModulesRef=LinIf
          DiagFaultStat_CCM_Cab_oCabSubnet_1ee92cda_Rx: PduRRoutingPathCommunicationType=COMMUNICATION_INTERFACE
            PduRSrcPdu_b10ab994 (PduRSrcPdu):
              PduRSourcePduHandleId = 52
              PduRSrcPduDirection = RECEIVE
              PduRSrcPduRef = DiagFaultStat_CCM_Cab_oCabSubnet_1ee92cda_Rx
              PduRSrcPduPduRBswModulesRef = CanIf
            DiagFaultStat_CCM_Cab_oCabSubnet_1ee92cda_Rx_b10ab994_Rx (PduRDestPdu):
              PduRDestPduHandleId = 45
              PduRDestPduDirection = RECEIVE
              PduRDestPduRoutingType = API_FORWARDING
              PduRDestPduDataProcessing = IMMEDIATE
              PduRPduLengthHandlingStrategy = UNUSED
              PduRTransmissionConfirmation = false
              PduRDestPduRef = DiagFaultStat_CCM_Cab_oCabSubnet_d4c98b2c_Rx
              PduRDestPduPduRBswModulesRef = Com
          DiagRespMsgIntTGW2_F4_40_BB2_oBackbone2_fbc59a63_Tx: PduRRoutingPathCommunicationType=TRANSPORT_PROTOCOL
            DiagRespMsgIntTGW2_F4_40_BB2_oBackbone2_3b72250e_Tx (PduRDestPdu):
              PduRDestPduHandleId = 44
              PduRDestPduDirection = TRANSMIT
              PduRDestPduRoutingType = API_FORWARDING
              PduRDestPduDataProcessing = IMMEDIATE
              PduRPduLengthHandlingStrategy = UNUSED
              PduRDestPduRef = DiagRespMsgIntTGW2_F4_40_BB2_oBackbone2_3b72250e_Tx
              PduRDestPduPduRBswModulesRef = CanTp
            PduRSrcPdu_c1ab151b (PduRSrcPdu):
              PduRSourcePduHandleId = 126
              PduRSrcPduDirection = TRANSMIT
              PduRSrcPduRef = DiagRespMsgIntTGW2_F4_40_BB2_oBackbone2_fbc59a63_Tx
              PduRSrcPduPduRBswModulesRef = Dcm
          CIOM_BB2_05P_oBackbone2_c68d9f0d_Tx: PduRRoutingPathCommunicationType=COMMUNICATION_INTERFACE
            PduRSrcPdu_8829348e (PduRSrcPdu): PduRSourcePduHandleId=17, PduRSrcPduDirection=TRANSMIT, PduRSrcPduRef=CIOM_BB2_05P_oBackbone2_c68d9f0d_Tx, PduRSrcPduPduRBswModulesRef=Com
            CIOM_BB2_05P_oBackbone2_637de593_Tx (PduRDestPdu):
              PduRDestPduHandleId = 19
              PduRDestPduDirection = TRANSMIT
              PduRDestPduRoutingType = API_FORWARDING
              PduRDestPduDataProcessing = IMMEDIATE
              PduRPduLengthHandlingStrategy = UNUSED
              PduRDestPduDataProvision = PDUR_DIRECT
              PduRTransmissionConfirmation = false
              PduRDestPduRef = CIOM_BB2_05P_oBackbone2_637de593_Tx
              PduRDestPduPduRBswModulesRef = CanIf
          DiagFaultStat_WRCS_Cab_oCabSubnet_6c860dc8_Rx: PduRRoutingPathCommunicationType=COMMUNICATION_INTERFACE
            DiagFaultStat_WRCS_Cab_oCabSubnet_6c860dc8_Rx_ca104489_Rx (PduRDestPdu):
              PduRDestPduHandleId = 50
              PduRDestPduDirection = RECEIVE
              PduRDestPduRoutingType = API_FORWARDING
              PduRDestPduDataProcessing = IMMEDIATE
              PduRPduLengthHandlingStrategy = UNUSED
              PduRTransmissionConfirmation = false
              PduRDestPduRef = DiagFaultStat_WRCS_Cab_oCabSubnet_3792ace7_Rx
              PduRDestPduPduRBswModulesRef = Com
            PduRSrcPdu_ca104489 (PduRSrcPdu):
              PduRSourcePduHandleId = 57
              PduRSrcPduDirection = RECEIVE
              PduRSrcPduRef = DiagFaultStat_WRCS_Cab_oCabSubnet_6c860dc8_Rx
              PduRSrcPduPduRBswModulesRef = CanIf
          CIOM_Cab_14P_oCabSubnet_3a165dd8_Tx: PduRRoutingPathCommunicationType=COMMUNICATION_INTERFACE
            CIOM_Cab_14P_oCabSubnet_5240bc4e_Tx (PduRDestPdu):
              PduRDestPduHandleId = 42
              PduRDestPduDirection = TRANSMIT
              PduRDestPduRoutingType = API_FORWARDING
              PduRDestPduDataProcessing = IMMEDIATE
              PduRPduLengthHandlingStrategy = UNUSED
              PduRDestPduDataProvision = PDUR_DIRECT
              PduRTransmissionConfirmation = false
              PduRDestPduRef = CIOM_Cab_14P_oCabSubnet_5240bc4e_Tx
              PduRDestPduPduRBswModulesRef = CanIf
            PduRSrcPdu_a28cb0c8 (PduRSrcPdu): PduRSourcePduHandleId=47, PduRSrcPduDirection=TRANSMIT, PduRSrcPduRef=CIOM_Cab_14P_oCabSubnet_3a165dd8_Tx, PduRSrcPduPduRBswModulesRef=Com
          VW_X_CIOMFMS_oFMSNet_a3003395_Tx: PduRRoutingPathCommunicationType=COMMUNICATION_INTERFACE
            PduRSrcPdu_0460a299 (PduRSrcPdu): PduRSourcePduHandleId=181, PduRSrcPduDirection=TRANSMIT, PduRSrcPduRef=VW_X_CIOMFMS_oFMSNet_a3003395_Tx, PduRSrcPduPduRBswModulesRef=Com
            VW_X_CIOMFMS_oFMSNet_1c90cc30_Tx (PduRDestPdu):
              PduRDestPduHandleId = 138
              PduRDestPduDirection = TRANSMIT
              PduRDestPduRoutingType = API_FORWARDING
              PduRDestPduDataProcessing = IMMEDIATE
              PduRPduLengthHandlingStrategy = UNUSED
              PduRDestPduDataProvision = PDUR_DIRECT
              PduRTransmissionConfirmation = false
              PduRDestPduRef = VW_X_CIOMFMS_oFMSNet_1c90cc30_Tx
              PduRDestPduPduRBswModulesRef = CanIf
          HMIIOM_BB2_22P_oBackbone2_ae7b50f4_Rx: PduRRoutingPathCommunicationType=COMMUNICATION_INTERFACE
            PduRSrcPdu_a0b53fe4 (PduRSrcPdu): PduRSourcePduHandleId=103, PduRSrcPduDirection=RECEIVE, PduRSrcPduRef=HMIIOM_BB2_22P_oBackbone2_ae7b50f4_Rx, PduRSrcPduPduRBswModulesRef=CanIf
            HMIIOM_BB2_22P_oBackbone2_ae7b50f4_Rx_a0b53fe4_Rx (PduRDestPdu):
              PduRDestPduHandleId = 96
              PduRDestPduDirection = RECEIVE
              PduRDestPduRoutingType = API_FORWARDING
              PduRDestPduDataProcessing = IMMEDIATE
              PduRPduLengthHandlingStrategy = UNUSED
              PduRTransmissionConfirmation = false
              PduRDestPduRef = HMIIOM_BB2_22P_oBackbone2_37283295_Rx
              PduRDestPduPduRBswModulesRef = Com
          CCM_Cab_06P_oCabSubnet_6e486c36_Rx: PduRRoutingPathCommunicationType=COMMUNICATION_INTERFACE
            CCM_Cab_06P_oCabSubnet_6e486c36_Rx_d0453951_Rx (PduRDestPdu):
              PduRDestPduHandleId = 27
              PduRDestPduDirection = RECEIVE
              PduRDestPduRoutingType = API_FORWARDING
              PduRDestPduDataProcessing = IMMEDIATE
              PduRPduLengthHandlingStrategy = UNUSED
              PduRTransmissionConfirmation = false
              PduRDestPduRef = CCM_Cab_06P_oCabSubnet_44e0b697_Rx
              PduRDestPduPduRBswModulesRef = Com
            PduRSrcPdu_d0453951 (PduRSrcPdu): PduRSourcePduHandleId=27, PduRSrcPduDirection=RECEIVE, PduRSrcPduRef=CCM_Cab_06P_oCabSubnet_6e486c36_Rx, PduRSrcPduPduRBswModulesRef=CanIf
          VMCU_BB2_05P_oBackbone2_ae2465d3_Rx: PduRRoutingPathCommunicationType=COMMUNICATION_INTERFACE
            PduRSrcPdu_20bae62b (PduRSrcPdu): PduRSourcePduHandleId=147, PduRSrcPduDirection=RECEIVE, PduRSrcPduRef=VMCU_BB2_05P_oBackbone2_ae2465d3_Rx, PduRSrcPduPduRBswModulesRef=CanIf
            VMCU_BB2_05P_oBackbone2_ae2465d3_Rx_20bae62b_Rx (PduRDestPdu):
              PduRDestPduHandleId = 140
              PduRDestPduDirection = RECEIVE
              PduRDestPduRoutingType = API_FORWARDING
              PduRDestPduDataProcessing = IMMEDIATE
              PduRPduLengthHandlingStrategy = UNUSED
              PduRTransmissionConfirmation = false
              PduRDestPduRef = VMCU_BB2_05P_oBackbone2_4a67b15c_Rx
              PduRDestPduPduRBswModulesRef = Com
          WRCS_Cab_03P_oCabSubnet_4e7c5881_Rx: PduRRoutingPathCommunicationType=COMMUNICATION_INTERFACE
            WRCS_Cab_03P_oCabSubnet_4e7c5881_Rx_182e241a_Rx (PduRDestPdu):
              PduRDestPduHandleId = 180
              PduRDestPduDirection = RECEIVE
              PduRDestPduRoutingType = API_FORWARDING
              PduRDestPduDataProcessing = IMMEDIATE
              PduRPduLengthHandlingStrategy = UNUSED
              PduRTransmissionConfirmation = false
              PduRDestPduRef = WRCS_Cab_03P_oCabSubnet_3cbdb1a7_Rx
              PduRDestPduPduRBswModulesRef = Com
            PduRSrcPdu_182e241a (PduRSrcPdu): PduRSourcePduHandleId=187, PduRSrcPduDirection=RECEIVE, PduRSrcPduRef=WRCS_Cab_03P_oCabSubnet_4e7c5881_Rx, PduRSrcPduPduRBswModulesRef=CanIf
          CIOM_5e8290e9_Rx: PduRRoutingPathCommunicationType=TRANSPORT_PROTOCOL
            CIOM_5d61a178_Tx (PduRDestPdu):
              PduRDestPduHandleId = 31
              PduRDestPduDirection = TRANSMIT
              PduRDestPduRoutingType = GATEWAY_ROUTING
              PduRDestPduDataProcessing = IMMEDIATE
              PduRPduLengthHandlingStrategy = UNUSED
              PduRDestPduQueueDepth = 4
              PduRTpThreshold = 1
              PduRDestPduRef = DiagReqMsgIntTGW2_A0_F4_Sec_oSecuritySubnet_c9e0207f_Tx
              PduRDestPduPduRBswModulesRef = CanTp
            PduRSrcPdu_d91d7573 (PduRSrcPdu):
              PduRSourcePduHandleId = 8
              PduRSrcPduDirection = RECEIVE
              PduRSrcPduRef = DiagReqMsgIntTGW2_A0_F4_BB2_oBackbone2_3595b5b5_Rx
              PduRSrcPduPduRBswModulesRef = CanTp
          CIOM_3bc88b72_Rx: PduRRoutingPathCommunicationType=TRANSPORT_PROTOCOL
            PduRSrcPdu_c050dec8 (PduRSrcPdu):
              PduRSourcePduHandleId = 7
              PduRSrcPduDirection = RECEIVE
              PduRSrcPduRef = DiagReqMsgIntHMIIOM_C0_F3_BB2_oBackbone2_66c2267a_Rx
              PduRSrcPduPduRBswModulesRef = CanTp
            CIOM_2b6cb3ad_Tx (PduRDestPdu):
              PduRDestPduHandleId = 27
              PduRDestPduDirection = TRANSMIT
              PduRDestPduRoutingType = GATEWAY_ROUTING
              PduRDestPduDataProcessing = IMMEDIATE
              PduRPduLengthHandlingStrategy = UNUSED
              PduRDestPduQueueDepth = 4
              PduRTpThreshold = 1
              PduRDestPduRef = DiagReqMsgIntHMIIOM_C0_F3_Sec_oSecuritySubnet_fe92025d_Tx
              PduRDestPduPduRBswModulesRef = CanTp
          EEC2_X_CIOMFMS_oFMSNet_8c94b781_Tx: PduRRoutingPathCommunicationType=COMMUNICATION_INTERFACE
            PduRSrcPdu_0b03aa0d (PduRSrcPdu): PduRSourcePduHandleId=129, PduRSrcPduDirection=TRANSMIT, PduRSrcPduRef=EEC2_X_CIOMFMS_oFMSNet_8c94b781_Tx, PduRSrcPduPduRBswModulesRef=Com
            EEC2_X_CIOMFMS_oFMSNet_821ee9a4_Tx (PduRDestPdu):
              PduRDestPduHandleId = 115
              PduRDestPduDirection = TRANSMIT
              PduRDestPduRoutingType = API_FORWARDING
              PduRDestPduDataProcessing = IMMEDIATE
              PduRPduLengthHandlingStrategy = UNUSED
              PduRDestPduDataProvision = PDUR_DIRECT
              PduRTransmissionConfirmation = false
              PduRDestPduRef = EEC2_X_CIOMFMS_oFMSNet_821ee9a4_Tx
              PduRDestPduPduRBswModulesRef = CanIf
          VMCU_BB2_54P_oBackbone2_b2c6b346_Rx: PduRRoutingPathCommunicationType=COMMUNICATION_INTERFACE
            VMCU_BB2_54P_oBackbone2_b2c6b346_Rx_a390fe54_Rx (PduRDestPdu):
              PduRDestPduHandleId = 148
              PduRDestPduDirection = RECEIVE
              PduRDestPduRoutingType = API_FORWARDING
              PduRDestPduDataProcessing = IMMEDIATE
              PduRPduLengthHandlingStrategy = UNUSED
              PduRTransmissionConfirmation = false
              PduRDestPduRef = VMCU_BB2_54P_oBackbone2_135206b4_Rx
              PduRDestPduPduRBswModulesRef = Com
            PduRSrcPdu_a390fe54 (PduRSrcPdu): PduRSourcePduHandleId=155, PduRSrcPduDirection=RECEIVE, PduRSrcPduRef=VMCU_BB2_54P_oBackbone2_b2c6b346_Rx, PduRSrcPduPduRBswModulesRef=CanIf
          CIOM_21025eab_Rx: PduRRoutingPathCommunicationType=COMMUNICATION_INTERFACE
            CIOM_03a719b0_Tx (PduRDestPdu):
              PduRDestPduHandleId = 113
              PduRDestPduDirection = TRANSMIT
              PduRDestPduRoutingType = GATEWAY_ROUTING
              PduRDestPduDataProcessing = IMMEDIATE
              PduRPduLengthHandlingStrategy = UNUSED
              PduRDestPduDataProvision = PDUR_DIRECT
              PduRTransmissionConfirmation = false
              PduRDestPduRef = DiagUUDTRespMsg1_F2_C0_BB2_oBackbone2_7fd3b1e0_Tx
              PduRDestPduPduRBswModulesRef = CanIf
            PduRSrcPdu_896e3989 (PduRSrcPdu):
              PduRSourcePduHandleId = 36
              PduRSrcPduDirection = RECEIVE
              PduRSrcPduRef = DiagUUDTRespMsg1_F2_C0_Sec_oSecuritySubnet_c4b8dd22_Rx
              PduRSrcPduPduRBswModulesRef = CanIf
          EEC14_X_CIOMFMS_oFMSNet_2c0ebba5_Tx: PduRRoutingPathCommunicationType=COMMUNICATION_INTERFACE
            EEC14_X_CIOMFMS_oFMSNet_2007104d_Tx (PduRDestPdu):
              PduRDestPduHandleId = 116
              PduRDestPduDirection = TRANSMIT
              PduRDestPduRoutingType = API_FORWARDING
              PduRDestPduDataProcessing = IMMEDIATE
              PduRPduLengthHandlingStrategy = UNUSED
              PduRDestPduDataProvision = PDUR_DIRECT
              PduRTransmissionConfirmation = false
              PduRDestPduRef = EEC14_X_CIOMFMS_oFMSNet_2007104d_Tx
              PduRDestPduPduRBswModulesRef = CanIf
            PduRSrcPdu_3f422fc3 (PduRSrcPdu): PduRSourcePduHandleId=130, PduRSrcPduDirection=TRANSMIT, PduRSrcPduRef=EEC14_X_CIOMFMS_oFMSNet_2c0ebba5_Tx, PduRSrcPduPduRBswModulesRef=Com
          CIOM_Cab_26P_oCabSubnet_262bcd48_Tx: PduRRoutingPathCommunicationType=COMMUNICATION_INTERFACE
            CIOM_Cab_26P_oCabSubnet_3192004e_Tx (PduRDestPdu):
              PduRDestPduHandleId = 52
              PduRDestPduDirection = TRANSMIT
              PduRDestPduRoutingType = API_FORWARDING
              PduRDestPduDataProcessing = IMMEDIATE
              PduRPduLengthHandlingStrategy = UNUSED
              PduRDestPduDataProvision = PDUR_DIRECT
              PduRTransmissionConfirmation = false
              PduRDestPduRef = CIOM_Cab_26P_oCabSubnet_3192004e_Tx
              PduRDestPduPduRBswModulesRef = CanIf
            PduRSrcPdu_ca0ceb23 (PduRSrcPdu): PduRSourcePduHandleId=59, PduRSrcPduDirection=TRANSMIT, PduRSrcPduRef=CIOM_Cab_26P_oCabSubnet_262bcd48_Tx, PduRSrcPduPduRBswModulesRef=Com
          EMS_BB2_09S_oBackbone2_b436f1c0_Rx: PduRRoutingPathCommunicationType=TRANSPORT_PROTOCOL
            EMS_BB2_09S_oBackbone2_b436f1c0_Rx_7ab1f990_Rx (PduRDestPdu):
              PduRDestPduHandleId = 11
              PduRDestPduDirection = RECEIVE
              PduRDestPduRoutingType = API_FORWARDING
              PduRDestPduDataProcessing = IMMEDIATE
              PduRPduLengthHandlingStrategy = UNUSED
              PduRDestPduRef = EMS_BB2_09S_oBackbone2_f00cfd06_Rx
              PduRDestPduPduRBswModulesRef = Com
            PduRSrcPdu_7ab1f990 (PduRSrcPdu): PduRSourcePduHandleId=57, PduRSrcPduDirection=RECEIVE, PduRSrcPduRef=EMS_BB2_09S_oBackbone2_b436f1c0_Rx, PduRSrcPduPduRBswModulesRef=CanTp
          FSP4_SwitchDetResp_L2_oLIN01_76fb096a_Rx: PduRRoutingPathCommunicationType=COMMUNICATION_INTERFACE
            PduRSrcPdu_21916aa6 (PduRSrcPdu): PduRSourcePduHandleId=97, PduRSrcPduDirection=RECEIVE, PduRSrcPduRef=FSP4_SwitchDetResp_L2_oLIN01_76fb096a_Rx, PduRSrcPduPduRBswModulesRef=LinIf
            FSP4_SwitchDetResp_L2_oLIN01_76fb096a_Rx_21916aa6_Rx (PduRDestPdu):
              PduRDestPduHandleId = 90
              PduRDestPduDirection = RECEIVE
              PduRDestPduRoutingType = API_FORWARDING
              PduRDestPduDataProcessing = IMMEDIATE
              PduRPduLengthHandlingStrategy = UNUSED
              PduRTransmissionConfirmation = false
              PduRDestPduRef = FSP4_SwitchDetResp_L2_oLIN01_7cba6eb3_Rx
              PduRDestPduPduRBswModulesRef = Com
          PhysDiagReqMsg_40_F2_BB2_oBackbone2_01e49dc9_Rx: PduRRoutingPathCommunicationType=TRANSPORT_PROTOCOL
            PduRSrcPdu_d62010ae (PduRSrcPdu):
              PduRSourcePduHandleId = 65
              PduRSrcPduDirection = RECEIVE
              PduRSrcPduRef = PhysDiagReqMsg_40_F2_BB2_oBackbone2_01e49dc9_Rx
              PduRSrcPduPduRBswModulesRef = CanTp
            PhysDiagReqMsg_40_F2_BB2_oBackbone2_01e49dc9_Rx_d62010ae_Rx (PduRDestPdu):
              PduRDestPduHandleId = 20
              PduRDestPduDirection = RECEIVE
              PduRDestPduRoutingType = API_FORWARDING
              PduRDestPduDataProcessing = IMMEDIATE
              PduRPduLengthHandlingStrategy = UNUSED
              PduRDestPduRef = PhysDiagReqMsg_40_F2_BB2_oBackbone2_e5e9f9a5_Rx
              PduRDestPduPduRBswModulesRef = Dcm
          CIOM_Cab_05S_oCabSubnet_0d11b7db_Tx: PduRRoutingPathCommunicationType=TRANSPORT_PROTOCOL
            CIOM_Cab_05S_oCabSubnet_86401064_Tx (PduRDestPdu):
              PduRDestPduHandleId = 4
              PduRDestPduDirection = TRANSMIT
              PduRDestPduRoutingType = API_FORWARDING
              PduRDestPduDataProcessing = IMMEDIATE
              PduRPduLengthHandlingStrategy = UNUSED
              PduRDestPduRef = CIOM_Cab_05S_oCabSubnet_86401064_Tx
              PduRDestPduPduRBswModulesRef = CanTp
            PduRSrcPdu_05d2c983 (PduRSrcPdu): PduRSourcePduHandleId=38, PduRSrcPduDirection=TRANSMIT, PduRSrcPduRef=CIOM_Cab_05S_oCabSubnet_0d11b7db_Tx, PduRSrcPduPduRBswModulesRef=Com
          CIOM_c39087bb_Rx: PduRRoutingPathCommunicationType=TRANSPORT_PROTOCOL
            PduRSrcPdu_bd1ce89a (PduRSrcPdu):
              PduRSourcePduHandleId = 43
              PduRSrcPduDirection = RECEIVE
              PduRSrcPduRef = DiagReqMsgIntTGW2_C0_F4_BB2_oBackbone2_a887a2e7_Rx
              PduRSrcPduPduRBswModulesRef = CanTp
            CIOM_98a0f91f_Tx (PduRDestPdu):
              PduRDestPduHandleId = 34
              PduRDestPduDirection = TRANSMIT
              PduRDestPduRoutingType = GATEWAY_ROUTING
              PduRDestPduDataProcessing = IMMEDIATE
              PduRPduLengthHandlingStrategy = UNUSED
              PduRDestPduQueueDepth = 4
              PduRTpThreshold = 1
              PduRDestPduRef = DiagReqMsgIntTGW2_C0_F4_Sec_oSecuritySubnet_0c217818_Tx
              PduRDestPduPduRBswModulesRef = CanTp
          AnmMsg_EMS_Backbone2_oBackbone2_bf0abd7e_Rx: PduRRoutingPathCommunicationType=COMMUNICATION_INTERFACE
            PduRSrcPdu_90682d55 (PduRSrcPdu):
              PduRSourcePduHandleId = 13
              PduRSrcPduDirection = RECEIVE
              PduRSrcPduRef = AnmMsg_EMS_Backbone2_oBackbone2_bf0abd7e_Rx
              PduRSrcPduPduRBswModulesRef = CanIf
            AnmMsg_EMS_Backbone2_oBackbone2_bf0abd7e_Rx_90682d55_Rx (PduRDestPdu):
              PduRDestPduHandleId = 13
              PduRDestPduDirection = RECEIVE
              PduRDestPduRoutingType = API_FORWARDING
              PduRDestPduDataProcessing = IMMEDIATE
              PduRPduLengthHandlingStrategy = UNUSED
              PduRTransmissionConfirmation = false
              PduRDestPduRef = AnmMsg_EMS_Backbone2_oBackbone2_99fd5a83_Rx
              PduRDestPduPduRBswModulesRef = Com
          CIOM_Cab_31P_oCabSubnet_c6572a66_Tx: PduRRoutingPathCommunicationType=COMMUNICATION_INTERFACE
            CIOM_Cab_31P_oCabSubnet_bff58228_Tx (PduRDestPdu):
              PduRDestPduHandleId = 55
              PduRDestPduDirection = TRANSMIT
              PduRDestPduRoutingType = API_FORWARDING
              PduRDestPduDataProcessing = IMMEDIATE
              PduRPduLengthHandlingStrategy = UNUSED
              PduRDestPduDataProvision = PDUR_DIRECT
              PduRTransmissionConfirmation = false
              PduRDestPduRef = CIOM_Cab_31P_oCabSubnet_bff58228_Tx
              PduRDestPduPduRBswModulesRef = CanIf
            PduRSrcPdu_6ca67470 (PduRSrcPdu): PduRSourcePduHandleId=64, PduRSrcPduDirection=TRANSMIT, PduRSrcPduRef=CIOM_Cab_31P_oCabSubnet_c6572a66_Tx, PduRSrcPduPduRBswModulesRef=Com
          CIOM_89137f18_Rx: PduRRoutingPathCommunicationType=TRANSPORT_PROTOCOL
            PduRSrcPdu_2e6f76ae (PduRSrcPdu):
              PduRSourcePduHandleId = 33
              PduRSrcPduDirection = RECEIVE
              PduRSrcPduRef = PhysDiagReqMsg_C0_F2_BB2_oBackbone2_a92be4b5_Rx
              PduRSrcPduPduRBswModulesRef = CanTp
            CIOM_ca2e8141_Tx (PduRDestPdu):
              PduRDestPduHandleId = 85
              PduRDestPduDirection = TRANSMIT
              PduRDestPduRoutingType = GATEWAY_ROUTING
              PduRDestPduDataProcessing = IMMEDIATE
              PduRPduLengthHandlingStrategy = UNUSED
              PduRDestPduQueueDepth = 4
              PduRTpThreshold = 1
              PduRDestPduRef = PhysDiagReqMsg_C0_F2_Sec_oSecuritySubnet_47ddad97_Tx
              PduRDestPduPduRBswModulesRef = CanTp
          CIOM_caac722b_Rx: PduRRoutingPathCommunicationType=TRANSPORT_PROTOCOL
            PduRSrcPdu_8c488735 (PduRSrcPdu):
              PduRSourcePduHandleId = 44
              PduRSrcPduDirection = RECEIVE
              PduRSrcPduRef = DiagRespMsgIntTGW2_F4_98_Cab_oCabSubnet_a81a78d1_Rx
              PduRSrcPduPduRBswModulesRef = CanTp
            CIOM_4e01b3dd_Tx (PduRDestPdu):
              PduRDestPduHandleId = 46
              PduRDestPduDirection = TRANSMIT
              PduRDestPduRoutingType = GATEWAY_ROUTING
              PduRDestPduDataProcessing = IMMEDIATE
              PduRPduLengthHandlingStrategy = UNUSED
              PduRDestPduQueueDepth = 4
              PduRTpThreshold = 1
              PduRDestPduRef = DiagRespMsgIntTGW2_F4_98_BB2_oBackbone2_2cb7b927_Tx
              PduRDestPduPduRBswModulesRef = CanTp
          HMIIOM_BB2_33P_oBackbone2_6953c5ad_Rx: PduRRoutingPathCommunicationType=COMMUNICATION_INTERFACE
            HMIIOM_BB2_33P_oBackbone2_6953c5ad_Rx_ce11e24e_Rx (PduRDestPdu):
              PduRDestPduHandleId = 99
              PduRDestPduDirection = RECEIVE
              PduRDestPduRoutingType = API_FORWARDING
              PduRDestPduDataProcessing = IMMEDIATE
              PduRPduLengthHandlingStrategy = UNUSED
              PduRTransmissionConfirmation = false
              PduRDestPduRef = HMIIOM_BB2_33P_oBackbone2_77b10a66_Rx
              PduRDestPduPduRBswModulesRef = Com
            PduRSrcPdu_ce11e24e (PduRSrcPdu): PduRSourcePduHandleId=106, PduRSrcPduDirection=RECEIVE, PduRSrcPduRef=HMIIOM_BB2_33P_oBackbone2_6953c5ad_Rx, PduRSrcPduPduRBswModulesRef=CanIf
