[part 2 of 2: package /ActiveEcuC]
AUTOSAR XML (schema 4-2-1)
package /ActiveEcuC  (continued)
  module config PduR: implementation-config-variant=VARIANT-PRE-COMPILE, module-description=PduR_Impl  (continued)
    PduRRoutingTables: PduRConfigurationId=0  (continued)
      PduRRoutingTable  (continued)
        463 x PduRRoutingPath:  (continued)
          CIOM_BB2_07P_oBackbone2_a6d12a46_Tx: PduRRoutingPathCommunicationType=COMMUNICATION_INTERFACE
            PduRSrcPdu_4205e179 (PduRSrcPdu): PduRSourcePduHandleId=19, PduRSrcPduDirection=TRANSMIT, PduRSrcPduRef=CIOM_BB2_07P_oBackbone2_a6d12a46_Tx, PduRSrcPduPduRBswModulesRef=Com
            CIOM_BB2_07P_oBackbone2_5bb8e886_Tx (PduRDestPdu):
              PduRDestPduHandleId = 21
              PduRDestPduDirection = TRANSMIT
              PduRDestPduRoutingType = API_FORWARDING
              PduRDestPduDataProcessing = IMMEDIATE
              PduRPduLengthHandlingStrategy = UNUSED
              PduRDestPduDataProvision = PDUR_DIRECT
              PduRTransmissionConfirmation = false
              PduRDestPduRef = CIOM_BB2_07P_oBackbone2_5bb8e886_Tx
              PduRDestPduPduRBswModulesRef = CanIf
          CIOM_9066f9c0_Rx: PduRRoutingPathCommunicationType=TRANSPORT_PROTOCOL
            PduRSrcPdu_c0680d6c (PduRSrcPdu):
              PduRSourcePduHandleId = 31
              PduRSrcPduDirection = RECEIVE
              PduRSrcPduRef = DiagReqMsgIntHMIIOM_53_F3_BB2_oBackbone2_cd6c54c8_Rx
              PduRSrcPduPduRBswModulesRef = CanTp
            CIOM_14cb3836_Tx (PduRDestPdu):
              PduRDestPduHandleId = 22
              PduRDestPduDirection = TRANSMIT
              PduRDestPduRoutingType = GATEWAY_ROUTING
              PduRDestPduDataProcessing = IMMEDIATE
              PduRPduLengthHandlingStrategy = UNUSED
              PduRDestPduQueueDepth = 4
              PduRTpThreshold = 1
              PduRDestPduRef = DiagReqMsgIntHMIIOM_53_F3_Cab_oCabSubnet_49c1953e_Tx
              PduRDestPduPduRBswModulesRef = CanTp
          CIOM_Cab_19P_oCabSubnet_7d3a3da6_Tx: PduRRoutingPathCommunicationType=COMMUNICATION_INTERFACE
            CIOM_Cab_19P_oCabSubnet_3104979a_Tx (PduRDestPdu):
              PduRDestPduHandleId = 47
              PduRDestPduDirection = TRANSMIT
              PduRDestPduRoutingType = API_FORWARDING
              PduRDestPduDataProcessing = IMMEDIATE
              PduRPduLengthHandlingStrategy = UNUSED
              PduRDestPduDataProvision = PDUR_DIRECT
              PduRTransmissionConfirmation = false
              PduRDestPduRef = CIOM_Cab_19P_oCabSubnet_3104979a_Tx
              PduRDestPduPduRBswModulesRef = CanIf
            PduRSrcPdu_bcbb5e6c (PduRSrcPdu): PduRSourcePduHandleId=52, PduRSrcPduDirection=TRANSMIT, PduRSrcPduRef=CIOM_Cab_19P_oCabSubnet_7d3a3da6_Tx, PduRSrcPduPduRBswModulesRef=Com
          AT1T1I1_X_CIOMFMS_oFMSNet_111e0664_Tx: PduRRoutingPathCommunicationType=COMMUNICATION_INTERFACE
            PduRSrcPdu_289e8325 (PduRSrcPdu): PduRSourcePduHandleId=2, PduRSrcPduDirection=TRANSMIT, PduRSrcPduRef=AT1T1I1_X_CIOMFMS_oFMSNet_111e0664_Tx, PduRSrcPduPduRBswModulesRef=Com
            AT1T1I1_X_CIOMFMS_oFMSNet_a4250889_Tx (PduRDestPdu):
              PduRDestPduHandleId = 2
              PduRDestPduDirection = TRANSMIT
              PduRDestPduRoutingType = API_FORWARDING
              PduRDestPduDataProcessing = IMMEDIATE
              PduRPduLengthHandlingStrategy = UNUSED
              PduRTransmissionConfirmation = false
              PduRDestPduDataProvision = PDUR_DIRECT
              PduRDestPduRef = AT1T1I1_X_CIOMFMS_oFMSNet_a4250889_Tx
              PduRDestPduPduRBswModulesRef = CanIf
          CIOM_Cab_27P_oCabSubnet_fbbd14cd_Tx: PduRRoutingPathCommunicationType=COMMUNICATION_INTERFACE
            CIOM_Cab_27P_oCabSubnet_c04805e4_Tx (PduRDestPdu):
              PduRDestPduHandleId = 53
              PduRDestPduDirection = TRANSMIT
              PduRDestPduRoutingType = API_FORWARDING
              PduRDestPduDataProcessing = IMMEDIATE
              PduRPduLengthHandlingStrategy = UNUSED
              PduRDestPduDataProvision = PDUR_DIRECT
              PduRTransmissionConfirmation = false
              PduRDestPduRef = CIOM_Cab_27P_oCabSubnet_c04805e4_Tx
              PduRDestPduPduRBswModulesRef = CanIf
            PduRSrcPdu_100ee8e0 (PduRSrcPdu): PduRSourcePduHandleId=60, PduRSrcPduDirection=TRANSMIT, PduRSrcPduRef=CIOM_Cab_27P_oCabSubnet_fbbd14cd_Tx, PduRSrcPduPduRBswModulesRef=Com
          AMB_X_CIOMFMS_oFMSNet_e990831c_Tx: PduRRoutingPathCommunicationType=COMMUNICATION_INTERFACE
            AMB_X_CIOMFMS_oFMSNet_7d255a73_Tx (PduRDestPdu):
              PduRDestPduHandleId = 1
              PduRDestPduDirection = TRANSMIT
              PduRDestPduRoutingType = API_FORWARDING
              PduRDestPduDataProcessing = IMMEDIATE
              PduRPduLengthHandlingStrategy = UNUSED
              PduRDestPduDataProvision = PDUR_DIRECT
              PduRTransmissionConfirmation = false
              PduRDestPduRef = AMB_X_CIOMFMS_oFMSNet_7d255a73_Tx
              PduRDestPduPduRBswModulesRef = CanIf
            PduRSrcPdu_ad4a6c2f (PduRSrcPdu): PduRSourcePduHandleId=1, PduRSrcPduDirection=TRANSMIT, PduRSrcPduRef=AMB_X_CIOMFMS_oFMSNet_e990831c_Tx, PduRSrcPduPduRBswModulesRef=Com
          CIOM_d30a6d0b_Rx: PduRRoutingPathCommunicationType=TRANSPORT_PROTOCOL
            PduRSrcPdu_39fe25b5 (PduRSrcPdu):
              PduRSourcePduHandleId = 46
              PduRSrcPduDirection = RECEIVE
              PduRSrcPduRef = DiagReqMsgIntTGW2_A1_F4_BB2_oBackbone2_b81d4857_Rx
              PduRSrcPduPduRBswModulesRef = CanTp
            CIOM_60d04da4_Tx (PduRDestPdu):
              PduRDestPduHandleId = 32
              PduRDestPduDirection = TRANSMIT
              PduRDestPduRoutingType = GATEWAY_ROUTING
              PduRDestPduDataProcessing = IMMEDIATE
              PduRPduLengthHandlingStrategy = UNUSED
              PduRDestPduQueueDepth = 4
              PduRTpThreshold = 1
              PduRDestPduRef = DiagReqMsgIntTGW2_A1_F4_Sec_oSecuritySubnet_f451cca3_Tx
              PduRDestPduPduRBswModulesRef = CanTp
          FSP1_Frame_L5_oLIN04_a341e84f_Rx: PduRRoutingPathCommunicationType=COMMUNICATION_INTERFACE
            FSP1_Frame_L5_oLIN04_a341e84f_Rx_1d41a162_Rx (PduRDestPdu):
              PduRDestPduHandleId = 75
              PduRDestPduDirection = RECEIVE
              PduRDestPduRoutingType = API_FORWARDING
              PduRDestPduDataProcessing = IMMEDIATE
              PduRPduLengthHandlingStrategy = UNUSED
              PduRTransmissionConfirmation = false
              PduRDestPduRef = FSP1_Frame_L5_oLIN04_fd21b130_Rx
              PduRDestPduPduRBswModulesRef = Com
            PduRSrcPdu_1d41a162 (PduRSrcPdu): PduRSourcePduHandleId=82, PduRSrcPduDirection=RECEIVE, PduRSrcPduRef=FSP1_Frame_L5_oLIN04_a341e84f_Rx, PduRSrcPduPduRBswModulesRef=LinIf
          DDM_Sec_04S_oSecuritySubnet_79c95f1e_Rx: PduRRoutingPathCommunicationType=TRANSPORT_PROTOCOL
            DDM_Sec_04S_oSecuritySubnet_79c95f1e_Rx_06bdd5c2_Rx (PduRDestPdu):
              PduRDestPduHandleId = 6
              PduRDestPduDirection = RECEIVE
              PduRDestPduRoutingType = API_FORWARDING
              PduRDestPduDataProcessing = IMMEDIATE
              PduRPduLengthHandlingStrategy = UNUSED
              PduRDestPduRef = DDM_Sec_04S_oSecuritySubnet_f7af7427_Rx
              PduRDestPduPduRBswModulesRef = Com
            PduRSrcPdu_06bdd5c2 (PduRSrcPdu): PduRSourcePduHandleId=52, PduRSrcPduDirection=RECEIVE, PduRSrcPduRef=DDM_Sec_04S_oSecuritySubnet_79c95f1e_Rx, PduRSrcPduPduRBswModulesRef=CanTp
          FSP1_SwitchDetResp_L3_oLIN02_228cd76e_Rx: PduRRoutingPathCommunicationType=COMMUNICATION_INTERFACE
            PduRSrcPdu_7bebd14f (PduRSrcPdu): PduRSourcePduHandleId=85, PduRSrcPduDirection=RECEIVE, PduRSrcPduRef=FSP1_SwitchDetResp_L3_oLIN02_228cd76e_Rx, PduRSrcPduPduRBswModulesRef=LinIf
            FSP1_SwitchDetResp_L3_oLIN02_228cd76e_Rx_7bebd14f_Rx (PduRDestPdu):
              PduRDestPduHandleId = 78
              PduRDestPduDirection = RECEIVE
              PduRDestPduRoutingType = API_FORWARDING
              PduRDestPduDataProcessing = IMMEDIATE
              PduRPduLengthHandlingStrategy = UNUSED
              PduRTransmissionConfirmation = false
              PduRDestPduRef = FSP1_SwitchDetResp_L3_oLIN02_772fe562_Rx
              PduRDestPduPduRBswModulesRef = Com
          DiagFaultStat_LECM_Cab_oCabSubnet_3cdbae0b_Rx: PduRRoutingPathCommunicationType=COMMUNICATION_INTERFACE
            DiagFaultStat_LECM_Cab_oCabSubnet_3cdbae0b_Rx_375b9c49_Rx (PduRDestPdu):
              PduRDestPduHandleId = 47
              PduRDestPduDirection = RECEIVE
              PduRDestPduRoutingType = API_FORWARDING
              PduRDestPduDataProcessing = IMMEDIATE
              PduRPduLengthHandlingStrategy = UNUSED
              PduRTransmissionConfirmation = false
              PduRDestPduRef = DiagFaultStat_LECM_Cab_oCabSubnet_870f9288_Rx
              PduRDestPduPduRBswModulesRef = Com
            PduRSrcPdu_375b9c49 (PduRSrcPdu):
              PduRSourcePduHandleId = 54
              PduRSrcPduDirection = RECEIVE
              PduRSrcPduRef = DiagFaultStat_LECM_Cab_oCabSubnet_3cdbae0b_Rx
              PduRSrcPduPduRBswModulesRef = CanIf
          Backlight_FuncInd_L4_oLIN03_b39aac6f_Tx: PduRRoutingPathCommunicationType=COMMUNICATION_INTERFACE
            PduRSrcPdu_86064c1e (PduRSrcPdu): PduRSourcePduHandleId=9, PduRSrcPduDirection=TRANSMIT, PduRSrcPduRef=Backlight_FuncInd_L4_oLIN03_b39aac6f_Tx, PduRSrcPduPduRBswModulesRef=Com
            Backlight_FuncInd_L4_oLIN03_aff40501_Tx (PduRDestPdu):
              PduRDestPduHandleId = 11
              PduRDestPduDirection = TRANSMIT
              PduRDestPduRoutingType = API_FORWARDING
              PduRDestPduDataProcessing = IMMEDIATE
              PduRPduLengthHandlingStrategy = UNUSED
              PduRDestPduDataProvision = PDUR_TRIGGERTRANSMIT
              PduRTransmissionConfirmation = false
              PduRDestPduRef = Backlight_FuncInd_L4_oLIN03_aff40501_Tx
              PduRDestPduPduRBswModulesRef = LinIf
          CIOM_BB2_28P_oBackbone2_60cf3bde_Tx: PduRRoutingPathCommunicationType=COMMUNICATION_INTERFACE
            CIOM_BB2_28P_oBackbone2_6ddcefa1_Tx (PduRDestPdu):
              PduRDestPduHandleId = 29
              PduRDestPduDirection = TRANSMIT
              PduRDestPduRoutingType = API_FORWARDING
              PduRDestPduDataProcessing = IMMEDIATE
              PduRPduLengthHandlingStrategy = UNUSED
              PduRDestPduDataProvision = PDUR_DIRECT
              PduRTransmissionConfirmation = false
              PduRDestPduRef = CIOM_BB2_28P_oBackbone2_6ddcefa1_Tx
              PduRDestPduPduRBswModulesRef = CanIf
            PduRSrcPdu_1345fc62 (PduRSrcPdu): PduRSourcePduHandleId=29, PduRSrcPduDirection=TRANSMIT, PduRSrcPduRef=CIOM_BB2_28P_oBackbone2_60cf3bde_Tx, PduRSrcPduPduRBswModulesRef=Com
          SlaveResp_ILCP2_oLIN03_39eebd8e_Rx: PduRRoutingPathCommunicationType=TRANSPORT_PROTOCOL
            PduRSrcPdu_95103cdf (PduRSrcPdu): PduRSourcePduHandleId=82, PduRSrcPduDirection=RECEIVE, PduRSrcPduRef=SlaveResp_ILCP2_oLIN03_39eebd8e_Rx, PduRSrcPduPduRBswModulesRef=LinTp
            SlaveResp_ILCP2_oLIN03_39eebd8e_Rx_95103cdf_Rx (PduRDestPdu):
              PduRDestPduHandleId = 37
              PduRDestPduDirection = RECEIVE
              PduRDestPduRoutingType = API_FORWARDING
              PduRDestPduDataProcessing = IMMEDIATE
              PduRPduLengthHandlingStrategy = UNUSED
              PduRDestPduRef = SlaveResp_ILCP2_oLIN03_0d94bad1_Rx
              PduRDestPduPduRBswModulesRef = Cdd
          CIOM_BB2_04P_oBackbone2_1b1b4688_Tx: PduRRoutingPathCommunicationType=COMMUNICATION_INTERFACE
            PduRSrcPdu_0bb1cb67 (PduRSrcPdu): PduRSourcePduHandleId=16, PduRSrcPduDirection=TRANSMIT, PduRSrcPduRef=CIOM_BB2_04P_oBackbone2_1b1b4688_Tx, PduRSrcPduPduRBswModulesRef=Com
            CIOM_BB2_04P_oBackbone2_92a7e039_Tx (PduRDestPdu):
              PduRDestPduHandleId = 18
              PduRDestPduDirection = TRANSMIT
              PduRDestPduRoutingType = API_FORWARDING
              PduRDestPduDataProcessing = IMMEDIATE
              PduRPduLengthHandlingStrategy = UNUSED
              PduRDestPduDataProvision = PDUR_DIRECT
              PduRTransmissionConfirmation = false
              PduRDestPduRef = CIOM_BB2_04P_oBackbone2_92a7e039_Tx
              PduRDestPduPduRBswModulesRef = CanIf
          DiagFaultStat_DDM_BB2_oBackbone2_5c858c9f_Tx: PduRRoutingPathCommunicationType=COMMUNICATION_INTERFACE
            DiagFaultStat_DDM_BB2_oBackbone2_f2c6a79a_Tx (PduRDestPdu):
              PduRDestPduHandleId = 101
              PduRDestPduDirection = TRANSMIT
              PduRDestPduRoutingType = API_FORWARDING
              PduRDestPduDataProcessing = IMMEDIATE
              PduRPduLengthHandlingStrategy = UNUSED
              PduRTransmissionConfirmation = true
              PduRDestPduDataProvision = PDUR_DIRECT
              PduRDestPduRef = DiagFaultStat_DDM_BB2_oBackbone2_f2c6a79a_Tx
              PduRDestPduPduRBswModulesRef = CanIf
            PduRSrcPdu_044119da (PduRSrcPdu):
              PduRSourcePduHandleId = 120
              PduRSrcPduDirection = TRANSMIT
              PduRSrcPduRef = DiagFaultStat_DDM_BB2_oBackbone2_5c858c9f_Tx
              PduRSrcPduPduRBswModulesRef = Com
          CIOM_c3ca048e_Rx: PduRRoutingPathCommunicationType=TRANSPORT_PROTOCOL
            PduRSrcPdu_99e30330 (PduRSrcPdu):
              PduRSourcePduHandleId = 40
              PduRSrcPduDirection = RECEIVE
              PduRSrcPduRef = DiagRespMsgIntTGW2_F4_53_Cab_oCabSubnet_a17c0e74_Rx
              PduRSrcPduPduRBswModulesRef = CanTp
            CIOM_4767c578_Tx (PduRDestPdu):
              PduRDestPduHandleId = 45
              PduRDestPduDirection = TRANSMIT
              PduRDestPduRoutingType = GATEWAY_ROUTING
              PduRDestPduDataProcessing = IMMEDIATE
              PduRPduLengthHandlingStrategy = UNUSED
              PduRDestPduQueueDepth = 4
              PduRTpThreshold = 1
              PduRDestPduRef = DiagRespMsgIntTGW2_F4_53_BB2_oBackbone2_25d1cf82_Tx
              PduRDestPduPduRBswModulesRef = CanTp
          CIOM_c64b391d_Rx: PduRRoutingPathCommunicationType=TRANSPORT_PROTOCOL
            PduRSrcPdu_dfacef7f (PduRSrcPdu):
              PduRSourcePduHandleId = 41
              PduRSrcPduDirection = RECEIVE
              PduRSrcPduRef = PhysDiagReqMsg_26_F2_BB2_oBackbone2_e673a2b0_Rx
              PduRSrcPduPduRBswModulesRef = CanTp
            CIOM_42e6f8eb_Tx (PduRDestPdu):
              PduRDestPduHandleId = 78
              PduRDestPduDirection = TRANSMIT
              PduRDestPduRoutingType = GATEWAY_ROUTING
              PduRDestPduDataProcessing = IMMEDIATE
              PduRPduLengthHandlingStrategy = UNUSED
              PduRDestPduQueueDepth = 4
              PduRTpThreshold = 1
              PduRDestPduRef = PhysDiagReqMsg_26_F2_Cab_oCabSubnet_62de6346_Tx
              PduRDestPduPduRBswModulesRef = CanTp
          FSP1_SwitchDetResp_L4_oLIN03_8d5aeec7_Rx: PduRRoutingPathCommunicationType=COMMUNICATION_INTERFACE
            PduRSrcPdu_d430c522 (PduRSrcPdu): PduRSourcePduHandleId=86, PduRSrcPduDirection=RECEIVE, PduRSrcPduRef=FSP1_SwitchDetResp_L4_oLIN03_8d5aeec7_Rx, PduRSrcPduPduRBswModulesRef=LinIf
            FSP1_SwitchDetResp_L4_oLIN03_8d5aeec7_Rx_d430c522_Rx (PduRDestPdu):
              PduRDestPduHandleId = 79
              PduRDestPduDirection = RECEIVE
              PduRDestPduRoutingType = API_FORWARDING
              PduRDestPduDataProcessing = IMMEDIATE
              PduRPduLengthHandlingStrategy = UNUSED
              PduRTransmissionConfirmation = false
              PduRDestPduRef = FSP1_SwitchDetResp_L4_oLIN03_0aeddced_Rx
              PduRDestPduPduRBswModulesRef = Com
          VMCU_BB2_29P_oBackbone2_515f6a4b_Rx: PduRRoutingPathCommunicationType=COMMUNICATION_INTERFACE
            PduRSrcPdu_35018803 (PduRSrcPdu): PduRSourcePduHandleId=151, PduRSrcPduDirection=RECEIVE, PduRSrcPduRef=VMCU_BB2_29P_oBackbone2_515f6a4b_Rx, PduRSrcPduPduRBswModulesRef=CanIf
            VMCU_BB2_29P_oBackbone2_515f6a4b_Rx_35018803_Rx (PduRDestPdu):
              PduRDestPduHandleId = 144
              PduRDestPduDirection = RECEIVE
              PduRDestPduRoutingType = API_FORWARDING
              PduRDestPduDataProcessing = IMMEDIATE
              PduRPduLengthHandlingStrategy = UNUSED
              PduRTransmissionConfirmation = false
              PduRDestPduRef = VMCU_BB2_29P_oBackbone2_31b3cc0a_Rx
              PduRDestPduPduRBswModulesRef = Com
          DiagUUDTRespMsg1_F2_40_BB2_oBackbone2_a38250b2_Tx: PduRRoutingPathCommunicationType=COMMUNICATION_INTERFACE
            PduRSrcPdu_14f3876f (PduRSrcPdu):
              PduRSourcePduHandleId = 127
              PduRSrcPduDirection = TRANSMIT
              PduRSrcPduRef = DiagUUDTRespMsg1_F2_40_BB2_oBackbone2_a38250b2_Tx
              PduRSrcPduPduRBswModulesRef = Dcm
            DiagUUDTRespMsg1_F2_40_BB2_oBackbone2_e836b7de_Tx (PduRDestPdu):
              PduRDestPduHandleId = 107
              PduRDestPduDirection = TRANSMIT
              PduRDestPduRoutingType = API_FORWARDING
              PduRDestPduDataProcessing = IMMEDIATE
              PduRPduLengthHandlingStrategy = UNUSED
              PduRTransmissionConfirmation = true
              PduRDestPduDataProvision = PDUR_DIRECT
              PduRDestPduRef = DiagUUDTRespMsg1_F2_40_BB2_oBackbone2_e836b7de_Tx
              PduRDestPduPduRBswModulesRef = CanIf
          CIOM_87c8c1da_Rx: PduRRoutingPathCommunicationType=TRANSPORT_PROTOCOL
            CIOM_d0c6636c_Tx (PduRDestPdu):
              PduRDestPduHandleId = 91
              PduRDestPduDirection = TRANSMIT
              PduRDestPduRoutingType = GATEWAY_ROUTING
              PduRDestPduDataProcessing = IMMEDIATE
              PduRPduLengthHandlingStrategy = UNUSED
              PduRDestPduQueueDepth = 4
              PduRTpThreshold = 1
              PduRDestPduRef = PhysDiagRespMsg_F2_A0_BB2_oBackbone2_788184a2_Tx
              PduRDestPduPduRBswModulesRef = CanTp
            PduRSrcPdu_b18fc6c3 (PduRSrcPdu):
              PduRSourcePduHandleId = 23
              PduRSrcPduDirection = RECEIVE
              PduRSrcPduRef = PhysDiagRespMsg_F2_A0_Sec_oSecuritySubnet_e8f54517_Rx
              PduRSrcPduPduRBswModulesRef = CanTp
          SlaveResp_FSP1_L4_oLIN03_92105fa7_Rx: PduRRoutingPathCommunicationType=TRANSPORT_PROTOCOL
            SlaveResp_FSP1_L4_oLIN03_92105fa7_Rx_fc6b6d63_Rx (PduRDestPdu):
              PduRDestPduHandleId = 29
              PduRDestPduDirection = RECEIVE
              PduRDestPduRoutingType = API_FORWARDING
              PduRDestPduDataProcessing = IMMEDIATE
              PduRPduLengthHandlingStrategy = UNUSED
              PduRDestPduRef = SlaveResp_FSP1_L4_oLIN03_b3e26e46_Rx
              PduRDestPduPduRBswModulesRef = Cdd
            PduRSrcPdu_fc6b6d63 (PduRSrcPdu): PduRSourcePduHandleId=74, PduRSrcPduDirection=RECEIVE, PduRSrcPduRef=SlaveResp_FSP1_L4_oLIN03_92105fa7_Rx, PduRSrcPduPduRBswModulesRef=LinTp
          CIOM_22bd0daa_Rx: PduRRoutingPathCommunicationType=TRANSPORT_PROTOCOL
            CIOM_a610cc5c_Tx (PduRDestPdu):
              PduRDestPduHandleId = 80
              PduRDestPduDirection = TRANSMIT
              PduRDestPduRoutingType = GATEWAY_ROUTING
              PduRDestPduDataProcessing = IMMEDIATE
              PduRPduLengthHandlingStrategy = UNUSED
              PduRDestPduQueueDepth = 4
              PduRTpThreshold = 1
              PduRDestPduRef = PhysDiagReqMsg_53_F2_Cab_oCabSubnet_862857f1_Tx
              PduRDestPduPduRBswModulesRef = CanTp
            PduRSrcPdu_266542d7 (PduRSrcPdu):
              PduRSourcePduHandleId = 17
              PduRSrcPduDirection = RECEIVE
              PduRSrcPduRef = PhysDiagReqMsg_53_F2_BB2_oBackbone2_02859607_Rx
              PduRSrcPduPduRBswModulesRef = CanTp
          CIOM_32d75efc_Rx: PduRRoutingPathCommunicationType=COMMUNICATION_INTERFACE
            CIOM_b67a9f0a_Tx (PduRDestPdu):
              PduRDestPduHandleId = 112
              PduRDestPduDirection = TRANSMIT
              PduRDestPduRoutingType = GATEWAY_ROUTING
              PduRDestPduDataProcessing = IMMEDIATE
              PduRPduLengthHandlingStrategy = UNUSED
              PduRDestPduDataProvision = PDUR_DIRECT
              PduRTransmissionConfirmation = false
              PduRDestPduRef = DiagUUDTRespMsg1_F2_A2_BB2_oBackbone2_ca0e375a_Tx
              PduRDestPduPduRBswModulesRef = CanIf
            PduRSrcPdu_ce15f821 (PduRSrcPdu):
              PduRSourcePduHandleId = 34
              PduRSrcPduDirection = RECEIVE
              PduRSrcPduRef = DiagUUDTRespMsg1_F2_A2_Cab_oCabSubnet_4ea3f6ac_Rx
              PduRSrcPduPduRBswModulesRef = CanIf
          VMCU_BB2_58P_oBackbone2_20589d38_Rx: PduRRoutingPathCommunicationType=COMMUNICATION_INTERFACE
            PduRSrcPdu_7e092eee (PduRSrcPdu): PduRSourcePduHandleId=157, PduRSrcPduDirection=RECEIVE, PduRSrcPduRef=VMCU_BB2_58P_oBackbone2_20589d38_Rx, PduRSrcPduPduRBswModulesRef=CanIf
            VMCU_BB2_58P_oBackbone2_20589d38_Rx_7e092eee_Rx (PduRDestPdu):
              PduRDestPduHandleId = 150
              PduRDestPduDirection = RECEIVE
              PduRDestPduRoutingType = API_FORWARDING
              PduRDestPduDataProcessing = IMMEDIATE
              PduRPduLengthHandlingStrategy = UNUSED
              PduRTransmissionConfirmation = false
              PduRDestPduRef = VMCU_BB2_58P_oBackbone2_89e8bf4f_Rx
              PduRDestPduPduRBswModulesRef = Com
          CIOM_0e4c34f4_Rx: PduRRoutingPathCommunicationType=COMMUNICATION_INTERFACE
            PduRSrcPdu_5dd96628 (PduRSrcPdu):
              PduRSourcePduHandleId = 31
              PduRSrcPduDirection = RECEIVE
              PduRSrcPduRef = DiagUUDTRespMsg1_F2_53_Cab_oCabSubnet_72389ca4_Rx
              PduRSrcPduPduRBswModulesRef = CanIf
            CIOM_8ae1f502_Tx (PduRDestPdu):
              PduRDestPduHandleId = 108
              PduRDestPduDirection = TRANSMIT
              PduRDestPduRoutingType = GATEWAY_ROUTING
              PduRDestPduDataProcessing = IMMEDIATE
              PduRPduLengthHandlingStrategy = UNUSED
              PduRDestPduDataProvision = PDUR_DIRECT
              PduRTransmissionConfirmation = false
              PduRDestPduRef = DiagUUDTRespMsg1_F2_53_BB2_oBackbone2_f6955d52_Tx
              PduRDestPduPduRBswModulesRef = CanIf
          CIOM_Sec_07S_oSecuritySubnet_1e212d85_Tx: PduRRoutingPathCommunicationType=TRANSPORT_PROTOCOL
            CIOM_Sec_07S_oSecuritySubnet_e302eca2_Tx (PduRDestPdu):
              PduRDestPduHandleId = 14
              PduRDestPduDirection = TRANSMIT
              PduRDestPduRoutingType = API_FORWARDING
              PduRDestPduDataProcessing = IMMEDIATE
              PduRPduLengthHandlingStrategy = UNUSED
              PduRDestPduRef = CIOM_Sec_07S_oSecuritySubnet_e302eca2_Tx
              PduRDestPduPduRBswModulesRef = CanTp
            PduRSrcPdu_1afac4d5 (PduRSrcPdu): PduRSourcePduHandleId=74, PduRSrcPduDirection=TRANSMIT, PduRSrcPduRef=CIOM_Sec_07S_oSecuritySubnet_1e212d85_Tx, PduRSrcPduPduRBswModulesRef=Com
          DDM_Sec_03S_oSecuritySubnet_a887cd16_Rx: PduRRoutingPathCommunicationType=TRANSPORT_PROTOCOL
            DDM_Sec_03S_oSecuritySubnet_a887cd16_Rx_fdae10f0_Rx (PduRDestPdu):
              PduRDestPduHandleId = 5
              PduRDestPduDirection = RECEIVE
              PduRDestPduRoutingType = API_FORWARDING
              PduRDestPduDataProcessing = IMMEDIATE
              PduRPduLengthHandlingStrategy = UNUSED
              PduRDestPduRef = DDM_Sec_03S_oSecuritySubnet_16817e43_Rx
              PduRDestPduPduRBswModulesRef = Com
            PduRSrcPdu_fdae10f0 (PduRSrcPdu): PduRSourcePduHandleId=51, PduRSrcPduDirection=RECEIVE, PduRSrcPduRef=DDM_Sec_03S_oSecuritySubnet_a887cd16_Rx, PduRSrcPduPduRBswModulesRef=CanTp
          MastertoTCP_oLIN02_d16528d3_Tx: PduRRoutingPathCommunicationType=COMMUNICATION_INTERFACE
            PduRSrcPdu_c21cbda2 (PduRSrcPdu): PduRSourcePduHandleId=171, PduRSrcPduDirection=TRANSMIT, PduRSrcPduRef=MastertoTCP_oLIN02_d16528d3_Tx, PduRSrcPduPduRBswModulesRef=Com
            MastertoTCP_oLIN02_7c7ed3d1_Tx (PduRDestPdu):
              PduRDestPduHandleId = 132
              PduRDestPduDirection = TRANSMIT
              PduRDestPduRoutingType = API_FORWARDING
              PduRDestPduDataProcessing = IMMEDIATE
              PduRPduLengthHandlingStrategy = UNUSED
              PduRTransmissionConfirmation = false
              PduRDestPduDataProvision = PDUR_TRIGGERTRANSMIT
              PduRDestPduRef = MastertoTCP_oLIN02_7c7ed3d1_Tx
              PduRDestPduPduRBswModulesRef = LinIf
          HMIIOM_BB2_36S_oBackbone2_fa2be35e_Rx: PduRRoutingPathCommunicationType=TRANSPORT_PROTOCOL
            HMIIOM_BB2_36S_oBackbone2_fa2be35e_Rx_270fccd3_Rx (PduRDestPdu):
              PduRDestPduHandleId = 16
              PduRDestPduDirection = RECEIVE
              PduRDestPduRoutingType = API_FORWARDING
              PduRDestPduDataProcessing = IMMEDIATE
              PduRPduLengthHandlingStrategy = UNUSED
              PduRDestPduRef = HMIIOM_BB2_36S_oBackbone2_1d006b85_Rx
              PduRDestPduPduRBswModulesRef = Com
            PduRSrcPdu_270fccd3 (PduRSrcPdu): PduRSourcePduHandleId=62, PduRSrcPduDirection=RECEIVE, PduRSrcPduRef=HMIIOM_BB2_36S_oBackbone2_fa2be35e_Rx, PduRSrcPduPduRBswModulesRef=CanTp
          CIOMtoSlaves1_L4_oLIN03_5a9c7863_Tx: PduRRoutingPathCommunicationType=COMMUNICATION_INTERFACE
            PduRSrcPdu_cad5212d (PduRSrcPdu): PduRSourcePduHandleId=81, PduRSrcPduDirection=TRANSMIT, PduRSrcPduRef=CIOMtoSlaves1_L4_oLIN03_5a9c7863_Tx, PduRSrcPduPduRBswModulesRef=Com
            CIOMtoSlaves1_L4_oLIN03_220ce125_Tx (PduRDestPdu):
              PduRDestPduHandleId = 63
              PduRDestPduDirection = TRANSMIT
              PduRDestPduRoutingType = API_FORWARDING
              PduRDestPduDataProcessing = IMMEDIATE
              PduRPduLengthHandlingStrategy = UNUSED
              PduRDestPduDataProvision = PDUR_TRIGGERTRANSMIT
              PduRTransmissionConfirmation = false
              PduRDestPduRef = CIOMtoSlaves1_L4_oLIN03_220ce125_Tx
              PduRDestPduPduRBswModulesRef = LinIf
          CIOM_072a4251_Rx: PduRRoutingPathCommunicationType=COMMUNICATION_INTERFACE
            PduRSrcPdu_8a94d610 (PduRSrcPdu):
              PduRSourcePduHandleId = 35
              PduRSrcPduDirection = RECEIVE
              PduRSrcPduRef = DiagUUDTRespMsg1_F2_98_Cab_oCabSubnet_7b5eea01_Rx
              PduRSrcPduPduRBswModulesRef = CanIf
            CIOM_838783a7_Tx (PduRDestPdu):
              PduRDestPduHandleId = 109
              PduRDestPduDirection = TRANSMIT
              PduRDestPduRoutingType = GATEWAY_ROUTING
              PduRDestPduDataProcessing = IMMEDIATE
              PduRPduLengthHandlingStrategy = UNUSED
              PduRDestPduDataProvision = PDUR_DIRECT
              PduRTransmissionConfirmation = false
              PduRDestPduRef = DiagUUDTRespMsg1_F2_98_BB2_oBackbone2_fff32bf7_Tx
              PduRDestPduPduRBswModulesRef = CanIf
          PhysDiagRespMsg_F2_40_BB2_oBackbone2_d76075a5_Tx: PduRRoutingPathCommunicationType=TRANSPORT_PROTOCOL
            PhysDiagRespMsg_F2_40_BB2_oBackbone2_1ef42df7_Tx (PduRDestPdu):
              PduRDestPduHandleId = 88
              PduRDestPduDirection = TRANSMIT
              PduRDestPduRoutingType = API_FORWARDING
              PduRDestPduDataProcessing = IMMEDIATE
              PduRPduLengthHandlingStrategy = UNUSED
              PduRDestPduRef = PhysDiagRespMsg_F2_40_BB2_oBackbone2_1ef42df7_Tx
              PduRDestPduPduRBswModulesRef = CanTp
            PduRSrcPdu_09be0918 (PduRSrcPdu):
              PduRSourcePduHandleId = 175
              PduRSrcPduDirection = TRANSMIT
              PduRSrcPduRef = PhysDiagRespMsg_F2_40_BB2_oBackbone2_d76075a5_Tx
              PduRSrcPduPduRBswModulesRef = Dcm
          CCM_Cab_01P_oCabSubnet_d6dd7ea3_Rx: PduRRoutingPathCommunicationType=COMMUNICATION_INTERFACE
            CCM_Cab_01P_oCabSubnet_d6dd7ea3_Rx_191cbf98_Rx (PduRDestPdu):
              PduRDestPduHandleId = 25
              PduRDestPduDirection = RECEIVE
              PduRDestPduRoutingType = API_FORWARDING
              PduRDestPduDataProcessing = IMMEDIATE
              PduRPduLengthHandlingStrategy = UNUSED
              PduRTransmissionConfirmation = false
              PduRDestPduRef = CCM_Cab_01P_oCabSubnet_3993b0cf_Rx
              PduRDestPduPduRBswModulesRef = Com
            PduRSrcPdu_191cbf98 (PduRSrcPdu): PduRSourcePduHandleId=25, PduRSrcPduDirection=RECEIVE, PduRSrcPduRef=CCM_Cab_01P_oCabSubnet_d6dd7ea3_Rx, PduRSrcPduPduRBswModulesRef=CanIf
          CIOM_a6da9c20_Rx: PduRRoutingPathCommunicationType=TRANSPORT_PROTOCOL
            CIOM_eeadebca_Tx (PduRDestPdu):
              PduRDestPduHandleId = 24
              PduRDestPduDirection = TRANSMIT
              PduRDestPduRoutingType = GATEWAY_ROUTING
              PduRDestPduDataProcessing = IMMEDIATE
              PduRPduLengthHandlingStrategy = UNUSED
              PduRDestPduQueueDepth = 4
              PduRTpThreshold = 1
              PduRDestPduRef = DiagReqMsgIntHMIIOM_A0_F3_Sec_oSecuritySubnet_3b535a3a_Tx
              PduRDestPduPduRBswModulesRef = CanTp
            PduRSrcPdu_71b786d1 (PduRSrcPdu):
              PduRSourcePduHandleId = 38
              PduRSrcPduDirection = RECEIVE
              PduRSrcPduRef = DiagReqMsgIntHMIIOM_A0_F3_BB2_oBackbone2_fbd03128_Rx
              PduRSrcPduPduRBswModulesRef = CanTp
          ERC1_x_EMSRetFMS_oFMSNet_71599960_Tx: PduRRoutingPathCommunicationType=COMMUNICATION_INTERFACE
            ERC1_x_EMSRetFMS_oFMSNet_04fe6f08_Tx (PduRDestPdu):
              PduRDestPduHandleId = 117
              PduRDestPduDirection = TRANSMIT
              PduRDestPduRoutingType = API_FORWARDING
              PduRDestPduDataProcessing = IMMEDIATE
              PduRPduLengthHandlingStrategy = UNUSED
              PduRTransmissionConfirmation = false
              PduRDestPduDataProvision = PDUR_DIRECT
              PduRDestPduRef = ERC1_x_EMSRetFMS_oFMSNet_04fe6f08_Tx
              PduRDestPduPduRBswModulesRef = CanIf
            PduRSrcPdu_cb9cbc04 (PduRSrcPdu): PduRSourcePduHandleId=131, PduRSrcPduDirection=TRANSMIT, PduRSrcPduRef=ERC1_x_EMSRetFMS_oFMSNet_71599960_Tx, PduRSrcPduPduRBswModulesRef=Com
          CIOM_39dfd6de_Rx: PduRRoutingPathCommunicationType=TRANSPORT_PROTOCOL
            CIOM_9f94b5ae_Tx (PduRDestPdu):
              PduRDestPduHandleId = 39
              PduRDestPduDirection = TRANSMIT
              PduRDestPduRoutingType = GATEWAY_ROUTING
              PduRDestPduDataProcessing = IMMEDIATE
              PduRPduLengthHandlingStrategy = UNUSED
              PduRDestPduQueueDepth = 4
              PduRTpThreshold = 1
              PduRDestPduRef = DiagRespMsgIntHMIIOM_F3_A0_BB2_oBackbone2_91123731_Tx
              PduRDestPduPduRBswModulesRef = CanTp
            PduRSrcPdu_ff6a6468 (PduRSrcPdu):
              PduRSourcePduHandleId = 19
              PduRSrcPduDirection = RECEIVE
              PduRSrcPduRef = DiagRespMsgIntHMIIOM_F3_A0_Sec_oSecuritySubnet_84b7da73_Rx
              PduRSrcPduPduRBswModulesRef = CanTp
          CIOM_Cab_10P_oCabSubnet_faaf374e_Tx: PduRRoutingPathCommunicationType=COMMUNICATION_INTERFACE
            PduRSrcPdu_9f126e32 (PduRSrcPdu): PduRSourcePduHandleId=43, PduRSrcPduDirection=TRANSMIT, PduRSrcPduRef=CIOM_Cab_10P_oCabSubnet_faaf374e_Tx, PduRSrcPduPduRBswModulesRef=Com
            CIOM_Cab_10P_oCabSubnet_23caa664_Tx (PduRDestPdu):
              PduRDestPduHandleId = 40
              PduRDestPduDirection = TRANSMIT
              PduRDestPduRoutingType = API_FORWARDING
              PduRDestPduDataProcessing = IMMEDIATE
              PduRPduLengthHandlingStrategy = UNUSED
              PduRDestPduDataProvision = PDUR_DIRECT
              PduRTransmissionConfirmation = false
              PduRDestPduRef = CIOM_Cab_10P_oCabSubnet_23caa664_Tx
              PduRDestPduPduRBswModulesRef = CanIf
          DiagFaultStat_SRS_BB2_oBackbone2_e5c83ca3_Tx: PduRRoutingPathCommunicationType=COMMUNICATION_INTERFACE
            PduRSrcPdu_946b283b (PduRSrcPdu):
              PduRSourcePduHandleId = 123
              PduRSrcPduDirection = TRANSMIT
              PduRSrcPduRef = DiagFaultStat_SRS_BB2_oBackbone2_e5c83ca3_Tx
              PduRSrcPduPduRBswModulesRef = Com
            DiagFaultStat_SRS_BB2_oBackbone2_c5219865_Tx (PduRDestPdu):
              PduRDestPduHandleId = 104
              PduRDestPduDirection = TRANSMIT
              PduRDestPduRoutingType = API_FORWARDING
              PduRDestPduDataProcessing = IMMEDIATE
              PduRPduLengthHandlingStrategy = UNUSED
              PduRTransmissionConfirmation = true
              PduRDestPduDataProvision = PDUR_DIRECT
              PduRDestPduRef = DiagFaultStat_SRS_BB2_oBackbone2_c5219865_Tx
              PduRDestPduPduRBswModulesRef = CanIf
          HRLFC_X_CIOMFMS_oFMSNet_2bd59f3d_Tx: PduRRoutingPathCommunicationType=COMMUNICATION_INTERFACE
            PduRSrcPdu_be3fbdb6 (PduRSrcPdu): PduRSourcePduHandleId=143, PduRSrcPduDirection=TRANSMIT, PduRSrcPduRef=HRLFC_X_CIOMFMS_oFMSNet_2bd59f3d_Tx, PduRSrcPduPduRBswModulesRef=Com
            HRLFC_X_CIOMFMS_oFMSNet_7d441e5f_Tx (PduRDestPdu):
              PduRDestPduHandleId = 129
              PduRDestPduDirection = TRANSMIT
              PduRDestPduRoutingType = API_FORWARDING
              PduRDestPduDataProcessing = IMMEDIATE
              PduRPduLengthHandlingStrategy = UNUSED
              PduRTransmissionConfirmation = false
              PduRDestPduDataProvision = PDUR_DIRECT
              PduRDestPduRef = HRLFC_X_CIOMFMS_oFMSNet_7d441e5f_Tx
              PduRDestPduPduRBswModulesRef = CanIf
          TCO1_X_CIOMFMS_oFMSNet_b4162784_Tx: PduRRoutingPathCommunicationType=COMMUNICATION_INTERFACE
            PduRSrcPdu_118133ce (PduRSrcPdu): PduRSourcePduHandleId=177, PduRSrcPduDirection=TRANSMIT, PduRSrcPduRef=TCO1_X_CIOMFMS_oFMSNet_b4162784_Tx, PduRSrcPduPduRBswModulesRef=Com
            TCO1_X_CIOMFMS_oFMSNet_cdc54e4b_Tx (PduRDestPdu):
              PduRDestPduHandleId = 135
              PduRDestPduDirection = TRANSMIT
              PduRDestPduRoutingType = API_FORWARDING
              PduRDestPduDataProcessing = IMMEDIATE
              PduRPduLengthHandlingStrategy = UNUSED
              PduRTransmissionConfirmation = false
              PduRDestPduDataProvision = PDUR_DIRECT
              PduRDestPduRef = TCO1_X_CIOMFMS_oFMSNet_cdc54e4b_Tx
              PduRDestPduPduRBswModulesRef = CanIf
          BBM_BB2_02P_oBackbone2_ae84b87e_Rx: PduRRoutingPathCommunicationType=COMMUNICATION_INTERFACE
            PduRSrcPdu_72b80dcb (PduRSrcPdu): PduRSourcePduHandleId=22, PduRSrcPduDirection=RECEIVE, PduRSrcPduRef=BBM_BB2_02P_oBackbone2_ae84b87e_Rx, PduRSrcPduPduRBswModulesRef=CanIf
            BBM_BB2_02P_oBackbone2_ae84b87e_Rx_72b80dcb_Rx (PduRDestPdu):
              PduRDestPduHandleId = 22
              PduRDestPduDirection = RECEIVE
              PduRDestPduRoutingType = API_FORWARDING
              PduRDestPduDataProcessing = IMMEDIATE
              PduRPduLengthHandlingStrategy = UNUSED
              PduRTransmissionConfirmation = false
              PduRDestPduRef = BBM_BB2_02P_oBackbone2_b0a9c179_Rx
              PduRDestPduPduRBswModulesRef = Com
          VMCU_BB2_31S_oBackbone2_9791f79f_Rx: PduRRoutingPathCommunicationType=TRANSPORT_PROTOCOL
            VMCU_BB2_31S_oBackbone2_9791f79f_Rx_962aaefb_Rx (PduRDestPdu):
              PduRDestPduHandleId = 45
              PduRDestPduDirection = RECEIVE
              PduRDestPduRoutingType = API_FORWARDING
              PduRDestPduDataProcessing = IMMEDIATE
              PduRPduLengthHandlingStrategy = UNUSED
              PduRDestPduRef = VMCU_BB2_31S_oBackbone2_81212ce1_Rx
              PduRDestPduPduRBswModulesRef = Com
            PduRSrcPdu_962aaefb (PduRSrcPdu): PduRSourcePduHandleId=89, PduRSrcPduDirection=RECEIVE, PduRSrcPduRef=VMCU_BB2_31S_oBackbone2_9791f79f_Rx, PduRSrcPduPduRBswModulesRef=CanTp
          MasterReq_FSP1_L2_oLIN01_d46fba5f_Tx: PduRRoutingPathCommunicationType=TRANSPORT_PROTOCOL
            PduRSrcPdu_a3b679cc (PduRSrcPdu): PduRSourcePduHandleId=151, PduRSrcPduDirection=TRANSMIT, PduRSrcPduRef=MasterReq_FSP1_L2_oLIN01_d46fba5f_Tx, PduRSrcPduPduRBswModulesRef=Cdd
            MasterReq_FSP1_L2_oLIN01_4856dd21_Tx (PduRDestPdu):
              PduRDestPduHandleId = 58
              PduRDestPduDirection = TRANSMIT
              PduRDestPduRoutingType = API_FORWARDING
              PduRDestPduDataProcessing = IMMEDIATE
              PduRPduLengthHandlingStrategy = UNUSED
              PduRDestPduRef = MasterReq_FSP1_L2_oLIN01_4856dd21_Tx
              PduRDestPduPduRBswModulesRef = LinTp
          AnmMsg_DACU_Backbone2_oBackbone2_dbe92592_Rx: PduRRoutingPathCommunicationType=COMMUNICATION_INTERFACE
            AnmMsg_DACU_Backbone2_oBackbone2_dbe92592_Rx_4a41b928_Rx (PduRDestPdu):
              PduRDestPduHandleId = 7
              PduRDestPduDirection = RECEIVE
              PduRDestPduRoutingType = API_FORWARDING
              PduRDestPduDataProcessing = IMMEDIATE
              PduRPduLengthHandlingStrategy = UNUSED
              PduRTransmissionConfirmation = false
              PduRDestPduRef = AnmMsg_DACU_Backbone2_oBackbone2_49517b4d_Rx
              PduRDestPduPduRBswModulesRef = Com
            PduRSrcPdu_4a41b928 (PduRSrcPdu):
              PduRSourcePduHandleId = 7
              PduRSrcPduDirection = RECEIVE
              PduRSrcPduRef = AnmMsg_DACU_Backbone2_oBackbone2_dbe92592_Rx
              PduRSrcPduPduRBswModulesRef = CanIf
          MasterReq_FSP2_L2_oLIN01_4d8ddc5e_Tx: PduRRoutingPathCommunicationType=TRANSPORT_PROTOCOL
            PduRSrcPdu_a2b3fcad (PduRSrcPdu): PduRSourcePduHandleId=156, PduRSrcPduDirection=TRANSMIT, PduRSrcPduRef=MasterReq_FSP2_L2_oLIN01_4d8ddc5e_Tx, PduRSrcPduPduRBswModulesRef=Cdd
            MasterReq_FSP2_L2_oLIN01_ba0130d9_Tx (PduRDestPdu):
              PduRDestPduHandleId = 63
              PduRDestPduDirection = TRANSMIT
              PduRDestPduRoutingType = API_FORWARDING
              PduRDestPduDataProcessing = IMMEDIATE
              PduRPduLengthHandlingStrategy = UNUSED
              PduRDestPduRef = MasterReq_FSP2_L2_oLIN01_ba0130d9_Tx
              PduRDestPduPduRBswModulesRef = LinTp
          VMCU_BB2_04P_oBackbone2_5ffe6079_Rx: PduRRoutingPathCommunicationType=COMMUNICATION_INTERFACE
            PduRSrcPdu_5090446e (PduRSrcPdu): PduRSourcePduHandleId=146, PduRSrcPduDirection=RECEIVE, PduRSrcPduRef=VMCU_BB2_04P_oBackbone2_5ffe6079_Rx, PduRSrcPduPduRBswModulesRef=CanIf
            VMCU_BB2_04P_oBackbone2_5ffe6079_Rx_5090446e_Rx (PduRDestPdu):
              PduRDestPduHandleId = 139
              PduRDestPduDirection = RECEIVE
              PduRDestPduRoutingType = API_FORWARDING
              PduRDestPduDataProcessing = IMMEDIATE
              PduRPduLengthHandlingStrategy = UNUSED
              PduRTransmissionConfirmation = false
              PduRDestPduRef = VMCU_BB2_04P_oBackbone2_97f168d9_Rx
              PduRDestPduPduRBswModulesRef = Com
          FMS1_X_CIOMFMS_oFMSNet_d38e3e3b_Tx: PduRRoutingPathCommunicationType=COMMUNICATION_INTERFACE
            PduRSrcPdu_2bda7b06 (PduRSrcPdu): PduRSourcePduHandleId=134, PduRSrcPduDirection=TRANSMIT, PduRSrcPduRef=FMS1_X_CIOMFMS_oFMSNet_d38e3e3b_Tx, PduRSrcPduPduRBswModulesRef=Com
            FMS1_X_CIOMFMS_oFMSNet_79c218f8_Tx (PduRDestPdu):
              PduRDestPduHandleId = 120
              PduRDestPduDirection = TRANSMIT
              PduRDestPduRoutingType = API_FORWARDING
              PduRDestPduDataProcessing = IMMEDIATE
              PduRPduLengthHandlingStrategy = UNUSED
              PduRDestPduDataProvision = PDUR_DIRECT
              PduRTransmissionConfirmation = false
              PduRDestPduRef = FMS1_X_CIOMFMS_oFMSNet_79c218f8_Tx
              PduRDestPduPduRBswModulesRef = CanIf
          CIOM_7d0741c1_Rx: PduRRoutingPathCommunicationType=COMMUNICATION_INTERFACE
            CIOM_3da9a113_Tx (PduRDestPdu):
              PduRDestPduHandleId = 111
              PduRDestPduDirection = TRANSMIT
              PduRDestPduRoutingType = GATEWAY_ROUTING
              PduRDestPduDataProcessing = IMMEDIATE
              PduRPduLengthHandlingStrategy = UNUSED
              PduRDestPduDataProvision = PDUR_DIRECT
              PduRTransmissionConfirmation = false
              PduRDestPduRef = DiagUUDTRespMsg1_F2_A1_BB2_oBackbone2_41dd0943_Tx
              PduRDestPduPduRBswModulesRef = CanIf
            PduRSrcPdu_7df464da (PduRSrcPdu):
              PduRSourcePduHandleId = 32
              PduRSrcPduDirection = RECEIVE
              PduRSrcPduRef = DiagUUDTRespMsg1_F2_A1_Sec_oSecuritySubnet_98bdc248_Rx
              PduRSrcPduPduRBswModulesRef = CanIf
          MasterReq_FSP1_L5_oLIN04_aec047c9_Tx: PduRRoutingPathCommunicationType=TRANSPORT_PROTOCOL
            PduRSrcPdu_6d3fc1f8 (PduRSrcPdu): PduRSourcePduHandleId=154, PduRSrcPduDirection=TRANSMIT, PduRSrcPduRef=MasterReq_FSP1_L5_oLIN04_aec047c9_Tx, PduRSrcPduPduRBswModulesRef=Cdd
            MasterReq_FSP1_L5_oLIN04_34dc6c16_Tx (PduRDestPdu):
              PduRDestPduHandleId = 61
              PduRDestPduDirection = TRANSMIT
              PduRDestPduRoutingType = API_FORWARDING
              PduRDestPduDataProcessing = IMMEDIATE
              PduRPduLengthHandlingStrategy = UNUSED
              PduRDestPduRef = MasterReq_FSP1_L5_oLIN04_34dc6c16_Tx
              PduRDestPduPduRBswModulesRef = LinTp
          MasterReq_FSP4_L2_oLIN01_a538161d_Tx: PduRRoutingPathCommunicationType=TRANSPORT_PROTOCOL
            PduRSrcPdu_f008f462 (PduRSrcPdu): PduRSourcePduHandleId=159, PduRSrcPduDirection=TRANSMIT, PduRSrcPduRef=MasterReq_FSP4_L2_oLIN01_a538161d_Tx, PduRSrcPduPduRBswModulesRef=Cdd
            MasterReq_FSP4_L2_oLIN01_85dfed68_Tx (PduRDestPdu):
              PduRDestPduHandleId = 66
              PduRDestPduDirection = TRANSMIT
              PduRDestPduRoutingType = API_FORWARDING
              PduRDestPduDataProcessing = IMMEDIATE
              PduRPduLengthHandlingStrategy = UNUSED
              PduRDestPduRef = MasterReq_FSP4_L2_oLIN01_85dfed68_Tx
              PduRDestPduPduRBswModulesRef = LinTp
          CIOM_Sec_11S_oSecuritySubnet_c7bf1158_Tx: PduRRoutingPathCommunicationType=TRANSPORT_PROTOCOL
            CIOM_Sec_11S_oSecuritySubnet_d4660cbf_Tx (PduRDestPdu):
              PduRDestPduHandleId = 18
              PduRDestPduDirection = TRANSMIT
              PduRDestPduRoutingType = API_FORWARDING
              PduRDestPduDataProcessing = IMMEDIATE
              PduRPduLengthHandlingStrategy = UNUSED
              PduRDestPduRef = CIOM_Sec_11S_oSecuritySubnet_d4660cbf_Tx
              PduRDestPduPduRBswModulesRef = CanTp
            PduRSrcPdu_4a8c70b8 (PduRSrcPdu): PduRSourcePduHandleId=78, PduRSrcPduDirection=TRANSMIT, PduRSrcPduRef=CIOM_Sec_11S_oSecuritySubnet_c7bf1158_Tx, PduRSrcPduPduRBswModulesRef=Com
          CCM_Cab_08P_oCabSubnet_c4134f5d_Rx: PduRRoutingPathCommunicationType=COMMUNICATION_INTERFACE
            CCM_Cab_08P_oCabSubnet_c4134f5d_Rx_f641b15a_Rx (PduRDestPdu):
              PduRDestPduHandleId = 29
              PduRDestPduDirection = RECEIVE
              PduRDestPduRoutingType = API_FORWARDING
              PduRDestPduDataProcessing = IMMEDIATE
              PduRPduLengthHandlingStrategy = UNUSED
              PduRTransmissionConfirmation = false
              PduRDestPduRef = CCM_Cab_08P_oCabSubnet_be06ba27_Rx
              PduRDestPduPduRBswModulesRef = Com
            PduRSrcPdu_f641b15a (PduRSrcPdu): PduRSourcePduHandleId=29, PduRSrcPduDirection=RECEIVE, PduRSrcPduRef=CCM_Cab_08P_oCabSubnet_c4134f5d_Rx, PduRSrcPduPduRBswModulesRef=CanIf
          CIOM_7490cd77_Rx: PduRRoutingPathCommunicationType=TRANSPORT_PROTOCOL
            PduRSrcPdu_304f257a (PduRSrcPdu):
              PduRSourcePduHandleId = 30
              PduRSrcPduDirection = RECEIVE
              PduRSrcPduRef = DiagReqMsgIntHMIIOM_26_F3_BB2_oBackbone2_299a607f_Rx
              PduRSrcPduPduRBswModulesRef = CanTp
            CIOM_f03d0c81_Tx (PduRDestPdu):
              PduRDestPduHandleId = 21
              PduRDestPduDirection = TRANSMIT
              PduRDestPduRoutingType = GATEWAY_ROUTING
              PduRDestPduDataProcessing = IMMEDIATE
              PduRPduLengthHandlingStrategy = UNUSED
              PduRDestPduQueueDepth = 4
              PduRTpThreshold = 1
              PduRDestPduRef = DiagReqMsgIntHMIIOM_26_F3_Cab_oCabSubnet_ad37a189_Tx
              PduRDestPduPduRBswModulesRef = CanTp
          DiagFaultStat_CCM_BB2_oBackbone2_9d39fab0_Tx: PduRRoutingPathCommunicationType=COMMUNICATION_INTERFACE
            DiagFaultStat_CCM_BB2_oBackbone2_9a44ed2c_Tx (PduRDestPdu):
              PduRDestPduHandleId = 99
              PduRDestPduDirection = TRANSMIT
              PduRDestPduRoutingType = API_FORWARDING
              PduRDestPduDataProcessing = IMMEDIATE
              PduRPduLengthHandlingStrategy = UNUSED
              PduRTransmissionConfirmation = true
              PduRDestPduDataProvision = PDUR_DIRECT
              PduRDestPduRef = DiagFaultStat_CCM_BB2_oBackbone2_9a44ed2c_Tx
              PduRDestPduPduRBswModulesRef = CanIf
            PduRSrcPdu_e1be2636 (PduRSrcPdu):
              PduRSourcePduHandleId = 118
              PduRSrcPduDirection = TRANSMIT
              PduRSrcPduRef = DiagFaultStat_CCM_BB2_oBackbone2_9d39fab0_Tx
              PduRSrcPduPduRBswModulesRef = Com
          CIOM_Cab_04S_oCabSubnet_d0876e5e_Tx: PduRRoutingPathCommunicationType=TRANSPORT_PROTOCOL
            CIOM_Cab_04S_oCabSubnet_779a15ce_Tx (PduRDestPdu):
              PduRDestPduHandleId = 3
              PduRDestPduDirection = TRANSMIT
              PduRDestPduRoutingType = API_FORWARDING
              PduRDestPduDataProcessing = IMMEDIATE
              PduRPduLengthHandlingStrategy = UNUSED
              PduRDestPduRef = CIOM_Cab_04S_oCabSubnet_779a15ce_Tx
              PduRDestPduPduRBswModulesRef = CanTp
            PduRSrcPdu_bc75d45f (PduRSrcPdu): PduRSourcePduHandleId=37, PduRSrcPduDirection=TRANSMIT, PduRSrcPduRef=CIOM_Cab_04S_oCabSubnet_d0876e5e_Tx, PduRSrcPduPduRBswModulesRef=Com
          HMIIOM_BB2_19P_CIOM_oBackbone2_dafe7cda_Rx: PduRRoutingPathCommunicationType=TRANSPORT_PROTOCOL
            HMIIOM_BB2_19P_CIOM_oBackbone2_dafe7cda_Rx_75cfe088_Rx (PduRDestPdu):
              PduRDestPduHandleId = 13
              PduRDestPduDirection = RECEIVE
              PduRDestPduRoutingType = API_FORWARDING
              PduRDestPduDataProcessing = IMMEDIATE
              PduRPduLengthHandlingStrategy = UNUSED
              PduRDestPduRef = HMIIOM_BB2_19P_CIOM_oBackbone2_da8f8d8b_Rx
              PduRDestPduPduRBswModulesRef = Com
            PduRSrcPdu_75cfe088 (PduRSrcPdu): PduRSourcePduHandleId=59, PduRSrcPduDirection=RECEIVE, PduRSrcPduRef=HMIIOM_BB2_19P_CIOM_oBackbone2_dafe7cda_Rx, PduRSrcPduPduRBswModulesRef=CanTp
          PDM_Sec_01P_oSecuritySubnet_5921b61c_Rx: PduRRoutingPathCommunicationType=COMMUNICATION_INTERFACE
            PduRSrcPdu_9d822126 (PduRSrcPdu): PduRSourcePduHandleId=125, PduRSrcPduDirection=RECEIVE, PduRSrcPduRef=PDM_Sec_01P_oSecuritySubnet_5921b61c_Rx, PduRSrcPduPduRBswModulesRef=CanIf
            PDM_Sec_01P_oSecuritySubnet_5921b61c_Rx_9d822126_Rx (PduRDestPdu):
              PduRDestPduHandleId = 118
              PduRDestPduDirection = RECEIVE
              PduRDestPduRoutingType = API_FORWARDING
              PduRDestPduDataProcessing = IMMEDIATE
              PduRPduLengthHandlingStrategy = UNUSED
              PduRTransmissionConfirmation = false
              PduRDestPduRef = PDM_Sec_01P_oSecuritySubnet_7ffa8e54_Rx
              PduRDestPduPduRBswModulesRef = Com
          CIOM_Sec_05S_oSecuritySubnet_1bf54606_Tx: PduRRoutingPathCommunicationType=TRANSPORT_PROTOCOL
            CIOM_Sec_05S_oSecuritySubnet_7a00e33f_Tx (PduRDestPdu):
              PduRDestPduHandleId = 12
              PduRDestPduDirection = TRANSMIT
              PduRDestPduRoutingType = API_FORWARDING
              PduRDestPduDataProcessing = IMMEDIATE
              PduRPduLengthHandlingStrategy = UNUSED
              PduRDestPduRef = CIOM_Sec_05S_oSecuritySubnet_7a00e33f_Tx
              PduRDestPduPduRBswModulesRef = CanTp
            PduRSrcPdu_2b407fd5 (PduRSrcPdu): PduRSourcePduHandleId=72, PduRSrcPduDirection=TRANSMIT, PduRSrcPduRef=CIOM_Sec_05S_oSecuritySubnet_1bf54606_Tx, PduRSrcPduPduRBswModulesRef=Com
          VMCU_BB2_52P_oBackbone2_fb89a479_Rx: PduRRoutingPathCommunicationType=COMMUNICATION_INTERFACE
            PduRSrcPdu_db8fea9c (PduRSrcPdu): PduRSourcePduHandleId=153, PduRSrcPduDirection=RECEIVE, PduRSrcPduRef=VMCU_BB2_52P_oBackbone2_fb89a479_Rx, PduRSrcPduPduRBswModulesRef=CanIf
            VMCU_BB2_52P_oBackbone2_fb89a479_Rx_db8fea9c_Rx (PduRDestPdu):
              PduRDestPduHandleId = 146
              PduRDestPduDirection = RECEIVE
              PduRDestPduRoutingType = API_FORWARDING
              PduRDestPduDataProcessing = IMMEDIATE
              PduRPduLengthHandlingStrategy = UNUSED
              PduRTransmissionConfirmation = false
              PduRDestPduRef = VMCU_BB2_52P_oBackbone2_b3b7d969_Rx
              PduRDestPduPduRBswModulesRef = Com
          SlaveResp_DLFW_oLIN03_2782f4b7_Rx: PduRRoutingPathCommunicationType=TRANSPORT_PROTOCOL
            PduRSrcPdu_f46eac1f (PduRSrcPdu): PduRSourcePduHandleId=68, PduRSrcPduDirection=RECEIVE, PduRSrcPduRef=SlaveResp_DLFW_oLIN03_2782f4b7_Rx, PduRSrcPduPduRBswModulesRef=LinTp
            SlaveResp_DLFW_oLIN03_2782f4b7_Rx_f46eac1f_Rx (PduRDestPdu):
              PduRDestPduHandleId = 23
              PduRDestPduDirection = RECEIVE
              PduRDestPduRoutingType = API_FORWARDING
              PduRDestPduDataProcessing = IMMEDIATE
              PduRPduLengthHandlingStrategy = UNUSED
              PduRDestPduRef = SlaveResp_DLFW_oLIN03_0f2202e7_Rx
              PduRDestPduPduRBswModulesRef = Cdd
          CIOM_BB2_01P_oBackbone2_0634f59b_Tx: PduRRoutingPathCommunicationType=COMMUNICATION_INTERFACE
            PduRSrcPdu_324776e1 (PduRSrcPdu): PduRSourcePduHandleId=13, PduRSrcPduDirection=TRANSMIT, PduRSrcPduRef=CIOM_BB2_01P_oBackbone2_0634f59b_Tx, PduRSrcPduPduRBswModulesRef=Com
            CIOM_BB2_01P_oBackbone2_12f7ffb9_Tx (PduRDestPdu):
              PduRDestPduHandleId = 15
              PduRDestPduDirection = TRANSMIT
              PduRDestPduRoutingType = API_FORWARDING
              PduRDestPduDataProcessing = IMMEDIATE
              PduRPduLengthHandlingStrategy = UNUSED
              PduRDestPduDataProvision = PDUR_DIRECT
              PduRTransmissionConfirmation = false
              PduRDestPduRef = CIOM_BB2_01P_oBackbone2_12f7ffb9_Tx
              PduRDestPduPduRBswModulesRef = CanIf
          BBM_BB2_06P_oBackbone2_df0ea254_Rx: PduRRoutingPathCommunicationType=COMMUNICATION_INTERFACE
            PduRSrcPdu_a833036d (PduRSrcPdu): PduRSourcePduHandleId=23, PduRSrcPduDirection=RECEIVE, PduRSrcPduRef=BBM_BB2_06P_oBackbone2_df0ea254_Rx, PduRSrcPduPduRBswModulesRef=CanIf
            BBM_BB2_06P_oBackbone2_df0ea254_Rx_a833036d_Rx (PduRDestPdu):
              PduRDestPduHandleId = 23
              PduRDestPduDirection = RECEIVE
              PduRDestPduRoutingType = API_FORWARDING
              PduRDestPduDataProcessing = IMMEDIATE
              PduRPduLengthHandlingStrategy = UNUSED
              PduRTransmissionConfirmation = false
              PduRDestPduRef = BBM_BB2_06P_oBackbone2_7010abef_Rx
              PduRDestPduPduRBswModulesRef = Com
          CIOM_Cab_33P_oCabSubnet_a60b9f2d_Tx: PduRRoutingPathCommunicationType=COMMUNICATION_INTERFACE
            PduRSrcPdu_787b56aa (PduRSrcPdu): PduRSourcePduHandleId=66, PduRSrcPduDirection=TRANSMIT, PduRSrcPduRef=CIOM_Cab_33P_oCabSubnet_a60b9f2d_Tx, PduRSrcPduPduRBswModulesRef=Com
            CIOM_Cab_33P_oCabSubnet_87308f3d_Tx (PduRDestPdu):
              PduRDestPduHandleId = 57
              PduRDestPduDirection = TRANSMIT
              PduRDestPduRoutingType = API_FORWARDING
              PduRDestPduDataProcessing = IMMEDIATE
              PduRPduLengthHandlingStrategy = UNUSED
              PduRDestPduDataProvision = PDUR_DIRECT
              PduRTransmissionConfirmation = false
              PduRDestPduRef = CIOM_Cab_33P_oCabSubnet_87308f3d_Tx
              PduRDestPduPduRBswModulesRef = CanIf
          PTODE_X_CIOMFMS_oFMSNet_74e3ffab_Tx: PduRRoutingPathCommunicationType=COMMUNICATION_INTERFACE
            PduRSrcPdu_03636d0a (PduRSrcPdu): PduRSourcePduHandleId=172, PduRSrcPduDirection=TRANSMIT, PduRSrcPduRef=PTODE_X_CIOMFMS_oFMSNet_74e3ffab_Tx, PduRSrcPduPduRBswModulesRef=Com
            PTODE_X_CIOMFMS_oFMSNet_abdf0c74_Tx (PduRDestPdu):
              PduRDestPduHandleId = 133
              PduRDestPduDirection = TRANSMIT
              PduRDestPduRoutingType = API_FORWARDING
              PduRDestPduDataProcessing = IMMEDIATE
              PduRPduLengthHandlingStrategy = UNUSED
              PduRDestPduDataProvision = PDUR_DIRECT
              PduRTransmissionConfirmation = false
              PduRDestPduRef = PTODE_X_CIOMFMS_oFMSNet_abdf0c74_Tx
              PduRDestPduPduRBswModulesRef = CanIf
          FSP_1_2_Req_L5_oLIN04_eb61afed_Tx: PduRRoutingPathCommunicationType=COMMUNICATION_INTERFACE
            FSP_1_2_Req_L5_oLIN04_6cd03e91_Tx (PduRDestPdu):
              PduRDestPduHandleId = 126
              PduRDestPduDirection = TRANSMIT
              PduRDestPduRoutingType = API_FORWARDING
              PduRDestPduDataProcessing = IMMEDIATE
              PduRPduLengthHandlingStrategy = UNUSED
              PduRDestPduDataProvision = PDUR_TRIGGERTRANSMIT
              PduRTransmissionConfirmation = false
              PduRDestPduRef = FSP_1_2_Req_L5_oLIN04_6cd03e91_Tx
              PduRDestPduPduRBswModulesRef = LinIf
            PduRSrcPdu_c731ca07 (PduRSrcPdu): PduRSourcePduHandleId=140, PduRSrcPduDirection=TRANSMIT, PduRSrcPduRef=FSP_1_2_Req_L5_oLIN04_eb61afed_Tx, PduRSrcPduPduRBswModulesRef=Com
          CIOM_2cbde143_Rx: PduRRoutingPathCommunicationType=TRANSPORT_PROTOCOL
            PduRSrcPdu_ccea7767 (PduRSrcPdu):
              PduRSourcePduHandleId = 6
              PduRSrcPduDirection = RECEIVE
              PduRSrcPduRef = PhysDiagRespMsg_F2_53_Cab_oCabSubnet_84fa068d_Rx
              PduRSrcPduPduRBswModulesRef = CanTp
            CIOM_a81020b5_Tx (PduRDestPdu):
              PduRDestPduHandleId = 89
              PduRDestPduDirection = TRANSMIT
              PduRDestPduRoutingType = GATEWAY_ROUTING
              PduRDestPduDataProcessing = IMMEDIATE
              PduRPduLengthHandlingStrategy = UNUSED
              PduRTpThreshold = 1
              PduRDestPduQueueDepth = 4
              PduRDestPduRef = PhysDiagRespMsg_F2_53_BB2_oBackbone2_0057c77b_Tx
              PduRDestPduPduRBswModulesRef = CanTp
          CIOM_Sec_06S_oSecuritySubnet_f1739b64_Tx: PduRRoutingPathCommunicationType=TRANSPORT_PROTOCOL
            CIOM_Sec_06S_oSecuritySubnet_423b684c_Tx (PduRDestPdu):
              PduRDestPduHandleId = 13
              PduRDestPduDirection = TRANSMIT
              PduRDestPduRoutingType = API_FORWARDING
              PduRDestPduDataProcessing = IMMEDIATE
              PduRPduLengthHandlingStrategy = UNUSED
              PduRDestPduRef = CIOM_Sec_06S_oSecuritySubnet_423b684c_Tx
              PduRDestPduPduRBswModulesRef = CanTp
            PduRSrcPdu_1c80e599 (PduRSrcPdu): PduRSourcePduHandleId=73, PduRSrcPduDirection=TRANSMIT, PduRSrcPduRef=CIOM_Sec_06S_oSecuritySubnet_f1739b64_Tx, PduRSrcPduPduRBswModulesRef=Com
          HOURS_X_CIOMFMS_oFMSNet_3c4de7ce_Tx: PduRRoutingPathCommunicationType=COMMUNICATION_INTERFACE
            HOURS_X_CIOMFMS_oFMSNet_012e8f51_Tx (PduRDestPdu):
              PduRDestPduHandleId = 128
              PduRDestPduDirection = TRANSMIT
              PduRDestPduRoutingType = API_FORWARDING
              PduRDestPduDataProcessing = IMMEDIATE
              PduRPduLengthHandlingStrategy = UNUSED
              PduRTransmissionConfirmation = false
              PduRDestPduDataProvision = PDUR_DIRECT
              PduRDestPduRef = HOURS_X_CIOMFMS_oFMSNet_012e8f51_Tx
              PduRDestPduPduRBswModulesRef = CanIf
            PduRSrcPdu_b58a23ae (PduRSrcPdu): PduRSourcePduHandleId=142, PduRSrcPduDirection=TRANSMIT, PduRSrcPduRef=HOURS_X_CIOMFMS_oFMSNet_3c4de7ce_Tx, PduRSrcPduPduRBswModulesRef=Com
          HMIIOM_BB2_09P_oBackbone2_e9954df9_Rx: PduRRoutingPathCommunicationType=COMMUNICATION_INTERFACE
            PduRSrcPdu_ebcbfcee (PduRSrcPdu): PduRSourcePduHandleId=102, PduRSrcPduDirection=RECEIVE, PduRSrcPduRef=HMIIOM_BB2_09P_oBackbone2_e9954df9_Rx, PduRSrcPduPduRBswModulesRef=CanIf
            HMIIOM_BB2_09P_oBackbone2_e9954df9_Rx_ebcbfcee_Rx (PduRDestPdu):
              PduRDestPduHandleId = 95
              PduRDestPduDirection = RECEIVE
              PduRDestPduRoutingType = API_FORWARDING
              PduRDestPduDataProcessing = IMMEDIATE
              PduRPduLengthHandlingStrategy = UNUSED
              PduRTransmissionConfirmation = false
              PduRDestPduRef = HMIIOM_BB2_09P_oBackbone2_318f499b_Rx
              PduRDestPduPduRBswModulesRef = Com
          DiagFaultStat_CIOM_BB2_oBackbone2_04816481_Tx: PduRRoutingPathCommunicationType=COMMUNICATION_INTERFACE
            DiagFaultStat_CIOM_BB2_oBackbone2_e34a7a3f_Tx (PduRDestPdu):
              PduRDestPduHandleId = 100
              PduRDestPduDirection = TRANSMIT
              PduRDestPduRoutingType = API_FORWARDING
              PduRDestPduDataProcessing = IMMEDIATE
              PduRPduLengthHandlingStrategy = UNUSED
              PduRTransmissionConfirmation = true
              PduRDestPduDataProvision = PDUR_DIRECT
              PduRDestPduRef = DiagFaultStat_CIOM_BB2_oBackbone2_e34a7a3f_Tx
              PduRDestPduPduRBswModulesRef = CanIf
            PduRSrcPdu_7f47f3d8 (PduRSrcPdu):
              PduRSourcePduHandleId = 119
              PduRSrcPduDirection = TRANSMIT
              PduRSrcPduRef = DiagFaultStat_CIOM_BB2_oBackbone2_04816481_Tx
              PduRSrcPduPduRBswModulesRef = Com
          DiagFaultStat_Alarm_Sec_oSecuritySubnet_c6873827_Rx: PduRRoutingPathCommunicationType=COMMUNICATION_INTERFACE
            PduRSrcPdu_0a2f5e94 (PduRSrcPdu):
              PduRSourcePduHandleId = 51
              PduRSrcPduDirection = RECEIVE
              PduRSrcPduRef = DiagFaultStat_Alarm_Sec_oSecuritySubnet_c6873827_Rx
              PduRSrcPduPduRBswModulesRef = CanIf
            DiagFaultStat_Alarm_Sec_oSecuritySubnet_c6873827_Rx_0a2f5e94_Rx (PduRDestPdu):
              PduRDestPduHandleId = 44
              PduRDestPduDirection = RECEIVE
              PduRDestPduRoutingType = API_FORWARDING
              PduRDestPduDataProcessing = IMMEDIATE
              PduRPduLengthHandlingStrategy = UNUSED
              PduRTransmissionConfirmation = false
              PduRDestPduRef = DiagFaultStat_Alarm_Sec_oSecuritySubnet_347db5f6_Rx
              PduRDestPduPduRBswModulesRef = Com
          DDM_Sec_05S_oSecuritySubnet_d8f0dbf0_Rx: PduRRoutingPathCommunicationType=TRANSPORT_PROTOCOL
            PduRSrcPdu_0948f4eb (PduRSrcPdu): PduRSourcePduHandleId=53, PduRSrcPduDirection=RECEIVE, PduRSrcPduRef=DDM_Sec_05S_oSecuritySubnet_d8f0dbf0_Rx, PduRSrcPduPduRBswModulesRef=CanTp
            DDM_Sec_05S_oSecuritySubnet_d8f0dbf0_Rx_0948f4eb_Rx (PduRDestPdu):
              PduRDestPduHandleId = 7
              PduRDestPduDirection = RECEIVE
              PduRDestPduRoutingType = API_FORWARDING
              PduRDestPduDataProcessing = IMMEDIATE
              PduRPduLengthHandlingStrategy = UNUSED
              PduRDestPduRef = DDM_Sec_05S_oSecuritySubnet_18fdc2c6_Rx
              PduRDestPduPduRBswModulesRef = Com
          FSP2_SwitchDetResp_L3_oLIN02_083067e6_Rx: PduRRoutingPathCommunicationType=COMMUNICATION_INTERFACE
            PduRSrcPdu_25794016 (PduRSrcPdu): PduRSourcePduHandleId=93, PduRSrcPduDirection=RECEIVE, PduRSrcPduRef=FSP2_SwitchDetResp_L3_oLIN02_083067e6_Rx, PduRSrcPduPduRBswModulesRef=LinIf
            FSP2_SwitchDetResp_L3_oLIN02_083067e6_Rx_25794016_Rx (PduRDestPdu):
              PduRDestPduHandleId = 86
              PduRDestPduDirection = RECEIVE
              PduRDestPduRoutingType = API_FORWARDING
              PduRDestPduDataProcessing = IMMEDIATE
              PduRPduLengthHandlingStrategy = UNUSED
              PduRTransmissionConfirmation = false
              PduRDestPduRef = FSP2_SwitchDetResp_L3_oLIN02_42c25331_Rx
              PduRDestPduPduRBswModulesRef = Com
          CL_X_CIOMFMS_oFMSNet_d1f9e889_Tx: PduRRoutingPathCommunicationType=COMMUNICATION_INTERFACE
            CL_X_CIOMFMS_oFMSNet_5e9df939_Tx (PduRDestPdu):
              PduRDestPduHandleId = 69
              PduRDestPduDirection = TRANSMIT
              PduRDestPduRoutingType = API_FORWARDING
              PduRDestPduDataProcessing = IMMEDIATE
              PduRPduLengthHandlingStrategy = UNUSED
              PduRDestPduDataProvision = PDUR_DIRECT
              PduRTransmissionConfirmation = false
              PduRDestPduRef = CL_X_CIOMFMS_oFMSNet_5e9df939_Tx
              PduRDestPduPduRBswModulesRef = CanIf
            PduRSrcPdu_25d1c4f5 (PduRSrcPdu): PduRSourcePduHandleId=87, PduRSrcPduDirection=TRANSMIT, PduRSrcPduRef=CL_X_CIOMFMS_oFMSNet_d1f9e889_Tx, PduRSrcPduPduRBswModulesRef=Com
          VDHR_X_CIOMFMS_oFMSNet_da3fd25a_Tx: PduRRoutingPathCommunicationType=COMMUNICATION_INTERFACE
            VDHR_X_CIOMFMS_oFMSNet_9598589a_Tx (PduRDestPdu):
              PduRDestPduHandleId = 136
              PduRDestPduDirection = TRANSMIT
              PduRDestPduRoutingType = API_FORWARDING
              PduRDestPduDataProcessing = IMMEDIATE
              PduRPduLengthHandlingStrategy = UNUSED
              PduRTransmissionConfirmation = false
              PduRDestPduDataProvision = PDUR_DIRECT
              PduRDestPduRef = VDHR_X_CIOMFMS_oFMSNet_9598589a_Tx
              PduRDestPduPduRBswModulesRef = CanIf
            PduRSrcPdu_a3a2462e (PduRSrcPdu): PduRSourcePduHandleId=178, PduRSrcPduDirection=TRANSMIT, PduRSrcPduRef=VDHR_X_CIOMFMS_oFMSNet_da3fd25a_Tx, PduRSrcPduPduRBswModulesRef=Com
          DLFWtoCIOM_L4_oLIN03_66a36f0d_Rx: PduRRoutingPathCommunicationType=COMMUNICATION_INTERFACE
            PduRSrcPdu_a0a38a40 (PduRSrcPdu): PduRSourcePduHandleId=41, PduRSrcPduDirection=RECEIVE, PduRSrcPduRef=DLFWtoCIOM_L4_oLIN03_66a36f0d_Rx, PduRSrcPduPduRBswModulesRef=LinIf
            DLFWtoCIOM_L4_oLIN03_66a36f0d_Rx_a0a38a40_Rx (PduRDestPdu):
              PduRDestPduHandleId = 34
              PduRDestPduDirection = RECEIVE
              PduRDestPduRoutingType = API_FORWARDING
              PduRDestPduDataProcessing = IMMEDIATE
              PduRPduLengthHandlingStrategy = UNUSED
              PduRTransmissionConfirmation = false
              PduRDestPduRef = DLFWtoCIOM_L4_oLIN03_65509040_Rx
              PduRDestPduPduRBswModulesRef = Com
          CIOM_BB2_03P_oBackbone2_666840d0_Tx: PduRRoutingPathCommunicationType=COMMUNICATION_INTERFACE
            CIOM_BB2_03P_oBackbone2_2a32f2ac_Tx (PduRDestPdu):
              PduRDestPduHandleId = 17
              PduRDestPduDirection = TRANSMIT
              PduRDestPduRoutingType = API_FORWARDING
              PduRDestPduDataProcessing = IMMEDIATE
              PduRPduLengthHandlingStrategy = UNUSED
              PduRDestPduDataProvision = PDUR_DIRECT
              PduRTransmissionConfirmation = false
              PduRDestPduRef = CIOM_BB2_03P_oBackbone2_2a32f2ac_Tx
              PduRDestPduPduRBswModulesRef = CanIf
            PduRSrcPdu_12ac6f81 (PduRSrcPdu): PduRSourcePduHandleId=15, PduRSrcPduDirection=TRANSMIT, PduRSrcPduRef=CIOM_BB2_03P_oBackbone2_666840d0_Tx, PduRSrcPduPduRBswModulesRef=Com
          SERV_X_CIOMFMS_oFMSNet_50d7a0fd_Tx: PduRRoutingPathCommunicationType=COMMUNICATION_INTERFACE
            SERV_X_CIOMFMS_oFMSNet_2bbb6097_Tx (PduRDestPdu):
              PduRDestPduHandleId = 134
              PduRDestPduDirection = TRANSMIT
              PduRDestPduRoutingType = API_FORWARDING
              PduRDestPduDataProcessing = IMMEDIATE
              PduRPduLengthHandlingStrategy = UNUSED
              PduRTransmissionConfirmation = false
              PduRDestPduDataProvision = PDUR_DIRECT
              PduRDestPduRef = SERV_X_CIOMFMS_oFMSNet_2bbb6097_Tx
              PduRDestPduPduRBswModulesRef = CanIf
            PduRSrcPdu_e908cc2f (PduRSrcPdu): PduRSourcePduHandleId=176, PduRSrcPduDirection=TRANSMIT, PduRSrcPduRef=SERV_X_CIOMFMS_oFMSNet_50d7a0fd_Tx, PduRSrcPduPduRBswModulesRef=Com
          CIOM_8ac3e654_Rx: PduRRoutingPathCommunicationType=TRANSPORT_PROTOCOL
            CIOM_f02f9169_Tx (PduRDestPdu):
              PduRDestPduHandleId = 48
              PduRDestPduDirection = TRANSMIT
              PduRDestPduRoutingType = GATEWAY_ROUTING
              PduRDestPduDataProcessing = IMMEDIATE
              PduRPduLengthHandlingStrategy = UNUSED
              PduRDestPduQueueDepth = 4
              PduRTpThreshold = 1
              PduRDestPduRef = DiagRespMsgIntTGW2_F4_A1_BB2_oBackbone2_92999b93_Tx
              PduRDestPduPduRBswModulesRef = CanTp
            PduRSrcPdu_df9a30f3 (PduRSrcPdu):
              PduRSourcePduHandleId = 12
              PduRSrcPduDirection = RECEIVE
              PduRSrcPduRef = DiagRespMsgIntTGW2_F4_A1_Sec_oSecuritySubnet_1433f276_Rx
              PduRSrcPduPduRBswModulesRef = CanTp
          CCM_Cab_03P_oCabSubnet_ee1873b6_Rx: PduRRoutingPathCommunicationType=TRANSPORT_PROTOCOL
            CCM_Cab_03P_oCabSubnet_ee1873b6_Rx_8a32f8f6_Rx (PduRDestPdu):
              PduRDestPduHandleId = 4
              PduRDestPduDirection = RECEIVE
              PduRDestPduRoutingType = API_FORWARDING
              PduRDestPduDataProcessing = IMMEDIATE
              PduRPduLengthHandlingStrategy = UNUSED
              PduRDestPduRef = CCM_Cab_03P_oCabSubnet_59cf0584_Rx
              PduRDestPduPduRBswModulesRef = Com
            PduRSrcPdu_8a32f8f6 (PduRSrcPdu): PduRSourcePduHandleId=4, PduRSrcPduDirection=RECEIVE, PduRSrcPduRef=CCM_Cab_03P_oCabSubnet_ee1873b6_Rx, PduRSrcPduPduRBswModulesRef=CanTp
          CIOM_785b5082_Rx: PduRRoutingPathCommunicationType=TRANSPORT_PROTOCOL
            CIOM_fcf69174_Tx (PduRDestPdu):
              PduRDestPduHandleId = 35
              PduRDestPduDirection = TRANSMIT
              PduRDestPduRoutingType = GATEWAY_ROUTING
              PduRDestPduDataProcessing = IMMEDIATE
              PduRPduLengthHandlingStrategy = UNUSED
              PduRDestPduQueueDepth = 4
              PduRTpThreshold = 1
              PduRDestPduRef = DiagRespMsgIntHMIIOM_F3_26_BB2_oBackbone2_f27013eb_Tx
              PduRDestPduPduRBswModulesRef = CanTp
            PduRSrcPdu_b9d033d4 (PduRSrcPdu):
              PduRSourcePduHandleId = 26
              PduRSrcPduDirection = RECEIVE
              PduRSrcPduRef = DiagRespMsgIntHMIIOM_F3_26_Cab_oCabSubnet_76ddd21d_Rx
              PduRSrcPduPduRBswModulesRef = CanTp
          CIOM_BB2_21S_oBackbone2_90c4e3c6_Tx: PduRRoutingPathCommunicationType=COMMUNICATION_INTERFACE
            PduRSrcPdu_aa6f2d0d (PduRSrcPdu): PduRSourcePduHandleId=25, PduRSrcPduDirection=TRANSMIT, PduRSrcPduRef=CIOM_BB2_21S_oBackbone2_90c4e3c6_Tx, PduRSrcPduPduRBswModulesRef=Com
            CIOM_BB2_21S_oBackbone2_6c3ae72c_Tx (PduRDestPdu):
              PduRDestPduHandleId = 25
              PduRDestPduDirection = TRANSMIT
              PduRDestPduRoutingType = API_FORWARDING
              PduRDestPduDataProcessing = IMMEDIATE
              PduRPduLengthHandlingStrategy = UNUSED
              PduRTransmissionConfirmation = true
              PduRDestPduDataProvision = PDUR_DIRECT
              PduRDestPduRef = CIOM_BB2_21S_oBackbone2_6c3ae72c_Tx
              PduRDestPduPduRBswModulesRef = CanIf
          WRCS_Cab_01P_oCabSubnet_76b95594_Rx: PduRRoutingPathCommunicationType=COMMUNICATION_INTERFACE
            WRCS_Cab_01P_oCabSubnet_76b95594_Rx_098a7866_Rx (PduRDestPdu):
              PduRDestPduHandleId = 178
              PduRDestPduDirection = RECEIVE
              PduRDestPduRoutingType = API_FORWARDING
              PduRDestPduDataProcessing = IMMEDIATE
              PduRPduLengthHandlingStrategy = UNUSED
              PduRTransmissionConfirmation = false
              PduRDestPduRef = WRCS_Cab_01P_oCabSubnet_5ce104ec_Rx
              PduRDestPduPduRBswModulesRef = Com
            PduRSrcPdu_098a7866 (PduRSrcPdu): PduRSourcePduHandleId=185, PduRSrcPduDirection=RECEIVE, PduRSrcPduRef=WRCS_Cab_01P_oCabSubnet_76b95594_Rx, PduRSrcPduPduRBswModulesRef=CanIf
          HMIIOM_BB2_23P_oBackbone2_5fa1555e_Rx: PduRRoutingPathCommunicationType=COMMUNICATION_INTERFACE
            HMIIOM_BB2_23P_oBackbone2_5fa1555e_Rx_a0403af9_Rx (PduRDestPdu):
              PduRDestPduHandleId = 97
              PduRDestPduDirection = RECEIVE
              PduRDestPduRoutingType = API_FORWARDING
              PduRDestPduDataProcessing = IMMEDIATE
              PduRPduLengthHandlingStrategy = UNUSED
              PduRTransmissionConfirmation = false
              PduRDestPduRef = HMIIOM_BB2_23P_oBackbone2_eabeeb10_Rx
              PduRDestPduPduRBswModulesRef = Com
            PduRSrcPdu_a0403af9 (PduRSrcPdu): PduRSourcePduHandleId=104, PduRSrcPduDirection=RECEIVE, PduRSrcPduRef=HMIIOM_BB2_23P_oBackbone2_5fa1555e_Rx, PduRSrcPduPduRBswModulesRef=CanIf
          CIOM_9ee26d6c_Rx: PduRRoutingPathCommunicationType=TRANSPORT_PROTOCOL
            PduRSrcPdu_ea4e2140 (PduRSrcPdu):
              PduRSourcePduHandleId = 15
              PduRSrcPduDirection = RECEIVE
              PduRSrcPduRef = DiagReqMsgIntTGW2_A2_F4_BB2_oBackbone2_f5f54830_Rx
              PduRSrcPduPduRBswModulesRef = CanTp
            CIOM_1a4fac9a_Tx (PduRDestPdu):
              PduRDestPduHandleId = 33
              PduRDestPduDirection = TRANSMIT
              PduRDestPduRoutingType = GATEWAY_ROUTING
              PduRDestPduDataProcessing = IMMEDIATE
              PduRPduLengthHandlingStrategy = UNUSED
              PduRDestPduQueueDepth = 4
              PduRTpThreshold = 1
              PduRDestPduRef = DiagReqMsgIntTGW2_A2_F4_Cab_oCabSubnet_715889c6_Tx
              PduRDestPduPduRBswModulesRef = CanTp
          EMS_BB2_01P_oBackbone2_440afce7_Rx: PduRRoutingPathCommunicationType=COMMUNICATION_INTERFACE
            PduRSrcPdu_ab107697 (PduRSrcPdu): PduRSourcePduHandleId=68, PduRSrcPduDirection=RECEIVE, PduRSrcPduRef=EMS_BB2_01P_oBackbone2_440afce7_Rx, PduRSrcPduPduRBswModulesRef=CanIf
            EMS_BB2_01P_oBackbone2_440afce7_Rx_ab107697_Rx (PduRDestPdu):
              PduRDestPduHandleId = 61
              PduRDestPduDirection = RECEIVE
              PduRDestPduRoutingType = API_FORWARDING
              PduRDestPduDataProcessing = IMMEDIATE
              PduRPduLengthHandlingStrategy = UNUSED
              PduRTransmissionConfirmation = false
              PduRDestPduRef = EMS_BB2_01P_oBackbone2_dd91fc9b_Rx
              PduRDestPduPduRBswModulesRef = Com
          FSP_1_2_Req_L3_oLIN02_c46d035f_Tx: PduRRoutingPathCommunicationType=COMMUNICATION_INTERFACE
            FSP_1_2_Req_L3_oLIN02_3be8803a_Tx (PduRDestPdu):
              PduRDestPduHandleId = 124
              PduRDestPduDirection = TRANSMIT
              PduRDestPduRoutingType = API_FORWARDING
              PduRDestPduDataProcessing = IMMEDIATE
              PduRPduLengthHandlingStrategy = UNUSED
              PduRDestPduDataProvision = PDUR_TRIGGERTRANSMIT
              PduRTransmissionConfirmation = false
              PduRDestPduRef = FSP_1_2_Req_L3_oLIN02_3be8803a_Tx
              PduRDestPduPduRBswModulesRef = LinIf
            PduRSrcPdu_e97535e6 (PduRSrcPdu): PduRSourcePduHandleId=138, PduRSrcPduDirection=TRANSMIT, PduRSrcPduRef=FSP_1_2_Req_L3_oLIN02_c46d035f_Tx, PduRSrcPduPduRBswModulesRef=Com
          AnmMsg_CIOM_Backbone2_oBackbone2_455d35af_Tx: PduRRoutingPathCommunicationType=COMMUNICATION_INTERFACE
            PduRSrcPdu_b5ff5295 (PduRSrcPdu): PduRSourcePduHandleId=3, PduRSrcPduDirection=TRANSMIT, PduRSrcPduRef=AnmMsg_CIOM_Backbone2_oBackbone2_455d35af_Tx, PduRSrcPduPduRBswModulesRef=Com
            AnmMsg_CIOM_Backbone2_oBackbone2_cf5ab87f_Tx (PduRDestPdu):
              PduRDestPduHandleId = 5
              PduRDestPduDirection = TRANSMIT
              PduRDestPduRoutingType = API_FORWARDING
              PduRDestPduDataProcessing = IMMEDIATE
              PduRPduLengthHandlingStrategy = UNUSED
              PduRTransmissionConfirmation = false
              PduRDestPduDataProvision = PDUR_DIRECT
              PduRDestPduRef = AnmMsg_CIOM_Backbone2_oBackbone2_cf5ab87f_Tx
              PduRDestPduPduRBswModulesRef = CanIf
          VMCU_BB2_32S_oBackbone2_5e8eff20_Rx: PduRRoutingPathCommunicationType=TRANSPORT_PROTOCOL
            VMCU_BB2_32S_oBackbone2_5e8eff20_Rx_8c4f8f58_Rx (PduRDestPdu):
              PduRDestPduHandleId = 46
              PduRDestPduDirection = RECEIVE
              PduRDestPduRoutingType = API_FORWARDING
              PduRDestPduDataProcessing = IMMEDIATE
              PduRPduLengthHandlingStrategy = UNUSED
              PduRDestPduRef = VMCU_BB2_32S_oBackbone2_3ceb402f_Rx
              PduRDestPduPduRBswModulesRef = Com
            PduRSrcPdu_8c4f8f58 (PduRSrcPdu): PduRSourcePduHandleId=90, PduRSrcPduDirection=RECEIVE, PduRSrcPduRef=VMCU_BB2_32S_oBackbone2_5e8eff20_Rx, PduRSrcPduPduRBswModulesRef=CanTp
          AnmMsg_DDM_SecuritySubnet_oSecuritySubnet_c6114aa9_Rx: PduRRoutingPathCommunicationType=COMMUNICATION_INTERFACE
            AnmMsg_DDM_SecuritySubnet_oSecuritySubnet_c6114aa9_Rx_bd5e212b_Rx (PduRDestPdu):
              PduRDestPduHandleId = 8
              PduRDestPduDirection = RECEIVE
              PduRDestPduRoutingType = API_FORWARDING
              PduRDestPduDataProcessing = IMMEDIATE
              PduRPduLengthHandlingStrategy = UNUSED
              PduRTransmissionConfirmation = false
              PduRDestPduRef = AnmMsg_DDM_SecuritySubnet_oSecuritySubnet_c5aaf372_Rx
              PduRDestPduPduRBswModulesRef = Com
            PduRSrcPdu_bd5e212b (PduRSrcPdu):
              PduRSourcePduHandleId = 8
              PduRSrcPduDirection = RECEIVE
              PduRSrcPduRef = AnmMsg_DDM_SecuritySubnet_oSecuritySubnet_c6114aa9_Rx
              PduRSrcPduPduRBswModulesRef = CanIf
          FSP1_Frame_L3_oLIN02_f47956e4_Rx: PduRRoutingPathCommunicationType=COMMUNICATION_INTERFACE
            PduRSrcPdu_65a06375 (PduRSrcPdu): PduRSourcePduHandleId=80, PduRSrcPduDirection=RECEIVE, PduRSrcPduRef=FSP1_Frame_L3_oLIN02_f47956e4_Rx, PduRSrcPduPduRBswModulesRef=LinIf
            FSP1_Frame_L3_oLIN02_f47956e4_Rx_65a06375_Rx (PduRDestPdu):
              PduRDestPduHandleId = 73
              PduRDestPduDirection = RECEIVE
              PduRDestPduRoutingType = API_FORWARDING
              PduRDestPduDataProcessing = IMMEDIATE
              PduRPduLengthHandlingStrategy = UNUSED
              PduRTransmissionConfirmation = false
              PduRDestPduRef = FSP1_Frame_L3_oLIN02_d22d1d82_Rx
              PduRDestPduPduRBswModulesRef = Com
          SRS_Cab_01P_oCabSubnet_81a51028_Rx: PduRRoutingPathCommunicationType=COMMUNICATION_INTERFACE
            SRS_Cab_01P_oCabSubnet_81a51028_Rx_b0d30411_Rx (PduRDestPdu):
              PduRDestPduHandleId = 122
              PduRDestPduDirection = RECEIVE
              PduRDestPduRoutingType = API_FORWARDING
              PduRDestPduDataProcessing = IMMEDIATE
              PduRPduLengthHandlingStrategy = UNUSED
              PduRTransmissionConfirmation = false
              PduRDestPduRef = SRS_Cab_01P_oCabSubnet_bd648bbe_Rx
              PduRDestPduPduRBswModulesRef = Com
            PduRSrcPdu_b0d30411 (PduRSrcPdu): PduRSourcePduHandleId=129, PduRSrcPduDirection=RECEIVE, PduRSrcPduRef=SRS_Cab_01P_oCabSubnet_81a51028_Rx, PduRSrcPduPduRBswModulesRef=CanIf
          SlaveResp_FSP4_L2_oLIN01_dbfd59db_Rx: PduRRoutingPathCommunicationType=TRANSPORT_PROTOCOL
            SlaveResp_FSP4_L2_oLIN01_dbfd59db_Rx_87b10390_Rx (PduRDestPdu):
              PduRDestPduHandleId = 35
              PduRDestPduDirection = RECEIVE
              PduRDestPduRoutingType = API_FORWARDING
              PduRDestPduDataProcessing = IMMEDIATE
              PduRPduLengthHandlingStrategy = UNUSED
              PduRDestPduRef = SlaveResp_FSP4_L2_oLIN01_ead4aaaf_Rx
              PduRDestPduPduRBswModulesRef = Cdd
            PduRSrcPdu_87b10390 (PduRSrcPdu): PduRSourcePduHandleId=80, PduRSrcPduDirection=RECEIVE, PduRSrcPduRef=SlaveResp_FSP4_L2_oLIN01_dbfd59db_Rx, PduRSrcPduPduRBswModulesRef=LinTp
          VI_X_CIOMFMS_oFMSNet_243f1e09_Tx: PduRRoutingPathCommunicationType=TRANSPORT_PROTOCOL
            VI_X_CIOMFMS_oFMSNet_55f8530d_Tx (PduRDestPdu):
              PduRDestPduHandleId = 97
              PduRDestPduDirection = TRANSMIT
              PduRDestPduRoutingType = API_FORWARDING
              PduRDestPduDataProcessing = IMMEDIATE
              PduRPduLengthHandlingStrategy = UNUSED
              PduRDestPduRef = VI_X_CIOMFMS_oFMSNet_55f8530d_Tx
              PduRDestPduPduRBswModulesRef = J1939Tp
            PduRSrcPdu_18bb5a35 (PduRSrcPdu): PduRSourcePduHandleId=179, PduRSrcPduDirection=TRANSMIT, PduRSrcPduRef=VI_X_CIOMFMS_oFMSNet_243f1e09_Tx, PduRSrcPduPduRBswModulesRef=Com
          MasterReq_ILCP2_oLIN03_4069fcbc_Tx: PduRRoutingPathCommunicationType=TRANSPORT_PROTOCOL
            MasterReq_ILCP2_oLIN03_cddbb9d5_Tx (PduRDestPdu):
              PduRDestPduHandleId = 68
              PduRDestPduDirection = TRANSMIT
              PduRDestPduRoutingType = API_FORWARDING
              PduRDestPduDataProcessing = IMMEDIATE
              PduRPduLengthHandlingStrategy = UNUSED
              PduRDestPduRef = MasterReq_ILCP2_oLIN03_cddbb9d5_Tx
              PduRDestPduPduRBswModulesRef = LinTp
            PduRSrcPdu_a3dfff04 (PduRSrcPdu): PduRSourcePduHandleId=161, PduRSrcPduDirection=TRANSMIT, PduRSrcPduRef=MasterReq_ILCP2_oLIN03_4069fcbc_Tx, PduRSrcPduPduRBswModulesRef=Cdd
          BBM_BB2_01P_oBackbone2_679bb0c1_Rx: PduRRoutingPathCommunicationType=COMMUNICATION_INTERFACE
            BBM_BB2_01P_oBackbone2_679bb0c1_Rx_4aacb8db_Rx (PduRDestPdu):
              PduRDestPduHandleId = 21
              PduRDestPduDirection = RECEIVE
              PduRDestPduRoutingType = API_FORWARDING
              PduRDestPduDataProcessing = IMMEDIATE
              PduRPduLengthHandlingStrategy = UNUSED
              PduRTransmissionConfirmation = false
              PduRDestPduRef = BBM_BB2_01P_oBackbone2_0d63adb7_Rx
              PduRDestPduPduRBswModulesRef = Com
            PduRSrcPdu_4aacb8db (PduRSrcPdu): PduRSourcePduHandleId=21, PduRSrcPduDirection=RECEIVE, PduRSrcPduRef=BBM_BB2_01P_oBackbone2_679bb0c1_Rx, PduRSrcPduPduRBswModulesRef=CanIf
          MasterReq_oLIN03_d322e1ab_Tx: PduRRoutingPathCommunicationType=TRANSPORT_PROTOCOL
            PduRSrcPdu_509ea690 (PduRSrcPdu): PduRSourcePduHandleId=169, PduRSrcPduDirection=TRANSMIT, PduRSrcPduRef=MasterReq_oLIN03_d322e1ab_Tx, PduRSrcPduPduRBswModulesRef=Cdd
            MasterReq_oLIN03_82f51b53_Tx (PduRDestPdu):
              PduRDestPduHandleId = 76
              PduRDestPduDirection = TRANSMIT
              PduRDestPduRoutingType = API_FORWARDING
              PduRDestPduDataProcessing = IMMEDIATE
              PduRPduLengthHandlingStrategy = UNUSED
              PduRDestPduRef = MasterReq_oLIN03_82f51b53_Tx
              PduRDestPduPduRBswModulesRef = LinTp
          FSP_1_2_Req_L4_oLIN03_b9af3ad0_Tx: PduRRoutingPathCommunicationType=COMMUNICATION_INTERFACE
            PduRSrcPdu_2e7a3026 (PduRSrcPdu): PduRSourcePduHandleId=139, PduRSrcPduDirection=TRANSMIT, PduRSrcPduRef=FSP_1_2_Req_L4_oLIN03_b9af3ad0_Tx, PduRSrcPduPduRBswModulesRef=Com
            FSP_1_2_Req_L4_oLIN03_943eb993_Tx (PduRDestPdu):
              PduRDestPduHandleId = 125
              PduRDestPduDirection = TRANSMIT
              PduRDestPduRoutingType = API_FORWARDING
              PduRDestPduDataProcessing = IMMEDIATE
              PduRPduLengthHandlingStrategy = UNUSED
              PduRDestPduDataProvision = PDUR_TRIGGERTRANSMIT
              PduRTransmissionConfirmation = false
              PduRDestPduRef = FSP_1_2_Req_L4_oLIN03_943eb993_Tx
              PduRDestPduPduRBswModulesRef = LinIf
          CIOM_Sec_10S_oSecuritySubnet_28eda7b9_Tx: PduRRoutingPathCommunicationType=TRANSPORT_PROTOCOL
            PduRSrcPdu_df90de79 (PduRSrcPdu): PduRSourcePduHandleId=77, PduRSrcPduDirection=TRANSMIT, PduRSrcPduRef=CIOM_Sec_10S_oSecuritySubnet_28eda7b9_Tx, PduRSrcPduPduRBswModulesRef=Com
            CIOM_Sec_10S_oSecuritySubnet_755f8851_Tx (PduRDestPdu):
              PduRDestPduHandleId = 17
              PduRDestPduDirection = TRANSMIT
              PduRDestPduRoutingType = API_FORWARDING
              PduRDestPduDataProcessing = IMMEDIATE
              PduRPduLengthHandlingStrategy = UNUSED
              PduRDestPduRef = CIOM_Sec_10S_oSecuritySubnet_755f8851_Tx
              PduRDestPduPduRBswModulesRef = CanTp
          EMS_BB2_05P_oBackbone2_3580e6cd_Rx: PduRRoutingPathCommunicationType=COMMUNICATION_INTERFACE
            EMS_BB2_05P_oBackbone2_3580e6cd_Rx_8f53c5a4_Rx (PduRDestPdu):
              PduRDestPduHandleId = 63
              PduRDestPduDirection = RECEIVE
              PduRDestPduRoutingType = API_FORWARDING
              PduRDestPduDataProcessing = IMMEDIATE
              PduRPduLengthHandlingStrategy = UNUSED
              PduRTransmissionConfirmation = false
              PduRDestPduRef = EMS_BB2_05P_oBackbone2_1d28960d_Rx
              PduRDestPduPduRBswModulesRef = Com
            PduRSrcPdu_8f53c5a4 (PduRSrcPdu): PduRSourcePduHandleId=70, PduRSrcPduDirection=RECEIVE, PduRSrcPduRef=EMS_BB2_05P_oBackbone2_3580e6cd_Rx, PduRSrcPduPduRBswModulesRef=CanIf
          Alarm_Sec_02P_oSecuritySubnet_0cca1998_Rx: PduRRoutingPathCommunicationType=COMMUNICATION_INTERFACE
            Alarm_Sec_02P_oSecuritySubnet_0cca1998_Rx_58f52ce6_Rx (PduRDestPdu):
              PduRDestPduHandleId = 3
              PduRDestPduDirection = RECEIVE
              PduRDestPduRoutingType = API_FORWARDING
              PduRDestPduDataProcessing = IMMEDIATE
              PduRPduLengthHandlingStrategy = UNUSED
              PduRTransmissionConfirmation = false
              PduRDestPduRef = Alarm_Sec_02P_oSecuritySubnet_c389f589_Rx
              PduRDestPduPduRBswModulesRef = Com
            PduRSrcPdu_58f52ce6 (PduRSrcPdu): PduRSourcePduHandleId=3, PduRSrcPduDirection=RECEIVE, PduRSrcPduRef=Alarm_Sec_02P_oSecuritySubnet_0cca1998_Rx, PduRSrcPduPduRBswModulesRef=CanIf
          CIOM_6a894124_Rx: PduRRoutingPathCommunicationType=TRANSPORT_PROTOCOL
            CIOM_ee2480d2_Tx (PduRDestPdu):
              PduRDestPduHandleId = 38
              PduRDestPduDirection = TRANSMIT
              PduRDestPduRoutingType = GATEWAY_ROUTING
              PduRDestPduDataProcessing = IMMEDIATE
              PduRPduLengthHandlingStrategy = UNUSED
              PduRDestPduQueueDepth = 4
              PduRTpThreshold = 1
              PduRDestPduRef = DiagRespMsgIntHMIIOM_F3_98_BB2_oBackbone2_e0a2024d_Tx
              PduRDestPduPduRBswModulesRef = CanTp
            PduRSrcPdu_c6acd63d (PduRSrcPdu):
              PduRSourcePduHandleId = 11
              PduRSrcPduDirection = RECEIVE
              PduRSrcPduRef = DiagRespMsgIntHMIIOM_F3_98_Cab_oCabSubnet_640fc3bb_Rx
              PduRSrcPduPduRBswModulesRef = CanTp
          SlaveResp_ELCP1_oLIN03_ecc8397c_Rx: PduRRoutingPathCommunicationType=TRANSPORT_PROTOCOL
            SlaveResp_ELCP1_oLIN03_ecc8397c_Rx_903f7ca8_Rx (PduRDestPdu):
              PduRDestPduHandleId = 24
              PduRDestPduDirection = RECEIVE
              PduRDestPduRoutingType = API_FORWARDING
              PduRDestPduDataProcessing = IMMEDIATE
              PduRPduLengthHandlingStrategy = UNUSED
              PduRDestPduRef = SlaveResp_ELCP1_oLIN03_8611f0b3_Rx
              PduRDestPduPduRBswModulesRef = Cdd
            PduRSrcPdu_903f7ca8 (PduRSrcPdu): PduRSourcePduHandleId=69, PduRSrcPduDirection=RECEIVE, PduRSrcPduRef=SlaveResp_ELCP1_oLIN03_ecc8397c_Rx, PduRSrcPduPduRBswModulesRef=LinTp
          MasterReq_ELCP2_oLIN03_4563b13d_Tx: PduRRoutingPathCommunicationType=TRANSPORT_PROTOCOL
            PduRSrcPdu_4290d944 (PduRSrcPdu): PduRSourcePduHandleId=149, PduRSrcPduDirection=TRANSMIT, PduRSrcPduRef=MasterReq_ELCP2_oLIN03_4563b13d_Tx, PduRSrcPduPduRBswModulesRef=Cdd
            MasterReq_ELCP2_oLIN03_6e18041a_Tx (PduRDestPdu):
              PduRDestPduHandleId = 56
              PduRDestPduDirection = TRANSMIT
              PduRDestPduRoutingType = API_FORWARDING
              PduRDestPduDataProcessing = IMMEDIATE
              PduRPduLengthHandlingStrategy = UNUSED
              PduRDestPduRef = MasterReq_ELCP2_oLIN03_6e18041a_Tx
              PduRDestPduPduRBswModulesRef = LinTp
          SRS_Cab_05P_oCabSubnet_f02f0a02_Rx: PduRRoutingPathCommunicationType=COMMUNICATION_INTERFACE
            PduRSrcPdu_6aca3982 (PduRSrcPdu): PduRSourcePduHandleId=132, PduRSrcPduDirection=RECEIVE, PduRSrcPduRef=SRS_Cab_05P_oCabSubnet_f02f0a02_Rx, PduRSrcPduPduRBswModulesRef=CanIf
            SRS_Cab_05P_oCabSubnet_f02f0a02_Rx_6aca3982_Rx (PduRDestPdu):
              PduRDestPduHandleId = 125
              PduRDestPduDirection = RECEIVE
              PduRDestPduRoutingType = API_FORWARDING
              PduRDestPduDataProcessing = IMMEDIATE
              PduRPduLengthHandlingStrategy = UNUSED
              PduRTransmissionConfirmation = false
              PduRDestPduRef = SRS_Cab_05P_oCabSubnet_7ddde128_Rx
              PduRDestPduPduRBswModulesRef = Com
          CIOM_d87e638d_Rx: PduRRoutingPathCommunicationType=TRANSPORT_PROTOCOL
            CIOM_5cd3a27b_Tx (PduRDestPdu):
              PduRDestPduHandleId = 43
              PduRDestPduDirection = TRANSMIT
              PduRDestPduRoutingType = GATEWAY_ROUTING
              PduRDestPduDataProcessing = IMMEDIATE
              PduRPduLengthHandlingStrategy = UNUSED
              PduRDestPduQueueDepth = 4
              PduRTpThreshold = 1
              PduRDestPduRef = DiagRespMsgIntTGW2_F4_26_BB2_oBackbone2_3e65a881_Tx
              PduRDestPduPduRBswModulesRef = CanTp
            PduRSrcPdu_25a59123 (PduRSrcPdu):
              PduRSourcePduHandleId = 48
              PduRSrcPduDirection = RECEIVE
              PduRSrcPduRef = DiagRespMsgIntTGW2_F4_26_Cab_oCabSubnet_bac86977_Rx
              PduRSrcPduPduRBswModulesRef = CanTp
          AnmMsg_WRCS_CabSubnet_oCabSubnet_dea22ca5_Rx: PduRRoutingPathCommunicationType=COMMUNICATION_INTERFACE
            PduRSrcPdu_f9521ac4 (PduRSrcPdu):
              PduRSourcePduHandleId = 20
              PduRSrcPduDirection = RECEIVE
              PduRSrcPduRef = AnmMsg_WRCS_CabSubnet_oCabSubnet_dea22ca5_Rx
              PduRSrcPduPduRBswModulesRef = CanIf
            AnmMsg_WRCS_CabSubnet_oCabSubnet_dea22ca5_Rx_f9521ac4_Rx (PduRDestPdu):
              PduRDestPduHandleId = 20
              PduRDestPduDirection = RECEIVE
              PduRDestPduRoutingType = API_FORWARDING
              PduRDestPduDataProcessing = IMMEDIATE
              PduRPduLengthHandlingStrategy = UNUSED
              PduRTransmissionConfirmation = false
              PduRDestPduRef = AnmMsg_WRCS_CabSubnet_oCabSubnet_fa464471_Rx
              PduRDestPduPduRBswModulesRef = Com
          CIOM_Sec_08S_oSecuritySubnet_e85e89ed_Tx: PduRRoutingPathCommunicationType=TRANSPORT_PROTOCOL
            CIOM_Sec_08S_oSecuritySubnet_3bd74a1d_Tx (PduRDestPdu):
              PduRDestPduHandleId = 15
              PduRDestPduDirection = TRANSMIT
              PduRDestPduRoutingType = API_FORWARDING
              PduRDestPduDataProcessing = IMMEDIATE
              PduRPduLengthHandlingStrategy = UNUSED
              PduRDestPduRef = CIOM_Sec_08S_oSecuritySubnet_3bd74a1d_Tx
              PduRDestPduPduRBswModulesRef = CanTp
            PduRSrcPdu_017c679d (PduRSrcPdu): PduRSourcePduHandleId=75, PduRSrcPduDirection=TRANSMIT, PduRSrcPduRef=CIOM_Sec_08S_oSecuritySubnet_e85e89ed_Tx, PduRSrcPduPduRBswModulesRef=Com
          CIOM_Sec_12S_oSecuritySubnet_2d39cc3a_Tx: PduRRoutingPathCommunicationType=TRANSPORT_PROTOCOL
            CIOM_Sec_12S_oSecuritySubnet_ec5d87cc_Tx (PduRDestPdu):
              PduRDestPduHandleId = 19
              PduRDestPduDirection = TRANSMIT
              PduRDestPduRoutingType = API_FORWARDING
              PduRDestPduDataProcessing = IMMEDIATE
              PduRPduLengthHandlingStrategy = UNUSED
              PduRDestPduRef = CIOM_Sec_12S_oSecuritySubnet_ec5d87cc_Tx
              PduRDestPduPduRBswModulesRef = CanTp
            PduRSrcPdu_c0583aba (PduRSrcPdu): PduRSourcePduHandleId=79, PduRSrcPduDirection=TRANSMIT, PduRSrcPduRef=CIOM_Sec_12S_oSecuritySubnet_2d39cc3a_Tx, PduRSrcPduPduRBswModulesRef=Com
          CIOM_245ee996_Rx: PduRRoutingPathCommunicationType=TRANSPORT_PROTOCOL
            CIOM_1f5874a4_Tx (PduRDestPdu):
              PduRDestPduHandleId = 92
              PduRDestPduDirection = TRANSMIT
              PduRDestPduRoutingType = GATEWAY_ROUTING
              PduRDestPduDataProcessing = IMMEDIATE
              PduRPduLengthHandlingStrategy = UNUSED
              PduRDestPduQueueDepth = 4
              PduRTpThreshold = 1
              PduRDestPduRef = PhysDiagRespMsg_F2_A1_BB2_oBackbone2_b71f936a_Tx
              PduRDestPduPduRBswModulesRef = CanTp
            PduRSrcPdu_6ea67099 (PduRSrcPdu):
              PduRSourcePduHandleId = 24
              PduRSrcPduDirection = RECEIVE
              PduRSrcPduRef = PhysDiagRespMsg_F2_A1_Sec_oSecuritySubnet_4b636d5b_Rx
              PduRSrcPduPduRBswModulesRef = CanTp
          Alarm_Sec_06S_oSecuritySubnet_06f6b741_Rx: PduRRoutingPathCommunicationType=TRANSPORT_PROTOCOL
            Alarm_Sec_06S_oSecuritySubnet_06f6b741_Rx_eb982057_Rx (PduRDestPdu):
              PduRDestPduHandleId = 1
              PduRDestPduDirection = RECEIVE
              PduRDestPduRoutingType = API_FORWARDING
              PduRDestPduDataProcessing = IMMEDIATE
              PduRPduLengthHandlingStrategy = UNUSED
              PduRDestPduRef = Alarm_Sec_06S_oSecuritySubnet_9bbb790b_Rx
              PduRDestPduPduRBswModulesRef = Com
            PduRSrcPdu_eb982057 (PduRSrcPdu): PduRSourcePduHandleId=1, PduRSrcPduDirection=RECEIVE, PduRSrcPduRef=Alarm_Sec_06S_oSecuritySubnet_06f6b741_Rx, PduRSrcPduPduRBswModulesRef=CanTp
          VMCU_BB2_03P_oBackbone2_e76b72ec_Rx: PduRRoutingPathCommunicationType=COMMUNICATION_INTERFACE
            PduRSrcPdu_c5e31929 (PduRSrcPdu): PduRSourcePduHandleId=145, PduRSrcPduDirection=RECEIVE, PduRSrcPduRef=VMCU_BB2_03P_oBackbone2_e76b72ec_Rx, PduRSrcPduPduRBswModulesRef=CanIf
            VMCU_BB2_03P_oBackbone2_e76b72ec_Rx_c5e31929_Rx (PduRDestPdu):
              PduRDestPduHandleId = 138
              PduRDestPduDirection = RECEIVE
              PduRDestPduRoutingType = API_FORWARDING
              PduRDestPduDataProcessing = IMMEDIATE
              PduRPduLengthHandlingStrategy = UNUSED
              PduRTransmissionConfirmation = false
              PduRDestPduRef = VMCU_BB2_03P_oBackbone2_ea826e81_Rx
              PduRDestPduPduRBswModulesRef = Com
          CIOM_BB2_11P_oBackbone2_9b3b14ed_Tx: PduRRoutingPathCommunicationType=COMMUNICATION_INTERFACE
            CIOM_BB2_11P_oBackbone2_24056f4a_Tx (PduRDestPdu):
              PduRDestPduHandleId = 23
              PduRDestPduDirection = TRANSMIT
              PduRDestPduRoutingType = API_FORWARDING
              PduRDestPduDataProcessing = IMMEDIATE
              PduRPduLengthHandlingStrategy = UNUSED
              PduRDestPduDataProvision = PDUR_DIRECT
              PduRTransmissionConfirmation = false
              PduRDestPduRef = CIOM_BB2_11P_oBackbone2_24056f4a_Tx
              PduRDestPduPduRBswModulesRef = CanIf
            PduRSrcPdu_78074b0a (PduRSrcPdu): PduRSourcePduHandleId=21, PduRSrcPduDirection=TRANSMIT, PduRSrcPduRef=CIOM_BB2_11P_oBackbone2_9b3b14ed_Tx, PduRSrcPduPduRBswModulesRef=Com
          CIOM_de91698d_Rx: PduRRoutingPathCommunicationType=COMMUNICATION_INTERFACE
            CIOM_f237b6db_Tx (PduRDestPdu):
              PduRDestPduHandleId = 110
              PduRDestPduDirection = TRANSMIT
              PduRDestPduRoutingType = GATEWAY_ROUTING
              PduRDestPduDataProcessing = IMMEDIATE
              PduRPduLengthHandlingStrategy = UNUSED
              PduRDestPduDataProvision = PDUR_DIRECT
              PduRTransmissionConfirmation = false
              PduRDestPduRef = DiagUUDTRespMsg1_F2_A0_BB2_oBackbone2_8e431e8b_Tx
              PduRDestPduPduRBswModulesRef = CanIf
            PduRSrcPdu_d17a9913 (PduRSrcPdu):
              PduRSourcePduHandleId = 37
              PduRSrcPduDirection = RECEIVE
              PduRSrcPduRef = DiagUUDTRespMsg1_F2_A0_Sec_oSecuritySubnet_3b2bea04_Rx
              PduRSrcPduPduRBswModulesRef = CanIf
          SlaveResp_TCP_oLIN02_cb8ee454_Rx: PduRRoutingPathCommunicationType=TRANSPORT_PROTOCOL
            SlaveResp_TCP_oLIN02_cb8ee454_Rx_68bca152_Rx (PduRDestPdu):
              PduRDestPduHandleId = 41
              PduRDestPduDirection = RECEIVE
              PduRDestPduRoutingType = API_FORWARDING
              PduRDestPduDataProcessing = IMMEDIATE
              PduRPduLengthHandlingStrategy = UNUSED
              PduRDestPduRef = SlaveResp_TCP_oLIN02_b3851a34_Rx
              PduRDestPduPduRBswModulesRef = Cdd
            PduRSrcPdu_68bca152 (PduRSrcPdu): PduRSourcePduHandleId=86, PduRSrcPduDirection=RECEIVE, PduRSrcPduRef=SlaveResp_TCP_oLIN02_cb8ee454_Rx, PduRSrcPduPduRBswModulesRef=LinTp
          CIOM_Cab_17P_oCabSubnet_87dc3116_Tx: PduRRoutingPathCommunicationType=COMMUNICATION_INTERFACE
            CIOM_Cab_17P_oCabSubnet_9b5fb4f1_Tx (PduRDestPdu):
              PduRDestPduHandleId = 45
              PduRDestPduDirection = TRANSMIT
              PduRDestPduRoutingType = API_FORWARDING
              PduRDestPduDataProcessing = IMMEDIATE
              PduRPduLengthHandlingStrategy = UNUSED
              PduRDestPduDataProvision = PDUR_DIRECT
              PduRTransmissionConfirmation = false
              PduRDestPduRef = CIOM_Cab_17P_oCabSubnet_9b5fb4f1_Tx
              PduRDestPduPduRBswModulesRef = CanIf
            PduRSrcPdu_0af615bd (PduRSrcPdu): PduRSourcePduHandleId=50, PduRSrcPduDirection=TRANSMIT, PduRSrcPduRef=CIOM_Cab_17P_oCabSubnet_87dc3116_Tx, PduRSrcPduPduRBswModulesRef=Com
          SlaveResp_CCFW_oLIN03_1d1ae08e_Rx: PduRRoutingPathCommunicationType=TRANSPORT_PROTOCOL
            SlaveResp_CCFW_oLIN03_1d1ae08e_Rx_5b587d0d_Rx (PduRDestPdu):
              PduRDestPduHandleId = 22
              PduRDestPduDirection = RECEIVE
              PduRDestPduRoutingType = API_FORWARDING
              PduRDestPduDataProcessing = IMMEDIATE
              PduRPduLengthHandlingStrategy = UNUSED
              PduRDestPduRef = SlaveResp_CCFW_oLIN03_d7124ce9_Rx
              PduRDestPduPduRBswModulesRef = Cdd
            PduRSrcPdu_5b587d0d (PduRSrcPdu): PduRSourcePduHandleId=67, PduRSrcPduDirection=RECEIVE, PduRSrcPduRef=SlaveResp_CCFW_oLIN03_1d1ae08e_Rx, PduRSrcPduPduRBswModulesRef=LinTp
          AnmMsg_ECUspare5_SecuritySubnet_oSecuritySubnet_40a00d45_Rx: PduRRoutingPathCommunicationType=COMMUNICATION_INTERFACE
            PduRSrcPdu_42489524 (PduRSrcPdu):
              PduRSourcePduHandleId = 11
              PduRSrcPduDirection = RECEIVE
              PduRSrcPduRef = AnmMsg_ECUspare5_SecuritySubnet_oSecuritySubnet_40a00d45_Rx
              PduRSrcPduPduRBswModulesRef = CanIf
            AnmMsg_ECUspare5_SecuritySubnet_oSecuritySubnet_40a00d45_Rx_42489524_Rx (PduRDestPdu):
              PduRDestPduHandleId = 11
              PduRDestPduDirection = RECEIVE
              PduRDestPduRoutingType = API_FORWARDING
              PduRDestPduDataProcessing = IMMEDIATE
              PduRPduLengthHandlingStrategy = UNUSED
              PduRTransmissionConfirmation = false
              PduRDestPduRef = AnmMsg_ECUspare5_SecuritySubnet_oSecuritySubnet_44137fdb_Rx
              PduRDestPduPduRBswModulesRef = Com
          ELCP1toCIOM_L4_oLIN03_be1ef9f9_Rx: PduRRoutingPathCommunicationType=COMMUNICATION_INTERFACE
            PduRSrcPdu_b63a736f (PduRSrcPdu): PduRSourcePduHandleId=66, PduRSrcPduDirection=RECEIVE, PduRSrcPduRef=ELCP1toCIOM_L4_oLIN03_be1ef9f9_Rx, PduRSrcPduPduRBswModulesRef=LinIf
            ELCP1toCIOM_L4_oLIN03_be1ef9f9_Rx_b63a736f_Rx (PduRDestPdu):
              PduRDestPduHandleId = 59
              PduRDestPduDirection = RECEIVE
              PduRDestPduRoutingType = API_FORWARDING
              PduRDestPduDataProcessing = IMMEDIATE
              PduRPduLengthHandlingStrategy = UNUSED
              PduRTransmissionConfirmation = false
              PduRDestPduRef = ELCP1toCIOM_L4_oLIN03_e80fe278_Rx
              PduRDestPduPduRBswModulesRef = Com
          CIOM_Cab_32P_oCabSubnet_7b9d46a8_Tx: PduRRoutingPathCommunicationType=COMMUNICATION_INTERFACE
            PduRSrcPdu_04f9241b (PduRSrcPdu): PduRSourcePduHandleId=65, PduRSrcPduDirection=TRANSMIT, PduRSrcPduRef=CIOM_Cab_32P_oCabSubnet_7b9d46a8_Tx, PduRSrcPduPduRBswModulesRef=Com
            CIOM_Cab_32P_oCabSubnet_76ea8a97_Tx (PduRDestPdu):
              PduRDestPduHandleId = 56
              PduRDestPduDirection = TRANSMIT
              PduRDestPduRoutingType = API_FORWARDING
              PduRDestPduDataProcessing = IMMEDIATE
              PduRPduLengthHandlingStrategy = UNUSED
              PduRDestPduDataProvision = PDUR_DIRECT
              PduRTransmissionConfirmation = false
              PduRDestPduRef = CIOM_Cab_32P_oCabSubnet_76ea8a97_Tx
              PduRDestPduPduRBswModulesRef = CanIf
          CVW_X_CIOMFMS_oFMSNet_f228048c_Tx: PduRRoutingPathCommunicationType=COMMUNICATION_INTERFACE
            PduRSrcPdu_3fb3dd7e (PduRSrcPdu): PduRSourcePduHandleId=88, PduRSrcPduDirection=TRANSMIT, PduRSrcPduRef=CVW_X_CIOMFMS_oFMSNet_f228048c_Tx, PduRSrcPduPduRBswModulesRef=Com
            CVW_X_CIOMFMS_oFMSNet_5a4bdaa1_Tx (PduRDestPdu):
              PduRDestPduHandleId = 70
              PduRDestPduDirection = TRANSMIT
              PduRDestPduRoutingType = API_FORWARDING
              PduRDestPduDataProcessing = IMMEDIATE
              PduRPduLengthHandlingStrategy = UNUSED
              PduRDestPduDataProvision = PDUR_DIRECT
              PduRTransmissionConfirmation = false
              PduRDestPduRef = CVW_X_CIOMFMS_oFMSNet_5a4bdaa1_Tx
              PduRDestPduPduRBswModulesRef = CanIf
          MasterReq_ELCP1_oLIN03_cbecb6de_Tx: PduRRoutingPathCommunicationType=TRANSPORT_PROTOCOL
            PduRSrcPdu_d6070b6b (PduRSrcPdu): PduRSourcePduHandleId=148, PduRSrcPduDirection=TRANSMIT, PduRSrcPduRef=MasterReq_ELCP1_oLIN03_cbecb6de_Tx, PduRSrcPduPduRBswModulesRef=Cdd
            MasterReq_ELCP1_oLIN03_18fd3d27_Tx (PduRDestPdu):
              PduRDestPduHandleId = 55
              PduRDestPduDirection = TRANSMIT
              PduRDestPduRoutingType = API_FORWARDING
              PduRDestPduDataProcessing = IMMEDIATE
              PduRPduLengthHandlingStrategy = UNUSED
              PduRDestPduRef = MasterReq_ELCP1_oLIN03_18fd3d27_Tx
              PduRDestPduPduRBswModulesRef = LinTp
          VP236_X_CIOMFMS_oFMSNet_b08a3073_Tx: PduRRoutingPathCommunicationType=COMMUNICATION_INTERFACE
            VP236_X_CIOMFMS_oFMSNet_634950b3_Tx (PduRDestPdu):
              PduRDestPduHandleId = 137
              PduRDestPduDirection = TRANSMIT
              PduRDestPduRoutingType = API_FORWARDING
              PduRDestPduDataProcessing = IMMEDIATE
              PduRPduLengthHandlingStrategy = UNUSED
              PduRDestPduDataProvision = PDUR_DIRECT
              PduRTransmissionConfirmation = false
              PduRDestPduRef = VP236_X_CIOMFMS_oFMSNet_634950b3_Tx
              PduRDestPduPduRBswModulesRef = CanIf
            PduRSrcPdu_589f7780 (PduRSrcPdu): PduRSourcePduHandleId=180, PduRSrcPduDirection=TRANSMIT, PduRSrcPduRef=VP236_X_CIOMFMS_oFMSNet_b08a3073_Tx, PduRSrcPduPduRBswModulesRef=Com
          SRS_Cab_04P_oCabSubnet_01f50fa8_Rx: PduRRoutingPathCommunicationType=COMMUNICATION_INTERFACE
            PduRSrcPdu_3354072d (PduRSrcPdu): PduRSourcePduHandleId=131, PduRSrcPduDirection=RECEIVE, PduRSrcPduRef=SRS_Cab_04P_oCabSubnet_01f50fa8_Rx, PduRSrcPduPduRBswModulesRef=CanIf
            SRS_Cab_04P_oCabSubnet_01f50fa8_Rx_3354072d_Rx (PduRDestPdu):
              PduRDestPduHandleId = 124
              PduRDestPduDirection = RECEIVE
              PduRDestPduRoutingType = API_FORWARDING
              PduRDestPduDataProcessing = IMMEDIATE
              PduRPduLengthHandlingStrategy = UNUSED
              PduRTransmissionConfirmation = false
              PduRDestPduRef = SRS_Cab_04P_oCabSubnet_a04b38ad_Rx
              PduRDestPduPduRBswModulesRef = Com
          VMCU_BB2_01P_oBackbone2_dfae7ff9_Rx: PduRRoutingPathCommunicationType=COMMUNICATION_INTERFACE
            VMCU_BB2_01P_oBackbone2_dfae7ff9_Rx_aa24f793_Rx (PduRDestPdu):
              PduRDestPduHandleId = 136
              PduRDestPduDirection = RECEIVE
              PduRDestPduRoutingType = API_FORWARDING
              PduRDestPduDataProcessing = IMMEDIATE
              PduRPduLengthHandlingStrategy = UNUSED
              PduRTransmissionConfirmation = false
              PduRDestPduRef = VMCU_BB2_01P_oBackbone2_8adedbca_Rx
              PduRDestPduPduRBswModulesRef = Com
            PduRSrcPdu_aa24f793 (PduRSrcPdu): PduRSourcePduHandleId=143, PduRSrcPduDirection=RECEIVE, PduRSrcPduRef=VMCU_BB2_01P_oBackbone2_dfae7ff9_Rx, PduRSrcPduPduRBswModulesRef=CanIf
          CIOM_Cab_22P_oCabSubnet_e692a7de_Tx: PduRRoutingPathCommunicationType=COMMUNICATION_INTERFACE
            CIOM_Cab_22P_oCabSubnet_40181a64_Tx (PduRDestPdu):
              PduRDestPduHandleId = 49
              PduRDestPduDirection = TRANSMIT
              PduRDestPduRoutingType = API_FORWARDING
              PduRDestPduDataProcessing = IMMEDIATE
              PduRPduLengthHandlingStrategy = UNUSED
              PduRDestPduDataProvision = PDUR_DIRECT
              PduRTransmissionConfirmation = false
              PduRDestPduRef = CIOM_Cab_22P_oCabSubnet_40181a64_Tx
              PduRDestPduPduRBswModulesRef = CanIf
            PduRSrcPdu_abb677a0 (PduRSrcPdu): PduRSourcePduHandleId=55, PduRSrcPduDirection=TRANSMIT, PduRSrcPduRef=CIOM_Cab_22P_oCabSubnet_e692a7de_Tx, PduRSrcPduPduRBswModulesRef=Com
          SlaveResp_FSP1_L5_oLIN04_6afed8a5_Rx: PduRRoutingPathCommunicationType=TRANSPORT_PROTOCOL
            PduRSrcPdu_377e0be2 (PduRSrcPdu): PduRSourcePduHandleId=75, PduRSrcPduDirection=RECEIVE, PduRSrcPduRef=SlaveResp_FSP1_L5_oLIN04_6afed8a5_Rx, PduRSrcPduPduRBswModulesRef=LinTp
            SlaveResp_FSP1_L5_oLIN04_6afed8a5_Rx_377e0be2_Rx (PduRDestPdu):
              PduRDestPduHandleId = 30
              PduRDestPduDirection = RECEIVE
              PduRDestPduRoutingType = API_FORWARDING
              PduRDestPduDataProcessing = IMMEDIATE
              PduRPduLengthHandlingStrategy = UNUSED
              PduRDestPduRef = SlaveResp_FSP1_L5_oLIN04_e12cfb7b_Rx
              PduRDestPduPduRBswModulesRef = Cdd
          DD_X_CIOMFMS_oFMSNet_391c539f_Tx: PduRRoutingPathCommunicationType=COMMUNICATION_INTERFACE
            DD_X_CIOMFMS_oFMSNet_c8687b55_Tx (PduRDestPdu):
              PduRDestPduHandleId = 71
              PduRDestPduDirection = TRANSMIT
              PduRDestPduRoutingType = API_FORWARDING
              PduRDestPduDataProcessing = IMMEDIATE
              PduRPduLengthHandlingStrategy = UNUSED
              PduRTransmissionConfirmation = false
              PduRDestPduDataProvision = PDUR_DIRECT
              PduRDestPduRef = DD_X_CIOMFMS_oFMSNet_c8687b55_Tx
              PduRDestPduPduRBswModulesRef = CanIf
            PduRSrcPdu_9de0f43a (PduRSrcPdu): PduRSourcePduHandleId=89, PduRSrcPduDirection=TRANSMIT, PduRSrcPduRef=DD_X_CIOMFMS_oFMSNet_391c539f_Tx, PduRSrcPduPduRBswModulesRef=Com
          HMIIOM_BB2_07P_oBackbone2_43ce6e92_Rx: PduRRoutingPathCommunicationType=COMMUNICATION_INTERFACE
            HMIIOM_BB2_07P_oBackbone2_43ce6e92_Rx_81d2b46b_Rx (PduRDestPdu):
              PduRDestPduHandleId = 93
              PduRDestPduDirection = RECEIVE
              PduRDestPduRoutingType = API_FORWARDING
              PduRDestPduDataProcessing = IMMEDIATE
              PduRPduLengthHandlingStrategy = UNUSED
              PduRTransmissionConfirmation = false
              PduRDestPduRef = HMIIOM_BB2_07P_oBackbone2_cb69452b_Rx
              PduRDestPduPduRBswModulesRef = Com
            PduRSrcPdu_81d2b46b (PduRSrcPdu): PduRSourcePduHandleId=100, PduRSrcPduDirection=RECEIVE, PduRSrcPduRef=HMIIOM_BB2_07P_oBackbone2_43ce6e92_Rx, PduRSrcPduPduRBswModulesRef=CanIf
          LECM1_Cab_04P_oCabSubnet_324a8202_Rx: PduRRoutingPathCommunicationType=COMMUNICATION_INTERFACE
            LECM1_Cab_04P_oCabSubnet_324a8202_Rx_406dd4e6_Rx (PduRDestPdu):
              PduRDestPduHandleId = 111
              PduRDestPduDirection = RECEIVE
              PduRDestPduRoutingType = API_FORWARDING
              PduRDestPduDataProcessing = IMMEDIATE
              PduRPduLengthHandlingStrategy = UNUSED
              PduRTransmissionConfirmation = false
              PduRDestPduRef = LECM1_Cab_04P_oCabSubnet_70a0dd53_Rx
              PduRDestPduPduRBswModulesRef = Com
            PduRSrcPdu_406dd4e6 (PduRSrcPdu): PduRSourcePduHandleId=118, PduRSrcPduDirection=RECEIVE, PduRSrcPduRef=LECM1_Cab_04P_oCabSubnet_324a8202_Rx, PduRSrcPduPduRBswModulesRef=CanIf
          AnmMsg_SRS_CabSubnet_oCabSubnet_5d05fd8e_Rx: PduRRoutingPathCommunicationType=COMMUNICATION_INTERFACE
            PduRSrcPdu_b4c75839 (PduRSrcPdu):
              PduRSourcePduHandleId = 17
              PduRSrcPduDirection = RECEIVE
              PduRSrcPduRef = AnmMsg_SRS_CabSubnet_oCabSubnet_5d05fd8e_Rx
              PduRSrcPduPduRBswModulesRef = CanIf
            AnmMsg_SRS_CabSubnet_oCabSubnet_5d05fd8e_Rx_b4c75839_Rx (PduRDestPdu):
              PduRDestPduHandleId = 17
              PduRDestPduDirection = RECEIVE
              PduRDestPduRoutingType = API_FORWARDING
              PduRDestPduDataProcessing = IMMEDIATE
              PduRPduLengthHandlingStrategy = UNUSED
              PduRTransmissionConfirmation = false
              PduRDestPduRef = AnmMsg_SRS_CabSubnet_oCabSubnet_aab008be_Rx
              PduRDestPduPduRBswModulesRef = Com
          CIOM_785bf6fc_Rx: PduRRoutingPathCommunicationType=TRANSPORT_PROTOCOL
            CIOM_2156cc07_Tx (PduRDestPdu):
              PduRDestPduHandleId = 94
              PduRDestPduDirection = TRANSMIT
              PduRDestPduRoutingType = GATEWAY_ROUTING
              PduRDestPduDataProcessing = IMMEDIATE
              PduRPduLengthHandlingStrategy = UNUSED
              PduRDestPduQueueDepth = 4
              PduRTpThreshold = 1
              PduRDestPduRef = PhysDiagRespMsg_F2_C0_BB2_oBackbone2_89112bc9_Tx
              PduRDestPduPduRBswModulesRef = CanTp
            PduRSrcPdu_89263a8e (PduRSrcPdu):
              PduRSourcePduHandleId = 27
              PduRSrcPduDirection = RECEIVE
              PduRSrcPduRef = PhysDiagRespMsg_F2_C0_Sec_oSecuritySubnet_17667231_Rx
              PduRSrcPduPduRBswModulesRef = CanTp
          CIOM_Sec_01P_oSecuritySubnet_43c7ca84_Tx: PduRRoutingPathCommunicationType=COMMUNICATION_INTERFACE
            PduRSrcPdu_3d78f7a3 (PduRSrcPdu): PduRSourcePduHandleId=68, PduRSrcPduDirection=TRANSMIT, PduRSrcPduRef=CIOM_Sec_01P_oSecuritySubnet_43c7ca84_Tx, PduRSrcPduPduRBswModulesRef=Com
            CIOM_Sec_01P_oSecuritySubnet_703c4de6_Tx (PduRDestPdu):
              PduRDestPduHandleId = 58
              PduRDestPduDirection = TRANSMIT
              PduRDestPduRoutingType = API_FORWARDING
              PduRDestPduDataProcessing = IMMEDIATE
              PduRPduLengthHandlingStrategy = UNUSED
              PduRDestPduDataProvision = PDUR_DIRECT
              PduRTransmissionConfirmation = false
              PduRDestPduRef = CIOM_Sec_01P_oSecuritySubnet_703c4de6_Tx
              PduRDestPduPduRBswModulesRef = CanIf
          AnmMsg_ECUspare2_Backbone2_oBackbone2_e3b7a645_Rx: PduRRoutingPathCommunicationType=COMMUNICATION_INTERFACE
            AnmMsg_ECUspare2_Backbone2_oBackbone2_e3b7a645_Rx_52e2e014_Rx (PduRDestPdu):
              PduRDestPduHandleId = 10
              PduRDestPduDirection = RECEIVE
              PduRDestPduRoutingType = API_FORWARDING
              PduRDestPduDataProcessing = IMMEDIATE
              PduRPduLengthHandlingStrategy = UNUSED
              PduRTransmissionConfirmation = false
              PduRDestPduRef = AnmMsg_ECUspare2_Backbone2_oBackbone2_a98084aa_Rx
              PduRDestPduPduRBswModulesRef = Com
            PduRSrcPdu_52e2e014 (PduRSrcPdu):
              PduRSourcePduHandleId = 10
              PduRSrcPduDirection = RECEIVE
              PduRSrcPduRef = AnmMsg_ECUspare2_Backbone2_oBackbone2_e3b7a645_Rx
              PduRSrcPduPduRBswModulesRef = CanIf
          CIOM_Cab_16P_oCabSubnet_5a4ae893_Tx: PduRRoutingPathCommunicationType=COMMUNICATION_INTERFACE
            PduRSrcPdu_80304e06 (PduRSrcPdu): PduRSourcePduHandleId=49, PduRSrcPduDirection=TRANSMIT, PduRSrcPduRef=CIOM_Cab_16P_oCabSubnet_5a4ae893_Tx, PduRSrcPduPduRBswModulesRef=Com
            CIOM_Cab_16P_oCabSubnet_6a85b15b_Tx (PduRDestPdu):
              PduRDestPduHandleId = 44
              PduRDestPduDirection = TRANSMIT
              PduRDestPduRoutingType = API_FORWARDING
              PduRDestPduDataProcessing = IMMEDIATE
              PduRPduLengthHandlingStrategy = UNUSED
              PduRDestPduDataProvision = PDUR_DIRECT
              PduRTransmissionConfirmation = false
              PduRDestPduRef = CIOM_Cab_16P_oCabSubnet_6a85b15b_Tx
              PduRDestPduPduRBswModulesRef = CanIf
          CCM_Cab_07P_oCabSubnet_9f92699c_Rx: PduRRoutingPathCommunicationType=COMMUNICATION_INTERFACE
            PduRSrcPdu_76f8d1a5 (PduRSrcPdu): PduRSourcePduHandleId=28, PduRSrcPduDirection=RECEIVE, PduRSrcPduRef=CCM_Cab_07P_oCabSubnet_9f92699c_Rx, PduRSrcPduPduRBswModulesRef=CanIf
            CCM_Cab_07P_oCabSubnet_9f92699c_Rx_76f8d1a5_Rx (PduRDestPdu):
              PduRDestPduHandleId = 28
              PduRDestPduDirection = RECEIVE
              PduRDestPduRoutingType = API_FORWARDING
              PduRDestPduDataProcessing = IMMEDIATE
              PduRPduLengthHandlingStrategy = UNUSED
              PduRTransmissionConfirmation = false
              PduRDestPduRef = CCM_Cab_07P_oCabSubnet_99766f12_Rx
              PduRDestPduPduRBswModulesRef = Com
          SlaveResp_RCECS_oLIN04_28099311_Rx: PduRRoutingPathCommunicationType=TRANSPORT_PROTOCOL
            PduRSrcPdu_0e5523b8 (PduRSrcPdu): PduRSourcePduHandleId=85, PduRSrcPduDirection=RECEIVE, PduRSrcPduRef=SlaveResp_RCECS_oLIN04_28099311_Rx, PduRSrcPduPduRBswModulesRef=LinTp
            SlaveResp_RCECS_oLIN04_28099311_Rx_0e5523b8_Rx (PduRDestPdu):
              PduRDestPduHandleId = 40
              PduRDestPduDirection = RECEIVE
              PduRDestPduRoutingType = API_FORWARDING
              PduRDestPduDataProcessing = IMMEDIATE
              PduRPduLengthHandlingStrategy = UNUSED
              PduRDestPduRef = SlaveResp_RCECS_oLIN04_f9903c90_Rx
              PduRDestPduPduRBswModulesRef = Cdd
          PDM_Sec_03S_oSecuritySubnet_236a0e23_Rx: PduRRoutingPathCommunicationType=TRANSPORT_PROTOCOL
            PduRSrcPdu_c4655c6f (PduRSrcPdu): PduRSourcePduHandleId=63, PduRSrcPduDirection=RECEIVE, PduRSrcPduRef=PDM_Sec_03S_oSecuritySubnet_236a0e23_Rx, PduRSrcPduPduRBswModulesRef=CanTp
            PDM_Sec_03S_oSecuritySubnet_236a0e23_Rx_c4655c6f_Rx (PduRDestPdu):
              PduRDestPduHandleId = 18
              PduRDestPduDirection = RECEIVE
              PduRDestPduRoutingType = API_FORWARDING
              PduRDestPduDataProcessing = IMMEDIATE
              PduRPduLengthHandlingStrategy = UNUSED
              PduRDestPduRef = PDM_Sec_03S_oSecuritySubnet_29b4be53_Rx
              PduRDestPduPduRBswModulesRef = Com
          FSP1_Frame_L4_oLIN03_5baf6f4d_Rx: PduRRoutingPathCommunicationType=COMMUNICATION_INTERFACE
            FSP1_Frame_L4_oLIN03_5baf6f4d_Rx_7272736c_Rx (PduRDestPdu):
              PduRDestPduHandleId = 74
              PduRDestPduDirection = RECEIVE
              PduRDestPduRoutingType = API_FORWARDING
              PduRDestPduDataProcessing = IMMEDIATE
              PduRPduLengthHandlingStrategy = UNUSED
              PduRTransmissionConfirmation = false
              PduRDestPduRef = FSP1_Frame_L4_oLIN03_afef240d_Rx
              PduRDestPduPduRBswModulesRef = Com
            PduRSrcPdu_7272736c (PduRSrcPdu): PduRSourcePduHandleId=81, PduRSrcPduDirection=RECEIVE, PduRSrcPduRef=FSP1_Frame_L4_oLIN03_5baf6f4d_Rx, PduRSrcPduPduRBswModulesRef=LinIf
          TECU_BB2_06S_oBackbone2_c069c78e_Rx: PduRRoutingPathCommunicationType=TRANSPORT_PROTOCOL
            PduRSrcPdu_187ffacf (PduRSrcPdu): PduRSourcePduHandleId=88, PduRSrcPduDirection=RECEIVE, PduRSrcPduRef=TECU_BB2_06S_oBackbone2_c069c78e_Rx, PduRSrcPduPduRBswModulesRef=CanTp
            TECU_BB2_06S_oBackbone2_c069c78e_Rx_187ffacf_Rx (PduRDestPdu):
              PduRDestPduHandleId = 43
              PduRDestPduDirection = RECEIVE
              PduRDestPduRoutingType = API_FORWARDING
              PduRDestPduDataProcessing = IMMEDIATE
              PduRPduLengthHandlingStrategy = UNUSED
              PduRDestPduRef = TECU_BB2_06S_oBackbone2_d4e6fa8b_Rx
              PduRDestPduPduRBswModulesRef = Com
          CIOM_Cab_13S_oCabSubnet_30fb8970_Tx: PduRRoutingPathCommunicationType=TRANSPORT_PROTOCOL
            PduRSrcPdu_ce8b3ea0 (PduRSrcPdu): PduRSourcePduHandleId=46, PduRSrcPduDirection=TRANSMIT, PduRSrcPduRef=CIOM_Cab_13S_oCabSubnet_30fb8970_Tx, PduRSrcPduPduRBswModulesRef=Com
            CIOM_Cab_13S_oCabSubnet_f9fd97a8_Tx (PduRDestPdu):
              PduRDestPduHandleId = 6
              PduRDestPduDirection = TRANSMIT
              PduRDestPduRoutingType = API_FORWARDING
              PduRDestPduDataProcessing = IMMEDIATE
              PduRPduLengthHandlingStrategy = UNUSED
              PduRDestPduRef = CIOM_Cab_13S_oCabSubnet_f9fd97a8_Tx
              PduRDestPduPduRBswModulesRef = CanTp
          EMS_BB2_13P_oBackbone2_4a3d6101_Rx: PduRRoutingPathCommunicationType=COMMUNICATION_INTERFACE
            EMS_BB2_13P_oBackbone2_4a3d6101_Rx_4530d6dc_Rx (PduRDestPdu):
              PduRDestPduHandleId = 66
              PduRDestPduDirection = RECEIVE
              PduRDestPduRoutingType = API_FORWARDING
              PduRDestPduDataProcessing = IMMEDIATE
              PduRPduLengthHandlingStrategy = UNUSED
              PduRTransmissionConfirmation = false
              PduRDestPduRef = EMS_BB2_13P_oBackbone2_20c2a8a6_Rx
              PduRDestPduPduRBswModulesRef = Com
            PduRSrcPdu_4530d6dc (PduRSrcPdu): PduRSourcePduHandleId=73, PduRSrcPduDirection=RECEIVE, PduRSrcPduRef=EMS_BB2_13P_oBackbone2_4a3d6101_Rx, PduRSrcPduPduRBswModulesRef=CanIf
          FMS_X_CIOMFMS_oFMSNet_44d7be16_Tx: PduRRoutingPathCommunicationType=COMMUNICATION_INTERFACE
            PduRSrcPdu_a9b97fd8 (PduRSrcPdu): PduRSourcePduHandleId=135, PduRSrcPduDirection=TRANSMIT, PduRSrcPduRef=FMS_X_CIOMFMS_oFMSNet_44d7be16_Tx, PduRSrcPduPduRBswModulesRef=Com
            FMS_X_CIOMFMS_oFMSNet_c973602f_Tx (PduRDestPdu):
              PduRDestPduHandleId = 121
              PduRDestPduDirection = TRANSMIT
              PduRDestPduRoutingType = API_FORWARDING
              PduRDestPduDataProcessing = IMMEDIATE
              PduRPduLengthHandlingStrategy = UNUSED
              PduRDestPduDataProvision = PDUR_DIRECT
              PduRTransmissionConfirmation = false
              PduRDestPduRef = FMS_X_CIOMFMS_oFMSNet_c973602f_Tx
              PduRDestPduPduRBswModulesRef = CanIf
          FSP_1_2_Req_L2_oLIN01_91ce527b_Tx: PduRRoutingPathCommunicationType=COMMUNICATION_INTERFACE
            PduRSrcPdu_d5491018 (PduRSrcPdu): PduRSourcePduHandleId=137, PduRSrcPduDirection=TRANSMIT, PduRSrcPduRef=FSP_1_2_Req_L2_oLIN01_91ce527b_Tx, PduRSrcPduPduRBswModulesRef=Com
            FSP_1_2_Req_L2_oLIN01_105a8fa6_Tx (PduRDestPdu):
              PduRDestPduHandleId = 123
              PduRDestPduDirection = TRANSMIT
              PduRDestPduRoutingType = API_FORWARDING
              PduRDestPduDataProcessing = IMMEDIATE
              PduRPduLengthHandlingStrategy = UNUSED
              PduRTransmissionConfirmation = false
              PduRDestPduDataProvision = PDUR_TRIGGERTRANSMIT
              PduRDestPduRef = FSP_1_2_Req_L2_oLIN01_105a8fa6_Tx
              PduRDestPduPduRBswModulesRef = LinIf
          CIOM_Cab_30S_oCabSubnet_6c5f2113_Tx: PduRRoutingPathCommunicationType=TRANSPORT_PROTOCOL
            CIOM_Cab_30S_oCabSubnet_5d07bef1_Tx (PduRDestPdu):
              PduRDestPduHandleId = 10
              PduRDestPduDirection = TRANSMIT
              PduRDestPduRoutingType = API_FORWARDING
              PduRDestPduDataProcessing = IMMEDIATE
              PduRPduLengthHandlingStrategy = UNUSED
              PduRDestPduRef = CIOM_Cab_30S_oCabSubnet_5d07bef1_Tx
              PduRDestPduPduRBswModulesRef = CanTp
            PduRSrcPdu_d71ba6b1 (PduRSrcPdu): PduRSourcePduHandleId=63, PduRSrcPduDirection=TRANSMIT, PduRSrcPduRef=CIOM_Cab_30S_oCabSubnet_6c5f2113_Tx, PduRSrcPduPduRBswModulesRef=Com
          SRS_Cab_03P_oCabSubnet_b9601d3d_Rx: PduRRoutingPathCommunicationType=COMMUNICATION_INTERFACE
            PduRSrcPdu_dc041688 (PduRSrcPdu): PduRSourcePduHandleId=130, PduRSrcPduDirection=RECEIVE, PduRSrcPduRef=SRS_Cab_03P_oCabSubnet_b9601d3d_Rx, PduRSrcPduPduRBswModulesRef=CanIf
            SRS_Cab_03P_oCabSubnet_b9601d3d_Rx_dc041688_Rx (PduRDestPdu):
              PduRDestPduHandleId = 123
              PduRDestPduDirection = RECEIVE
              PduRDestPduRoutingType = API_FORWARDING
              PduRDestPduDataProcessing = IMMEDIATE
              PduRPduLengthHandlingStrategy = UNUSED
              PduRTransmissionConfirmation = false
              PduRDestPduRef = SRS_Cab_03P_oCabSubnet_dd383ef5_Rx
              PduRDestPduPduRBswModulesRef = Com
          EMS_BB2_11S_oBackbone2_61d05567_Rx: PduRRoutingPathCommunicationType=TRANSPORT_PROTOCOL
            EMS_BB2_11S_oBackbone2_61d05567_Rx_ab3d4554_Rx (PduRDestPdu):
              PduRDestPduHandleId = 12
              PduRDestPduDirection = RECEIVE
              PduRDestPduRoutingType = API_FORWARDING
              PduRDestPduDataProcessing = IMMEDIATE
              PduRPduLengthHandlingStrategy = UNUSED
              PduRDestPduRef = EMS_BB2_11S_oBackbone2_3700cf1d_Rx
              PduRDestPduPduRBswModulesRef = Com
            PduRSrcPdu_ab3d4554 (PduRSrcPdu): PduRSourcePduHandleId=58, PduRSrcPduDirection=RECEIVE, PduRSrcPduRef=EMS_BB2_11S_oBackbone2_61d05567_Rx, PduRSrcPduPduRBswModulesRef=CanTp
          SlaveResp_FSP2_L3_oLIN02_cf918bf6_Rx: PduRRoutingPathCommunicationType=TRANSPORT_PROTOCOL
            SlaveResp_FSP2_L3_oLIN02_cf918bf6_Rx_1b1ab2ff_Rx (PduRDestPdu):
              PduRDestPduHandleId = 33
              PduRDestPduDirection = RECEIVE
              PduRDestPduRoutingType = API_FORWARDING
              PduRDestPduDataProcessing = IMMEDIATE
              PduRPduLengthHandlingStrategy = UNUSED
              PduRDestPduRef = SlaveResp_FSP2_L3_oLIN02_57c231c8_Rx
              PduRDestPduPduRBswModulesRef = Cdd
            PduRSrcPdu_1b1ab2ff (PduRSrcPdu): PduRSourcePduHandleId=78, PduRSrcPduDirection=RECEIVE, PduRSrcPduRef=SlaveResp_FSP2_L3_oLIN02_cf918bf6_Rx, PduRSrcPduPduRBswModulesRef=LinTp
          HMIIOM_BB2_34S_oBackbone2_c2eeee4b_Rx: PduRRoutingPathCommunicationType=COMMUNICATION_INTERFACE
            HMIIOM_BB2_34S_oBackbone2_c2eeee4b_Rx_f28ba4c2_Rx (PduRDestPdu):
              PduRDestPduHandleId = 100
              PduRDestPduDirection = RECEIVE
              PduRDestPduRoutingType = API_FORWARDING
              PduRDestPduDataProcessing = IMMEDIATE
              PduRPduLengthHandlingStrategy = UNUSED
              PduRTransmissionConfirmation = false
              PduRDestPduRef = HMIIOM_BB2_34S_oBackbone2_7d5cdece_Rx
              PduRDestPduPduRBswModulesRef = Com
            PduRSrcPdu_f28ba4c2 (PduRSrcPdu): PduRSourcePduHandleId=107, PduRSrcPduDirection=RECEIVE, PduRSrcPduRef=HMIIOM_BB2_34S_oBackbone2_c2eeee4b_Rx, PduRSrcPduPduRBswModulesRef=CanIf
          CIOM_20ba8835_Rx: PduRRoutingPathCommunicationType=TRANSPORT_PROTOCOL
            PduRSrcPdu_246f1e3b (PduRSrcPdu):
              PduRSourcePduHandleId = 16
              PduRSrcPduDirection = RECEIVE
              PduRSrcPduRef = PhysDiagReqMsg_98_F2_BB2_oBackbone2_00821398_Rx
              PduRSrcPduPduRBswModulesRef = CanTp
            CIOM_a41749c3_Tx (PduRDestPdu):
              PduRDestPduHandleId = 81
              PduRDestPduDirection = TRANSMIT
              PduRDestPduRoutingType = GATEWAY_ROUTING
              PduRDestPduDataProcessing = IMMEDIATE
              PduRPduLengthHandlingStrategy = UNUSED
              PduRDestPduQueueDepth = 4
              PduRTpThreshold = 1
              PduRDestPduRef = PhysDiagReqMsg_98_F2_Cab_oCabSubnet_842fd26e_Tx
              PduRDestPduPduRBswModulesRef = CanTp
          CIOM_Cab_18P_oCabSubnet_a0ace423_Tx: PduRRoutingPathCommunicationType=COMMUNICATION_INTERFACE
            CIOM_Cab_18P_oCabSubnet_c0de9230_Tx (PduRDestPdu):
              PduRDestPduHandleId = 46
              PduRDestPduDirection = TRANSMIT
              PduRDestPduRoutingType = API_FORWARDING
              PduRDestPduDataProcessing = IMMEDIATE
              PduRPduLengthHandlingStrategy = UNUSED
              PduRDestPduDataProvision = PDUR_DIRECT
              PduRTransmissionConfirmation = false
              PduRDestPduRef = CIOM_Cab_18P_oCabSubnet_c0de9230_Tx
              PduRDestPduPduRBswModulesRef = CanIf
            PduRSrcPdu_23a300e9 (PduRSrcPdu): PduRSourcePduHandleId=51, PduRSrcPduDirection=TRANSMIT, PduRSrcPduRef=CIOM_Cab_18P_oCabSubnet_a0ace423_Tx, PduRSrcPduPduRBswModulesRef=Com
          FSP1_Frame_L2_oLIN01_dfcb5978_Rx: PduRRoutingPathCommunicationType=COMMUNICATION_INTERFACE
            PduRSrcPdu_8621b565 (PduRSrcPdu): PduRSourcePduHandleId=79, PduRSrcPduDirection=RECEIVE, PduRSrcPduRef=FSP1_Frame_L2_oLIN01_dfcb5978_Rx, PduRSrcPduPduRBswModulesRef=LinIf
            FSP1_Frame_L2_oLIN01_dfcb5978_Rx_8621b565_Rx (PduRDestPdu):
              PduRDestPduHandleId = 72
              PduRDestPduDirection = RECEIVE
              PduRDestPduRoutingType = API_FORWARDING
              PduRDestPduDataProcessing = IMMEDIATE
              PduRPduLengthHandlingStrategy = UNUSED
              PduRTransmissionConfirmation = false
              PduRDestPduRef = FSP1_Frame_L2_oLIN01_878e4ca6_Rx
              PduRDestPduPduRBswModulesRef = Com
          CIOM_BB2_20S_oBackbone2_4d523a43_Tx: PduRRoutingPathCommunicationType=COMMUNICATION_INTERFACE
            PduRSrcPdu_0f0671d5 (PduRSrcPdu): PduRSourcePduHandleId=24, PduRSrcPduDirection=TRANSMIT, PduRSrcPduRef=CIOM_BB2_20S_oBackbone2_4d523a43_Tx, PduRSrcPduPduRBswModulesRef=Com
            CIOM_BB2_20S_oBackbone2_9de0e286_Tx (PduRDestPdu):
              PduRDestPduHandleId = 24
              PduRDestPduDirection = TRANSMIT
              PduRDestPduRoutingType = API_FORWARDING
              PduRDestPduDataProcessing = IMMEDIATE
              PduRPduLengthHandlingStrategy = UNUSED
              PduRTransmissionConfirmation = true
              PduRDestPduDataProvision = PDUR_DIRECT
              PduRDestPduRef = CIOM_BB2_20S_oBackbone2_9de0e286_Tx
              PduRDestPduPduRBswModulesRef = CanIf
          EMS_BB2_04P_oBackbone2_c45ae367_Rx: PduRRoutingPathCommunicationType=COMMUNICATION_INTERFACE
            EMS_BB2_04P_oBackbone2_c45ae367_Rx_ace186fb_Rx (PduRDestPdu):
              PduRDestPduHandleId = 62
              PduRDestPduDirection = RECEIVE
              PduRDestPduRoutingType = API_FORWARDING
              PduRDestPduDataProcessing = IMMEDIATE
              PduRPduLengthHandlingStrategy = UNUSED
              PduRTransmissionConfirmation = false
              PduRDestPduRef = EMS_BB2_04P_oBackbone2_c0be4f88_Rx
              PduRDestPduPduRBswModulesRef = Com
            PduRSrcPdu_ace186fb (PduRSrcPdu): PduRSourcePduHandleId=69, PduRSrcPduDirection=RECEIVE, PduRSrcPduRef=EMS_BB2_04P_oBackbone2_c45ae367_Rx, PduRSrcPduPduRBswModulesRef=CanIf
          ELCP2toCIOM_L4_oLIN03_7701f146_Rx: PduRRoutingPathCommunicationType=COMMUNICATION_INTERFACE
            ELCP2toCIOM_L4_oLIN03_7701f146_Rx_97ced8ff_Rx (PduRDestPdu):
              PduRDestPduHandleId = 60
              PduRDestPduDirection = RECEIVE
              PduRDestPduRoutingType = API_FORWARDING
              PduRDestPduDataProcessing = IMMEDIATE
              PduRPduLengthHandlingStrategy = UNUSED
              PduRTransmissionConfirmation = false
              PduRDestPduRef = ELCP2toCIOM_L4_oLIN03_bb95b9fc_Rx
              PduRDestPduPduRBswModulesRef = Com
            PduRSrcPdu_97ced8ff (PduRSrcPdu): PduRSourcePduHandleId=67, PduRSrcPduDirection=RECEIVE, PduRSrcPduRef=ELCP2toCIOM_L4_oLIN03_7701f146_Rx, PduRSrcPduPduRBswModulesRef=LinIf
          CIOM_15f853f7_Rx: PduRRoutingPathCommunicationType=COMMUNICATION_INTERFACE
            CIOM_91559201_Tx (PduRDestPdu):
              PduRDestPduHandleId = 106
              PduRDestPduDirection = TRANSMIT
              PduRDestPduRoutingType = GATEWAY_ROUTING
              PduRDestPduDataProcessing = IMMEDIATE
              PduRPduLengthHandlingStrategy = UNUSED
              PduRDestPduDataProvision = PDUR_DIRECT
              PduRTransmissionConfirmation = false
              PduRDestPduRef = DiagUUDTRespMsg1_F2_26_BB2_oBackbone2_ed213a51_Tx
              PduRDestPduPduRBswModulesRef = CanIf
            PduRSrcPdu_1dcb13ac (PduRSrcPdu):
              PduRSourcePduHandleId = 33
              PduRSrcPduDirection = RECEIVE
              PduRSrcPduRef = DiagUUDTRespMsg1_F2_26_Cab_oCabSubnet_698cfba7_Rx
              PduRSrcPduPduRBswModulesRef = CanIf
          VP232_X_ERAU_oFMSNet_67abd5b0_Rx: PduRRoutingPathCommunicationType=COMMUNICATION_INTERFACE
            VP232_X_ERAU_oFMSNet_67abd5b0_Rx_c6e87d5c_Rx (PduRDestPdu):
              PduRDestPduHandleId = 177
              PduRDestPduDirection = RECEIVE
              PduRDestPduRoutingType = API_FORWARDING
              PduRDestPduDataProcessing = IMMEDIATE
              PduRPduLengthHandlingStrategy = UNUSED
              PduRTransmissionConfirmation = false
              PduRDestPduRef = VP232_X_ERAU_oFMSNet_34122677_Rx
              PduRDestPduPduRBswModulesRef = Com
            PduRSrcPdu_c6e87d5c (PduRSrcPdu): PduRSourcePduHandleId=184, PduRSrcPduDirection=RECEIVE, PduRSrcPduRef=VP232_X_ERAU_oFMSNet_67abd5b0_Rx, PduRSrcPduPduRBswModulesRef=CanIf
          CIOM_Cab_09P_oCabSubnet_e035dcd0_Tx: PduRRoutingPathCommunicationType=COMMUNICATION_INTERFACE
            CIOM_Cab_09P_oCabSubnet_07f60769_Tx (PduRDestPdu):
              PduRDestPduHandleId = 39
              PduRDestPduDirection = TRANSMIT
              PduRDestPduRoutingType = API_FORWARDING
              PduRDestPduDataProcessing = IMMEDIATE
              PduRPduLengthHandlingStrategy = UNUSED
              PduRDestPduDataProvision = PDUR_DIRECT
              PduRTransmissionConfirmation = false
              PduRDestPduRef = CIOM_Cab_09P_oCabSubnet_07f60769_Tx
              PduRDestPduPduRBswModulesRef = CanIf
            PduRSrcPdu_0c1b703d (PduRSrcPdu): PduRSourcePduHandleId=42, PduRSrcPduDirection=TRANSMIT, PduRSrcPduRef=CIOM_Cab_09P_oCabSubnet_e035dcd0_Tx, PduRSrcPduPduRBswModulesRef=Com
          PDM_Sec_04S_oSecuritySubnet_f2249c2b_Rx: PduRRoutingPathCommunicationType=TRANSPORT_PROTOCOL
            PduRSrcPdu_26b85268 (PduRSrcPdu): PduRSourcePduHandleId=64, PduRSrcPduDirection=RECEIVE, PduRSrcPduRef=PDM_Sec_04S_oSecuritySubnet_f2249c2b_Rx, PduRSrcPduPduRBswModulesRef=CanTp
            PDM_Sec_04S_oSecuritySubnet_f2249c2b_Rx_26b85268_Rx (PduRDestPdu):
              PduRDestPduHandleId = 19
              PduRDestPduDirection = RECEIVE
              PduRDestPduRoutingType = API_FORWARDING
              PduRDestPduDataProcessing = IMMEDIATE
              PduRPduLengthHandlingStrategy = UNUSED
              PduRDestPduRef = PDM_Sec_04S_oSecuritySubnet_c89ab437_Rx
              PduRDestPduPduRBswModulesRef = Com
          VMCU_BB2_57P_oBackbone2_7bd9bbf9_Rx: PduRRoutingPathCommunicationType=TRANSPORT_PROTOCOL
            PduRSrcPdu_46a397e3 (PduRSrcPdu): PduRSourcePduHandleId=92, PduRSrcPduDirection=RECEIVE, PduRSrcPduRef=VMCU_BB2_57P_oBackbone2_7bd9bbf9_Rx, PduRSrcPduPduRBswModulesRef=CanTp
            VMCU_BB2_57P_oBackbone2_7bd9bbf9_Rx_46a397e3_Rx (PduRDestPdu):
              PduRDestPduHandleId = 48
              PduRDestPduDirection = RECEIVE
              PduRDestPduRoutingType = API_FORWARDING
              PduRDestPduDataProcessing = IMMEDIATE
              PduRPduLengthHandlingStrategy = UNUSED
              PduRDestPduRef = VMCU_BB2_57P_oBackbone2_ae986a7a_Rx
              PduRDestPduPduRBswModulesRef = Com
          PduRRoutingPath_002: PduRRoutingPathCommunicationType=COMMUNICATION_INTERFACE
            PduRDestPdu_2 (PduRDestPdu):
              PduRDestPduHandleId = 4
              PduRDestPduDirection = TRANSMIT
              PduRDestPduRoutingType = API_FORWARDING
              PduRDestPduDataProcessing = IMMEDIATE
              PduRPduLengthHandlingStrategy = UNUSED
              PduRDestPduDataProvision = PDUR_DIRECT
              PduRTransmissionConfirmation = true
              PduRDestPduRef = AckmTxPdu_FMSNet_J1939_44d89c3b
              PduRDestPduPduRBswModulesRef = CanIf
            PduRSrcPdu_2 (PduRSrcPdu): PduRSourcePduHandleId=174, PduRSrcPduDirection=TRANSMIT, PduRSrcPduRef=AckmTxPdu_FMSNet_J1939_44d89c3b, PduRSrcPduPduRBswModulesRef=J1939Rm
          PduRRoutingPath_003: PduRRoutingPathCommunicationType=COMMUNICATION_INTERFACE
            PduRDestPdu_3 (PduRDestPdu):
              PduRDestPduHandleId = 121
              PduRDestPduDirection = RECEIVE
              PduRDestPduRoutingType = API_FORWARDING
              PduRDestPduDataProcessing = IMMEDIATE
              PduRPduLengthHandlingStrategy = UNUSED
              PduRTransmissionConfirmation = false
              PduRDestPduRef = RqstRxPdu_FMNSet_J1939
              PduRDestPduPduRBswModulesRef = J1939Rm
            PduRSrcPdu_3 (PduRSrcPdu): PduRSourcePduHandleId=127, PduRSrcPduDirection=RECEIVE, PduRSrcPduRef=RqstRxPdu_FMNSet_J1939, PduRSrcPduPduRBswModulesRef=CanIf
          Debug4_SCIM_BB2_oBackbone2_c6d0040a_Tx: PduRRoutingPathCommunicationType=COMMUNICATION_INTERFACE
            PduRSrcPdu_ac0cad50 (PduRSrcPdu): PduRSourcePduHandleId=93, PduRSrcPduDirection=TRANSMIT, PduRSrcPduRef=Debug4_SCIM_BB2_oBackbone2_c6d0040a_Tx, PduRSrcPduPduRBswModulesRef=Com
            Debug4_SCIM_BB2_oBackbone2_0cf5f8b4_Tx (PduRDestPdu):
              PduRDestPduHandleId = 74
              PduRDestPduDirection = TRANSMIT
              PduRDestPduRoutingType = API_FORWARDING
              PduRDestPduDataProcessing = IMMEDIATE
              PduRPduLengthHandlingStrategy = UNUSED
              PduRDestPduDataProvision = PDUR_DIRECT
              PduRTransmissionConfirmation = true
              PduRDestPduRef = Debug4_SCIM_BB2_oBackbone2_0cf5f8b4_Tx
              PduRDestPduPduRBswModulesRef = CanIf
          VMCU_BB2_100P_oBackbone2_9f8a2897_Rx: PduRRoutingPathCommunicationType=COMMUNICATION_INTERFACE
            VMCU_BB2_100P_oBackbone2_9f8a2897_Rx_47fe19fd_Rx (PduRDestPdu):
              PduRDestPduHandleId = 166
              PduRDestPduDirection = RECEIVE
              PduRDestPduRoutingType = API_FORWARDING
              PduRDestPduDataProcessing = IMMEDIATE
              PduRPduLengthHandlingStrategy = UNUSED
              PduRTransmissionConfirmation = false
              PduRDestPduRef = VMCU_BB2_100P_oBackbone2_ff8ed6a7_Rx
              PduRDestPduPduRBswModulesRef = Com
            PduRSrcPdu_47fe19fd (PduRSrcPdu): PduRSourcePduHandleId=173, PduRSrcPduDirection=RECEIVE, PduRSrcPduRef=VMCU_BB2_100P_oBackbone2_9f8a2897_Rx, PduRSrcPduPduRBswModulesRef=CanIf
          IC3_BB2_02P_oBackbone2_306c24c9_Rx: PduRRoutingPathCommunicationType=COMMUNICATION_INTERFACE
            PduRSrcPdu_deeb321e (PduRSrcPdu): PduRSourcePduHandleId=112, PduRSrcPduDirection=RECEIVE, PduRSrcPduRef=IC3_BB2_02P_oBackbone2_306c24c9_Rx, PduRSrcPduPduRBswModulesRef=CanIf
            IC3_BB2_02P_oBackbone2_306c24c9_Rx_deeb321e_Rx (PduRDestPdu):
              PduRDestPduHandleId = 105
              PduRDestPduDirection = RECEIVE
              PduRDestPduRoutingType = API_FORWARDING
              PduRDestPduDataProcessing = IMMEDIATE
              PduRPduLengthHandlingStrategy = UNUSED
              PduRTransmissionConfirmation = false
              PduRDestPduRef = IC3_BB2_02P_oBackbone2_7972d9f8_Rx
              PduRDestPduPduRBswModulesRef = Com
          VMCU_BB2_90P_oBackbone2_74636b79_Rx: PduRRoutingPathCommunicationType=COMMUNICATION_INTERFACE
            VMCU_BB2_90P_oBackbone2_74636b79_Rx_5cc978c1_Rx (PduRDestPdu):
              PduRDestPduHandleId = 158
              PduRDestPduDirection = RECEIVE
              PduRDestPduRoutingType = API_FORWARDING
              PduRDestPduDataProcessing = IMMEDIATE
              PduRPduLengthHandlingStrategy = UNUSED
              PduRTransmissionConfirmation = false
              PduRDestPduRef = VMCU_BB2_90P_oBackbone2_f91efd0f_Rx
              PduRDestPduPduRBswModulesRef = Com
            PduRSrcPdu_5cc978c1 (PduRSrcPdu): PduRSourcePduHandleId=165, PduRSrcPduDirection=RECEIVE, PduRSrcPduRef=VMCU_BB2_90P_oBackbone2_74636b79_Rx, PduRSrcPduPduRBswModulesRef=CanIf
          VMCU_BB2_110P_oBackbone2_a978b864_Rx: PduRRoutingPathCommunicationType=COMMUNICATION_INTERFACE
            PduRSrcPdu_0c61a87a (PduRSrcPdu): PduRSourcePduHandleId=181, PduRSrcPduDirection=RECEIVE, PduRSrcPduRef=VMCU_BB2_110P_oBackbone2_a978b864_Rx, PduRSrcPduPduRBswModulesRef=CanIf
            VMCU_BB2_110P_oBackbone2_a978b864_Rx_0c61a87a_Rx (PduRDestPdu):
              PduRDestPduHandleId = 174
              PduRDestPduDirection = RECEIVE
              PduRDestPduRoutingType = API_FORWARDING
              PduRDestPduDataProcessing = IMMEDIATE
              PduRPduLengthHandlingStrategy = UNUSED
              PduRTransmissionConfirmation = false
              PduRDestPduRef = VMCU_BB2_110P_oBackbone2_628137d1_Rx
              PduRDestPduPduRBswModulesRef = Com
          Debug12_SCIM_BB2_oBackbone2_c85f77be_Tx: PduRRoutingPathCommunicationType=COMMUNICATION_INTERFACE
            Debug12_SCIM_BB2_oBackbone2_352827a4_Tx (PduRDestPdu):
              PduRDestPduHandleId = 82
              PduRDestPduDirection = TRANSMIT
              PduRDestPduRoutingType = API_FORWARDING
              PduRDestPduDataProcessing = IMMEDIATE
              PduRPduLengthHandlingStrategy = UNUSED
              PduRDestPduDataProvision = PDUR_DIRECT
              PduRTransmissionConfirmation = true
              PduRDestPduRef = Debug12_SCIM_BB2_oBackbone2_352827a4_Tx
              PduRDestPduPduRBswModulesRef = CanIf
            PduRSrcPdu_5ca24c3c (PduRSrcPdu): PduRSourcePduHandleId=101, PduRSrcPduDirection=TRANSMIT, PduRSrcPduRef=Debug12_SCIM_BB2_oBackbone2_c85f77be_Tx, PduRSrcPduPduRBswModulesRef=Com
          VMCU_BB2_89P_oBackbone2_505fca74_Rx: PduRRoutingPathCommunicationType=COMMUNICATION_INTERFACE
            VMCU_BB2_89P_oBackbone2_505fca74_Rx_428b6950_Rx (PduRDestPdu):
              PduRDestPduHandleId = 157
              PduRDestPduDirection = RECEIVE
              PduRDestPduRoutingType = API_FORWARDING
              PduRDestPduDataProcessing = IMMEDIATE
              PduRPduLengthHandlingStrategy = UNUSED
              PduRTransmissionConfirmation = false
              PduRDestPduRef = VMCU_BB2_89P_oBackbone2_e3841691_Rx
              PduRDestPduPduRBswModulesRef = Com
            PduRSrcPdu_428b6950 (PduRSrcPdu): PduRSourcePduHandleId=164, PduRSrcPduDirection=RECEIVE, PduRSrcPduRef=VMCU_BB2_89P_oBackbone2_505fca74_Rx, PduRSrcPduPduRBswModulesRef=CanIf
          VMCU_BB2_91P_oBackbone2_85b96ed3_Rx: PduRRoutingPathCommunicationType=COMMUNICATION_INTERFACE
            PduRSrcPdu_360d1e42 (PduRSrcPdu): PduRSourcePduHandleId=166, PduRSrcPduDirection=RECEIVE, PduRSrcPduRef=VMCU_BB2_91P_oBackbone2_85b96ed3_Rx, PduRSrcPduPduRBswModulesRef=CanIf
            VMCU_BB2_91P_oBackbone2_85b96ed3_Rx_360d1e42_Rx (PduRDestPdu):
              PduRDestPduHandleId = 159
              PduRDestPduDirection = RECEIVE
              PduRDestPduRoutingType = API_FORWARDING
              PduRDestPduDataProcessing = IMMEDIATE
              PduRPduLengthHandlingStrategy = UNUSED
              PduRTransmissionConfirmation = false
              PduRDestPduRef = VMCU_BB2_91P_oBackbone2_2488248a_Rx
              PduRDestPduPduRBswModulesRef = Com
          Debug3_SCIM_BB2_oBackbone2_af378252_Tx: PduRRoutingPathCommunicationType=COMMUNICATION_INTERFACE
            Debug3_SCIM_BB2_oBackbone2_f6c80be3_Tx (PduRDestPdu):
              PduRDestPduHandleId = 73
              PduRDestPduDirection = TRANSMIT
              PduRDestPduRoutingType = API_FORWARDING
              PduRDestPduDataProcessing = IMMEDIATE
              PduRPduLengthHandlingStrategy = UNUSED
              PduRDestPduDataProvision = PDUR_DIRECT
              PduRTransmissionConfirmation = true
              PduRDestPduRef = Debug3_SCIM_BB2_oBackbone2_f6c80be3_Tx
              PduRDestPduPduRBswModulesRef = CanIf
            PduRSrcPdu_25b1c7e0 (PduRSrcPdu): PduRSourcePduHandleId=92, PduRSrcPduDirection=TRANSMIT, PduRSrcPduRef=Debug3_SCIM_BB2_oBackbone2_af378252_Tx, PduRSrcPduPduRBswModulesRef=Com
          VMCU_BB2_107P_oBackbone2_271f3a02_Rx: PduRRoutingPathCommunicationType=COMMUNICATION_INTERFACE
            PduRSrcPdu_ed07f0ed (PduRSrcPdu): PduRSourcePduHandleId=179, PduRSrcPduDirection=RECEIVE, PduRSrcPduRef=VMCU_BB2_107P_oBackbone2_271f3a02_Rx, PduRSrcPduPduRBswModulesRef=CanIf
            VMCU_BB2_107P_oBackbone2_271f3a02_Rx_ed07f0ed_Rx (PduRDestPdu):
              PduRDestPduHandleId = 172
              PduRDestPduDirection = RECEIVE
              PduRDestPduRoutingType = API_FORWARDING
              PduRDestPduDataProcessing = IMMEDIATE
              PduRPduLengthHandlingStrategy = UNUSED
              PduRTransmissionConfirmation = false
              PduRDestPduRef = VMCU_BB2_107P_oBackbone2_82fdd0ff_Rx
              PduRDestPduPduRBswModulesRef = Com
          VMCU_BB2_96P_oBackbone2_3d2c7c46_Rx: PduRRoutingPathCommunicationType=COMMUNICATION_INTERFACE
            VMCU_BB2_96P_oBackbone2_3d2c7c46_Rx_44fdf1f0_Rx (PduRDestPdu):
              PduRDestPduHandleId = 163
              PduRDestPduDirection = RECEIVE
              PduRDestPduRoutingType = API_FORWARDING
              PduRDestPduDataProcessing = IMMEDIATE
              PduRPduLengthHandlingStrategy = UNUSED
              PduRTransmissionConfirmation = false
              PduRDestPduRef = VMCU_BB2_96P_oBackbone2_59fb22d2_Rx
              PduRDestPduPduRBswModulesRef = Com
            PduRSrcPdu_44fdf1f0 (PduRSrcPdu): PduRSourcePduHandleId=170, PduRSrcPduDirection=RECEIVE, PduRSrcPduRef=VMCU_BB2_96P_oBackbone2_3d2c7c46_Rx, PduRSrcPduPduRBswModulesRef=CanIf
          VMCU_BB2_98P_oBackbone2_97775f2d_Rx: PduRRoutingPathCommunicationType=COMMUNICATION_INTERFACE
            PduRSrcPdu_014c614e (PduRSrcPdu): PduRSourcePduHandleId=171, PduRSrcPduDirection=RECEIVE, PduRSrcPduRef=VMCU_BB2_98P_oBackbone2_97775f2d_Rx, PduRSrcPduPduRBswModulesRef=CanIf
            VMCU_BB2_98P_oBackbone2_97775f2d_Rx_014c614e_Rx (PduRDestPdu):
              PduRDestPduHandleId = 164
              PduRDestPduDirection = RECEIVE
              PduRDestPduRoutingType = API_FORWARDING
              PduRDestPduDataProcessing = IMMEDIATE
              PduRPduLengthHandlingStrategy = UNUSED
              PduRTransmissionConfirmation = false
              PduRDestPduRef = VMCU_BB2_98P_oBackbone2_a31d2e62_Rx
              PduRDestPduPduRBswModulesRef = Com
          CIOM_BB2_30P_oBackbone2_a7c309c5_Tx: PduRRoutingPathCommunicationType=COMMUNICATION_INTERFACE
            PduRSrcPdu_5840d625 (PduRSrcPdu): PduRSourcePduHandleId=31, PduRSrcPduDirection=TRANSMIT, PduRSrcPduRef=CIOM_BB2_30P_oBackbone2_a7c309c5_Tx, PduRSrcPduPduRBswModulesRef=Com
            CIOM_BB2_30P_oBackbone2_b83a4b06_Tx (PduRDestPdu):
              PduRDestPduHandleId = 31
              PduRDestPduDirection = TRANSMIT
              PduRDestPduRoutingType = API_FORWARDING
              PduRDestPduDataProcessing = IMMEDIATE
              PduRPduLengthHandlingStrategy = UNUSED
              PduRDestPduDataProvision = PDUR_DIRECT
              PduRTransmissionConfirmation = false
              PduRDestPduRef = CIOM_BB2_30P_oBackbone2_b83a4b06_Tx
              PduRDestPduPduRBswModulesRef = CanIf
          VMCU_BB2_102P_oBackbone2_a74f2582_Rx: PduRRoutingPathCommunicationType=COMMUNICATION_INTERFACE
            PduRSrcPdu_19e2dee6 (PduRSrcPdu): PduRSourcePduHandleId=175, PduRSrcPduDirection=RECEIVE, PduRSrcPduRef=VMCU_BB2_102P_oBackbone2_a74f2582_Rx, PduRSrcPduPduRBswModulesRef=CanIf
            VMCU_BB2_102P_oBackbone2_a74f2582_Rx_19e2dee6_Rx (PduRDestPdu):
              PduRDestPduHandleId = 168
              PduRDestPduDirection = RECEIVE
              PduRDestPduRoutingType = API_FORWARDING
              PduRDestPduDataProcessing = IMMEDIATE
              PduRPduLengthHandlingStrategy = UNUSED
              PduRTransmissionConfirmation = false
              PduRDestPduRef = VMCU_BB2_102P_oBackbone2_9fd263ec_Rx
              PduRDestPduPduRBswModulesRef = Com
          VMCU_BB2_99P_oBackbone2_66ad5a87_Rx: PduRRoutingPathCommunicationType=COMMUNICATION_INTERFACE
            PduRSrcPdu_8c112a34 (PduRSrcPdu): PduRSourcePduHandleId=172, PduRSrcPduDirection=RECEIVE, PduRSrcPduRef=VMCU_BB2_99P_oBackbone2_66ad5a87_Rx, PduRSrcPduPduRBswModulesRef=CanIf
            VMCU_BB2_99P_oBackbone2_66ad5a87_Rx_8c112a34_Rx (PduRDestPdu):
              PduRDestPduHandleId = 165
              PduRDestPduDirection = RECEIVE
              PduRDestPduRoutingType = API_FORWARDING
              PduRDestPduDataProcessing = IMMEDIATE
              PduRPduLengthHandlingStrategy = UNUSED
              PduRTransmissionConfirmation = false
              PduRDestPduRef = VMCU_BB2_99P_oBackbone2_7e8bf7e7_Rx
              PduRDestPduPduRBswModulesRef = Com
          VMCU_BB2_111P_oBackbone2_58a2bdce_Rx: PduRRoutingPathCommunicationType=COMMUNICATION_INTERFACE
            VMCU_BB2_111P_oBackbone2_58a2bdce_Rx_e6c93928_Rx (PduRDestPdu):
              PduRDestPduHandleId = 175
              PduRDestPduDirection = RECEIVE
              PduRDestPduRoutingType = API_FORWARDING
              PduRDestPduDataProcessing = IMMEDIATE
              PduRPduLengthHandlingStrategy = UNUSED
              PduRTransmissionConfirmation = false
              PduRDestPduRef = VMCU_BB2_111P_oBackbone2_bf17ee54_Rx
              PduRDestPduPduRBswModulesRef = Com
            PduRSrcPdu_e6c93928 (PduRSrcPdu): PduRSourcePduHandleId=182, PduRSrcPduDirection=RECEIVE, PduRSrcPduRef=VMCU_BB2_111P_oBackbone2_58a2bdce_Rx, PduRSrcPduPduRBswModulesRef=CanIf
          VMCU_BB2_105P_oBackbone2_1fda3717_Rx: PduRRoutingPathCommunicationType=COMMUNICATION_INTERFACE
            PduRSrcPdu_503c628f (PduRSrcPdu): PduRSourcePduHandleId=177, PduRSrcPduDirection=RECEIVE, PduRSrcPduRef=VMCU_BB2_105P_oBackbone2_1fda3717_Rx, PduRSrcPduPduRBswModulesRef=CanIf
            VMCU_BB2_105P_oBackbone2_1fda3717_Rx_503c628f_Rx (PduRDestPdu):
              PduRDestPduHandleId = 170
              PduRDestPduDirection = RECEIVE
              PduRDestPduRoutingType = API_FORWARDING
              PduRDestPduDataProcessing = IMMEDIATE
              PduRPduLengthHandlingStrategy = UNUSED
              PduRTransmissionConfirmation = false
              PduRDestPduRef = VMCU_BB2_105P_oBackbone2_e2a165b4_Rx
              PduRDestPduPduRBswModulesRef = Com
          VMCU_BB2_106P_oBackbone2_d6c53fa8_Rx: PduRRoutingPathCommunicationType=COMMUNICATION_INTERFACE
            VMCU_BB2_106P_oBackbone2_d6c53fa8_Rx_c783b7c8_Rx (PduRDestPdu):
              PduRDestPduHandleId = 171
              PduRDestPduDirection = RECEIVE
              PduRDestPduRoutingType = API_FORWARDING
              PduRDestPduDataProcessing = IMMEDIATE
              PduRPduLengthHandlingStrategy = UNUSED
              PduRTransmissionConfirmation = false
              PduRDestPduRef = VMCU_BB2_106P_oBackbone2_5f6b097a_Rx
              PduRDestPduPduRBswModulesRef = Com
            PduRSrcPdu_c783b7c8 (PduRSrcPdu): PduRSourcePduHandleId=178, PduRSrcPduDirection=RECEIVE, PduRSrcPduRef=VMCU_BB2_106P_oBackbone2_d6c53fa8_Rx, PduRSrcPduPduRBswModulesRef=CanIf
          Debug5_SCIM_BB2_oBackbone2_590a8794_Tx: PduRRoutingPathCommunicationType=COMMUNICATION_INTERFACE
            PduRSrcPdu_09743343 (PduRSrcPdu): PduRSourcePduHandleId=94, PduRSrcPduDirection=TRANSMIT, PduRSrcPduRef=Debug5_SCIM_BB2_oBackbone2_590a8794_Tx, PduRSrcPduPduRBswModulesRef=Com
            Debug5_SCIM_BB2_oBackbone2_a3b16af3_Tx (PduRDestPdu):
              PduRDestPduHandleId = 75
              PduRDestPduDirection = TRANSMIT
              PduRDestPduRoutingType = API_FORWARDING
              PduRDestPduDataProcessing = IMMEDIATE
              PduRPduLengthHandlingStrategy = UNUSED
              PduRDestPduDataProvision = PDUR_DIRECT
              PduRTransmissionConfirmation = true
              PduRDestPduRef = Debug5_SCIM_BB2_oBackbone2_a3b16af3_Tx
              PduRDestPduPduRBswModulesRef = CanIf
          AnmMsg_IC3_Backbone2_oBackbone2_51836988_Rx: PduRRoutingPathCommunicationType=COMMUNICATION_INTERFACE
            PduRSrcPdu_7995df46 (PduRSrcPdu):
              PduRSourcePduHandleId = 14
              PduRSrcPduDirection = RECEIVE
              PduRSrcPduRef = AnmMsg_IC3_Backbone2_oBackbone2_51836988_Rx
              PduRSrcPduPduRBswModulesRef = CanIf
            AnmMsg_IC3_Backbone2_oBackbone2_51836988_Rx_7995df46_Rx (PduRDestPdu):
              PduRDestPduHandleId = 14
              PduRDestPduDirection = RECEIVE
              PduRDestPduRoutingType = API_FORWARDING
              PduRDestPduDataProcessing = IMMEDIATE
              PduRPduLengthHandlingStrategy = UNUSED
              PduRTransmissionConfirmation = false
              PduRDestPduRef = AnmMsg_IC3_Backbone2_oBackbone2_8d54783a_Rx
              PduRDestPduPduRBswModulesRef = Com
          VMCU_BB2_109P_oBackbone2_8d441969_Rx: PduRRoutingPathCommunicationType=COMMUNICATION_INTERFACE
            PduRSrcPdu_68cc32d5 (PduRSrcPdu): PduRSourcePduHandleId=180, PduRSrcPduDirection=RECEIVE, PduRSrcPduRef=VMCU_BB2_109P_oBackbone2_8d441969_Rx, PduRSrcPduPduRBswModulesRef=CanIf
            VMCU_BB2_109P_oBackbone2_8d441969_Rx_68cc32d5_Rx (PduRDestPdu):
              PduRDestPduHandleId = 173
              PduRDestPduDirection = RECEIVE
              PduRDestPduRoutingType = API_FORWARDING
              PduRDestPduDataProcessing = IMMEDIATE
              PduRPduLengthHandlingStrategy = UNUSED
              PduRTransmissionConfirmation = false
              PduRDestPduRef = VMCU_BB2_109P_oBackbone2_781bdc4f_Rx
              PduRDestPduPduRBswModulesRef = Com
          DebugCtrl1_SCIM_BB2_oBackbone2_c4c282ac_Rx: PduRRoutingPathCommunicationType=COMMUNICATION_INTERFACE
            PduRSrcPdu_9698b879 (PduRSrcPdu): PduRSourcePduHandleId=42, PduRSrcPduDirection=RECEIVE, PduRSrcPduRef=DebugCtrl1_SCIM_BB2_oBackbone2_c4c282ac_Rx, PduRSrcPduPduRBswModulesRef=CanIf
            DebugCtrl1_SCIM_BB2_oBackbone2_c4c282ac_Rx_9698b879_Rx (PduRDestPdu):
              PduRDestPduHandleId = 35
              PduRDestPduDirection = RECEIVE
              PduRDestPduRoutingType = API_FORWARDING
              PduRDestPduDataProcessing = IMMEDIATE
              PduRPduLengthHandlingStrategy = UNUSED
              PduRTransmissionConfirmation = false
              PduRDestPduRef = DebugCtrl1_SCIM_BB2_oBackbone2_4d739d72_Rx
              PduRDestPduPduRBswModulesRef = Com
          Debug11_SCIM_BB2_oBackbone2_b341f55d_Tx: PduRRoutingPathCommunicationType=COMMUNICATION_INTERFACE
            PduRSrcPdu_8ca60034 (PduRSrcPdu): PduRSourcePduHandleId=100, PduRSrcPduDirection=TRANSMIT, PduRSrcPduRef=Debug11_SCIM_BB2_oBackbone2_b341f55d_Tx, PduRSrcPduPduRBswModulesRef=Com
            Debug11_SCIM_BB2_oBackbone2_1f94972c_Tx (PduRDestPdu):
              PduRDestPduHandleId = 81
              PduRDestPduDirection = TRANSMIT
              PduRDestPduRoutingType = API_FORWARDING
              PduRDestPduDataProcessing = IMMEDIATE
              PduRPduLengthHandlingStrategy = UNUSED
              PduRDestPduDataProvision = PDUR_DIRECT
              PduRTransmissionConfirmation = true
              PduRDestPduRef = Debug11_SCIM_BB2_oBackbone2_1f94972c_Tx
              PduRDestPduPduRBswModulesRef = CanIf
          IC3_BB2_03S_oBackbone2_d29e1810_Rx: PduRRoutingPathCommunicationType=COMMUNICATION_INTERFACE
            IC3_BB2_03S_oBackbone2_d29e1810_Rx_1629dc33_Rx (PduRDestPdu):
              PduRDestPduHandleId = 106
              PduRDestPduDirection = RECEIVE
              PduRDestPduRoutingType = API_FORWARDING
              PduRDestPduDataProcessing = IMMEDIATE
              PduRPduLengthHandlingStrategy = UNUSED
              PduRTransmissionConfirmation = false
              PduRDestPduRef = IC3_BB2_03S_oBackbone2_d37ad28d_Rx
              PduRDestPduPduRBswModulesRef = Com
            PduRSrcPdu_1629dc33 (PduRSrcPdu): PduRSourcePduHandleId=113, PduRSrcPduDirection=RECEIVE, PduRSrcPduRef=IC3_BB2_03S_oBackbone2_d29e1810_Rx, PduRSrcPduPduRBswModulesRef=CanIf
          VMCU_BB2_95P_oBackbone2_f43374f9_Rx: PduRRoutingPathCommunicationType=COMMUNICATION_INTERFACE
            PduRSrcPdu_888be3ba (PduRSrcPdu): PduRSourcePduHandleId=169, PduRSrcPduDirection=RECEIVE, PduRSrcPduRef=VMCU_BB2_95P_oBackbone2_f43374f9_Rx, PduRSrcPduPduRBswModulesRef=CanIf
            VMCU_BB2_95P_oBackbone2_f43374f9_Rx_888be3ba_Rx (PduRDestPdu):
              PduRDestPduHandleId = 162
              PduRDestPduDirection = RECEIVE
              PduRDestPduRoutingType = API_FORWARDING
              PduRDestPduDataProcessing = IMMEDIATE
              PduRPduLengthHandlingStrategy = UNUSED
              PduRTransmissionConfirmation = false
              PduRDestPduRef = VMCU_BB2_95P_oBackbone2_e4314e1c_Rx
              PduRDestPduPduRBswModulesRef = Com
          Debug6_SCIM_BB2_oBackbone2_22140577_Tx: PduRRoutingPathCommunicationType=COMMUNICATION_INTERFACE
            PduRSrcPdu_5aa77b20 (PduRSrcPdu): PduRSourcePduHandleId=95, PduRSrcPduDirection=TRANSMIT, PduRSrcPduRef=Debug6_SCIM_BB2_oBackbone2_22140577_Tx, PduRSrcPduPduRBswModulesRef=Com
            Debug6_SCIM_BB2_oBackbone2_890dda7b_Tx (PduRDestPdu):
              PduRDestPduHandleId = 76
              PduRDestPduDirection = TRANSMIT
              PduRDestPduRoutingType = API_FORWARDING
              PduRDestPduDataProcessing = IMMEDIATE
              PduRPduLengthHandlingStrategy = UNUSED
              PduRTransmissionConfirmation = true
              PduRDestPduDataProvision = PDUR_DIRECT
              PduRDestPduRef = Debug6_SCIM_BB2_oBackbone2_890dda7b_Tx
              PduRDestPduPduRBswModulesRef = CanIf
          VMCU_BB2_101P_oBackbone2_6e502d3d_Rx: PduRRoutingPathCommunicationType=COMMUNICATION_INTERFACE
            VMCU_BB2_101P_oBackbone2_6e502d3d_Rx_1a3da258_Rx (PduRDestPdu):
              PduRDestPduHandleId = 167
              PduRDestPduDirection = RECEIVE
              PduRDestPduRoutingType = API_FORWARDING
              PduRDestPduDataProcessing = IMMEDIATE
              PduRPduLengthHandlingStrategy = UNUSED
              PduRTransmissionConfirmation = false
              PduRDestPduRef = VMCU_BB2_101P_oBackbone2_22180f22_Rx
              PduRDestPduPduRBswModulesRef = Com
            PduRSrcPdu_1a3da258 (PduRSrcPdu): PduRSourcePduHandleId=174, PduRSrcPduDirection=RECEIVE, PduRSrcPduRef=VMCU_BB2_101P_oBackbone2_6e502d3d_Rx, PduRSrcPduPduRBswModulesRef=CanIf
          DebugCtrl2_SCIM_BB2_oBackbone2_ee7e3224_Rx: PduRRoutingPathCommunicationType=COMMUNICATION_INTERFACE
            PduRSrcPdu_28df1206 (PduRSrcPdu): PduRSourcePduHandleId=43, PduRSrcPduDirection=RECEIVE, PduRSrcPduRef=DebugCtrl2_SCIM_BB2_oBackbone2_ee7e3224_Rx, PduRSrcPduPduRBswModulesRef=CanIf
            DebugCtrl2_SCIM_BB2_oBackbone2_ee7e3224_Rx_28df1206_Rx (PduRDestPdu):
              PduRDestPduHandleId = 36
              PduRDestPduDirection = RECEIVE
              PduRDestPduRoutingType = API_FORWARDING
              PduRDestPduDataProcessing = IMMEDIATE
              PduRPduLengthHandlingStrategy = UNUSED
              PduRTransmissionConfirmation = false
              PduRDestPduRef = DebugCtrl2_SCIM_BB2_oBackbone2_366d1f91_Rx
              PduRDestPduPduRBswModulesRef = Com
          Debug10_SCIM_BB2_oBackbone2_2c9b76c3_Tx: PduRRoutingPathCommunicationType=COMMUNICATION_INTERFACE
            Debug10_SCIM_BB2_oBackbone2_b0d0056b_Tx (PduRDestPdu):
              PduRDestPduHandleId = 80
              PduRDestPduDirection = TRANSMIT
              PduRDestPduRoutingType = API_FORWARDING
              PduRDestPduDataProcessing = IMMEDIATE
              PduRPduLengthHandlingStrategy = UNUSED
              PduRTransmissionConfirmation = true
              PduRDestPduDataProvision = PDUR_DIRECT
              PduRDestPduRef = Debug10_SCIM_BB2_oBackbone2_b0d0056b_Tx
              PduRDestPduPduRBswModulesRef = CanIf
            PduRSrcPdu_b3a74504 (PduRSrcPdu): PduRSourcePduHandleId=99, PduRSrcPduDirection=TRANSMIT, PduRSrcPduRef=Debug10_SCIM_BB2_oBackbone2_2c9b76c3_Tx, PduRSrcPduPduRBswModulesRef=Com
          VMCU_BB2_93P_oBackbone2_bd7c63c6_Rx: PduRRoutingPathCommunicationType=COMMUNICATION_INTERFACE
            VMCU_BB2_93P_oBackbone2_bd7c63c6_Rx_c9a67c36_Rx (PduRDestPdu):
              PduRDestPduHandleId = 161
              PduRDestPduDirection = RECEIVE
              PduRDestPduRoutingType = API_FORWARDING
              PduRDestPduDataProcessing = IMMEDIATE
              PduRPduLengthHandlingStrategy = UNUSED
              PduRTransmissionConfirmation = false
              PduRDestPduRef = VMCU_BB2_93P_oBackbone2_44d491c1_Rx
              PduRDestPduPduRBswModulesRef = Com
            PduRSrcPdu_c9a67c36 (PduRSrcPdu): PduRSourcePduHandleId=168, PduRSrcPduDirection=RECEIVE, PduRSrcPduRef=VMCU_BB2_93P_oBackbone2_bd7c63c6_Rx, PduRSrcPduPduRBswModulesRef=CanIf
          CIOM_BB2_31S_oBackbone2_0dcb02b0_Tx: PduRRoutingPathCommunicationType=COMMUNICATION_INTERFACE
            PduRSrcPdu_b7330ab5 (PduRSrcPdu): PduRSourcePduHandleId=32, PduRSrcPduDirection=TRANSMIT, PduRSrcPduRef=CIOM_BB2_31S_oBackbone2_0dcb02b0_Tx, PduRSrcPduPduRBswModulesRef=Com
            CIOM_BB2_31S_oBackbone2_5ac877df_Tx (PduRDestPdu):
              PduRDestPduHandleId = 32
              PduRDestPduDirection = TRANSMIT
              PduRDestPduRoutingType = API_FORWARDING
              PduRDestPduDataProcessing = IMMEDIATE
              PduRPduLengthHandlingStrategy = UNUSED
              PduRDestPduDataProvision = PDUR_DIRECT
              PduRTransmissionConfirmation = true
              PduRDestPduRef = CIOM_BB2_31S_oBackbone2_5ac877df_Tx
              PduRDestPduPduRBswModulesRef = CanIf
          IC3_BB2_01S_oBackbone2_ea5b1505_Rx: PduRRoutingPathCommunicationType=COMMUNICATION_INTERFACE
            PduRSrcPdu_4f3328b4 (PduRSrcPdu): PduRSourcePduHandleId=111, PduRSrcPduDirection=RECEIVE, PduRSrcPduRef=IC3_BB2_01S_oBackbone2_ea5b1505_Rx, PduRSrcPduPduRBswModulesRef=CanIf
            IC3_BB2_01S_oBackbone2_ea5b1505_Rx_4f3328b4_Rx (PduRDestPdu):
              PduRDestPduHandleId = 104
              PduRDestPduDirection = RECEIVE
              PduRDestPduRoutingType = API_FORWARDING
              PduRDestPduDataProcessing = IMMEDIATE
              PduRPduLengthHandlingStrategy = UNUSED
              PduRTransmissionConfirmation = false
              PduRDestPduRef = IC3_BB2_01S_oBackbone2_b32667c6_Rx
              PduRDestPduPduRBswModulesRef = Com
          VMCU_BB2_103P_oBackbone2_56952028_Rx: PduRRoutingPathCommunicationType=COMMUNICATION_INTERFACE
            VMCU_BB2_103P_oBackbone2_56952028_Rx_c4eaf174_Rx (PduRDestPdu):
              PduRDestPduHandleId = 169
              PduRDestPduDirection = RECEIVE
              PduRDestPduRoutingType = API_FORWARDING
              PduRDestPduDataProcessing = IMMEDIATE
              PduRPduLengthHandlingStrategy = UNUSED
              PduRTransmissionConfirmation = false
              PduRDestPduRef = VMCU_BB2_103P_oBackbone2_4244ba69_Rx
              PduRDestPduPduRBswModulesRef = Com
            PduRSrcPdu_c4eaf174 (PduRSrcPdu): PduRSourcePduHandleId=176, PduRSrcPduDirection=RECEIVE, PduRSrcPduRef=VMCU_BB2_103P_oBackbone2_56952028_Rx, PduRSrcPduPduRBswModulesRef=CanIf
          VMCU_BB2_86P_oBackbone2_0bdeecb5_Rx: PduRRoutingPathCommunicationType=COMMUNICATION_INTERFACE
            PduRSrcPdu_e1971d41 (PduRSrcPdu): PduRSourcePduHandleId=161, PduRSrcPduDirection=RECEIVE, PduRSrcPduRef=VMCU_BB2_86P_oBackbone2_0bdeecb5_Rx, PduRSrcPduPduRBswModulesRef=CanIf
            VMCU_BB2_86P_oBackbone2_0bdeecb5_Rx_e1971d41_Rx (PduRDestPdu):
              PduRDestPduHandleId = 154
              PduRDestPduDirection = RECEIVE
              PduRDestPduRoutingType = API_FORWARDING
              PduRDestPduDataProcessing = IMMEDIATE
              PduRPduLengthHandlingStrategy = UNUSED
              PduRTransmissionConfirmation = false
              PduRDestPduRef = VMCU_BB2_86P_oBackbone2_c4f4c3a4_Rx
              PduRDestPduPduRBswModulesRef = Com
          Debug2_SCIM_BB2_oBackbone2_30ed01cc_Tx: PduRRoutingPathCommunicationType=COMMUNICATION_INTERFACE
            PduRSrcPdu_2ce36745 (PduRSrcPdu): PduRSourcePduHandleId=91, PduRSrcPduDirection=TRANSMIT, PduRSrcPduRef=Debug2_SCIM_BB2_oBackbone2_30ed01cc_Tx, PduRSrcPduPduRBswModulesRef=Com
            Debug2_SCIM_BB2_oBackbone2_598c99a4_Tx (PduRDestPdu):
              PduRDestPduHandleId = 72
              PduRDestPduDirection = TRANSMIT
              PduRDestPduRoutingType = API_FORWARDING
              PduRDestPduDataProcessing = IMMEDIATE
              PduRPduLengthHandlingStrategy = UNUSED
              PduRDestPduDataProvision = PDUR_DIRECT
              PduRTransmissionConfirmation = true
              PduRDestPduRef = Debug2_SCIM_BB2_oBackbone2_598c99a4_Tx
              PduRDestPduPduRBswModulesRef = CanIf
          Debug8_SCIM_BB2_oBackbone2_f1db09c7_Tx: PduRRoutingPathCommunicationType=COMMUNICATION_INTERFACE
            Debug8_SCIM_BB2_oBackbone2_a6073a94_Tx (PduRDestPdu):
              PduRDestPduHandleId = 78
              PduRDestPduDirection = TRANSMIT
              PduRDestPduRoutingType = API_FORWARDING
              PduRDestPduDataProcessing = IMMEDIATE
              PduRPduLengthHandlingStrategy = UNUSED
              PduRTransmissionConfirmation = true
              PduRDestPduDataProvision = PDUR_DIRECT
              PduRDestPduRef = Debug8_SCIM_BB2_oBackbone2_a6073a94_Tx
              PduRDestPduPduRBswModulesRef = CanIf
            PduRSrcPdu_b2e0da7e (PduRSrcPdu): PduRSourcePduHandleId=97, PduRSrcPduDirection=TRANSMIT, PduRSrcPduRef=Debug8_SCIM_BB2_oBackbone2_f1db09c7_Tx, PduRSrcPduPduRBswModulesRef=Com
          Debug9_SCIM_BB2_oBackbone2_6e018a59_Tx: PduRRoutingPathCommunicationType=COMMUNICATION_INTERFACE
            Debug9_SCIM_BB2_oBackbone2_0943a8d3_Tx (PduRDestPdu):
              PduRDestPduHandleId = 79
              PduRDestPduDirection = TRANSMIT
              PduRDestPduRoutingType = API_FORWARDING
              PduRDestPduDataProcessing = IMMEDIATE
              PduRPduLengthHandlingStrategy = UNUSED
              PduRDestPduDataProvision = PDUR_DIRECT
              PduRTransmissionConfirmation = true
              PduRDestPduRef = Debug9_SCIM_BB2_oBackbone2_0943a8d3_Tx
              PduRDestPduPduRBswModulesRef = CanIf
            PduRSrcPdu_3cfadc61 (PduRSrcPdu): PduRSourcePduHandleId=98, PduRSrcPduDirection=TRANSMIT, PduRSrcPduRef=Debug9_SCIM_BB2_oBackbone2_6e018a59_Tx, PduRSrcPduPduRBswModulesRef=Com
          Debug7_SCIM_BB2_oBackbone2_bdce86e9_Tx: PduRRoutingPathCommunicationType=COMMUNICATION_INTERFACE
            Debug7_SCIM_BB2_oBackbone2_2649483c_Tx (PduRDestPdu):
              PduRDestPduHandleId = 77
              PduRDestPduDirection = TRANSMIT
              PduRDestPduRoutingType = API_FORWARDING
              PduRDestPduDataProcessing = IMMEDIATE
              PduRPduLengthHandlingStrategy = UNUSED
              PduRTransmissionConfirmation = true
              PduRDestPduDataProvision = PDUR_DIRECT
              PduRDestPduRef = Debug7_SCIM_BB2_oBackbone2_2649483c_Tx
              PduRDestPduPduRBswModulesRef = CanIf
            PduRSrcPdu_72be8d01 (PduRSrcPdu): PduRSourcePduHandleId=96, PduRSrcPduDirection=TRANSMIT, PduRSrcPduRef=Debug7_SCIM_BB2_oBackbone2_bdce86e9_Tx, PduRSrcPduPduRBswModulesRef=Com
          Debug13_SCIM_BB2_oBackbone2_5785f420_Tx: PduRRoutingPathCommunicationType=COMMUNICATION_INTERFACE
            Debug13_SCIM_BB2_oBackbone2_9a6cb5e3_Tx (PduRDestPdu):
              PduRDestPduHandleId = 83
              PduRDestPduDirection = TRANSMIT
              PduRDestPduRoutingType = API_FORWARDING
              PduRDestPduDataProcessing = IMMEDIATE
              PduRPduLengthHandlingStrategy = UNUSED
              PduRDestPduDataProvision = PDUR_DIRECT
              PduRTransmissionConfirmation = true
              PduRDestPduRef = Debug13_SCIM_BB2_oBackbone2_9a6cb5e3_Tx
              PduRDestPduPduRBswModulesRef = CanIf
            PduRSrcPdu_e64023a1 (PduRSrcPdu): PduRSourcePduHandleId=102, PduRSrcPduDirection=TRANSMIT, PduRSrcPduRef=Debug13_SCIM_BB2_oBackbone2_5785f420_Tx, PduRSrcPduPduRBswModulesRef=Com
          VMCU_BB2_87P_oBackbone2_fa04e91f_Rx: PduRRoutingPathCommunicationType=COMMUNICATION_INTERFACE
            PduRSrcPdu_820cfccf (PduRSrcPdu): PduRSourcePduHandleId=162, PduRSrcPduDirection=RECEIVE, PduRSrcPduRef=VMCU_BB2_87P_oBackbone2_fa04e91f_Rx, PduRSrcPduPduRBswModulesRef=CanIf
            VMCU_BB2_87P_oBackbone2_fa04e91f_Rx_820cfccf_Rx (PduRDestPdu):
              PduRDestPduHandleId = 155
              PduRDestPduDirection = RECEIVE
              PduRDestPduRoutingType = API_FORWARDING
              PduRDestPduDataProcessing = IMMEDIATE
              PduRPduLengthHandlingStrategy = UNUSED
              PduRTransmissionConfirmation = false
              PduRDestPduRef = VMCU_BB2_87P_oBackbone2_19621a21_Rx
              PduRDestPduPduRBswModulesRef = Com
          VMCU_BB2_88P_oBackbone2_a185cfde_Rx: PduRRoutingPathCommunicationType=COMMUNICATION_INTERFACE
            VMCU_BB2_88P_oBackbone2_a185cfde_Rx_fb44c2d0_Rx (PduRDestPdu):
              PduRDestPduHandleId = 156
              PduRDestPduDirection = RECEIVE
              PduRDestPduRoutingType = API_FORWARDING
              PduRDestPduDataProcessing = IMMEDIATE
              PduRPduLengthHandlingStrategy = UNUSED
              PduRTransmissionConfirmation = false
              PduRDestPduRef = VMCU_BB2_88P_oBackbone2_3e12cf14_Rx
              PduRDestPduPduRBswModulesRef = Com
            PduRSrcPdu_fb44c2d0 (PduRSrcPdu): PduRSourcePduHandleId=163, PduRSrcPduDirection=RECEIVE, PduRSrcPduRef=VMCU_BB2_88P_oBackbone2_a185cfde_Rx, PduRSrcPduPduRBswModulesRef=CanIf
          CIOM_BB2_32S_oBackbone2_b0016e7e_Tx: PduRRoutingPathCommunicationType=TRANSPORT_PROTOCOL
            CIOM_BB2_32S_oBackbone2_93d77f60_Tx (PduRDestPdu):
              PduRDestPduHandleId = 2
              PduRDestPduDirection = TRANSMIT
              PduRDestPduRoutingType = API_FORWARDING
              PduRDestPduDataProcessing = IMMEDIATE
              PduRPduLengthHandlingStrategy = UNUSED
              PduRDestPduRef = CIOM_BB2_32S_oBackbone2_93d77f60_Tx
              PduRDestPduPduRBswModulesRef = CanTp
            PduRSrcPdu_fcfec5f9 (PduRSrcPdu): PduRSourcePduHandleId=33, PduRSrcPduDirection=TRANSMIT, PduRSrcPduRef=CIOM_BB2_32S_oBackbone2_b0016e7e_Tx, PduRSrcPduPduRBswModulesRef=Com
          VMCU_BB2_92P_oBackbone2_4ca6666c_Rx: PduRRoutingPathCommunicationType=COMMUNICATION_INTERFACE
            PduRSrcPdu_5e990be0 (PduRSrcPdu): PduRSourcePduHandleId=167, PduRSrcPduDirection=RECEIVE, PduRSrcPduRef=VMCU_BB2_92P_oBackbone2_4ca6666c_Rx, PduRSrcPduPduRBswModulesRef=CanIf
            VMCU_BB2_92P_oBackbone2_4ca6666c_Rx_5e990be0_Rx (PduRDestPdu):
              PduRDestPduHandleId = 160
              PduRDestPduDirection = RECEIVE
              PduRDestPduRoutingType = API_FORWARDING
              PduRDestPduDataProcessing = IMMEDIATE
              PduRPduLengthHandlingStrategy = UNUSED
              PduRTransmissionConfirmation = false
              PduRDestPduRef = VMCU_BB2_92P_oBackbone2_99424844_Rx
              PduRDestPduPduRBswModulesRef = Com
          VMCU_BB2_119P_oBackbone2_bbb6899a_Rx: PduRRoutingPathCommunicationType=COMMUNICATION_INTERFACE
            VMCU_BB2_119P_oBackbone2_bbb6899a_Rx_42c2ab6b_Rx (PduRDestPdu):
              PduRDestPduHandleId = 176
              PduRDestPduDirection = RECEIVE
              PduRDestPduRoutingType = API_FORWARDING
              PduRDestPduDataProcessing = IMMEDIATE
              PduRPduLengthHandlingStrategy = UNUSED
              PduRTransmissionConfirmation = false
              PduRDestPduRef = VMCU_BB2_119P_oBackbone2_e5143d39_Rx
              PduRDestPduPduRBswModulesRef = Com
            PduRSrcPdu_42c2ab6b (PduRSrcPdu): PduRSourcePduHandleId=183, PduRSrcPduDirection=RECEIVE, PduRSrcPduRef=VMCU_BB2_119P_oBackbone2_bbb6899a_Rx, PduRSrcPduPduRBswModulesRef=CanIf
          Debug16_SCIM_BB2_oBackbone2_daa67305_Tx: PduRRoutingPathCommunicationType=COMMUNICATION_INTERFACE
            PduRSrcPdu_83858552 (PduRSrcPdu): PduRSourcePduHandleId=105, PduRSrcPduDirection=TRANSMIT, PduRSrcPduRef=Debug16_SCIM_BB2_oBackbone2_daa67305_Tx, PduRSrcPduPduRBswModulesRef=Com
            Debug16_SCIM_BB2_oBackbone2_e5a9647b_Tx (PduRDestPdu):
              PduRDestPduHandleId = 86
              PduRDestPduDirection = TRANSMIT
              PduRDestPduRoutingType = API_FORWARDING
              PduRDestPduDataProcessing = IMMEDIATE
              PduRPduLengthHandlingStrategy = UNUSED
              PduRDestPduDataProvision = PDUR_DIRECT
              PduRTransmissionConfirmation = true
              PduRDestPduRef = Debug16_SCIM_BB2_oBackbone2_e5a9647b_Tx
              PduRDestPduPduRBswModulesRef = CanIf
          DebugCtrl4_SCIM_BB2_oBackbone2_bb075334_Rx: PduRRoutingPathCommunicationType=COMMUNICATION_INTERFACE
            DebugCtrl4_SCIM_BB2_oBackbone2_bb075334_Rx_b399288b_Rx (PduRDestPdu):
              PduRDestPduHandleId = 38
              PduRDestPduDirection = RECEIVE
              PduRDestPduRoutingType = API_FORWARDING
              PduRDestPduDataProcessing = IMMEDIATE
              PduRPduLengthHandlingStrategy = UNUSED
              PduRTransmissionConfirmation = false
              PduRDestPduRef = DebugCtrl4_SCIM_BB2_oBackbone2_c0501a57_Rx
              PduRDestPduPduRBswModulesRef = Com
            PduRSrcPdu_b399288b (PduRSrcPdu): PduRSourcePduHandleId=45, PduRSrcPduDirection=RECEIVE, PduRSrcPduRef=DebugCtrl4_SCIM_BB2_oBackbone2_bb075334_Rx, PduRSrcPduPduRBswModulesRef=CanIf
          Debug24_SCIM_BB2_oBackbone2_071adf38_Tx: PduRRoutingPathCommunicationType=COMMUNICATION_INTERFACE
            PduRSrcPdu_298e7c8d (PduRSrcPdu): PduRSourcePduHandleId=112, PduRSrcPduDirection=TRANSMIT, PduRSrcPduRef=Debug24_SCIM_BB2_oBackbone2_071adf38_Tx, PduRSrcPduPduRBswModulesRef=Com
            Debug24_SCIM_BB2_oBackbone2_8318f116_Tx (PduRDestPdu):
              PduRDestPduHandleId = 93
              PduRDestPduDirection = TRANSMIT
              PduRDestPduRoutingType = API_FORWARDING
              PduRDestPduDataProcessing = IMMEDIATE
              PduRPduLengthHandlingStrategy = UNUSED
              PduRDestPduDataProvision = PDUR_DIRECT
              PduRTransmissionConfirmation = true
              PduRDestPduRef = Debug24_SCIM_BB2_oBackbone2_8318f116_Tx
              PduRDestPduPduRBswModulesRef = CanIf
          Debug14_SCIM_BB2_oBackbone2_3e627278_Tx: PduRRoutingPathCommunicationType=COMMUNICATION_INTERFACE
            Debug14_SCIM_BB2_oBackbone2_605146b4_Tx (PduRDestPdu):
              PduRDestPduHandleId = 84
              PduRDestPduDirection = TRANSMIT
              PduRDestPduRoutingType = API_FORWARDING
              PduRDestPduDataProcessing = IMMEDIATE
              PduRPduLengthHandlingStrategy = UNUSED
              PduRDestPduDataProvision = PDUR_DIRECT
              PduRTransmissionConfirmation = true
              PduRDestPduRef = Debug14_SCIM_BB2_oBackbone2_605146b4_Tx
              PduRDestPduPduRBswModulesRef = CanIf
            PduRSrcPdu_af613944 (PduRSrcPdu): PduRSourcePduHandleId=103, PduRSrcPduDirection=TRANSMIT, PduRSrcPduRef=Debug14_SCIM_BB2_oBackbone2_3e627278_Tx, PduRSrcPduPduRBswModulesRef=Com
          DebugCtrl5_SCIM_BB2_oBackbone2_1443c173_Rx: PduRRoutingPathCommunicationType=COMMUNICATION_INTERFACE
            DebugCtrl5_SCIM_BB2_oBackbone2_1443c173_Rx_6c01495b_Rx (PduRDestPdu):
              PduRDestPduHandleId = 39
              PduRDestPduDirection = RECEIVE
              PduRDestPduRoutingType = API_FORWARDING
              PduRDestPduDataProcessing = IMMEDIATE
              PduRPduLengthHandlingStrategy = UNUSED
              PduRTransmissionConfirmation = false
              PduRDestPduRef = DebugCtrl5_SCIM_BB2_oBackbone2_5f8a99c9_Rx
              PduRDestPduPduRBswModulesRef = Com
            PduRSrcPdu_6c01495b (PduRSrcPdu): PduRSourcePduHandleId=46, PduRSrcPduDirection=RECEIVE, PduRSrcPduRef=DebugCtrl5_SCIM_BB2_oBackbone2_1443c173_Rx, PduRSrcPduPduRBswModulesRef=CanIf
          Debug20_SCIM_BB2_oBackbone2_15e3db83_Tx: PduRRoutingPathCommunicationType=COMMUNICATION_INTERFACE
            Debug20_SCIM_BB2_oBackbone2_5399b2c9_Tx (PduRDestPdu):
              PduRDestPduHandleId = 90
              PduRDestPduDirection = TRANSMIT
              PduRDestPduRoutingType = API_FORWARDING
              PduRDestPduDataProcessing = IMMEDIATE
              PduRPduLengthHandlingStrategy = UNUSED
              PduRDestPduDataProvision = PDUR_DIRECT
              PduRTransmissionConfirmation = true
              PduRDestPduRef = Debug20_SCIM_BB2_oBackbone2_5399b2c9_Tx
              PduRDestPduPduRBswModulesRef = CanIf
            PduRSrcPdu_34c2207b (PduRSrcPdu): PduRSourcePduHandleId=109, PduRSrcPduDirection=TRANSMIT, PduRSrcPduRef=Debug20_SCIM_BB2_oBackbone2_15e3db83_Tx, PduRSrcPduPduRBswModulesRef=Com
          Debug26_SCIM_BB2_oBackbone2_e3dede45_Tx: PduRRoutingPathCommunicationType=COMMUNICATION_INTERFACE
            PduRSrcPdu_3e38f0d7 (PduRSrcPdu): PduRSourcePduHandleId=114, PduRSrcPduDirection=TRANSMIT, PduRSrcPduRef=Debug26_SCIM_BB2_oBackbone2_e3dede45_Tx, PduRSrcPduPduRBswModulesRef=Com
            Debug26_SCIM_BB2_oBackbone2_06e0d3d9_Tx (PduRDestPdu):
              PduRDestPduHandleId = 95
              PduRDestPduDirection = TRANSMIT
              PduRDestPduRoutingType = API_FORWARDING
              PduRDestPduDataProcessing = IMMEDIATE
              PduRPduLengthHandlingStrategy = UNUSED
              PduRDestPduDataProvision = PDUR_DIRECT
              PduRTransmissionConfirmation = true
              PduRDestPduRef = Debug26_SCIM_BB2_oBackbone2_06e0d3d9_Tx
              PduRDestPduPduRBswModulesRef = CanIf
          Debug17_SCIM_BB2_oBackbone2_457cf09b_Tx: PduRRoutingPathCommunicationType=COMMUNICATION_INTERFACE
            PduRSrcPdu_3944ee2e (PduRSrcPdu): PduRSourcePduHandleId=106, PduRSrcPduDirection=TRANSMIT, PduRSrcPduRef=Debug17_SCIM_BB2_oBackbone2_457cf09b_Tx, PduRSrcPduPduRBswModulesRef=Com
            Debug17_SCIM_BB2_oBackbone2_4aedf63c_Tx (PduRDestPdu):
              PduRDestPduHandleId = 87
              PduRDestPduDirection = TRANSMIT
              PduRDestPduRoutingType = API_FORWARDING
              PduRDestPduDataProcessing = IMMEDIATE
              PduRPduLengthHandlingStrategy = UNUSED
              PduRTransmissionConfirmation = true
              PduRDestPduDataProvision = PDUR_DIRECT
              PduRDestPduRef = Debug17_SCIM_BB2_oBackbone2_4aedf63c_Tx
              PduRDestPduPduRBswModulesRef = CanIf
          DebugCtrl8_SCIM_BB2_oBackbone2_11f59114_Rx: PduRRoutingPathCommunicationType=COMMUNICATION_INTERFACE
            PduRSrcPdu_040ccb6e (PduRSrcPdu): PduRSourcePduHandleId=49, PduRSrcPduDirection=RECEIVE, PduRSrcPduRef=DebugCtrl8_SCIM_BB2_oBackbone2_11f59114_Rx, PduRSrcPduPduRBswModulesRef=CanIf
            DebugCtrl8_SCIM_BB2_oBackbone2_11f59114_Rx_040ccb6e_Rx (PduRDestPdu):
              PduRDestPduHandleId = 42
              PduRDestPduDirection = RECEIVE
              PduRDestPduRoutingType = API_FORWARDING
              PduRDestPduDataProcessing = IMMEDIATE
              PduRPduLengthHandlingStrategy = UNUSED
              PduRTransmissionConfirmation = false
              PduRDestPduRef = DebugCtrl8_SCIM_BB2_oBackbone2_f75b179a_Rx
              PduRDestPduPduRBswModulesRef = Com
          Debug21_SCIM_BB2_oBackbone2_8a39581d_Tx: PduRRoutingPathCommunicationType=COMMUNICATION_INTERFACE
            Debug21_SCIM_BB2_oBackbone2_fcdd208e_Tx (PduRDestPdu):
              PduRDestPduHandleId = 91
              PduRDestPduDirection = TRANSMIT
              PduRDestPduRoutingType = API_FORWARDING
              PduRDestPduDataProcessing = IMMEDIATE
              PduRPduLengthHandlingStrategy = UNUSED
              PduRDestPduDataProvision = PDUR_DIRECT
              PduRTransmissionConfirmation = true
              PduRDestPduRef = Debug21_SCIM_BB2_oBackbone2_fcdd208e_Tx
              PduRDestPduPduRBswModulesRef = CanIf
            PduRSrcPdu_2a7710f3 (PduRSrcPdu): PduRSourcePduHandleId=110, PduRSrcPduDirection=TRANSMIT, PduRSrcPduRef=Debug21_SCIM_BB2_oBackbone2_8a39581d_Tx, PduRSrcPduPduRBswModulesRef=Com
          Debug22_SCIM_BB2_oBackbone2_f127dafe_Tx: PduRRoutingPathCommunicationType=COMMUNICATION_INTERFACE
            Debug22_SCIM_BB2_oBackbone2_d6619006_Tx (PduRDestPdu):
              PduRDestPduHandleId = 92
              PduRDestPduDirection = TRANSMIT
              PduRDestPduRoutingType = API_FORWARDING
              PduRDestPduDataProcessing = IMMEDIATE
              PduRPduLengthHandlingStrategy = UNUSED
              PduRDestPduDataProvision = PDUR_DIRECT
              PduRTransmissionConfirmation = true
              PduRDestPduRef = Debug22_SCIM_BB2_oBackbone2_d6619006_Tx
              PduRDestPduPduRBswModulesRef = CanIf
            PduRSrcPdu_7ce1187f (PduRSrcPdu): PduRSourcePduHandleId=111, PduRSrcPduDirection=TRANSMIT, PduRSrcPduRef=Debug22_SCIM_BB2_oBackbone2_f127dafe_Tx, PduRSrcPduPduRBswModulesRef=Com
          DebugCtrl7_SCIM_BB2_oBackbone2_91bbe3bc_Rx: PduRRoutingPathCommunicationType=COMMUNICATION_INTERFACE
            PduRSrcPdu_d02c5230 (PduRSrcPdu): PduRSourcePduHandleId=48, PduRSrcPduDirection=RECEIVE, PduRSrcPduRef=DebugCtrl7_SCIM_BB2_oBackbone2_91bbe3bc_Rx, PduRSrcPduPduRBswModulesRef=CanIf
            DebugCtrl7_SCIM_BB2_oBackbone2_91bbe3bc_Rx_d02c5230_Rx (PduRDestPdu):
              PduRDestPduHandleId = 41
              PduRDestPduDirection = RECEIVE
              PduRDestPduRoutingType = API_FORWARDING
              PduRDestPduDataProcessing = IMMEDIATE
              PduRPduLengthHandlingStrategy = UNUSED
              PduRTransmissionConfirmation = false
              PduRDestPduRef = DebugCtrl7_SCIM_BB2_oBackbone2_bb4e98b4_Rx
              PduRDestPduPduRBswModulesRef = Com
          DebugCtrl3_SCIM_BB2_oBackbone2_413aa063_Rx: PduRRoutingPathCommunicationType=COMMUNICATION_INTERFACE
            DebugCtrl3_SCIM_BB2_oBackbone2_413aa063_Rx_5f913e39_Rx (PduRDestPdu):
              PduRDestPduHandleId = 37
              PduRDestPduDirection = RECEIVE
              PduRDestPduRoutingType = API_FORWARDING
              PduRDestPduDataProcessing = IMMEDIATE
              PduRPduLengthHandlingStrategy = UNUSED
              PduRTransmissionConfirmation = false
              PduRDestPduRef = DebugCtrl3_SCIM_BB2_oBackbone2_a9b79c0f_Rx
              PduRDestPduPduRBswModulesRef = Com
            PduRSrcPdu_5f913e39 (PduRSrcPdu): PduRSourcePduHandleId=44, PduRSrcPduDirection=RECEIVE, PduRSrcPduRef=DebugCtrl3_SCIM_BB2_oBackbone2_413aa063_Rx, PduRSrcPduPduRBswModulesRef=CanIf
          DebugCtrl6_SCIM_BB2_oBackbone2_3eff71fb_Rx: PduRRoutingPathCommunicationType=COMMUNICATION_INTERFACE
            PduRSrcPdu_d9967bb3 (PduRSrcPdu): PduRSourcePduHandleId=47, PduRSrcPduDirection=RECEIVE, PduRSrcPduRef=DebugCtrl6_SCIM_BB2_oBackbone2_3eff71fb_Rx, PduRSrcPduPduRBswModulesRef=CanIf
            DebugCtrl6_SCIM_BB2_oBackbone2_3eff71fb_Rx_d9967bb3_Rx (PduRDestPdu):
              PduRDestPduHandleId = 40
              PduRDestPduDirection = RECEIVE
              PduRDestPduRoutingType = API_FORWARDING
              PduRDestPduDataProcessing = IMMEDIATE
              PduRPduLengthHandlingStrategy = UNUSED
              PduRTransmissionConfirmation = false
              PduRDestPduRef = DebugCtrl6_SCIM_BB2_oBackbone2_24941b2a_Rx
              PduRDestPduPduRBswModulesRef = Com
          Debug25_SCIM_BB2_oBackbone2_98c05ca6_Tx: PduRRoutingPathCommunicationType=COMMUNICATION_INTERFACE
            PduRSrcPdu_27718bf6 (PduRSrcPdu): PduRSourcePduHandleId=113, PduRSrcPduDirection=TRANSMIT, PduRSrcPduRef=Debug25_SCIM_BB2_oBackbone2_98c05ca6_Tx, PduRSrcPduPduRBswModulesRef=Com
            Debug25_SCIM_BB2_oBackbone2_2c5c6351_Tx (PduRDestPdu):
              PduRDestPduHandleId = 94
              PduRDestPduDirection = TRANSMIT
              PduRDestPduRoutingType = API_FORWARDING
              PduRDestPduDataProcessing = IMMEDIATE
              PduRPduLengthHandlingStrategy = UNUSED
              PduRDestPduDataProvision = PDUR_DIRECT
              PduRTransmissionConfirmation = true
              PduRDestPduRef = Debug25_SCIM_BB2_oBackbone2_2c5c6351_Tx
              PduRDestPduPduRBswModulesRef = CanIf
          DebugCtrl9_SCIM_BB2_oBackbone2_beb10353_Rx: PduRRoutingPathCommunicationType=COMMUNICATION_INTERFACE
            PduRSrcPdu_0afce3dd (PduRSrcPdu): PduRSourcePduHandleId=50, PduRSrcPduDirection=RECEIVE, PduRSrcPduRef=DebugCtrl9_SCIM_BB2_oBackbone2_beb10353_Rx, PduRSrcPduPduRBswModulesRef=CanIf
            DebugCtrl9_SCIM_BB2_oBackbone2_beb10353_Rx_0afce3dd_Rx (PduRDestPdu):
              PduRDestPduHandleId = 43
              PduRDestPduDirection = RECEIVE
              PduRDestPduRoutingType = API_FORWARDING
              PduRDestPduDataProcessing = IMMEDIATE
              PduRPduLengthHandlingStrategy = UNUSED
              PduRTransmissionConfirmation = false
              PduRDestPduRef = DebugCtrl9_SCIM_BB2_oBackbone2_68819404_Rx
              PduRDestPduPduRBswModulesRef = Com
          Debug27_SCIM_BB2_oBackbone2_7c045ddb_Tx: PduRRoutingPathCommunicationType=COMMUNICATION_INTERFACE
            PduRSrcPdu_0709a8dd (PduRSrcPdu): PduRSourcePduHandleId=115, PduRSrcPduDirection=TRANSMIT, PduRSrcPduRef=Debug27_SCIM_BB2_oBackbone2_7c045ddb_Tx, PduRSrcPduPduRBswModulesRef=Com
            Debug27_SCIM_BB2_oBackbone2_a9a4419e_Tx (PduRDestPdu):
              PduRDestPduHandleId = 96
              PduRDestPduDirection = TRANSMIT
              PduRDestPduRoutingType = API_FORWARDING
              PduRDestPduDataProcessing = IMMEDIATE
              PduRPduLengthHandlingStrategy = UNUSED
              PduRDestPduDataProvision = PDUR_DIRECT
              PduRTransmissionConfirmation = true
              PduRDestPduRef = Debug27_SCIM_BB2_oBackbone2_a9a4419e_Tx
              PduRDestPduPduRBswModulesRef = CanIf
          Debug18_SCIM_BB2_oBackbone2_09697fb5_Tx: PduRRoutingPathCommunicationType=COMMUNICATION_INTERFACE
            Debug18_SCIM_BB2_oBackbone2_caa38494_Tx (PduRDestPdu):
              PduRDestPduHandleId = 88
              PduRDestPduDirection = TRANSMIT
              PduRDestPduRoutingType = API_FORWARDING
              PduRDestPduDataProcessing = IMMEDIATE
              PduRPduLengthHandlingStrategy = UNUSED
              PduRDestPduDataProvision = PDUR_DIRECT
              PduRTransmissionConfirmation = true
              PduRDestPduRef = Debug18_SCIM_BB2_oBackbone2_caa38494_Tx
              PduRDestPduPduRBswModulesRef = CanIf
            PduRSrcPdu_ea683547 (PduRSrcPdu): PduRSourcePduHandleId=107, PduRSrcPduDirection=TRANSMIT, PduRSrcPduRef=Debug18_SCIM_BB2_oBackbone2_09697fb5_Tx, PduRSrcPduPduRBswModulesRef=Com
          Debug15_SCIM_BB2_oBackbone2_a1b8f1e6_Tx: PduRRoutingPathCommunicationType=COMMUNICATION_INTERFACE
            Debug15_SCIM_BB2_oBackbone2_cf15d4f3_Tx (PduRDestPdu):
              PduRDestPduHandleId = 85
              PduRDestPduDirection = TRANSMIT
              PduRDestPduRoutingType = API_FORWARDING
              PduRDestPduDataProcessing = IMMEDIATE
              PduRPduLengthHandlingStrategy = UNUSED
              PduRDestPduDataProvision = PDUR_DIRECT
              PduRTransmissionConfirmation = true
              PduRDestPduRef = Debug15_SCIM_BB2_oBackbone2_cf15d4f3_Tx
              PduRDestPduPduRBswModulesRef = CanIf
            PduRSrcPdu_16fa9ce7 (PduRSrcPdu): PduRSourcePduHandleId=104, PduRSrcPduDirection=TRANSMIT, PduRSrcPduRef=Debug15_SCIM_BB2_oBackbone2_a1b8f1e6_Tx, PduRSrcPduPduRBswModulesRef=Com
          Debug19_SCIM_BB2_oBackbone2_96b3fc2b_Tx: PduRRoutingPathCommunicationType=COMMUNICATION_INTERFACE
            PduRSrcPdu_5304476e (PduRSrcPdu): PduRSourcePduHandleId=108, PduRSrcPduDirection=TRANSMIT, PduRSrcPduRef=Debug19_SCIM_BB2_oBackbone2_96b3fc2b_Tx, PduRSrcPduPduRBswModulesRef=Com
            Debug19_SCIM_BB2_oBackbone2_65e716d3_Tx (PduRDestPdu):
              PduRDestPduHandleId = 89
              PduRDestPduDirection = TRANSMIT
              PduRDestPduRoutingType = API_FORWARDING
              PduRDestPduDataProcessing = IMMEDIATE
              PduRPduLengthHandlingStrategy = UNUSED
              PduRDestPduDataProvision = PDUR_DIRECT
              PduRTransmissionConfirmation = true
              PduRDestPduRef = Debug19_SCIM_BB2_oBackbone2_65e716d3_Tx
              PduRDestPduPduRBswModulesRef = CanIf
          Debug28_SCIM_BB2_oBackbone2_3011d2f5_Tx: PduRRoutingPathCommunicationType=COMMUNICATION_INTERFACE
            PduRSrcPdu_253fe2a1 (PduRSrcPdu): PduRSourcePduHandleId=116, PduRSrcPduDirection=TRANSMIT, PduRSrcPduRef=Debug28_SCIM_BB2_oBackbone2_3011d2f5_Tx, PduRSrcPduPduRBswModulesRef=Com
            Debug28_SCIM_BB2_oBackbone2_29ea3336_Tx (PduRDestPdu):
              PduRDestPduHandleId = 97
              PduRDestPduDirection = TRANSMIT
              PduRDestPduRoutingType = API_FORWARDING
              PduRDestPduDataProcessing = IMMEDIATE
              PduRPduLengthHandlingStrategy = UNUSED
              PduRTransmissionConfirmation = true
              PduRDestPduDataProvision = PDUR_DIRECT
              PduRDestPduRef = Debug28_SCIM_BB2_oBackbone2_29ea3336_Tx
              PduRDestPduPduRBswModulesRef = CanIf
          BBM_BB2_03S_CIOM_oBackbone2_a3c4774b_Rx: PduRRoutingPathCommunicationType=TRANSPORT_PROTOCOL
            BBM_BB2_03S_CIOM_oBackbone2_a3c4774b_Rx_bd0d068c_Rx (PduRDestPdu):
              PduRDestPduHandleId = 3
              PduRDestPduDirection = RECEIVE
              PduRDestPduRoutingType = API_FORWARDING
              PduRDestPduDataProcessing = IMMEDIATE
              PduRPduLengthHandlingStrategy = UNUSED
              PduRDestPduRef = BBM_BB2_03S_CIOM_oBackbone2_d5047985_Rx
              PduRDestPduPduRBswModulesRef = Com
            PduRSrcPdu_bd0d068c (PduRSrcPdu): PduRSourcePduHandleId=3, PduRSrcPduDirection=RECEIVE, PduRSrcPduRef=BBM_BB2_03S_CIOM_oBackbone2_a3c4774b_Rx, PduRSrcPduPduRBswModulesRef=CanTp
          CIOM_BB2_12S_oBackbone2_516faad3_Tx: PduRRoutingPathCommunicationType=TRANSPORT_PROTOCOL
            CIOM_BB2_12S_oBackbone2_fe325e86_Tx (PduRDestPdu):
              PduRDestPduHandleId = 0
              PduRDestPduDirection = TRANSMIT
              PduRDestPduRoutingType = API_FORWARDING
              PduRDestPduDataProcessing = IMMEDIATE
              PduRPduLengthHandlingStrategy = UNUSED
              PduRDestPduRef = CIOM_BB2_12S_oBackbone2_fe325e86_Tx
              PduRDestPduPduRBswModulesRef = CanTp
            PduRSrcPdu_973cde10 (PduRSrcPdu): PduRSourcePduHandleId=22, PduRSrcPduDirection=TRANSMIT, PduRSrcPduRef=CIOM_BB2_12S_oBackbone2_516faad3_Tx, PduRSrcPduPduRBswModulesRef=Com
          CIOM_BB2_13S_oBackbone2_8cf97356_Tx: PduRRoutingPathCommunicationType=TRANSPORT_PROTOCOL
            CIOM_BB2_13S_oBackbone2_0fe85b2c_Tx (PduRDestPdu):
              PduRDestPduHandleId = 1
              PduRDestPduDirection = TRANSMIT
              PduRDestPduRoutingType = API_FORWARDING
              PduRDestPduDataProcessing = IMMEDIATE
              PduRPduLengthHandlingStrategy = UNUSED
              PduRDestPduRef = CIOM_BB2_13S_oBackbone2_0fe85b2c_Tx
              PduRDestPduPduRBswModulesRef = CanTp
            PduRSrcPdu_89789648 (PduRSrcPdu): PduRSourcePduHandleId=23, PduRSrcPduDirection=TRANSMIT, PduRSrcPduRef=CIOM_BB2_13S_oBackbone2_8cf97356_Tx, PduRSrcPduPduRBswModulesRef=Com
      PduRTxBufferTable: PduRMaxTxBufferNumber=4
        4 x PduRTxBuffer, all with PduRPduMaxLength=32:
          PduRTxBuffer
          PduRTxBuffer_{1..3}
    9 x PduRBswModules, all with PduRCancelReceive=false, PduRChangeParameterRequestApi=false:
      LinTp: PduRCancelTransmit=false, PduRCommunicationInterface=false, PduRLowerModule=true, PduRTransportProtocol=true, PduRTriggertransmit=false, PduRTxConfirmation=false, PduRUpperModule=false, PduRUseTag=false, PduRBswModuleRef=LinTp
      CanIf: PduRCancelTransmit=true, PduRCommunicationInterface=true, PduRLowerModule=true, PduRTransportProtocol=false, PduRTriggertransmit=false, PduRTxConfirmation=true, PduRUpperModule=false, PduRUseTag=false, PduRBswModuleRef=CanIf
      Com: PduRCancelTransmit=false, PduRCommunicationInterface=true, PduRLowerModule=false, PduRTransportProtocol=true, PduRTriggertransmit=true, PduRTxConfirmation=true, PduRUpperModule=true, PduRUseTag=false, PduRBswModuleRef=Com
      J1939Tp: PduRCancelTransmit=false, PduRCommunicationInterface=false, PduRLowerModule=true, PduRTransportProtocol=true, PduRTriggertransmit=false, PduRTxConfirmation=false, PduRUpperModule=false, PduRUseTag=false, PduRBswModuleRef=J1939Tp
      LinIf: PduRCancelTransmit=false, PduRCommunicationInterface=true, PduRLowerModule=true, PduRTransportProtocol=false, PduRTriggertransmit=true, PduRTxConfirmation=true, PduRUpperModule=false, PduRUseTag=false, PduRBswModuleRef=LinIf
      J1939Rm: PduRCancelTransmit=false, PduRCommunicationInterface=true, PduRLowerModule=false, PduRTransportProtocol=false, PduRTriggertransmit=false, PduRTxConfirmation=true, PduRUpperModule=true, PduRUseTag=false, PduRBswModuleRef=J1939Rm
      CanTp: PduRCancelTransmit=true, PduRCommunicationInterface=false, PduRLowerModule=true, PduRTransportProtocol=true, PduRTriggertransmit=false, PduRTxConfirmation=false, PduRUpperModule=false, PduRUseTag=false, PduRBswModuleRef=CanTp
      Dcm: PduRCancelTransmit=true, PduRCommunicationInterface=true, PduRLowerModule=false, PduRTransportProtocol=true, PduRTriggertransmit=false, PduRTxConfirmation=true, PduRUpperModule=true, PduRUseTag=true, PduRBswModuleRef=Dcm
      Cdd: PduRCancelTransmit=false, PduRCommunicationInterface=false, PduRLowerModule=false, PduRTransportProtocol=true, PduRTriggertransmit=false, PduRTxConfirmation=false, PduRUpperModule=true, PduRUseTag=false, PduRBswModuleRef=Cdd
