AUTOSAR XML (schema 4-2-1)
package /ActiveEcuC
  module config Os: implementation-config-variant=VARIANT-PRE-COMPILE, module-description=Os_Impl
    OsPublishedInformation: OsKernelVersion=7, OsPlatformName=PowerPC
      MPC574xC1 (OsDerivativeInformation):
        OsMpuAlignment = 32
        OsStackAlignment = 8
        OsExceptionVectorTableAlignment = 256
        OsInterruptVectorTableAlignment = 4096
        OsHardwareManuals = Freescale Semiconductor MPC5746C Reference Manual, Rev. 2.1, 06/2015, chapters Core description, MC_ME, INTC, PIT, STM, SMPU, SEMA4
        OsCoreIdSprNumber = 286
        3 x OsHardwareTimer, all with OsHardwareTimerSize=32:
          STM0: OsHardwareTimerId=0, OsHardwareTimerBaseAddress=4228284416, OsHardwareTimerUnit=FRT, OsHardwareTimerType=STM
            4 x OsHardwareTimerChannel:
              STM0_CH0: OsHardwareTimerChannelId=0, OsHardwareTimerChannelIntSource=36, OsHardwareTimerChannelOffset=16
              STM0_CH1: OsHardwareTimerChannelId=1, OsHardwareTimerChannelIntSource=37, OsHardwareTimerChannelOffset=32
              STM0_CH2: OsHardwareTimerChannelId=2, OsHardwareTimerChannelIntSource=38, OsHardwareTimerChannelOffset=48
              STM0_CH3: OsHardwareTimerChannelId=3, OsHardwareTimerChannelIntSource=39, OsHardwareTimerChannelOffset=64
          PIT0: OsHardwareTimerId=0, OsHardwareTimerBaseAddress=4294459392, OsHardwareTimerUnit=PIT, OsHardwareTimerType=PIT
            16 x OsHardwareTimerChannel:
              PIT0_CH10: OsHardwareTimerChannelId=10, OsHardwareTimerChannelIntSource=236, OsHardwareTimerChannelOffset=416
              PIT0_CH11: OsHardwareTimerChannelId=11, OsHardwareTimerChannelIntSource=237, OsHardwareTimerChannelOffset=432
              PIT0_CH12: OsHardwareTimerChannelId=12, OsHardwareTimerChannelIntSource=238, OsHardwareTimerChannelOffset=448
              PIT0_CH13: OsHardwareTimerChannelId=13, OsHardwareTimerChannelIntSource=239, OsHardwareTimerChannelOffset=464
              PIT0_CH9: OsHardwareTimerChannelId=9, OsHardwareTimerChannelIntSource=235, OsHardwareTimerChannelOffset=400
              PIT0_CH5: OsHardwareTimerChannelId=5, OsHardwareTimerChannelIntSource=231, OsHardwareTimerChannelOffset=336
              PIT0_CH14: OsHardwareTimerChannelId=14, OsHardwareTimerChannelIntSource=240, OsHardwareTimerChannelOffset=480
              PIT0_CH6: OsHardwareTimerChannelId=6, OsHardwareTimerChannelIntSource=232, OsHardwareTimerChannelOffset=352
              PIT0_CH15: OsHardwareTimerChannelId=15, OsHardwareTimerChannelIntSource=241, OsHardwareTimerChannelOffset=496
              PIT0_CH7: OsHardwareTimerChannelId=7, OsHardwareTimerChannelIntSource=233, OsHardwareTimerChannelOffset=368
              PIT0_CH8: OsHardwareTimerChannelId=8, OsHardwareTimerChannelIntSource=234, OsHardwareTimerChannelOffset=384
              PIT0_CH1: OsHardwareTimerChannelId=1, OsHardwareTimerChannelIntSource=227, OsHardwareTimerChannelOffset=272
              PIT0_CH2: OsHardwareTimerChannelId=2, OsHardwareTimerChannelIntSource=228, OsHardwareTimerChannelOffset=288
              PIT0_CH3: OsHardwareTimerChannelId=3, OsHardwareTimerChannelIntSource=229, OsHardwareTimerChannelOffset=304
              PIT0_CH4: OsHardwareTimerChannelId=4, OsHardwareTimerChannelIntSource=230, OsHardwareTimerChannelOffset=320
              PIT0_CH0: OsHardwareTimerChannelId=0, OsHardwareTimerChannelIntSource=226, OsHardwareTimerChannelOffset=256
          STM1: OsHardwareTimerId=1, OsHardwareTimerBaseAddress=4228300800, OsHardwareTimerUnit=FRT, OsHardwareTimerType=STM
            4 x OsHardwareTimerChannel:
              STM1_CH0: OsHardwareTimerChannelId=0, OsHardwareTimerChannelIntSource=40, OsHardwareTimerChannelOffset=16
              STM1_CH1: OsHardwareTimerChannelId=1, OsHardwareTimerChannelIntSource=41, OsHardwareTimerChannelOffset=32
              STM1_CH2: OsHardwareTimerChannelId=2, OsHardwareTimerChannelIntSource=42, OsHardwareTimerChannelOffset=48
              STM1_CH3: OsHardwareTimerChannelId=3, OsHardwareTimerChannelIntSource=43, OsHardwareTimerChannelOffset=64
        INTC0 (OsSystemIntCtrl):
          OsSystemIntCtrlBaseAddress = 4228120576
          OsSystemIntCtrlMaxPrios = 15
          OsSystemIntCtrlMaxSources = 765
          OsSystemIntCtrlPrioOrder = ASC
          OsSystemIntCtrlType = 4C
        OsModeEntryModule: OsModeEntryModuleBaseAddress=4294672384
        OsDSMCModule
        CORE0 (OsPhysicalCore):
          OsPhysicalCoreId = 0
          OsPhysicalCoreDefaultEntrySymbol = _start_c0
          OsPhysicalCoreType = GPR32
          OsPhysicalCoreExceptionSources = 12
          OsPhysicalCoreIsAutostart = true
          OsPhysicalCoreMasterStartAllowed = true
          OsPhysicalCorePrivelegedHwAccess = true
          OsPhysicalCoreCprOffset = 16
          OsPhysicalCoreHasMCSRR = true
          OsPhysicalCoreIvorWritable = false
          OsPhysicalCoreSpeSupported = true
          OsPhysicalCoreGateLockValue = 1
          OsPhysicalCoreStackProtectionUnit = SMPU0
          MC_ME_ADDR_OFFSET (OsPhysicalCoreAddress): OsPhysicalCoreAddressValue=484
          MC_ME_CTRL_OFFSET (OsPhysicalCoreAddress): OsPhysicalCoreAddressValue=454
        CORE1 (OsPhysicalCore):
          OsPhysicalCoreId = 1
          OsPhysicalCoreDefaultEntrySymbol = _start_c1
          OsPhysicalCoreType = GPR32
          OsPhysicalCoreExceptionSources = 10
          OsPhysicalCoreIsAutostart = false
          OsPhysicalCoreMasterStartAllowed = false
          OsPhysicalCorePrivelegedHwAccess = true
          OsPhysicalCoreCprOffset = 20
          OsPhysicalCoreHasMCSRR = true
          OsPhysicalCoreIvorWritable = false
          OsPhysicalCoreSpeSupported = false
          OsPhysicalCoreGateLockValue = 2
          OsPhysicalCoreStackProtectionUnit = SMPU0
          MC_ME_ADDR_OFFSET (OsPhysicalCoreAddress): OsPhysicalCoreAddressValue=492
          MC_ME_CTRL_OFFSET (OsPhysicalCoreAddress): OsPhysicalCoreAddressValue=458
        SMPU0 (OsSystemMpu): OsSystemMpuId=0, OsSystemMpuBaseAddress=4227923968, OsSystemMpuMaxRegions=16, OsSystemMpuType=SMPU_A_FMT1
        OsMemoryRegionSpecifics
          e200Z2 (OsMemoryRegionBusMaster): OsMemoryRegionBusMasterId=1
          e200Z4 (OsMemoryRegionBusMaster): OsMemoryRegionBusMasterId=0
          3 x OsMemoryRegionAccess:
            USER_W: OsMemoryRegionAccessRights=W, OsMemoryRegionAccessType=USER
            SUPERVISOR_W: OsMemoryRegionAccessRights=W, OsMemoryRegionAccessType=SUPERVISOR
            SUPERVISOR_RX: OsMemoryRegionAccessRights=RX, OsMemoryRegionAccessType=SUPERVISOR
          e200Z4_Debug (OsMemoryRegionBusMaster): OsMemoryRegionBusMasterId=8
          USER_RX (OsMemoryRegionAccess): OsMemoryRegionAccessRights=RX, OsMemoryRegionAccessType=USER
          3 x OsMemoryRegionBusMaster:
            HSM: OsMemoryRegionBusMasterId=3
            eDMA: OsMemoryRegionBusMasterId=4
            Ethernet: OsMemoryRegionBusMasterId=5
          PID_ENABLE (OsMemoryRegionFlag)
          e200Z2_Debug (OsMemoryRegionBusMaster): OsMemoryRegionBusMasterId=9
          CACHE_INHIBIT (OsMemoryRegionFlag)
          FlexRay (OsMemoryRegionBusMaster): OsMemoryRegionBusMasterId=6
    OS_APPMODE_ANY (OsAppMode)
    OSDEFAULTAPPMODE (OsAppMode)
    OsOS:
      OsStackMonitoring = true
      OsStatus = EXTENDED
      OsUseGetServiceId = false
      OsUseParameterAccess = false
      OsUseResScheduler = false
      OsForcibleTermination = true
      OsGenerateCalloutStubs = true
      OsGenerateMemMap = COMPLETE
      OsGenerateMemMapForNearAddressing = true
      OsGenerateMemMapForThreads = false
      OsServiceProtection = false
      OsStackUsageMeasurement = false
      OsUseXSignalAsyncApiCalls = false
      OsFpuUsage = NONE
      OsNumberOfCores = 1
      OsScalabilityClass = SC3
      OsMasterCore = OsCore0
      OsSystemTimer = SystemTimer
      OsHardwareInitCore = OsCore0
      OsHooks: OsErrorHook=true, OsPostTaskHook=false, OsPreTaskHook=false, OsShutdownHook=false, OsStartupHook=false, OsProtectionHook=true
      OsDebug: OsAssertions=true, OsORTIDebugSupport=ORTI_23_ADDITIONAL
    SystemTimer (OsCounter):
      OsCounterMaxAllowedValue = 1073741823
      OsCounterMinCycle = 1
      OsCounterType = HARDWARE
      OsSecondsPerTick = 1.25E-8
      OsCounterTicksPerBase = 1
      OsCounterAccessingApplication = SystemApplication_OsCore0
      OsDriver: OsDriverHighResolution=true, OsDriverHardwareTimerChannelRef=STM0_CH1, OsDriverIsrRef=CounterIsr_SystemTimer
    8 x OsIsr, all with OsIsrCategory=CATEGORY_2, OsIsrInterruptType=EXTERNAL, OsIsrInterruptPriority=7, OsIsrStackSize=1024, OsIsrEnableNesting=false, OsIsrUsesFpu=false:
      CanIsr_0_MB16To31: OsIsrInterruptSource=572, OsIsrSpecialFunctionName=CanMailboxIsr_0  # Os Interrupt Service Routine PLAIN_TEXT CAN Tx and Rx Interrupt. This OsIsr container has been created automatically based on the driver configuration.
      CanIsr_0_MB64To95: OsIsrInterruptSource=574, OsIsrSpecialFunctionName=CanMailboxIsr_0  # Os Interrupt Service Routine PLAIN_TEXT CAN Tx and Rx Interrupt. This OsIsr container has been created automatically based on the driver configuration.
      CanIsr_0_MB32To63: OsIsrInterruptSource=573, OsIsrSpecialFunctionName=CanMailboxIsr_0  # Os Interrupt Service Routine PLAIN_TEXT CAN Tx and Rx Interrupt. This OsIsr container has been created automatically based on the driver configuration.
      CanIsr_0_MB00To03: OsIsrInterruptSource=568, OsIsrSpecialFunctionName=CanMailboxIsr_0  # Os Interrupt Service Routine PLAIN_TEXT CAN Tx and Rx Interrupt. This OsIsr container has been created automatically based on the driver configuration.
      CanIsr_0_MB08To11: OsIsrInterruptSource=570, OsIsrSpecialFunctionName=CanMailboxIsr_0  # Os Interrupt Service Routine PLAIN_TEXT CAN Tx and Rx Interrupt. This OsIsr container has been created automatically based on the driver configuration.
      CanIsr_0_MB12To15: OsIsrInterruptSource=571, OsIsrSpecialFunctionName=CanMailboxIsr_0  # Os Interrupt Service Routine PLAIN_TEXT CAN Tx and Rx Interrupt. This OsIsr container has been created automatically based on the driver configuration.
      CanIsr_0_MB04To07: OsIsrInterruptSource=569, OsIsrSpecialFunctionName=CanMailboxIsr_0  # Os Interrupt Service Routine PLAIN_TEXT CAN Tx and Rx Interrupt. This OsIsr container has been created automatically based on the driver configuration.
      CanIsr_0_BusOff: OsIsrInterruptSource=567, OsIsrSpecialFunctionName=CanBusOffIsr_0  # Os Interrupt Service Routine PLAIN_TEXT CAN BusOff Interrupt. This OsIsr container has been created automatically based on the driver configuration.
    OsCore0 (OsCore):  # 1.0.0.0 PLAIN_TEXT This name has to be set xxx because .... 1.0.0.1 Name has changed bacause ...
      OsCoreIsAutostart = true
      OsCoreIsAutosar = true
      OsCoreEntrySymbol = _start
      OsCorePhysicalCoreRef = CORE0
      OsCoreEcucCoreRef = EcucCoreDefinition
      OsCoreIdleTask = IdleTask_OsCore0
      OsCoreSystemApplication = SystemApplication_OsCore0
      OsCoreStacks:
        OsCoreKernelStackSize = 1024
        OsCoreStartupStackSize = 1024
        OsCoreShutdownStackSize = 1024
        OsCoreErrorStackSize = 1024
        OsCoreProtectionStackSize = 1024
        OsCoreInitStackSize = 2048
    IdleTask_OsCore0 (OsTask):
      OsTaskActivation = 1
      OsTaskPriority = 4294967295
      OsTaskSchedule = FULL
      OsTaskStackSharing = false
      OsTaskStackSize = 2048
      OsTaskType = AUTO
      OsTaskUsesFpu = false
      OsTaskAccessingApplication = SystemApplication_OsCore0
      OsTaskAutostart: OsTaskAppModeRef=OS_APPMODE_ANY
    SystemApplication_OsCore0 (OsApplication):
      OsTrusted = true
      OsTrustedApplicationDelayTimingViolationCall = false
      OsTrustedApplicationWithProtection = false
      OsApplicationIsPrivileged = true
      OsAppUseTrustedFunctionStubs = false
      OsApplicationCoreRef = EcucCoreDefinition
      OsAppTaskRef = IdleTask_OsCore0
      OsAppCounterRef = SystemTimer
      OsAppIsrRef = CounterIsr_SystemTimer
      OsApplicationHooks: OsAppErrorHook=false, OsAppShutdownHook=false, OsAppStartupHook=false
    17 x OsIsr, all with OsIsrCategory=CATEGORY_2, OsIsrInterruptType=EXTERNAL, OsIsrStackSize=1024, OsIsrEnableNesting=false, OsIsrUsesFpu=false:
      CounterIsr_SystemTimer: OsIsrInterruptSource=37, OsIsrInterruptPriority=15, OsIsrSpecialFunctionName=Os_TimerHrtIsr
      CanIsr_2_MB32To63: OsIsrInterruptSource=597, OsIsrInterruptPriority=8, OsIsrSpecialFunctionName=CanMailboxIsr_2  # Os Interrupt Service Routine PLAIN_TEXT CAN Tx and Rx Interrupt. This OsIsr container has been created automatically based on the driver configuration.
      CanIsr_2_MB08To11: OsIsrInterruptSource=594, OsIsrInterruptPriority=8, OsIsrSpecialFunctionName=CanMailboxIsr_2  # Os Interrupt Service Routine PLAIN_TEXT CAN Tx and Rx Interrupt. This OsIsr container has been created automatically based on the driver configuration.
      CanIsr_2_MB04To07: OsIsrInterruptSource=593, OsIsrInterruptPriority=8, OsIsrSpecialFunctionName=CanMailboxIsr_2  # Os Interrupt Service Routine PLAIN_TEXT CAN Tx and Rx Interrupt. This OsIsr container has been created automatically based on the driver configuration.
      CanIsr_2_MB64To95: OsIsrInterruptSource=598, OsIsrInterruptPriority=8, OsIsrSpecialFunctionName=CanMailboxIsr_2  # Os Interrupt Service Routine PLAIN_TEXT CAN Tx and Rx Interrupt. This OsIsr container has been created automatically based on the driver configuration.
      CanIsr_2_BusOff: OsIsrInterruptSource=591, OsIsrInterruptPriority=8, OsIsrSpecialFunctionName=CanBusOffIsr_2  # Os Interrupt Service Routine PLAIN_TEXT CAN BusOff Interrupt. This OsIsr container has been created automatically based on the driver configuration.
      CanIsr_2_MB12To15: OsIsrInterruptSource=595, OsIsrInterruptPriority=8, OsIsrSpecialFunctionName=CanMailboxIsr_2  # Os Interrupt Service Routine PLAIN_TEXT CAN Tx and Rx Interrupt. This OsIsr container has been created automatically based on the driver configuration.
      CanIsr_2_MB16To31: OsIsrInterruptSource=596, OsIsrInterruptPriority=8, OsIsrSpecialFunctionName=CanMailboxIsr_2  # Os Interrupt Service Routine PLAIN_TEXT CAN Tx and Rx Interrupt. This OsIsr container has been created automatically based on the driver configuration.
      CanIsr_2_MB00To03: OsIsrInterruptSource=592, OsIsrInterruptPriority=8, OsIsrSpecialFunctionName=CanMailboxIsr_2  # Os Interrupt Service Routine PLAIN_TEXT CAN Tx and Rx Interrupt. This OsIsr container has been created automatically based on the driver configuration.
      CanIsr_4_MB64To95: OsIsrInterruptSource=622, OsIsrInterruptPriority=4, OsIsrSpecialFunctionName=CanMailboxIsr_4  # Os Interrupt Service Routine PLAIN_TEXT CAN Tx and Rx Interrupt. This OsIsr container has been created automatically based on the driver configuration.
      CanIsr_4_MB16To31: OsIsrInterruptSource=620, OsIsrInterruptPriority=4, OsIsrSpecialFunctionName=CanMailboxIsr_4  # Os Interrupt Service Routine PLAIN_TEXT CAN Tx and Rx Interrupt. This OsIsr container has been created automatically based on the driver configuration.
      CanIsr_4_MB00To03: OsIsrInterruptSource=616, OsIsrInterruptPriority=4, OsIsrSpecialFunctionName=CanMailboxIsr_4  # Os Interrupt Service Routine PLAIN_TEXT CAN Tx and Rx Interrupt. This OsIsr container has been created automatically based on the driver configuration.
      CanIsr_4_BusOff: OsIsrInterruptSource=615, OsIsrInterruptPriority=4, OsIsrSpecialFunctionName=CanBusOffIsr_4  # Os Interrupt Service Routine PLAIN_TEXT CAN BusOff Interrupt. This OsIsr container has been created automatically based on the driver configuration.
      CanIsr_4_MB32To63: OsIsrInterruptSource=621, OsIsrInterruptPriority=4, OsIsrSpecialFunctionName=CanMailboxIsr_4  # Os Interrupt Service Routine PLAIN_TEXT CAN Tx and Rx Interrupt. This OsIsr container has been created automatically based on the driver configuration.
      CanIsr_4_MB12To15: OsIsrInterruptSource=619, OsIsrInterruptPriority=4, OsIsrSpecialFunctionName=CanMailboxIsr_4  # Os Interrupt Service Routine PLAIN_TEXT CAN Tx and Rx Interrupt. This OsIsr container has been created automatically based on the driver configuration.
      CanIsr_4_MB08To11: OsIsrInterruptSource=618, OsIsrInterruptPriority=4, OsIsrSpecialFunctionName=CanMailboxIsr_4  # Os Interrupt Service Routine PLAIN_TEXT CAN Tx and Rx Interrupt. This OsIsr container has been created automatically based on the driver configuration.
      CanIsr_4_MB04To07: OsIsrInterruptSource=617, OsIsrInterruptPriority=4, OsIsrSpecialFunctionName=CanMailboxIsr_4  # Os Interrupt Service Routine PLAIN_TEXT CAN Tx and Rx Interrupt. This OsIsr container has been created automatically based on the driver configuration.
    OsResource:
      OsResourceProperty = STANDARD
      OsResourceAccessingApplication = OsApplication_Trusted_Core0
      OsResourceAccessingApplication = SystemApplication_OsCore0
      OsResourceAccessingApplication = OsApplication_Untrusted_Core0
    3 x OsIsr, all with OsIsrCategory=CATEGORY_2, OsIsrInterruptType=EXTERNAL, OsIsrInterruptPriority=13, OsIsrStackSize=1024, OsIsrEnableNesting=false, OsIsrUsesFpu=false, OsIsrSpecialFunctionName=LinIsr_1:
      Lin_Channel_1_ERR: OsIsrInterruptSource=381  # Os Interrupt Service Routine PLAIN_TEXT LIN interrupt ERR for Channel 1. This OsInterrupt container has been created automatically based on the driver configuration.
      Lin_Channel_1_RXI: OsIsrInterruptSource=379  # Os Interrupt Service Routine PLAIN_TEXT LIN interrupt RXI for Channel 1. This OsInterrupt container has been created automatically based on the driver configuration.
      Lin_Channel_1_TXI: OsIsrInterruptSource=380  # Os Interrupt Service Routine PLAIN_TEXT LIN interrupt TXI for Channel 1. This OsInterrupt container has been created automatically based on the driver configuration.
    OsApplication_Trusted_Core0 (OsApplication):
      OsTrusted = true
      OsTrustedApplicationDelayTimingViolationCall = false
      OsTrustedApplicationWithProtection = false
      OsApplicationIsPrivileged = true
      OsAppUseTrustedFunctionStubs = false
      OsApplicationCoreRef = EcucCoreDefinition
      OsAppIsrRef = Gpt_PIT_0_TIMER_0_ISR
      OsAppTaskRef = StartApplication_Trusted_Task
      OsAppAlarmRef = Alarm_StartApplication_Trusted_Task
      OsAppIsrRef = IRQ_LFIC_WKUP_27_28
      OsAppIsrRef = PWM_LS_EMIOS1_Ch6_7
      OsAppAlarmRef = Rte_Al_TE_StartApplication_Trusted_Task_0_10ms
      OsAppTaskRef = PvtTask
      OsAppAlarmRef = Rte_Al_TE_PvtTask_0_10ms
      OsAppIsrRef = ADC_0_EOC
      OsAppIsrRef = ADC_1_EOC
      OsAppIsrRef = PWM_HS_EMIOS0_Ch24_25
      OsAppAlarmRef = Rte_Al_TE_TP_RE_SMK_TP
      OsApplicationHooks: OsAppErrorHook=false, OsAppShutdownHook=false, OsAppStartupHook=false
    OsApplication_Untrusted_Core0 (OsApplication):
      OsTrusted = false
      OsTrustedApplicationDelayTimingViolationCall = false
      OsTrustedApplicationWithProtection = false
      OsApplicationIsPrivileged = false
      OsAppUseTrustedFunctionStubs = false
      OsApplicationCoreRef = EcucCoreDefinition
      OsAppTaskRef = Default_Appl_Task
      OsAppTaskRef = Default_BSW_Async_Task
      OsAppTaskRef = Default_Init_Task
      OsAppAlarmRef = Rte_Al_TE_StartApplication_StartApplication_Cyclic1000ms
      OsAppAlarmRef = Rte_Al_TE_StartApplication_StartApplication_Cyclic1ms
      OsAppAlarmRef = Rte_Al_TE_StartApplication_StartApplication_Cyclic250ms
      OsAppAlarmRef = Rte_Al_TE2_Default_BSW_Async_Task_0_100ms
      OsAppAlarmRef = Rte_Al_TE2_Default_BSW_Async_Task_0_10ms
      OsAppAlarmRef = Rte_Al_TE2_Default_BSW_Async_Task_0_20ms
      OsAppAlarmRef = Rte_Al_TE2_Default_BSW_Async_Task_0_5ms
      OsAppIsrRef = CanIsr_0_BusOff
      OsAppIsrRef = CanIsr_0_MB00To03
      OsAppIsrRef = CanIsr_0_MB04To07
      OsAppIsrRef = CanIsr_0_MB08To11
      OsAppIsrRef = CanIsr_0_MB12To15
      OsAppIsrRef = CanIsr_0_MB16To31
      OsAppIsrRef = CanIsr_0_MB32To63
      OsAppIsrRef = CanIsr_0_MB64To95
      OsAppIsrRef = CanIsr_2_BusOff
      OsAppIsrRef = CanIsr_2_MB00To03
      OsAppIsrRef = CanIsr_2_MB04To07
      OsAppIsrRef = CanIsr_2_MB08To11
      OsAppIsrRef = CanIsr_2_MB12To15
      OsAppIsrRef = CanIsr_2_MB16To31
      OsAppIsrRef = CanIsr_2_MB32To63
      OsAppIsrRef = CanIsr_2_MB64To95
      OsAppIsrRef = CanIsr_4_BusOff
      OsAppIsrRef = CanIsr_4_MB00To03
      OsAppIsrRef = CanIsr_4_MB04To07
      OsAppIsrRef = CanIsr_4_MB08To11
      OsAppIsrRef = CanIsr_4_MB12To15
      OsAppIsrRef = CanIsr_4_MB16To31
      OsAppIsrRef = CanIsr_4_MB32To63
      OsAppIsrRef = CanIsr_4_MB64To95
      OsAppIsrRef = Lin_Channel_1_ERR
      OsAppIsrRef = Lin_Channel_1_RXI
      OsAppIsrRef = Lin_Channel_1_TXI
      OsAppTaskRef = StartApplication_MemoryViolation_Task
      OsAppAlarmRef = Alarm_StartApplication_MemoryViolation_Task
      OsAppAlarmRef = Rte_Al_TE_StartApplication_StartApplication_MEMORYPROTECTION_Cyclic10ms
      OsAppIsrRef = CanIsr_1_BusOff
      OsAppIsrRef = CanIsr_1_MB04To07
      OsAppIsrRef = CanIsr_1_MB08To11
      OsAppIsrRef = CanIsr_1_MB12To15
      OsAppIsrRef = CanIsr_1_MB16To31
      OsAppIsrRef = CanIsr_1_MB32To63
      OsAppIsrRef = CanIsr_1_MB64To95
      OsAppIsrRef = CanIsr_1_MB00To03
      OsAppIsrRef = Lin_Channel_6_ERR
      OsAppIsrRef = Lin_Channel_6_RXI
      OsAppIsrRef = Lin_Channel_6_TXI
      OsAppIsrRef = Lin_Channel_7_ERR
      OsAppIsrRef = Lin_Channel_7_RXI
      OsAppIsrRef = Lin_Channel_7_TXI
      OsAppIsrRef = Lin_Channel_10_ERR
      OsAppIsrRef = Lin_Channel_10_RXI
      OsAppIsrRef = Lin_Channel_10_TXI
      OsAppIsrRef = CanIsr_7_BusOff
      OsAppIsrRef = CanIsr_7_MB00To03
      OsAppIsrRef = CanIsr_7_MB04To07
      OsAppIsrRef = CanIsr_7_MB08To11
      OsAppIsrRef = CanIsr_7_MB12To15
      OsAppIsrRef = CanIsr_7_MB16To31
      OsAppIsrRef = CanIsr_7_MB32To63
      OsAppIsrRef = CanIsr_7_MB64To95
      OsAppAlarmRef = Rte_Al_TE_StartApplication_StartApplication_Cyclic10ms
      OsAppIsrRef = Lin_Channel_0_ERR
      OsAppIsrRef = Lin_Channel_0_RXI
      OsAppIsrRef = Lin_Channel_0_TXI
      OsApplicationHooks: OsAppErrorHook=false, OsAppShutdownHook=false, OsAppStartupHook=false
    3 x OsTask, all with OsTaskActivation=1, OsTaskStackSharing=false, OsTaskStackSize=2048, OsTaskUsesFpu=false, OsTaskAccessingApplication=SystemApplication_OsCore0:
      Default_Init_Task: OsTaskPriority=50, OsTaskSchedule=NON, OsTaskType=BASIC
        OsTaskAutostart: OsTaskAppModeRef=OS_APPMODE_ANY
      Default_BSW_Async_Task: OsTaskPriority=30, OsTaskSchedule=FULL, OsTaskType=EXTENDED, OsTaskResourceRef=OsResource, OsTaskEventRef=Rte_Ev_Cyclic2_Default_BSW_Async_Task_0_100ms, OsTaskEventRef=Rte_Ev_Cyclic2_Default_BSW_Async_Task_0_10ms, OsTaskEventRef=Rte_Ev_Cyclic2_Default_BSW_Async_Task_0_20ms, OsTaskEventRef=Rte_Ev_Cyclic2_Default_BSW_Async_Task_0_5ms, OsTaskAccessingApplication=OsApplication_Untrusted_Core0, OsTaskEventRef=Rte_Ev_Run_ComM_GetCurrentComMode, OsTaskEventRef=Rte_Ev_Run_ComM_RequestComMode, OsTaskEventRef=Rte_Ev_Run_EcuM_SelectShutdownTarget, OsTaskAccessingApplication=OsApplication_Trusted_Core0, OsTaskEventRef=Rte_Ev_Run_DemMaster_OsApplication_Untrusted_Core0_SetOperationCycleState, OsTaskEventRef=Rte_Ev_Run_BswM_BswM_Read_LIN3_ScheduleTableRequestMode, OsTaskEventRef=Rte_Ev_Run_BswM_BswM_Read_LIN1_ScheduleTableRequestMode, OsTaskEventRef=Rte_Ev_Run_BswM_BswM_Read_LIN2_ScheduleTableRequestMode, OsTaskEventRef=Rte_Ev_Run_BswM_BswM_Read_LIN4_ScheduleTableRequestMode, OsTaskEventRef=Rte_Ev_Run_BswM_BswM_Read_LIN5_ScheduleTableRequestMode
      Default_Appl_Task: OsTaskPriority=5, OsTaskSchedule=FULL, OsTaskType=EXTENDED, OsTaskEventRef=Rte_Ev_Run_StartApplication_StartApplication_Cyclic1000ms, OsTaskEventRef=Rte_Ev_Run_StartApplication_StartApplication_Cyclic1ms, OsTaskEventRef=Rte_Ev_Run_StartApplication_StartApplication_Cyclic250ms, OsTaskEventRef=Rte_Ev_Run_StartApplication_StartApplication_OnDataRec_RxCtrl, OsTaskEventRef=Rte_Ev_Run_StartApplication_StartApplication_OnDataRec_RxData, OsTaskAccessingApplication=OsApplication_Trusted_Core0, OsTaskEventRef=Rte_Ev_Run_StartApplication_StartApplication_Cyclic10ms
    4 x OsAlarm, all with OsAlarmCounterRef=SystemTimer, OsAlarmAccessingApplication=SystemApplication_OsCore0:
      Rte_Al_TE2_Default_BSW_Async_Task_0_100ms
        OsAlarmAction
          OsAlarmSetEvent: OsAlarmSetEventRef=Rte_Ev_Cyclic2_Default_BSW_Async_Task_0_100ms, OsAlarmSetEventTaskRef=Default_BSW_Async_Task
      Rte_Al_TE2_Default_BSW_Async_Task_0_10ms
        OsAlarmAction
          OsAlarmSetEvent: OsAlarmSetEventRef=Rte_Ev_Cyclic2_Default_BSW_Async_Task_0_10ms, OsAlarmSetEventTaskRef=Default_BSW_Async_Task
      Rte_Al_TE2_Default_BSW_Async_Task_0_20ms
        OsAlarmAction
          OsAlarmSetEvent: OsAlarmSetEventRef=Rte_Ev_Cyclic2_Default_BSW_Async_Task_0_20ms, OsAlarmSetEventTaskRef=Default_BSW_Async_Task
      Rte_Al_TE2_Default_BSW_Async_Task_0_5ms
        OsAlarmAction
          OsAlarmSetEvent: OsAlarmSetEventRef=Rte_Ev_Cyclic2_Default_BSW_Async_Task_0_5ms, OsAlarmSetEventTaskRef=Default_BSW_Async_Task
    4 x OsEvent:
      Rte_Ev_Cyclic2_Default_BSW_Async_Task_0_100ms
      Rte_Ev_Cyclic2_Default_BSW_Async_Task_0_10ms
      Rte_Ev_Cyclic2_Default_BSW_Async_Task_0_20ms
      Rte_Ev_Cyclic2_Default_BSW_Async_Task_0_5ms
    OsMemoryProtection
      3 x OsMemoryRegion, all with OsMemoryRegionProtectionUnit=SMPU0, OsMemoryRegionBusMasters=e200Z4, OsMemoryRegionBusMasters=e200Z4_Debug:
        OsMemoryRegion_Data_SystemApplication: OsMemoryRegionStartAddress=_OS_SystemApplication_OsCore0_VAR_ALL_START, OsMemoryRegionEndAddress=_OS_SystemApplication_OsCore0_VAR_ALL_END, OsMemoryRegionAccessRights=SUPERVISOR_W
        OsMemoryRegion_DataFlash: OsMemoryRegionStartAddress=0x00F8C000, OsMemoryRegionEndAddress=0x0157FFFF, OsMemoryRegionAccessRights=SUPERVISOR_W, OsMemoryRegionBusMasters=HSM
        OsMemoryRegion_NonTrusted: OsMemoryRegionStartAddress=_OS_OsApplication_Untrusted_Core0_VAR_ALL_START, OsMemoryRegionEndAddress=_OS_OsApplication_Untrusted_Core0_VAR_ALL_END, OsMemoryRegionAccessRights=USER_W, OsMemoryRegionOwner=OsApplication_Untrusted_Core0
      CAN_PROTECTED_AREA_CH0 (OsPeripheralRegion): OsPeripheralRegionStartAddress=0xFFEC0000, OsPeripheralRegionEndAddress=0xFFECFFFF, OsPeripheralRegionAccessingApp=OsApplication_Untrusted_Core0
      5 x OsMemoryRegion, all with OsMemoryRegionProtectionUnit=SMPU0, OsMemoryRegionBusMasters=e200Z4, OsMemoryRegionBusMasters=e200Z4_Debug:
        OsMemoryRegion_Data_Trusted: OsMemoryRegionStartAddress=_OS_OsApplication_Trusted_Core0_VAR_ALL_START, OsMemoryRegionEndAddress=_OS_OsApplication_Trusted_Core0_VAR_ALL_END, OsMemoryRegionAccessRights=USER_W, OsMemoryRegionOwner=OsApplication_Trusted_Core0
        OsMemoryRegion_GlobalShared: OsMemoryRegionStartAddress=_OS_GLOBALSHARED_VAR_START, OsMemoryRegionEndAddress=_OS_GLOBALSHARED_VAR_END, OsMemoryRegionAccessRights=SUPERVISOR_W, OsMemoryRegionAccessRights=USER_W
        OsMemoryRegion_Peripheral: OsMemoryRegionStartAddress=0xF0000000, OsMemoryRegionEndAddress=0xFFFFFFFF, OsMemoryRegionAccessRights=SUPERVISOR_W, OsMemoryRegionAccessRights=USER_W
        OsMemoryRegion_ReadExecuteAll: OsMemoryRegionStartAddress=0x00000000, OsMemoryRegionEndAddress=0xFFFFFFFF, OsMemoryRegionAccessRights=SUPERVISOR_RX, OsMemoryRegionAccessRights=USER_RX, OsMemoryRegionBusMasters=eDMA, OsMemoryRegionBusMasters=HSM
        OsMemoryRegion_RAM: OsMemoryRegionStartAddress=0x40000000, OsMemoryRegionEndAddress=_OS_CORE0_STACKS_START, OsMemoryRegionAccessRights=SUPERVISOR_W
      8 x OsPeripheralRegion, all with OsPeripheralRegionAccessingApp=OsApplication_Untrusted_Core0:
        CAN_PROTECTED_AREA_CH1: OsPeripheralRegionStartAddress=0xFBEC0000, OsPeripheralRegionEndAddress=0xFBEC3FFF
        CAN_PROTECTED_AREA_CH2: OsPeripheralRegionStartAddress=0xFFEC4000, OsPeripheralRegionEndAddress=0xFFEC7FFF
        CAN_PROTECTED_AREA_CH3: OsPeripheralRegionStartAddress=0xFBEC4000, OsPeripheralRegionEndAddress=0xFBEC7FFF
        CAN_PROTECTED_AREA_CH4: OsPeripheralRegionStartAddress=0xFFEC8000, OsPeripheralRegionEndAddress=0xFFECBFFF
        CAN_PROTECTED_AREA_CH7: OsPeripheralRegionStartAddress=0xFBEC0000, OsPeripheralRegionEndAddress=0xFBECFFFF
        Dio: OsPeripheralRegionStartAddress=0xFFFC0000, OsPeripheralRegionEndAddress=0xFFFC2000
        ADC_PROTECTED_AREA_ADC0: OsPeripheralRegionStartAddress=0xFFE00000, OsPeripheralRegionEndAddress=0xFFE03FFF, OsPeripheralRegionAccessingApp=OsApplication_Trusted_Core0
        ADC_PROTECTED_AREA_ADC1: OsPeripheralRegionStartAddress=0xFBE00000, OsPeripheralRegionEndAddress=0xFBE03FFF, OsPeripheralRegionAccessingApp=OsApplication_Trusted_Core0
    3 x OsAlarm, all with OsAlarmCounterRef=SystemTimer, OsAlarmAccessingApplication=SystemApplication_OsCore0:
      Rte_Al_TE_StartApplication_StartApplication_Cyclic1000ms
        OsAlarmAction
          OsAlarmSetEvent: OsAlarmSetEventRef=Rte_Ev_Run_StartApplication_StartApplication_Cyclic1000ms, OsAlarmSetEventTaskRef=Default_Appl_Task
      Rte_Al_TE_StartApplication_StartApplication_Cyclic1ms
        OsAlarmAction
          OsAlarmSetEvent: OsAlarmSetEventRef=Rte_Ev_Run_StartApplication_StartApplication_Cyclic1ms, OsAlarmSetEventTaskRef=Default_Appl_Task
      Rte_Al_TE_StartApplication_StartApplication_Cyclic250ms
        OsAlarmAction
          OsAlarmSetEvent: OsAlarmSetEventRef=Rte_Ev_Run_StartApplication_StartApplication_Cyclic250ms, OsAlarmSetEventTaskRef=Default_Appl_Task
    8 x OsEvent:
      Rte_Ev_Run_ComM_GetCurrentComMode
      Rte_Ev_Run_ComM_RequestComMode
      Rte_Ev_Run_EcuM_SelectShutdownTarget
      Rte_Ev_Run_StartApplication_StartApplication_Cyclic1000ms
      Rte_Ev_Run_StartApplication_StartApplication_Cyclic1ms
      Rte_Ev_Run_StartApplication_StartApplication_Cyclic250ms
      Rte_Ev_Run_StartApplication_StartApplication_OnDataRec_RxCtrl
      Rte_Ev_Run_StartApplication_StartApplication_OnDataRec_RxData
    Gpt_PIT_0_TIMER_0_ISR (OsIsr):
      OsIsrCategory = CATEGORY_2
      OsIsrInterruptType = EXTERNAL
      OsIsrInterruptSource = 226
      OsIsrInterruptPriority = 1
      OsIsrStackSize = 1024
      OsIsrEnableNesting = false
      OsIsrUsesFpu = false
    Rte_Ev_Run_DemMaster_OsApplication_Untrusted_Core0_SetOperationCycleState (OsEvent)
    StartApplication_MemoryViolation_Task (OsTask):
      OsTaskActivation = 1
      OsTaskPriority = 40
      OsTaskSchedule = FULL
      OsTaskStackSharing = false
      OsTaskStackSize = 1024
      OsTaskType = EXTENDED
      OsTaskUsesFpu = false
      OsTaskAccessingApplication = SystemApplication_OsCore0
      OsTaskAccessingApplication = OsApplication_Trusted_Core0
      OsTaskEventRef = Rte_Ev_Run_StartApplication_StartApplication_MEMORYPROTECTION_Cyclic10ms
    Alarm_StartApplication_MemoryViolation_Task (OsAlarm): OsAlarmCounterRef=SystemTimer, OsAlarmAccessingApplication=SystemApplication_OsCore0
      OsAlarmAction
        OsAlarmActivateTask: OsAlarmActivateTaskRef=StartApplication_MemoryViolation_Task
    StartApplication_Trusted_Task (OsTask):
      OsTaskActivation = 1
      OsTaskPriority = 41
      OsTaskSchedule = FULL
      OsTaskStackSharing = false
      OsTaskStackSize = 1024
      OsTaskType = EXTENDED
      OsTaskUsesFpu = false
      OsTaskAccessingApplication = SystemApplication_OsCore0
      OsTaskAccessingApplication = OsApplication_Untrusted_Core0
      OsTaskEventRef = Rte_Ev_Run_StartApplicationTrusted_StartApplicationTrusted_OnDataRec_TrustedData
      OsTaskEventRef = Rte_Ev_Cyclic_StartApplication_Trusted_Task_0_10ms
      OsTaskEventRef = Rte_Ev_Run_IOHWAB_IoHwAb_RficNRESDio_P_Read
    Alarm_StartApplication_Trusted_Task (OsAlarm): OsAlarmCounterRef=SystemTimer, OsAlarmAccessingApplication=SystemApplication_OsCore0
      OsAlarmAction
        OsAlarmActivateTask: OsAlarmActivateTaskRef=StartApplication_Trusted_Task
    Rte_Al_TE_StartApplication_StartApplication_MEMORYPROTECTION_Cyclic10ms (OsAlarm): OsAlarmCounterRef=SystemTimer, OsAlarmAccessingApplication=SystemApplication_OsCore0
      OsAlarmAction
        OsAlarmSetEvent:
          OsAlarmSetEventRef = Rte_Ev_Run_StartApplication_StartApplication_MEMORYPROTECTION_Cyclic10ms
          OsAlarmSetEventTaskRef = StartApplication_MemoryViolation_Task
    Rte_Ev_Run_StartApplicationTrusted_StartApplicationTrusted_OnDataRec_TrustedData (OsEvent)
    Rte_Ev_Run_StartApplication_StartApplication_MEMORYPROTECTION_Cyclic10ms (OsEvent)
    19 x OsIsr, all with OsIsrCategory=CATEGORY_2, OsIsrInterruptType=EXTERNAL, OsIsrStackSize=1024, OsIsrEnableNesting=false, OsIsrUsesFpu=false:
      CanIsr_1_MB12To15: OsIsrInterruptSource=583, OsIsrInterruptPriority=3, OsIsrSpecialFunctionName=CanMailboxIsr_1  # Os Interrupt Service Routine PLAIN_TEXT CAN Tx and Rx Interrupt. This OsIsr container has been created automatically based on the driver configuration.
      CanIsr_1_MB00To03: OsIsrInterruptSource=580, OsIsrInterruptPriority=3, OsIsrSpecialFunctionName=CanMailboxIsr_1  # Os Interrupt Service Routine PLAIN_TEXT CAN Tx and Rx Interrupt. This OsIsr container has been created automatically based on the driver configuration.
      CanIsr_1_MB64To95: OsIsrInterruptSource=586, OsIsrInterruptPriority=3, OsIsrSpecialFunctionName=CanMailboxIsr_1  # Os Interrupt Service Routine PLAIN_TEXT CAN Tx and Rx Interrupt. This OsIsr container has been created automatically based on the driver configuration.
      CanIsr_1_MB04To07: OsIsrInterruptSource=581, OsIsrInterruptPriority=3, OsIsrSpecialFunctionName=CanMailboxIsr_1  # Os Interrupt Service Routine PLAIN_TEXT CAN Tx and Rx Interrupt. This OsIsr container has been created automatically based on the driver configuration.
      CanIsr_1_BusOff: OsIsrInterruptSource=579, OsIsrInterruptPriority=3, OsIsrSpecialFunctionName=CanBusOffIsr_1  # Os Interrupt Service Routine PLAIN_TEXT CAN BusOff Interrupt. This OsIsr container has been created automatically based on the driver configuration.
      CanIsr_1_MB32To63: OsIsrInterruptSource=585, OsIsrInterruptPriority=3, OsIsrSpecialFunctionName=CanMailboxIsr_1  # Os Interrupt Service Routine PLAIN_TEXT CAN Tx and Rx Interrupt. This OsIsr container has been created automatically based on the driver configuration.
      CanIsr_1_MB16To31: OsIsrInterruptSource=584, OsIsrInterruptPriority=3, OsIsrSpecialFunctionName=CanMailboxIsr_1  # Os Interrupt Service Routine PLAIN_TEXT CAN Tx and Rx Interrupt. This OsIsr container has been created automatically based on the driver configuration.
      CanIsr_1_MB08To11: OsIsrInterruptSource=582, OsIsrInterruptPriority=3, OsIsrSpecialFunctionName=CanMailboxIsr_1  # Os Interrupt Service Routine PLAIN_TEXT CAN Tx and Rx Interrupt. This OsIsr container has been created automatically based on the driver configuration.
      ADC_0_EOC: OsIsrInterruptSource=548, OsIsrInterruptPriority=2, OsIsrSpecialFunctionName=Adc_Adcdig_EndGroupConvUnit0
      ADC_1_EOC: OsIsrInterruptSource=554, OsIsrInterruptPriority=9, OsIsrSpecialFunctionName=Adc_Adcdig_EndGroupConvUnit1
      Lin_Channel_6_ERR: OsIsrInterruptSource=396, OsIsrInterruptPriority=9, OsIsrSpecialFunctionName=LinIsr_6  # Os Interrupt Service Routine PLAIN_TEXT LIN interrupt ERR for Channel 6. This OsInterrupt container has been created automatically based on the driver configuration.
      Lin_Channel_6_RXI: OsIsrInterruptSource=394, OsIsrInterruptPriority=9, OsIsrSpecialFunctionName=LinIsr_6  # Os Interrupt Service Routine PLAIN_TEXT LIN interrupt RXI for Channel 6. This OsInterrupt container has been created automatically based on the driver configuration.
      Lin_Channel_6_TXI: OsIsrInterruptSource=395, OsIsrInterruptPriority=9, OsIsrSpecialFunctionName=LinIsr_6  # Os Interrupt Service Routine PLAIN_TEXT LIN interrupt TXI for Channel 6. This OsInterrupt container has been created automatically based on the driver configuration.
      Lin_Channel_7_ERR: OsIsrInterruptSource=399, OsIsrInterruptPriority=12, OsIsrSpecialFunctionName=LinIsr_7  # Os Interrupt Service Routine PLAIN_TEXT LIN interrupt ERR for Channel 7. This OsInterrupt container has been created automatically based on the driver configuration.
      Lin_Channel_7_RXI: OsIsrInterruptSource=397, OsIsrInterruptPriority=12, OsIsrSpecialFunctionName=LinIsr_7  # Os Interrupt Service Routine PLAIN_TEXT LIN interrupt RXI for Channel 7. This OsInterrupt container has been created automatically based on the driver configuration.
      Lin_Channel_7_TXI: OsIsrInterruptSource=398, OsIsrInterruptPriority=12, OsIsrSpecialFunctionName=LinIsr_7  # Os Interrupt Service Routine PLAIN_TEXT LIN interrupt TXI for Channel 7. This OsInterrupt container has been created automatically based on the driver configuration.
      Lin_Channel_10_ERR: OsIsrInterruptSource=408, OsIsrInterruptPriority=14, OsIsrSpecialFunctionName=LinIsr_10  # Os Interrupt Service Routine PLAIN_TEXT LIN interrupt ERR for Channel 10. This OsInterrupt container has been created automatically based on the driver configuration.
      Lin_Channel_10_RXI: OsIsrInterruptSource=406, OsIsrInterruptPriority=14, OsIsrSpecialFunctionName=LinIsr_10  # Os Interrupt Service Routine PLAIN_TEXT LIN interrupt RXI for Channel 10. This OsInterrupt container has been created automatically based on the driver configuration.
      Lin_Channel_10_TXI: OsIsrInterruptSource=407, OsIsrInterruptPriority=14, OsIsrSpecialFunctionName=LinIsr_10  # Os Interrupt Service Routine PLAIN_TEXT LIN interrupt TXI for Channel 10. This OsInterrupt container has been created automatically based on the driver configuration.
    5 x OsEvent:
      Rte_Ev_Run_BswM_BswM_Read_LIN3_ScheduleTableRequestMode
      Rte_Ev_Run_BswM_BswM_Read_LIN1_ScheduleTableRequestMode
      Rte_Ev_Run_BswM_BswM_Read_LIN2_ScheduleTableRequestMode
      Rte_Ev_Run_BswM_BswM_Read_LIN4_ScheduleTableRequestMode
      Rte_Ev_Run_BswM_BswM_Read_LIN5_ScheduleTableRequestMode
    IRQ_LFIC_WKUP_27_28 (OsIsr):
      OsIsrCategory = CATEGORY_2
      OsIsrInterruptType = EXTERNAL
      OsIsrInterruptSource = 671
      OsIsrInterruptPriority = 1
      OsIsrStackSize = 1024
      OsIsrEnableNesting = false
      OsIsrUsesFpu = false
      OsIsrSpecialFunctionName = WKPU_EXT_IRQ_24_31_ISR
    PWM_LS_EMIOS1_Ch6_7 (OsIsr):
      OsIsrCategory = CATEGORY_2
      OsIsrInterruptType = EXTERNAL
      OsIsrInterruptSource = 725
      OsIsrInterruptPriority = 0
      OsIsrStackSize = 1024
      OsIsrEnableNesting = false
      OsIsrUsesFpu = false
      OsIsrSpecialFunctionName = EMIOS_1_CH_6_CH_7_ISR
    Rte_Al_TE_StartApplication_Trusted_Task_0_10ms (OsAlarm): OsAlarmCounterRef=SystemTimer, OsAlarmAccessingApplication=OsApplication_Untrusted_Core0, OsAlarmAccessingApplication=SystemApplication_OsCore0
      OsAlarmAction
        OsAlarmSetEvent: OsAlarmSetEventRef=Rte_Ev_Cyclic_StartApplication_Trusted_Task_0_10ms, OsAlarmSetEventTaskRef=StartApplication_Trusted_Task
    Rte_Ev_Cyclic_StartApplication_Trusted_Task_0_10ms (OsEvent)
    PvtTask (OsTask):
      OsTaskActivation = 1
      OsTaskPriority = 42
      OsTaskSchedule = FULL
      OsTaskStackSharing = false
      OsTaskStackSize = 1024
      OsTaskType = AUTO
      OsTaskUsesFpu = false
      OsTaskAccessingApplication = SystemApplication_OsCore0
      OsTaskAccessingApplication = OsApplication_Trusted_Core0
      OsTaskAccessingApplication = OsApplication_Untrusted_Core0
      OsTaskEventRef = Rte_Ev_Cyclic_PvtTask_0_10ms
      OsTaskEventRef = Rte_Ev_Run_CDD_RFIC_RE_rfic_init
      OsTaskEventRef = Rte_Ev_Run_TestLin_Re_LIN0_FSP1_L1_FSP1DiagInfoL1_RXCbk
      OsTaskEventRef = Rte_Ev_Run_TestLin_Re_LIN0_FSP1_L1_FSP1DiagInfoL1_RxTimeout
      OsTaskEventRef = Rte_Ev_Run_TestLin_Re_LIN0_FSP1_L1_FSP1ResponseErrorL1_RXCbk
      OsTaskEventRef = Rte_Ev_Run_TestLin_Re_LIN0_FSP1_L1_FSP1ResponseErrorL1_RxTimeout
      OsTaskEventRef = Rte_Ev_Run_TestLin_Re_LIN0_FSP1_L1_SwitchDetectionNeeded1L1_RXCbk
      OsTaskEventRef = Rte_Ev_Run_TestLin_Re_LIN0_FSP1_L1_SwitchDetectionNeeded1L1_RxTimeout
      OsTaskEventRef = Rte_Ev_Run_TestLin_Re_LIN0_FSP2_L1_FSP2DiagInfoL1_RXCbk
      OsTaskEventRef = Rte_Ev_Run_TestLin_Re_LIN0_FSP2_L1_FSP2DiagInfoL1_RxTimeout
      OsTaskEventRef = Rte_Ev_Run_TestLin_Re_LIN0_FSP2_L1_FSP2ResponseErrorL1_RXCbk
      OsTaskEventRef = Rte_Ev_Run_TestLin_Re_LIN0_FSP2_L1_FSP2ResponseErrorL1_RxTimeout
      OsTaskEventRef = Rte_Ev_Run_TestLin_Re_LIN0_FSP2_L1_FSP2SwitchStatusL1_RXCbk
      OsTaskEventRef = Rte_Ev_Run_TestLin_Re_LIN0_FSP2_L1_FSP2SwitchStatusL1_RxTimeout
      OsTaskEventRef = Rte_Ev_Run_TestLin_Re_LIN0_FSP2_L1_SwitchDetectionNeeded2L1_RXCbk
      OsTaskEventRef = Rte_Ev_Run_TestLin_Re_LIN0_FSP2_L1_SwitchDetectionNeeded2L1_RxTimeout
      OsTaskEventRef = Rte_Ev_Run_TestLin_Re_LIN0_ILCP1_DiagInfoILCP1_RXCbk
      OsTaskEventRef = Rte_Ev_Run_TestLin_Re_LIN0_ILCP1_DiagInfoILCP1_RxTimeout
      OsTaskEventRef = Rte_Ev_Run_TestLin_Re_LIN0_ILCP1_LIN_DoorAutoFuncBtn_stat_RXCbk
      OsTaskEventRef = Rte_Ev_Run_TestLin_Re_LIN0_ILCP1_LIN_DoorAutoFuncBtn_stat_RxTimeout
      OsTaskEventRef = Rte_Ev_Run_TestLin_Re_LIN0_ILCP1_LIN_IntLghtDimmingLvlDecBtn_s_RXCbk
      OsTaskEventRef = Rte_Ev_Run_TestLin_Re_LIN0_ILCP1_LIN_IntLghtDimmingLvlDecBtn_s_RxTimeout
      OsTaskEventRef = Rte_Ev_Run_TestLin_Re_LIN0_ILCP1_LIN_IntLghtDimmingLvlIncBtn_s_RXCbk
      OsTaskEventRef = Rte_Ev_Run_TestLin_Re_LIN0_ILCP1_LIN_IntLghtDimmingLvlIncBtn_s_RxTimeout
      OsTaskEventRef = Rte_Ev_Run_TestLin_Re_LIN0_ILCP1_LIN_IntLghtModeSelrFreeWheel_s_RXCbk
      OsTaskEventRef = Rte_Ev_Run_TestLin_Re_LIN0_ILCP1_LIN_IntLghtModeSelrFreeWheel_s_RxTimeout
      OsTaskEventRef = Rte_Ev_Run_TestLin_Re_LIN0_ILCP1_ResponseErrorILCP1_RXCbk
      OsTaskEventRef = Rte_Ev_Run_TestLin_Re_LIN0_ILCP1_ResponseErrorILCP1_RxTimeout
      OsTaskEventRef = Rte_Ev_Run_TP_RE_SMK_TP
    Rte_Al_TE_PvtTask_0_10ms (OsAlarm): OsAlarmCounterRef=SystemTimer, OsAlarmAccessingApplication=OsApplication_Untrusted_Core0, OsAlarmAccessingApplication=SystemApplication_OsCore0
      OsAlarmAction
        OsAlarmSetEvent: OsAlarmSetEventRef=Rte_Ev_Cyclic_PvtTask_0_10ms, OsAlarmSetEventTaskRef=PvtTask
    3 x OsEvent:
      Rte_Ev_Cyclic_PvtTask_0_10ms
      Rte_Ev_Run_CDD_RFIC_RE_rfic_init
      Rte_Ev_Run_IOHWAB_IoHwAb_RficNRESDio_P_Read
    9 x OsIsr, all with OsIsrCategory=CATEGORY_2, OsIsrInterruptType=EXTERNAL, OsIsrStackSize=1024, OsIsrEnableNesting=false, OsIsrUsesFpu=false:
      PWM_HS_EMIOS0_Ch24_25: OsIsrInterruptSource=718, OsIsrInterruptPriority=0, OsIsrSpecialFunctionName=EMIOS_0_CH_24_CH_25_ISR
      CanIsr_7_MB08To11: OsIsrInterruptSource=654, OsIsrInterruptPriority=5, OsIsrSpecialFunctionName=CanMailboxIsr_7  # Os Interrupt Service Routine PLAIN_TEXT CAN Tx and Rx Interrupt. This OsIsr container has been created automatically based on the driver configuration.
      CanIsr_7_MB00To03: OsIsrInterruptSource=652, OsIsrInterruptPriority=5, OsIsrSpecialFunctionName=CanMailboxIsr_7  # Os Interrupt Service Routine PLAIN_TEXT CAN Tx and Rx Interrupt. This OsIsr container has been created automatically based on the driver configuration.
      CanIsr_7_MB32To63: OsIsrInterruptSource=657, OsIsrInterruptPriority=5, OsIsrSpecialFunctionName=CanMailboxIsr_7  # Os Interrupt Service Routine PLAIN_TEXT CAN Tx and Rx Interrupt. This OsIsr container has been created automatically based on the driver configuration.
      CanIsr_7_MB12To15: OsIsrInterruptSource=655, OsIsrInterruptPriority=5, OsIsrSpecialFunctionName=CanMailboxIsr_7  # Os Interrupt Service Routine PLAIN_TEXT CAN Tx and Rx Interrupt. This OsIsr container has been created automatically based on the driver configuration.
      CanIsr_7_MB64To95: OsIsrInterruptSource=658, OsIsrInterruptPriority=5, OsIsrSpecialFunctionName=CanMailboxIsr_7  # Os Interrupt Service Routine PLAIN_TEXT CAN Tx and Rx Interrupt. This OsIsr container has been created automatically based on the driver configuration.
      CanIsr_7_MB04To07: OsIsrInterruptSource=653, OsIsrInterruptPriority=5, OsIsrSpecialFunctionName=CanMailboxIsr_7  # Os Interrupt Service Routine PLAIN_TEXT CAN Tx and Rx Interrupt. This OsIsr container has been created automatically based on the driver configuration.
      CanIsr_7_MB16To31: OsIsrInterruptSource=656, OsIsrInterruptPriority=5, OsIsrSpecialFunctionName=CanMailboxIsr_7  # Os Interrupt Service Routine PLAIN_TEXT CAN Tx and Rx Interrupt. This OsIsr container has been created automatically based on the driver configuration.
      CanIsr_7_BusOff: OsIsrInterruptSource=651, OsIsrInterruptPriority=5, OsIsrSpecialFunctionName=CanBusOffIsr_7  # Os Interrupt Service Routine PLAIN_TEXT CAN BusOff Interrupt. This OsIsr container has been created automatically based on the driver configuration.
    Rte_Al_TE_StartApplication_StartApplication_Cyclic10ms (OsAlarm): OsAlarmCounterRef=SystemTimer, OsAlarmAccessingApplication=SystemApplication_OsCore0
      OsAlarmAction
        OsAlarmSetEvent: OsAlarmSetEventRef=Rte_Ev_Run_StartApplication_StartApplication_Cyclic10ms, OsAlarmSetEventTaskRef=Default_Appl_Task
    27 x OsEvent:
      Rte_Ev_Run_StartApplication_StartApplication_Cyclic10ms
      Rte_Ev_Run_TestLin_Re_LIN0_FSP1_L1_FSP1DiagInfoL1_RXCbk
      Rte_Ev_Run_TestLin_Re_LIN0_FSP1_L1_FSP1DiagInfoL1_RxTimeout
      Rte_Ev_Run_TestLin_Re_LIN0_FSP1_L1_FSP1ResponseErrorL1_RXCbk
      Rte_Ev_Run_TestLin_Re_LIN0_FSP1_L1_FSP1ResponseErrorL1_RxTimeout
      Rte_Ev_Run_TestLin_Re_LIN0_FSP1_L1_SwitchDetectionNeeded1L1_RXCbk
      Rte_Ev_Run_TestLin_Re_LIN0_FSP1_L1_SwitchDetectionNeeded1L1_RxTimeout
      Rte_Ev_Run_TestLin_Re_LIN0_FSP2_L1_FSP2DiagInfoL1_RXCbk
      Rte_Ev_Run_TestLin_Re_LIN0_FSP2_L1_FSP2DiagInfoL1_RxTimeout
      Rte_Ev_Run_TestLin_Re_LIN0_FSP2_L1_FSP2ResponseErrorL1_RXCbk
      Rte_Ev_Run_TestLin_Re_LIN0_FSP2_L1_FSP2ResponseErrorL1_RxTimeout
      Rte_Ev_Run_TestLin_Re_LIN0_FSP2_L1_FSP2SwitchStatusL1_RXCbk
      Rte_Ev_Run_TestLin_Re_LIN0_FSP2_L1_FSP2SwitchStatusL1_RxTimeout
      Rte_Ev_Run_TestLin_Re_LIN0_FSP2_L1_SwitchDetectionNeeded2L1_RXCbk
      Rte_Ev_Run_TestLin_Re_LIN0_FSP2_L1_SwitchDetectionNeeded2L1_RxTimeout
      Rte_Ev_Run_TestLin_Re_LIN0_ILCP1_DiagInfoILCP1_RXCbk
      Rte_Ev_Run_TestLin_Re_LIN0_ILCP1_DiagInfoILCP1_RxTimeout
      Rte_Ev_Run_TestLin_Re_LIN0_ILCP1_LIN_DoorAutoFuncBtn_stat_RXCbk
      Rte_Ev_Run_TestLin_Re_LIN0_ILCP1_LIN_DoorAutoFuncBtn_stat_RxTimeout
      Rte_Ev_Run_TestLin_Re_LIN0_ILCP1_LIN_IntLghtDimmingLvlDecBtn_s_RXCbk
      Rte_Ev_Run_TestLin_Re_LIN0_ILCP1_LIN_IntLghtDimmingLvlDecBtn_s_RxTimeout
      Rte_Ev_Run_TestLin_Re_LIN0_ILCP1_LIN_IntLghtDimmingLvlIncBtn_s_RXCbk
      Rte_Ev_Run_TestLin_Re_LIN0_ILCP1_LIN_IntLghtDimmingLvlIncBtn_s_RxTimeout
      Rte_Ev_Run_TestLin_Re_LIN0_ILCP1_LIN_IntLghtModeSelrFreeWheel_s_RXCbk
      Rte_Ev_Run_TestLin_Re_LIN0_ILCP1_LIN_IntLghtModeSelrFreeWheel_s_RxTimeout
      Rte_Ev_Run_TestLin_Re_LIN0_ILCP1_ResponseErrorILCP1_RXCbk
      Rte_Ev_Run_TestLin_Re_LIN0_ILCP1_ResponseErrorILCP1_RxTimeout
    3 x OsIsr, all with OsIsrCategory=CATEGORY_2, OsIsrInterruptType=EXTERNAL, OsIsrInterruptPriority=6, OsIsrStackSize=1024, OsIsrEnableNesting=false, OsIsrUsesFpu=false, OsIsrSpecialFunctionName=LinIsr_0:
      Lin_Channel_0_TXI: OsIsrInterruptSource=377  # Os Interrupt Service Routine PLAIN_TEXT LIN interrupt TXI for Channel 0. This OsInterrupt container has been created automatically based on the driver configuration.
      Lin_Channel_0_ERR: OsIsrInterruptSource=378  # Os Interrupt Service Routine PLAIN_TEXT LIN interrupt ERR for Channel 0. This OsInterrupt container has been created automatically based on the driver configuration.
      Lin_Channel_0_RXI: OsIsrInterruptSource=376  # Os Interrupt Service Routine PLAIN_TEXT LIN interrupt RXI for Channel 0. This OsInterrupt container has been created automatically based on the driver configuration.
    Rte_Al_TE_TP_RE_SMK_TP (OsAlarm): OsAlarmCounterRef=SystemTimer, OsAlarmAccessingApplication=OsApplication_Untrusted_Core0, OsAlarmAccessingApplication=SystemApplication_OsCore0
      OsAlarmAction
        OsAlarmSetEvent: OsAlarmSetEventRef=Rte_Ev_Run_TP_RE_SMK_TP, OsAlarmSetEventTaskRef=PvtTask
    Rte_Ev_Run_TP_RE_SMK_TP (OsEvent)
