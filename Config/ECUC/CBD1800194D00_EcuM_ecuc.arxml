AUTOSAR XML (schema 4-2-1)
package /EcuM
  module config EcuM: implementation-config-variant=VARIANT-POST-BUILD-LOADABLE, module-description=EcuM_Impl
    CommonPublishedInformation:
      ArReleaseMajorVersion = 4
      ArReleaseMinorVersion = 2
      ArReleaseRevisionVersion = 2
      ModuleId = 10
      SwMajorVersion = 1
      SwMinorVersion = 0
      SwPatchVersion = 0
      VendorId = 43
    EcuMConfiguration
      EcuMCommonConfiguration: EcuMConfigConsistencyHash=4401219749183872370, EcuMDefaultAppMode=OSDEFAULTAPPMODE, EcuMOSResource=OsResource
        EcuMDefaultShutdownTarget: EcuMDefaultState=EcuMStateOff
        EcuMSleepMode_0 (EcuMSleepMode): EcuMSleepModeId=0, EcuMSleepModeSuspend=true, EcuMSleepModeMcuModeRef=McuModeSettingConf_0, EcuMWakeupSourceMask=CN_Backbone2_78967e2c
        15 x EcuMWakeupSource, all with EcuMWakeupSourcePolling=false:
          ECUM_WKSOURCE_POWER: EcuMWakeupSourceId=0, EcuMValidationTimeout=0, EcuMCheckWakeupTimeout=0
          ECUM_WKSOURCE_RESET: EcuMWakeupSourceId=1, EcuMValidationTimeout=0, EcuMCheckWakeupTimeout=0
          ECUM_WKSOURCE_INTERNAL_RESET: EcuMWakeupSourceId=2, EcuMValidationTimeout=0, EcuMCheckWakeupTimeout=0
          ECUM_WKSOURCE_INTERNAL_WDG: EcuMWakeupSourceId=3, EcuMValidationTimeout=0, EcuMCheckWakeupTimeout=0
          ECUM_WKSOURCE_EXTERNAL_WDG: EcuMWakeupSourceId=4, EcuMValidationTimeout=0, EcuMCheckWakeupTimeout=0
          CN_LIN01_5bde9749: EcuMWakeupSourceId=11, EcuMComMChannelRef=CN_LIN01_5bde9749
          CN_CabSubnet_9ea693f1: EcuMWakeupSourceId=6, EcuMComMChannelRef=CN_CabSubnet_9ea693f1
          CN_Backbone1J1939_0b1f4bae: EcuMWakeupSourceId=8, EcuMComMChannelRef=CN_Backbone1J1939_0b1f4bae
          CN_LIN04_2bb463c6: EcuMWakeupSourceId=14, EcuMComMChannelRef=CN_LIN04_2bb463c6
          CN_Backbone2_78967e2c: EcuMWakeupSourceId=5, EcuMComMChannelRef=CN_Backbone2_78967e2c
          CN_LIN02_c2d7c6f3: EcuMWakeupSourceId=12, EcuMComMChannelRef=CN_LIN02_c2d7c6f3
          CN_SecuritySubnet_e7a0ee54: EcuMWakeupSourceId=7, EcuMComMChannelRef=CN_SecuritySubnet_e7a0ee54
          CN_LIN00_2cd9a7df: EcuMWakeupSourceId=10, EcuMComMChannelRef=CN_LIN00_2cd9a7df
          CN_LIN03_b5d0f665: EcuMWakeupSourceId=13, EcuMComMChannelRef=CN_LIN03_b5d0f665
          CN_FMSNet_fce1aae5: EcuMWakeupSourceId=9, EcuMComMChannelRef=CN_FMSNet_fce1aae5
        EcuMDriverInitListZero
          23 x EcuMDriverInitItem:
            BswM_InitMemory: index=0, EcuMModuleID=BswM, EcuMModuleService=BswM_InitMemory, EcuMModuleHeader=BswM.h
            CanIf_InitMemory: index=1, EcuMModuleID=CanIf, EcuMModuleService=CanIf_InitMemory, EcuMModuleHeader=CanIf.h
            CanSM_InitMemory: index=2, EcuMModuleID=CanSM, EcuMModuleService=CanSM_InitMemory, EcuMModuleHeader=CanSM_EcuM.h
            Can_InitMemory: index=3, EcuMModuleID=Can, EcuMModuleService=Can_InitMemory, EcuMModuleHeader=Can.h
            ComM_InitMemory: index=4, EcuMModuleID=ComM, EcuMModuleService=ComM_InitMemory, EcuMModuleHeader=ComM.h
            Com_InitMemory: index=5, EcuMModuleID=Com, EcuMModuleService=Com_InitMemory, EcuMModuleHeader=Com.h
            Det_InitMemory: index=6, EcuMModuleID=Det, EcuMModuleService=Det_InitMemory, EcuMModuleHeader=Det.h
            J1939Nm_InitMemory: index=7, EcuMModuleID=J1939Nm, EcuMModuleService=J1939Nm_InitMemory, EcuMModuleHeader=J1939Nm.h
            J1939Rm_InitMemory: index=8, EcuMModuleID=J1939Rm, EcuMModuleService=J1939Rm_InitMemory, EcuMModuleHeader=J1939Rm.h
            J1939Tp_InitMemory: index=9, EcuMModuleID=J1939Tp, EcuMModuleService=J1939Tp_InitMemory, EcuMModuleHeader=J1939Tp.h
            LinIf_InitMemory: index=10, EcuMModuleID=LinIf, EcuMModuleService=LinIf_InitMemory, EcuMModuleHeader=LinIf.h
            LinSM_InitMemory: index=12, EcuMModuleID=LinSM, EcuMModuleService=LinSM_InitMemory, EcuMModuleHeader=LinSM.h
            Lin_InitMemory: index=13, EcuMModuleID=Lin, EcuMModuleService=Lin_InitMemory, EcuMModuleHeader=Lin.h
            Nm_InitMemory: index=14, EcuMModuleID=Nm, EcuMModuleService=Nm_InitMemory, EcuMModuleHeader=Nm.h
            PduR_InitMemory: index=15, EcuMModuleID=PduR, EcuMModuleService=PduR_InitMemory, EcuMModuleHeader=PduR.h
            Rte_InitMemory: index=16, EcuMModuleID=Rte, EcuMModuleService=Rte_InitMemory, EcuMModuleHeader=Rte_Main.h
            Dem_InitMemory: index=17, EcuMModuleID=Dem, EcuMModuleService=Dem_InitMemory, EcuMModuleHeader=Dem.h
            CanNm_InitMemory: index=18, EcuMModuleID=CanNm, EcuMModuleService=CanNm_InitMemory, EcuMModuleHeader=CanNm.h
            CanTp_InitMemory: index=19, EcuMModuleID=CanTp, EcuMModuleService=CanTp_InitMemory, EcuMModuleHeader=CanTp.h
            Dcm_InitMemory: index=20, EcuMModuleID=Dcm, EcuMModuleService=Dcm_InitMemory, EcuMModuleHeader=Dcm.h
            Issm_InitMemory: index=21, EcuMModuleID=Issm, EcuMModuleService=Issm_InitMemory, EcuMModuleHeader=Issm.h
            Det_Init: index=22, EcuMModuleID=Det, EcuMModuleService=Det_Init, EcuMModuleHeader=Det.h
            Dem_PreInit: index=23, EcuMModuleID=Dem, EcuMModuleService=Dem_PreInit, EcuMModuleHeader=Dem.h
        EcuMDriverInitListOne
          12 x EcuMDriverInitItem:
            Mcu_Init: index=6, EcuMModuleID=Mcu, EcuMModuleService=Mcu_Init, EcuMModuleHeader=Mcu.h
            Mcu_InitClock_AdditionalCode: index=1, EcuMModuleID=Code, EcuMAdditionalInitCode=Mcu_InitClock(0), EcuMModuleHeader=Mcu.h
            Mcu_GetPllStatus_AdditionalCode: index=3, EcuMModuleID=Code, EcuMAdditionalInitCode=while (MCU_PLL_LOCKED != Mcu_GetPllStatus()), EcuMModuleHeader=Mcu.h
            Mcu_DistributePllClock: index=4, EcuMModuleID=Mcu, EcuMModuleService=Mcu_DistributePllClock, EcuMModuleHeader=Mcu.h
            Port_Init: index=7, EcuMModuleID=Port, EcuMModuleService=Port_Init, EcuMModuleHeader=Port.h
            Fls_Init: index=9, EcuMModuleID=Fls, EcuMModuleService=Fls_Init, EcuMModuleHeader=Fls.h
            Gpt_Init: index=10, EcuMModuleID=Gpt, EcuMModuleService=Gpt_Init, EcuMModuleHeader=Gpt.h
            Mcl_Init: index=11, EcuMModuleID=Mcl, EcuMModuleService=Mcl_Init, EcuMModuleHeader=CDD_Mcl.h
            Pwm_Init: index=12, EcuMModuleID=Pwm, EcuMModuleService=Pwm_Init, EcuMModuleHeader=Pwm.h
            Spi_Init: index=13, EcuMModuleID=Spi, EcuMModuleService=Spi_Init, EcuMModuleHeader=Spi.h
            Icu_Init: index=15, EcuMModuleID=Icu, EcuMModuleService=Icu_Init, EcuMModuleHeader=Icu.h
            Adc_Init: index=16, EcuMModuleID=Adc, EcuMModuleService=Adc_Init, EcuMModuleHeader=Adc.h
        EcuMDemEventParameterRefs:
          ECUM_E_RAM_CHECK_FAILED = AutoCreatedDemEvent_ECUM_E_RAM_CHECK_FAILED
          ECUM_E_IMPROPER_CALLER = AutoCreatedDemEvent_ECUM_E_IMPROPER_CALLER
          ECUM_E_CONFIGURATION_DATA_INCONSISTENT = AutoCreatedDemEvent_ECUM_E_CONFIGURATION_DATA_INCONSISTENT
          ECUM_E_ALL_RUN_REQUESTS_KILLED = AutoCreatedDemEvent_ECUM_E_ALL_RUN_REQUESTS_KILLED
        EcuMDriverRestartList
      EcuMFlexConfiguration: EcuMFlexModuleConfigurationRef=CanConfigSet, EcuMFlexModuleConfigurationRef=LinGlobalConfig, EcuMNormalMcuModeRef=McuModeSettingConf_0
        3 x EcuMResetMode:
          ECUM_RESET_MCU: EcuMResetModeId=0
          ECUM_RESET_WDG: EcuMResetModeId=1
          ECUM_RESET_IO: EcuMResetModeId=2
        4 x EcuMShutdownCause:
          ECUM_CAUSE_UNKNOWN: EcuMShutdownCauseId=0
          ECUM_CAUSE_ECU_STATE: EcuMShutdownCauseId=1
          ECUM_CAUSE_WDGM: EcuMShutdownCauseId=2
          ECUM_CAUSE_DCM: EcuMShutdownCauseId=3
        ECUM_RESET_WAKEUP (EcuMResetMode): EcuMResetModeId=3
    EcuMGeneral:
      EcuMDevErrorDetect = false
      EcuMIncludeDem = true
      EcuMIncludeDet = true
      EcuMMainFunctionPeriod = 0.1
      EcuMVersionInfoApi = true
      EcuMDeferredBswMNotification = false
      EcuMSlaveCoreHandling = true
      EcuMEnableFixBehavior = false
      EcuMGeneration: EcuMOutOfBoundsWriteSanitizer=false, EcuMOutOfBoundsReadSanitizer=false, EcuMInterfacesForDeactivatedData=false
    EcuMFlexGeneral: EcuMAlarmClockPresent=false, EcuMResetLoopDetection=false, EcuMEnableDefBehaviour=false
