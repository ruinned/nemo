AUTOSAR XML (schema 4-2-1)
package /ActiveEcuC
  module config CanTrcv: implementation-config-variant=VARIANT-PRE-COMPILE
    CanTrcvConfigSet: CanTrcvSPICommRetries=0, CanTrcvSPICommTimeout=0
      5 x CanTrcvChannel, all with CanTrcvChannelUsed=true, CanTrcvControlsPowerSupply=false, CanTrcvHwPnSupport=false, CanTrcvInitState=CANTRCV_OP_MODE_NORMAL, CanTrcvWakeupByBusUsed=false:
        CanTrcvChannel_BB1: CanTrcvChannelId=0, CanTrcvMaxBaudrate=250
          CanTrcvAccess
            CanTrcvDioAccess
              CanTrcvDioChannelAccess: CanTrcvHardwareInterfaceName=BB1_STB, CanTrcvDioSymNameRef=CAN1STB
        CanTrcvChannel_BB2: CanTrcvChannelId=1, CanTrcvMaxBaudrate=500
          CanTrcvAccess
            CanTrcvDioAccess
              CanTrcvDioChannelAccess: CanTrcvHardwareInterfaceName=BB2_STB, CanTrcvDioSymNameRef=CAN2STB
        CanTrcvChannel_CapSubnet: CanTrcvChannelId=2, CanTrcvMaxBaudrate=500
          CanTrcvAccess
            CanTrcvDioAccess
              CanTrcvDioChannelAccess: CanTrcvHardwareInterfaceName=CabSubnet_STB, CanTrcvDioSymNameRef=CAN3_STB
        CanTrcvChannel_FMSNet: CanTrcvChannelId=3, CanTrcvMaxBaudrate=250
          CanTrcvAccess
            CanTrcvDioAccess
              CanTrcvDioChannelAccess: CanTrcvHardwareInterfaceName=FMSNet_STB, CanTrcvDioSymNameRef=CAN4_STB
        CanTrcvChannel_Security: CanTrcvChannelId=4, CanTrcvMaxBaudrate=500
          CanTrcvAccess
            CanTrcvDioAccess
              CanTrcvDioChannelAccess: CanTrcvHardwareInterfaceName=Security_STB, CanTrcvDioSymNameRef=CAN5STB
    CanTrcvGeneral:
      CanTrcvDevErrorDetect = false
      CanTrcvGetVersionInfo = false
      CanTrcvSPICommRetries = 0
      CanTrcvSPICommTimeout = 0
      CanTrcvWaitCount = 0
      CanTrcvWakeUpSupport = CANTRCV_WAKEUP_NOT_SUPPORTED
