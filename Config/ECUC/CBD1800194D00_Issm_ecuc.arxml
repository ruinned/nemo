AUTOSAR XML (schema 4-2-1)
package /ActiveEcuC
  module config Issm: implementation-config-variant=VARIANT-PRE-COMPILE, module-description=Issm_Impl
    IssmGeneral:
      IssmDevErrorDetect = true
      IssmMainFunctionPeriod = 0.01
      IssmMinIssActivationTime = 5
      IssmModuleInstanceId = 1
      IssmBswMRunRequest = BswMIssmRunRequest
      IssmBswMEnterRunNotification = BswMIssmEnterRunCallout
      IssmBswMExitRunNotification = BswMIssmExitRunCallout
      3 x IssmChannel:
        CHNL_df893ad5: IssmComMUser=CN_CabSubnet_aa77b0b0, IssmNetworkHandle=CN_CabSubnet_9ea693f1, IssmRxSignalRef=AnmSig_CCM_CabSubnet_oAnmMsg_CCM_CabSubnet_oCabSubnet_eb4ad192_Rx, IssmRxSignalRef=AnmSig_ECUspare6_CabSubnet_oAnmMsg_ECUspare6_CabSubnet_oCabSubnet_b891e97c_Rx, IssmRxSignalRef=AnmSig_LECM1_CabSubnet_oAnmMsg_LECM1_CabSubnet_oCabSubnet_e04b322d_Rx, IssmRxSignalRef=AnmSig_SRS_CabSubnet_oAnmMsg_SRS_CabSubnet_oCabSubnet_deb2073e_Rx, IssmRxSignalRef=AnmSig_WRCS_CabSubnet_oAnmMsg_WRCS_CabSubnet_oCabSubnet_a4bc01b1_Rx, IssmTxSignalRef=AnmSig_CIOM_CabSubnet_oAnmMsg_CIOM_CabSubnet_oCabSubnet_5a34740d_Tx
          IssmIssPerChannel: IssmIssChannel=IssmIss_002
        CHNL_a6b6a922: IssmComMUser=CN_Backbone2_3f947ba3, IssmNetworkHandle=CN_Backbone2_78967e2c, IssmRxSignalRef=AnmSig_BBM_Backbone2_oAnmMsg_BBM_Backbone2_oBackbone2_396d1d95_Rx, IssmRxSignalRef=AnmSig_DACU_Backbone2_oAnmMsg_DACU_Backbone2_oBackbone2_82fc6af4_Rx, IssmRxSignalRef=AnmSig_ECUspare1_Backbone2_oAnmMsg_ECUspare1_Backbone2_oBackbone2_9471a62d_Rx, IssmRxSignalRef=AnmSig_ECUspare2_Backbone2_oAnmMsg_ECUspare2_Backbone2_oBackbone2_fa2b273f_Rx, IssmRxSignalRef=AnmSig_EMS_Backbone2_oAnmMsg_EMS_Backbone2_oBackbone2_c10b5f2c_Rx, IssmRxSignalRef=AnmSig_IC3_Backbone2_oAnmMsg_IC3_Backbone2_oBackbone2_15db4986_Rx, IssmRxSignalRef=AnmSig_TECU_Backbone2_oAnmMsg_TECU_Backbone2_oBackbone2_a0843952_Rx, IssmRxSignalRef=AnmSig_VMCU_Backbone2_oAnmMsg_VMCU_Backbone2_oBackbone2_64a6ada3_Rx, IssmTxSignalRef=AnmSig_CIOM_Backbone2_oAnmMsg_CIOM_Backbone2_oBackbone2_8a1cbf56_Tx
          IssmIssPerChannel: IssmIssChannel=IssmIss_001
        CHNL_53cce282: IssmComMUser=CN_SecuritySubnet_7cec9a61, IssmNetworkHandle=CN_SecuritySubnet_e7a0ee54, IssmRxSignalRef=AnmSig_Alarm_SecuritySubnet_oAnmMsg_Alarm_SecuritySubnet_oSecuritySubnet_b4bb691c_Rx, IssmRxSignalRef=AnmSig_DDM_SecuritySubnet_oAnmMsg_DDM_SecuritySubnet_oSecuritySubnet_b331a2fd_Rx, IssmRxSignalRef=AnmSig_ECUspare5_SecuritySubnet_oAnmMsg_ECUspare5_SecuritySubnet_oSecuritySubnet_c77f9883_Rx, IssmRxSignalRef=AnmSig_PDM_SecuritySubnet_oAnmMsg_PDM_SecuritySubnet_oSecuritySubnet_99da07cf_Rx, IssmTxSignalRef=AnmSig_CIOM_SecuritySubnet_oAnmMsg_CIOM_SecuritySubnet_oSecuritySubnet_c3c93d33_Tx
          IssmIssPerChannel: IssmIssChannel=IssmIss
      3 x IssmIss:
        IssmIss: IssmIssIdentifier=0
        IssmIss_001: IssmIssIdentifier=1
        IssmIss_002: IssmIssIdentifier=2
      IssmUser: IssmUserIdentifier=0
        3 x IssmIssPerUser:
          IssmIssPerUser: IssmUserIss=IssmIss
          IssmIssPerUser_001: IssmUserIss=IssmIss_001
          IssmIssPerUser_002: IssmUserIss=IssmIss_002
