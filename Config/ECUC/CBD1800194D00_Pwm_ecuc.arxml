AUTOSAR XML (schema 4-2-1)
package /Pwm
  module config Pwm: implementation-config-variant=VARIANT-POST-BUILD, module-description=Pwm_Impl
    CommonPublishedInformation:
      ArReleaseMajorVersion = 4
      ArReleaseMinorVersion = 2
      ArReleaseRevisionVersion = 2
      ModuleId = 121
      SwMajorVersion = 1
      SwMinorVersion = 0
      SwPatchVersion = 0
      VendorId = 43
    PwmChannelConfigSet
      5 x PwmChannel, all with PwmDutycycleDefault=16384, PwmHwIP=eMios, PwmIdleState=PWM_LOW, PwmPeriodDefault=40000, PwmPeriodInTicks=true, PwmPolarity=PWM_HIGH, PwmMcuClockReferencePoint=F80_CLK:
        PwmChannel_HS_PWM_IN1: PwmChannelId=3, PwmChannelClass=PWM_VARIABLE_PERIOD, PwmeMiosChannel=PwmeMiosChannels_HS_PWM_IN1
        PwmChannel_LS_GATE1: PwmChannelId=0, PwmChannelClass=PWM_FIXED_PERIOD, PwmeMiosChannel=PwmeMiosChannels_LS_GATE1
        PwmChannel_LS_GATE2: PwmChannelId=1, PwmChannelClass=PWM_FIXED_PERIOD, PwmeMiosChannel=PwmeMiosChannels_LS_GATE2
        PwmChannel_LS_GATE3: PwmChannelId=2, PwmChannelClass=PWM_VARIABLE_PERIOD, PwmeMiosChannel=PwmeMiosChannels_LS_GATE3
        PwmChannel_REG_WDT_OUT: PwmChannelId=4, PwmChannelClass=PWM_FIXED_PERIOD, PwmeMiosChannel=PwmeMiosChannels_REG_WDT_OUT
      PwmeMios_0 (PwmeMios): PwmeMiosModule=eMios_0
        PwmeMiosChannels_HS_PWM_IN1 (PwmeMiosChannels):
          EmiosUnifiedChannelBusSelect = PWM_BUS_INTERNAL_COUNTER_U32
          OffsetDelayAdjust = false
          PwmFreezeEnable = false
          PwmModeSelect = PWM_MODE_OPWFMB_U32
          PwmOffset = 0
          PwmPrescaler = PwmPrescalerDiv1
          PwmPrescaler_Alternate = PwmPrescalerDiv1
          PwmTriggerDelay = 0
          Pwm_Deadtime = 0
          PwmeMiosChannel = Channel_24
        PwmeMiosChannels_REG_WDT_OUT (PwmeMiosChannels):
          EmiosUnifiedChannelBusSelect = PWM_BUS_F_U32
          OffsetDelayAdjust = false
          PwmFreezeEnable = false
          PwmModeSelect = PWM_MODE_OPWMB_U32
          PwmOffset = 0
          PwmPrescaler = PwmPrescalerDiv1
          PwmPrescaler_Alternate = PwmPrescalerDiv1
          PwmTriggerDelay = 0
          Pwm_Deadtime = 0
          PwmeMiosChannel = Channel_29
        PwmeMiosMasterBus_A (PwmeMiosMasterBus):
          MasterBusPeriodDefault = 40000
          MasterBusPeriodInTicks = true
          MasterBusPrescaler = PwmPrescalerDiv1
          MasterBusPrescaler_Alternate = PwmPrescalerDiv1
          MasterModeSelect = MASTER_MODE_UP_BUFFERED_COUNTER_U32
          PwmeMiosMasterBus = Channel_23
        PwmeMiosChannels_HS_PWM_IN2 (PwmeMiosChannels):
          EmiosUnifiedChannelBusSelect = PWM_BUS_A_U32
          OffsetDelayAdjust = false
          PwmFreezeEnable = false
          PwmModeSelect = PWM_MODE_OPWMB_U32
          PwmOffset = 0
          PwmPrescaler = PwmPrescalerDiv1
          PwmPrescaler_Alternate = PwmPrescalerDiv1
          PwmTriggerDelay = 0
          Pwm_Deadtime = 0
          PwmeMiosChannel = Channel_25
        PwmeMiosMasterBus_F (PwmeMiosMasterBus):
          MasterBusPeriodDefault = 40000
          MasterBusPeriodInTicks = true
          MasterBusPrescaler = PwmPrescalerDiv1
          MasterBusPrescaler_Alternate = PwmPrescalerDiv1
          MasterModeSelect = MASTER_MODE_UP_BUFFERED_COUNTER_U32
          PwmeMiosMasterBus = Channel_22
      PwmeMios_1 (PwmeMios): PwmeMiosModule=eMios_1
        3 x PwmeMiosChannels, all with OffsetDelayAdjust=false, PwmFreezeEnable=false, PwmOffset=0, PwmPrescaler=PwmPrescalerDiv1, PwmPrescaler_Alternate=PwmPrescalerDiv1, PwmTriggerDelay=0, Pwm_Deadtime=0:
          PwmeMiosChannels_LS_GATE1: EmiosUnifiedChannelBusSelect=PWM_BUS_A_U32, PwmModeSelect=PWM_MODE_OPWMB_U32, PwmeMiosChannel=Channel_6
          PwmeMiosChannels_LS_GATE2: EmiosUnifiedChannelBusSelect=PWM_BUS_F_U32, PwmModeSelect=PWM_MODE_OPWMB_U32, PwmeMiosChannel=Channel_7
          PwmeMiosChannels_LS_GATE3: EmiosUnifiedChannelBusSelect=PWM_BUS_INTERNAL_COUNTER_U32, PwmModeSelect=PWM_MODE_OPWFMB_U32, PwmeMiosChannel=Channel_8
        PwmeMiosMasterBus_A (PwmeMiosMasterBus):
          MasterBusPeriodDefault = 40000
          MasterBusPeriodInTicks = true
          MasterBusPrescaler = PwmPrescalerDiv1
          MasterBusPrescaler_Alternate = PwmPrescalerDiv1
          MasterModeSelect = MASTER_MODE_UP_BUFFERED_COUNTER_U32
          PwmeMiosMasterBus = Channel_23
        PwmeMiosMasterBus_F (PwmeMiosMasterBus):
          MasterBusPeriodDefault = 40000
          MasterBusPeriodInTicks = true
          MasterBusPrescaler = PwmPrescalerDiv1
          MasterBusPrescaler_Alternate = PwmPrescalerDiv1
          MasterModeSelect = MASTER_MODE_UP_BUFFERED_COUNTER_U32
          PwmeMiosMasterBus = Channel_22
      PwmChannel_HS_PWM_IN2 (PwmChannel):
        PwmChannelId = 5
        PwmDutycycleDefault = 16384
        PwmHwIP = eMios
        PwmIdleState = PWM_LOW
        PwmPeriodDefault = 40000
        PwmPeriodInTicks = true
        PwmPolarity = PWM_HIGH
        PwmChannelClass = PWM_FIXED_PERIOD_SHIFTED
        PwmMcuClockReferencePoint = F80_CLK
        PwmeMiosChannel = PwmeMiosChannels_HS_PWM_IN2
    PwmConfigurationOfOptApiServices:
      MultiPwmChannelSynch = false
      PwmDeInitApi = true
      PwmGetChannelStateApi = false
      PwmGetOutputState = false
      PwmSetChannelOutputApi = true
      PwmSetCounterBusApi = false
      PwmSetDutyCycle = true
      PwmSetOutputToIdle = true
      PwmSetPeriodAndDuty = true
      PwmSetTriggerDelayApi = false
      PwmVersionInfoApi = true
    PwmGeneral:
      PwmChangeRegisterA = false
      PwmDevErrorDetect = false
      PwmDutycycleUpdatedEndperiod = true
      PwmEnableDualClockMode = false
      PwmEnableUserModeSupport = false
      PwmIndex = 0
      PwmNotificationSupported = true
      PwmPeriodUpdatedEndperiod = true
      PwmTimerPrecision = PWM_16BIT
      EmiosOperationModes: PwmDAOCfeature=true, PwmOPWFMBfeature=true, PwmOPWMBfeature=true, PwmOPWMCBfeature=false, PwmOPWMTfeature=false
      64 x PwmHwConfiguration:
        PwmHwConfiguration_0: PwmChannelIsUsed=false, PwmInterruptEnable=false, PwmInterruptHwId=EMIOS_0_CH_0
        PwmHwConfiguration_1: PwmChannelIsUsed=false, PwmInterruptEnable=false, PwmInterruptHwId=EMIOS_0_CH_1
        PwmHwConfiguration_{10..19}: PwmChannelIsUsed=false, PwmInterruptEnable=false, PwmInterruptHwId=EMIOS_0_CH_{10..19}
        PwmHwConfiguration_2: PwmChannelIsUsed=false, PwmInterruptEnable=false, PwmInterruptHwId=EMIOS_0_CH_2
        PwmHwConfiguration_20: PwmChannelIsUsed=false, PwmInterruptEnable=false, PwmInterruptHwId=EMIOS_0_CH_20
        PwmHwConfiguration_21: PwmChannelIsUsed=false, PwmInterruptEnable=false, PwmInterruptHwId=EMIOS_0_CH_21
        PwmHwConfiguration_{22..24}: PwmChannelIsUsed=true, PwmInterruptEnable=false, PwmInterruptHwId=EMIOS_0_CH_{22..24}
        PwmHwConfiguration_25: PwmChannelIsUsed=true, PwmInterruptEnable=true, PwmInterruptHwId=EMIOS_0_CH_25
        PwmHwConfiguration_{26..28}: PwmChannelIsUsed=false, PwmInterruptEnable=false, PwmInterruptHwId=EMIOS_0_CH_{26..28}
        PwmHwConfiguration_29: PwmChannelIsUsed=true, PwmInterruptEnable=false, PwmInterruptHwId=EMIOS_0_CH_29
        PwmHwConfiguration_3: PwmChannelIsUsed=false, PwmInterruptEnable=false, PwmInterruptHwId=EMIOS_0_CH_3
        PwmHwConfiguration_30: PwmChannelIsUsed=false, PwmInterruptEnable=false, PwmInterruptHwId=EMIOS_0_CH_30
        PwmHwConfiguration_31: PwmChannelIsUsed=false, PwmInterruptEnable=false, PwmInterruptHwId=EMIOS_0_CH_31
        PwmHwConfiguration_32: PwmChannelIsUsed=false, PwmInterruptEnable=false, PwmInterruptHwId=EMIOS_1_CH_0
        PwmHwConfiguration_33: PwmChannelIsUsed=false, PwmInterruptEnable=false, PwmInterruptHwId=EMIOS_1_CH_1
        PwmHwConfiguration_34: PwmChannelIsUsed=false, PwmInterruptEnable=false, PwmInterruptHwId=EMIOS_1_CH_2
        PwmHwConfiguration_35: PwmChannelIsUsed=false, PwmInterruptEnable=false, PwmInterruptHwId=EMIOS_1_CH_3
        PwmHwConfiguration_36: PwmChannelIsUsed=false, PwmInterruptEnable=false, PwmInterruptHwId=EMIOS_1_CH_4
        PwmHwConfiguration_37: PwmChannelIsUsed=false, PwmInterruptEnable=false, PwmInterruptHwId=EMIOS_1_CH_5
        PwmHwConfiguration_38: PwmChannelIsUsed=true, PwmInterruptEnable=true, PwmInterruptHwId=EMIOS_1_CH_6
        PwmHwConfiguration_39: PwmChannelIsUsed=true, PwmInterruptEnable=true, PwmInterruptHwId=EMIOS_1_CH_7
        PwmHwConfiguration_4: PwmChannelIsUsed=false, PwmInterruptEnable=false, PwmInterruptHwId=EMIOS_0_CH_4
        PwmHwConfiguration_40: PwmChannelIsUsed=true, PwmInterruptEnable=false, PwmInterruptHwId=EMIOS_1_CH_8
        PwmHwConfiguration_41: PwmChannelIsUsed=false, PwmInterruptEnable=false, PwmInterruptHwId=EMIOS_1_CH_9
        PwmHwConfiguration_42: PwmChannelIsUsed=false, PwmInterruptEnable=false, PwmInterruptHwId=EMIOS_1_CH_10
        PwmHwConfiguration_43: PwmChannelIsUsed=false, PwmInterruptEnable=false, PwmInterruptHwId=EMIOS_1_CH_11
        PwmHwConfiguration_44: PwmChannelIsUsed=false, PwmInterruptEnable=false, PwmInterruptHwId=EMIOS_1_CH_12
        PwmHwConfiguration_45: PwmChannelIsUsed=false, PwmInterruptEnable=false, PwmInterruptHwId=EMIOS_1_CH_13
        PwmHwConfiguration_46: PwmChannelIsUsed=false, PwmInterruptEnable=false, PwmInterruptHwId=EMIOS_1_CH_14
        PwmHwConfiguration_47: PwmChannelIsUsed=false, PwmInterruptEnable=false, PwmInterruptHwId=EMIOS_1_CH_15
        PwmHwConfiguration_48: PwmChannelIsUsed=false, PwmInterruptEnable=false, PwmInterruptHwId=EMIOS_1_CH_16
        PwmHwConfiguration_49: PwmChannelIsUsed=false, PwmInterruptEnable=false, PwmInterruptHwId=EMIOS_1_CH_17
        PwmHwConfiguration_5: PwmChannelIsUsed=false, PwmInterruptEnable=false, PwmInterruptHwId=EMIOS_0_CH_5
        PwmHwConfiguration_50: PwmChannelIsUsed=false, PwmInterruptEnable=false, PwmInterruptHwId=EMIOS_1_CH_18
        PwmHwConfiguration_51: PwmChannelIsUsed=false, PwmInterruptEnable=false, PwmInterruptHwId=EMIOS_1_CH_19
        PwmHwConfiguration_52: PwmChannelIsUsed=false, PwmInterruptEnable=false, PwmInterruptHwId=EMIOS_1_CH_20
        PwmHwConfiguration_53: PwmChannelIsUsed=false, PwmInterruptEnable=false, PwmInterruptHwId=EMIOS_1_CH_21
        PwmHwConfiguration_54: PwmChannelIsUsed=true, PwmInterruptEnable=false, PwmInterruptHwId=EMIOS_1_CH_22
        PwmHwConfiguration_55: PwmChannelIsUsed=true, PwmInterruptEnable=false, PwmInterruptHwId=EMIOS_1_CH_23
        PwmHwConfiguration_56: PwmChannelIsUsed=false, PwmInterruptEnable=false, PwmInterruptHwId=EMIOS_1_CH_24
        PwmHwConfiguration_57: PwmChannelIsUsed=false, PwmInterruptEnable=false, PwmInterruptHwId=EMIOS_1_CH_25
        PwmHwConfiguration_58: PwmChannelIsUsed=false, PwmInterruptEnable=false, PwmInterruptHwId=EMIOS_1_CH_26
        PwmHwConfiguration_59: PwmChannelIsUsed=false, PwmInterruptEnable=false, PwmInterruptHwId=EMIOS_1_CH_27
        PwmHwConfiguration_6: PwmChannelIsUsed=false, PwmInterruptEnable=false, PwmInterruptHwId=EMIOS_0_CH_6
        PwmHwConfiguration_60: PwmChannelIsUsed=false, PwmInterruptEnable=false, PwmInterruptHwId=EMIOS_1_CH_28
        PwmHwConfiguration_61: PwmChannelIsUsed=false, PwmInterruptEnable=false, PwmInterruptHwId=EMIOS_1_CH_29
        PwmHwConfiguration_62: PwmChannelIsUsed=false, PwmInterruptEnable=false, PwmInterruptHwId=EMIOS_1_CH_30
        PwmHwConfiguration_63: PwmChannelIsUsed=false, PwmInterruptEnable=false, PwmInterruptHwId=EMIOS_1_CH_31
        PwmHwConfiguration_{7..9}: PwmChannelIsUsed=false, PwmInterruptEnable=false, PwmInterruptHwId=EMIOS_0_CH_{7..9}
