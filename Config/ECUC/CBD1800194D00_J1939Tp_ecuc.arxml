AUTOSAR XML (schema 4-2-1)
package /ActiveEcuC
  module config J1939Tp: implementation-config-variant=VARIANT-PRE-COMPILE, module-description=J1939Tp_Impl
    J1939TpConfiguration
      Backbone1J1939_dba64907 (J1939TpRxChannel): J1939TpRxSa=238, J1939TpRxChannelComMNetworkHandleRef=CN_Backbone1J1939_0b1f4bae
        DI_X_TACHO_oBackbone1J1939_6121ec8b_Rx (J1939TpRxPg): J1939TpRxPgDynLength=true, J1939TpRxPgPGN=65131
          J1939TpRxNSdu_dc2079cf (J1939TpRxNSdu): J1939TpRxNSduId=0, J1939TpRxNSduRef=DI_X_TACHO_oBackbone1J1939_6121ec8b_Rx
          J1939TpRxDirectNPdu_dc2079cf (J1939TpRxDirectNPdu): J1939TpRxDirectNPduId=3, J1939TpRxDirectNPduRef=TPDirect_0FE6B_Tp_oBackbone1J1939_71559532_Rx
        PropTCO2_X_TACHO_oBackbone1J1939_4169b979_Rx (J1939TpRxPg): J1939TpRxPgDynLength=false, J1939TpRxPgPGN=65475
          J1939TpRxNSdu_e1788331 (J1939TpRxNSdu): J1939TpRxNSduId=1, J1939TpRxNSduRef=PropTCO2_X_TACHO_oBackbone1J1939_4169b979_Rx
        J1939TpRxCmNPdu_6eff89d5 (J1939TpRxCmNPdu): J1939TpRxCmNPduId=1, J1939TpRxCmNPduRef=TPCM_Tp_oBackbone1J1939_b357cc8b_Rx
        J1939TpRxDtNPdu_6eff89d5 (J1939TpRxDtNPdu): J1939TpRxDtNPduId=2, J1939TpRxDtNPduRef=TPDT_Tp_oBackbone1J1939_005f683d_Rx
        FcNPdu_Backbone1J1939_dba64907 (J1939TpTxFcNPdu): J1939TpTxFcNPduTxConfId=2, J1939TpTxFcNPduRef=FcNPdu_Backbone1J1939_dba64907_Tx
      FMSNet_J1939_70bdad51 (J1939TpTxChannel): J1939TpTxSa=49, J1939TpTxChannelComMNetworkHandleRef=CN_FMSNet_fce1aae5
        DI_X_CIOMFMS_oFMSNet_45299e3a_Tx (J1939TpTxPg): J1939TpTxPgDynLength=true, J1939TpTxPgPGN=65131
          J1939TpTxNSdu_d8e4c05b (J1939TpTxNSdu): J1939TpTxNSduId=1, J1939TpTxNSduRef=DI_X_CIOMFMS_oFMSNet_45299e3a_Tx
          J1939TpTxDirectNPdu_d8e4c05b (J1939TpTxDirectNPdu): J1939TpTxDirectNPduTxConfId=3, J1939TpTxDirectNPduRef=TPDirect_0FE6B_Tp_oFMSNet_0aa5f2bd_Tx
        J1939TpTxCmNPdu_531b8760 (J1939TpTxCmNPdu): J1939TpTxCmNPduTxConfId=0, J1939TpTxCmNPduRef=TPCM_Tp_oFMSNet_527e1bbd_Tx
        J1939TpTxDtNPdu_531b8760 (J1939TpTxDtNPdu): J1939TpTxDtNPduTxConfId=1, J1939TpTxDtNPduRef=TPDT_Tp_oFMSNet_b75dd625_Tx
        FcNPdu_FMSNet_J1939_70bdad51 (J1939TpRxFcNPdu): J1939TpRxFcNPduId=0, J1939TpRxFcNPduRef=FcNPdu_Backbone1J1939_dba64907_Rx
      FMSNet_J1939_5ab570f8 (J1939TpTxChannel): J1939TpTxSa=49, J1939TpTxChannelComMNetworkHandleRef=CN_FMSNet_fce1aae5
        J1939TpTxCmNPdu_fc76e444 (J1939TpTxCmNPdu): J1939TpTxCmNPduTxConfId=0, J1939TpTxCmNPduRef=TPCM_Tp_oFMSNet_527e1bbd_Tx
        VI_X_CIOMFMS_oFMSNet_55f8530d_Tx (J1939TpTxPg): J1939TpTxPgDynLength=false, J1939TpTxPgPGN=65260
          J1939TpTxNSdu_90d241ce (J1939TpTxNSdu): J1939TpTxNSduId=0, J1939TpTxNSduRef=VI_X_CIOMFMS_oFMSNet_55f8530d_Tx
        J1939TpTxDtNPdu_fc76e444 (J1939TpTxDtNPdu): J1939TpTxDtNPduTxConfId=1, J1939TpTxDtNPduRef=TPDT_Tp_oFMSNet_b75dd625_Tx
        FcNPdu_FMSNet_J1939_5ab570f8 (J1939TpRxFcNPdu): J1939TpRxFcNPduId=0, J1939TpRxFcNPduRef=FcNPdu_Backbone1J1939_dba64907_Rx
    J1939TpGeneral:
      J1939TpDevErrorDetect = false
      J1939TpMainFunctionPeriod = 0.01
      J1939TpTxConfTimeout = 1.5
      J1939TpVersionInfoApi = false
      J1939TpSupportBam = true
      J1939TpSupportCmdt = true
      J1939TpSupportEtp = false
      J1939TpSupportFptp = false
      J1939TpRuntimeErrorReport = false
