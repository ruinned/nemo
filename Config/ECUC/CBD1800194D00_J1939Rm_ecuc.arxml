AUTOSAR XML (schema 4-2-1)
package /ActiveEcuC
  module config J1939Rm: implementation-config-variant=VARIANT-PRE-COMPILE, module-description=J1939Rm_Impl
    J1939RmGeneral:
      J1939RmSupportRequest2 = false
      J1939RmDevErrorDetect = false
      J1939RmMainFunctionPeriod = 0.01
      J1939RmSupportAckIndication = false
      J1939RmSupportAckTransmission = false
      J1939RmSupportRequestIndication = true
      J1939RmSupportRequestTransmission = false
      J1939RmSupportTimeoutSupervision = false
      J1939RmTxConfirmationTimeout = 1.5
      J1939RmVersionInfoApi = false
      J1939RmSupportComUser = true
      J1939RmRuntimeErrorReport = false
    J1939RmConfigSet
      Backbone1J1939_54966c1b (J1939RmChannel):
        J1939RmIsobusChannel = false
        J1939RmAckQueueSize = 10
        J1939RmRequestQueueSize = 10
        J1939RmRequestTimeoutMonitors = 10
        J1939RmRequest2QueueSize = 10
        J1939RmComMNetworkHandleRef = CN_Backbone1J1939_0b1f4bae
        RqstRxPdu_Backbone1J1939_54966c1b (J1939RmRqstRxPdu): J1939RmRqstRxPduId=0, J1939RmRqstRxPduRef=RqstRxPdu_Backbone1J1939_54966c1b
        AckmTxPdu_Backbone1J1939_54966c1b (J1939RmAckmTxPdu): J1939RmAckmTxPduId=0, J1939RmAckmTxPduRef=AckmTxPdu_Backbone1J1939_54966c1b
      CIOM_4d5cd289 (J1939RmNode): J1939RmNmNodeRef=CIOM_4d5cd289, J1939RmNodeChannelRef=Backbone1J1939_54966c1b, J1939RmNodeChannelRef=FMSNet_J1939_44d89c3b
        3 x J1939RmUser, all with J1939RmUserAckIndication=false, J1939RmUserSendAck=false, J1939RmUserSendRequest=false, J1939RmUserTimeoutSupervision=false:
          CIOM_cbc3dd0f: J1939RmUserPGN=60928, J1939RmUserType=J1939RM_USER_J1939NM, J1939RmUserRequestIndication=true
          Com_CIOM_4d5cd289: J1939RmUserRequestIndication=false, J1939RmUserType=J1939RM_USER_COM
            CIOM_BB1_01P_oBackbone1J1939_83fef105_Tx (J1939RmComIPdu): J1939RmComIPduPGN=65348, J1939RmComIPduRef=CIOM_BB1_01P_oBackbone1J1939_83fef105_Tx
          J1939RmUser_StartApplication: J1939RmUserRequestIndication=false, J1939RmUserType=J1939RM_USER_RTE, J1939RmUserId=0
      FMSNet_J1939_44d89c3b (J1939RmChannel):
        J1939RmIsobusChannel = false
        J1939RmAckQueueSize = 10
        J1939RmRequestQueueSize = 10
        J1939RmRequestTimeoutMonitors = 10
        J1939RmRequest2QueueSize = 10
        J1939RmComMNetworkHandleRef = CN_FMSNet_fce1aae5
        AckmTxPdu_FMSNet_J1939_44d89c3b (J1939RmAckmTxPdu): J1939RmAckmTxPduId=1, J1939RmAckmTxPduRef=AckmTxPdu_FMSNet_J1939_44d89c3b
        RqstRxPdu_FMSNet_J1939_44d89c3b (J1939RmRqstRxPdu): J1939RmRqstRxPduId=1, J1939RmRqstRxPduRef=RqstRxPdu_FMNSet_J1939
