AUTOSAR XML (schema 4-2-1)
package /Mcu
  module config Mcu: implementation-config-variant=VARIANT-POST-BUILD, module-description=Mcu_Impl
    CommonPublishedInformation:
      ArReleaseMajorVersion = 4
      ArReleaseMinorVersion = 2
      ArReleaseRevisionVersion = 2
      ModuleId = 101
      SwMajorVersion = 1
      SwMinorVersion = 0
      SwPatchVersion = 0
      VendorApiInfix = 
      VendorId = 43
    McuCoreControlConfiguration: McuCADDRnControl=false
    McuDebugConfiguration:
      McuDisableCmuApi = false
      McuDisableDemReportErrorStatus = false
      McuEmiosConfigureGprenApi = false
      McuGetMidrStructureApi = false
      McuGetPeriphStateApi = false
      McuGetPowerDomainApi = false
      McuGetPowerModeStatetApi = false
      McuGetSystemStatetApi = false
      McuSscmGetMemConfigApi = false
      McuSscmGetStatusApi = false
      McuSscmGetUopsApi = false
    McuEMIOSConfiguration: McuEMIOSControl=true
    McuGeneralConfiguration:
      McuCalloutBeforePerformReset = false
      McuDevErrorDetect = true
      McuDisableFlashConfigFromRam = false
      McuEnableUserModeSupport = false
      McuEnterLowPowerMode = true
      McuGetRamStateApi = false
      McuInitClock = true
      McuNoPll = false
      McuPerformResetApi = false
      McuPerformResetCallout = NULL_PTR
      McuTimeout = 50000
      McuUseLpuModes = false
      McuVersionInfoApi = true
    McuModuleConfiguration:
      McuClockSrcFailureNotification = ENABLED
      McuExternalClockFrequencyHz = 16000000
      McuFastCrystalFrequencyHz = 16000000
      McuFastIrcFrequencyHz = 16000000
      McuNumberOfMcuModes = 1
      McuRamSectors = 1
      McuSlowCrystalFrequencyHz = 32767
      McuSlowIrcFrequencyHz = 128000
      McuResetSetting = 1
      McuClockSettingConfig_0 (McuClockSettingConfig):
        McuClkSetFIRCOSC_En = true
        McuClkSetFXOSC_En = true
        McuClkSetPLL0_En = true
        McuClkSetSIRCOSC_En = true
        McuClkSetSXOSC_En = false
        McuClksysClockMcuControl = true
        McuClockSettingId = 0
        McuSystemClkDiv{0..6}_En = true
        McuSystemClkDiv_Divider0 = 1
        McuSystemClkDiv_Divider1 = 2
        McuSystemClkDiv_Divider2 = 4
        McuSystemClkDiv_Divider3 = 4
        McuSystemClkDiv_Divider4 = 2
        McuSystemClkDiv_Divider5 = 2
        McuSystemClkDiv_Divider6 = 8
        McuSystemClockF160Freq = 160000000
        McuSystemClockF20Freq = 20000000
        McuSystemClockF40Freq = 40000000
        McuSystemClockF80Freq = 80000000
        McuSystemClockFS80Freq = 80000000
        McuSystemClockS160Freq = 160000000
        McuSystemClockS40Freq = 40000000
        McuSystemClockS80Freq = 80000000
        McuSystemClockSwitch = PLL0_PHI0
        McuAuxClock2: McuAuxClkFreq=40000000, McuAuxClk_Source=F40, McuAuxClockUnderMcuControl=true
        McuAuxClock4: McuAuxClkFreq=40000000, McuAuxClk_Source=F40, McuAuxClockUnderMcuControl=false
        McuAuxClock5_FMPLL_CLKIN (McuAuxClock5): McuAuxClkFreq=16000000, McuAuxClk_Source=FXOSC, McuAuxClockUnderMcuControl=true
        McuAuxClock6_CLKOUT_0 (McuAuxClock6): McuAuxClkDiv0Freq=4000000, McuAuxClkDiv0_Divisor=20, McuAuxClkDiv0_En=true, McuAuxClk_Source=PLL0_PHI1, McuAuxClockUnderMcuControl=true
        McuAuxClock8_SPI0 (McuAuxClock8): McuAuxClkFreq=40000000, McuAuxClk_Source=F40, McuAuxClockUnderMcuControl=true
        McuAuxClock9_FlexCAN0 (McuAuxClock9): McuAuxClkFreq=80000000, McuAuxClk_Source=FS80, McuAuxClockUnderMcuControl=true
        McuCLKOUT1: McuCLKOUT1Div_En=true, McuCLKOUT1Freq=160000000, McuCLKOUT1UnderMcuControl=true, McuCLKOUT1_Divisor=1, McuCLKOUT1_Source=PLL0_PHI0
        McuClkMonitor_0: McuClkMonitorEn=false, McuHighFrequencyRef=4095, McuLowFrequencyRef=0, McuRCDivisorFactor=DIV_1
        McuEMIOS
          McuEMIOS_0:
            McuEMIOS_Clk = 80000000
            McuExternalTimeBase = true
            McuFreezeBit = false
            McuGlobalPrescaler = 1
            McuGlobalPrescalerEnable = true
            McuGlobalTimeBaseEnable = true
            McuMdisBit = false
          McuEMIOS_1:
            McuEMIOS_Clk = 80000000
            McuExternalTimeBase = true
            McuFreezeBit = false
            McuGlobalPrescaler = 1
            McuGlobalPrescalerEnable = true
            McuGlobalTimeBaseEnable = true
            McuMdisBit = false
          McuEMIOS_2:
            McuEMIOS_Clk = 100000000
            McuMdisBit = false
            McuFreezeBit = false
            McuGlobalTimeBaseEnable = true
            McuExternalTimeBase = false
            McuGlobalPrescalerEnable = false
            McuGlobalPrescaler = 1
        McuFIRC: McuFIRCUnderMcuControl=true, McuFIRC_Div=1, McuFIRC_DivOutputValue=16000000
        McuFXOSC:
          McuFXOSCUnderMcuControl = true
          McuFXOSC_Div = 1
          McuFXOSC_DivOutputValue = 16000000
          McuFXOSC_EOCV = 48
          McuFXOSC_M_OSC = false
          McuFXOSC_OSCBYP = false
          McuFXOSC_OSCM = true
        McuFlash: McuFlashAddrPipelineControl=0, McuFlashReadWaitStateControl=4
        McuPll_0: McuPLLUnderMcuControl=true
          McuPll_Configuration:
            McuExternalPowerDownCycleInt = false
            McuPllCal3Mfden = 4096
            McuPllCalBypcal = false
            McuPllCrLolie = false
            McuPllCrLolre = false
            McuPllDvMfd = 80
            McuPllDvPrediv = 2
            McuPllDvRfdphi = 1
            McuPllDvRfdphi1 = 2
            McuPllFdDthDis = false
            McuPllFdMfn = 0
            McuPllFdSdm2 = false
            McuPllFdSdm3 = false
            McuPllFdSmden = false
            McuPllFmSscgbyp = false
            McuPllFmStepno = 0
            McuPllFmStepsize = 0
          McuPll_Parameter: PLL_PHI1_Frequency=80000000, PLL_PHI_Frequency=160000000, PLL_VCO_Frequency=640000000
        McuProgClkSwitch: McuProgresSwitchDuration=0
          McuPcsConfig_0 (McuPcsConfig): McuPCS_DivEnd=999, McuPCS_DivInit=999, McuPCS_DivRate=0, McuPCS_DivStart=999, McuPCS_Name=PCS_1
          McuPcsConfig_1 (McuPcsConfig): McuPCS_DivEnd=999, McuPCS_DivInit=999, McuPCS_DivRate=0, McuPCS_DivStart=999, McuPCS_Name=PCS_2
        McuRam
          McuRamPRAMC_0_PRCR1: McuFT_DIS=0, McuP0BODIS=false, McuP1BODIS=false, McuPRI=2
          McuRamPRAMC_1_PRCR1: McuFT_DIS=0, McuP0BODIS=false
          McuRamPRAMC_2_PRCR1: McuFT_DIS=0, McuP0BODIS=false
        McuSIRC: McuSIRCUnderMcuControl=true, McuSIRC_Div=1, McuSIRC_DivOutputValue=128000
        McuSXOSC:
          McuSXOSCUnderMcuControl = true
          McuSXOSC_ALC = false
          McuSXOSC_Div = 1
          McuSXOSC_DivOutputValue = 32767
          McuSXOSC_EOCV = 64
          McuSXOSC_M_OSC = false
          McuSXOSC_OSCBYP = false
        7 x McuClockReferencePoint:
          F40_CLK: McuClockFrequencySelect=F40, McuClockReferencePointFrequency=40000000
          SIRC_CLK: McuClockFrequencySelect=SIRC, McuClockReferencePointFrequency=128000
          SYS_CLK: McuClockFrequencySelect=F160, McuClockReferencePointFrequency=160000000
          F80_CLK: McuClockFrequencySelect=F80, McuClockReferencePointFrequency=80000000
          FS80_CLK: McuClockFrequencySelect=F80, McuClockReferencePointFrequency=80000000
          FXOSC_CLK: McuClockFrequencySelect=FXOSC, McuClockReferencePointFrequency=16000000
          CAN_CLK: McuClockFrequencySelect=F40, McuClockReferencePointFrequency=40000000
      McuCoreConfiguration
        McuCoreZ2Configuration:
          McuBootAddress = 0
          McuCCTL3Drun = false
          McuCCTL3Run{0..3} = false
          McuCCTL3Safe = false
          McuCoreReset = false
          McuUseDefaultBootAddrEnable = true
        McuCoreZ4AConfiguration:
          McuBootAddress = 0
          McuCCTL1Drun = true
          McuCCTL1Run{0..3} = true
          McuCCTL1Safe = true
          McuCoreReset = false
          McuUseDefaultBootAddrEnable = true
        McuCoreZ4BConfiguration:
          McuBootAddress = 0
          McuCCTL2Drun = false
          McuCCTL2Run{0..3} = false
          McuCCTL2Safe = false
          McuCoreReset = false
          McuUseDefaultBootAddrEnable = true
      McuEnableMode: McuModeRun1=true, McuModeRun2=true, McuModeRun3=true, McuModeStandBy0=false, McuModeStop0=false
      McuInterruptEvents: McuAlternateResetEvent=false
      McuInterruptTransition: McuInvalidConfiguration=false, McuInvalidCoreConfiguration=false, McuInvalidMode=false, McuSafeMode=false, McuTransitionComplete=false
      8 x McuLowPowerConfig, all with McuStandby0=false, McuStop0=false:
        McuLowPowerConfig_{0..7}
      McuModeSettingConf_0 (McuModeSettingConf):
        McuFXoscControl = false
        McuFastTransition = false
        McuFircControl = true
        McuFlashPowerControl = NormalMode
        McuMainVoltageRegulatorControl = true
        McuMode = 0
        McuOutputPowerDownControl = false
        McuPll0Control = true
        McuPowerLevelControl = 0
        McuPowerMode = DRUN
        McuSIrcOscControl = false
        McuSXOscControl = false
        McuSystemClockSwitch = PLL0_PHI0
        McuCoreConfiguration:
          McuCoreCaddr1BootAddr = 0
          McuCoreCaddr1ResetEnable = false
          McuCoreCaddr2BootAddr = 0
          McuCoreCaddr2ResetEnable = false
          McuCoreCaddr3BootAddr = 0
          McuCoreCaddr3ResetEnable = false
          McuCoreZ2DefaultBootAddrEnable = true
          McuCoreZ4ADefaultBootAddrEnable = true
          McuCoreZ4BDefaultBootAddrEnable = true
        McuLpuConfiguration:
          McuCAN0ContinuousOperation = false
          McuDirectDrun = false
          McuDisableAdc0 = false
          McuDisableBctu = false
          McuDisableCan0 = false
          McuDisableCmp{0..2} = false
          McuDisableEmios0 = false
          McuDisableEmios2 = false
          McuDisableLin0 = false
          McuDisableMemu1 = false
          McuDisableSpi0 = false
          McuFXoscControl = false
          McuFircControl = true
          McuLpuMRIGInterruptEnable = false
          McuLpuNEMInterruptEnable = false
          McuLpuSleep = false
          McuSIrcOscControl = false
          McuSXOscControl = false
          McuSystemClockSelect = false
        McuModeSettingConfAfterWkp:
          McuFXoscControl = false
          McuFircControl = true
          McuFlashPowerControl = NormalMode
          McuOutputPowerDownControl = false
          McuPll0Control = true
          McuPowerLevelControl = 0
          McuSIrcOscControl = false
          McuSXOscControl = false
          McuSystemClockSwitch = PLL0_PHI0
      57 x McuPeripheral, all with McuPerDBGConfig=false, McuPerLowPwrConfig=McuLowPowerConfig_0, McuPerRunConfig=McuRunConfig_0:
        McuPeripheral_0: McuPerName=PCTL0_BCTU
        McuPeripheral_1: McuPerName=PCTL1_eMIOS_0
        McuPeripheral_10: McuPerName=PCTL24_ADC_0
        McuPeripheral_11: McuPerName=PCTL25_ADC_1
        McuPeripheral_12: McuPerName=PCTL28_FlexRay
        McuPeripheral_13: McuPerName=PCTL30_IIC_0
        McuPeripheral_14: McuPerName=PCTL31_IIC_1
        McuPeripheral_15: McuPerName=PCTL32_IIC_2
        McuPeripheral_16: McuPerName=PCTL33_IIC_3
        McuPeripheral_17: McuPerName=PCTL40_DSPI_0
        McuPeripheral_18: McuPerName=PCTL41_DSPI_1
        McuPeripheral_19: McuPerName=PCTL42_DSPI_3
        McuPeripheral_2: McuPerName=PCTL2_eMIOS_1
        McuPeripheral_20: McuPerName=PCTL43_DSPI_4
        McuPeripheral_21: McuPerName=PCTL50_LIN_0
        McuPeripheral_22: McuPerName=PCTL51_LIN_1
        McuPeripheral_23: McuPerName=PCTL52_LIN_2
        McuPeripheral_24: McuPerName=PCTL53_LIN_3
        McuPeripheral_25: McuPerName=PCTL54_LIN_4
        McuPeripheral_26: McuPerName=PCTL55_LIN_5
        McuPeripheral_27: McuPerName=PCTL56_LIN_6
        McuPeripheral_28: McuPerName=PCTL57_LIN_7
        McuPeripheral_29: McuPerName=PCTL58_LIN_8
        McuPeripheral_3: McuPerName=PCTL10_SAI0
        McuPeripheral_30: McuPerName=PCTL59_LIN_9
        McuPeripheral_31: McuPerName=PCTL60_LIN_10
        McuPeripheral_32: McuPerName=PCTL61_LIN_11
        McuPeripheral_33: McuPerName=PCTL62_LIN_12
        McuPeripheral_34: McuPerName=PCTL63_LIN_13
        McuPeripheral_35: McuPerName=PCTL64_LIN_14
        McuPeripheral_36: McuPerName=PCTL65_LIN_15
        McuPeripheral_37: McuPerName=PCTL70_FLEXCAN_0
        McuPeripheral_38: McuPerName=PCTL71_FLEXCAN_1
        McuPeripheral_39: McuPerName=PCTL72_FLEXCAN_2
        McuPeripheral_4: McuPerName=PCTL11_SAI1
        McuPeripheral_40: McuPerName=PCTL73_FLEXCAN_3
        McuPeripheral_41: McuPerName=PCTL74_FLEXCAN_4
        McuPeripheral_42: McuPerName=PCTL75_FLEXCAN_5
        McuPeripheral_43: McuPerName=PCTL76_FLEXCAN_6
        McuPeripheral_44: McuPerName=PCTL77_FLEXCAN_7
        McuPeripheral_45: McuPerName=PCTL82_JDC
        McuPeripheral_46: McuPerName=PCTL83_MEMU_0
        McuPeripheral_47: McuPerName=PCTL84_CRC
        McuPeripheral_48: McuPerName=PCTL90_DMAMUX
        McuPeripheral_49: McuPerName=PCTL91_PIT_RTI_0
        McuPeripheral_5: McuPerName=PCTL12_SAI2
        McuPeripheral_50: McuPerName=PCTL93_WKPU
        McuPeripheral_51: McuPerName=PCTL96_SPI0
        McuPeripheral_52: McuPerName=PCTL97_SPI1
        McuPeripheral_53: McuPerName=PCTL98_SPI2
        McuPeripheral_54: McuPerName=PCTL99_SPI3
        McuPeripheral_55: McuPerName=PCTL102_RTC_API
        McuPeripheral_56: McuPerName=PCTL105_MEMU_1
        McuPeripheral_6: McuPerName=PCTL15_ENET
        McuPeripheral_7: McuPerName=PCTL20_CMP_0
        McuPeripheral_8: McuPerName=PCTL21_CMP_1
        McuPeripheral_9: McuPerName=PCTL22_CMP_2
      McuPlatformFlashConfig:
        McuBAFDisable = false
        McuFlashArbitrationMode = 0
        McuMaster0AccessProt = 3
        McuMaster{10..15}AccessProt = 3
        McuMaster{1..9}AccessProt = 3
        McuPort0DataPrefetch = false
        McuPort0InstructionPrefetch = false
        McuPort0Master0Prefetch = false
        McuPort0Master{10..15}Prefetch = false
        McuPort0Master{1..9}Prefetch = false
        McuPort0PageBufferConfiguration = 0
        McuPort0PrefetchLimit = 0
        McuPort0ReadBufferEnable = true
        McuPort1DataPrefetch = false
        McuPort1InstructionPrefetch = false
        McuPort1Master0Prefetch = false
        McuPort1Master{10..15}Prefetch = false
        McuPort1Master{1..9}Prefetch = false
        McuPort1PageBufferConfiguration = 0
        McuPort1PrefetchLimit = 0
        McuPort1ReadBufferEnable = true
        McuPort2DataPrefetch = false
        McuPort2InstructionPrefetch = false
        McuPort2Master0Prefetch = false
        McuPort2Master{10..15}Prefetch = false
        McuPort2Master{1..9}Prefetch = false
        McuPort2PageBufferConfiguration = 0
        McuPort2PrefetchLimit = 0
        McuPort2ReadBufferEnable = true
      McuPowerControl
        McuPmcMisc_Config: McuPmcMcr_FlashLpFastExistDis=true, McuPmcMcr_HvdRee=false, McuPmcMcr_LvdIoHiRee=false, McuPmcMcr_LvdPd2ColdRee=false
        McuPmcRamDomain_Config: McuPmcRdCr_MemSleep=false, McuPmcRdCr_PadKeep=false, McuPmcRdCr_Rd128Ret=false, McuPmcRdCr_Rd256Ret=false, McuPmcRdCr_Rd64Ret=false
      McuResetConfig: McuDestResetEscThreshold=15, McuFunctResetEscThreshold=15, McuResetType=FunctionalReset
        Mcu_BE_FCCU_LONG_ResetSource: McuResetPin=true
        Mcu_BE_FCCU_SHORT_ResetSource: McuResetPin=true
        Mcu_BE_HSM_FUNC_ResetSource: McuResetPin=true
        Mcu_D_CMU_OLR_ResetSource: McuDisableReset=false, McuEnableInterruptSafe=false, McuResetPhase=PHASE_1, McuResetPin=true
        Mcu_D_HVD_LV_COLD_ResetSource: McuDisableReset=false, McuEnableInterruptSafe=false, McuResetPhase=PHASE_1
        Mcu_D_JTAG_FUNC_ResetSource: McuDisableReset=false, McuEnableInterruptSafe=false, McuResetPhase=PHASE_1, McuResetPin=true
        Mcu_D_LVD_IO_A_HI_ResetSource: McuDisableReset=false, McuEnableInterruptSafe=false, McuResetPhase=PHASE_1
        Mcu_D_LVD_LV_PD2_COLD_ResetSource: McuDisableReset=false, McuEnableInterruptSafe=false, McuResetPhase=PHASE_1, McuResetPin=true
        Mcu_D_NMI_WKPU_ResetSource: McuDisableReset=false, McuEnableInterruptSafe=false, McuResetPhase=PHASE_1, McuResetPin=true
        Mcu_D_Z2_DBG_ResetSource: McuDisableReset=false, McuEnableInterruptSafe=false, McuResetPhase=PHASE_1, McuResetPin=true
        Mcu_D_Z4A_DBG_ResetSource: McuDisableReset=false, McuEnableInterruptSafe=false, McuResetPhase=PHASE_1, McuResetPin=true
        Mcu_D_Z4B_DBG_ResetSource: McuDisableReset=false, McuEnableInterruptSafe=false, McuResetPhase=PHASE_1, McuResetPin=true
        Mcu_SS_EXR_ResetSource: McuResetPhase=PHASE_1
        Mcu_SS_SOFT_FUNC_ResetSource: McuResetPhase=PHASE_1, McuResetPin=true
      8 x McuRunConfig, all with McuModeDRun=true, McuModeRun0=true, McuModeRun1=true, McuModeRun2=true, McuModeRun3=true, McuModeSafe=true:
        McuRunConfig_{0..7}
      McuDemEventParameterRefs:
        MCU_E_TIMEOUT_FAILURE = AutoCreatedDemEvent_MCU_E_TIMEOUT_FAILURE
        MCU_E_SSCM_CER_FAILURE = AutoCreatedDemEvent_MCU_E_SSCM_CER_FAILURE
        MCU_E_INVALIDMODE_CONFIG = AutoCreatedDemEvent_MCU_E_INVALIDMODE_CONFIG
        MCU_E_CLOCK_FAILURE = AutoCreatedDemEvent_MCU_E_CLOCK_FAILURE
      McuRamSectorSettingConf:
        McuRamSectorId = 0
        McuRamDefaultValue = 186
        McuRamSectionBaseAddress = 1073741824
        McuRamSectionSize = 1024
        McuRamSectionBaseAddrLinkerSym = 
        McuRamSectionSizeLinkerSym = 
    McuPublishedInformation
      27 x McuResetReasonConf:
        MCU_CMU_OLR_RESET: McuResetReason=15
        MCU_EXR_RESET: McuResetReason=9
        MCU_FCCU_LONG_RESET: McuResetReason=16
        MCU_FCCU_SHORT_RESET: McuResetReason=17
        MCU_FUNC_ESC_RESET: McuResetReason=4
        MCU_HSM_DEST_RESET: McuResetReason=1
        MCU_HSM_FUNC_RESET: McuResetReason=10
        MCU_HVD_LV_COLD_RESET: McuResetReason=22
        MCU_JTAG_FUNC_RESET: McuResetReason=13
        MCU_LVD_IO_A_HI_RESET: McuResetReason=21
        MCU_LVD_LV_PD2_COLD_RESET: McuResetReason=23
        MCU_MULTIPLE_RESET_REASON: McuResetReason=25
        MCU_NMI_WKPU_RESET: McuResetReason=12
        MCU_NO_RESET_REASON: McuResetReason=24
        MCU_POWER_ON_RESET: McuResetReason=0
        MCU_RESET_UNDEFINED: McuResetReason=26
        MCU_SOFT_DEST_RESET: McuResetReason=2
        MCU_SOFT_FUNC_RESET: McuResetReason=11
        MCU_SSCM_SEC_RESET: McuResetReason=3
        MCU_ST_DONE_RESET: McuResetReason=14
        MCU_SUF_RESET: McuResetReason=5
        MCU_SWT0_RESET: McuResetReason=6
        MCU_SWT1_RESET: McuResetReason=7
        MCU_SWT2_RESET: McuResetReason=8
        MCU_Z2_DBG_RESET: McuResetReason=20
        MCU_Z4A_DBG_RESET: McuResetReason=18
        MCU_Z4B_DBG_RESET: McuResetReason=19
