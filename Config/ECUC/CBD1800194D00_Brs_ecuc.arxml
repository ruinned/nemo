AUTOSAR XML (schema 4-2-1)
package /ActiveEcuC
  module config Brs: implementation-config-variant=VARIANT-PRE-COMPILE, module-description=Brs_Impl
    BrsGeneral:
      BrsEnableTgfSupport = false
      BrsEnableOsSupport = true
      BrsEnableOsEmulation = false
      BrsEnableTfwSupport = false
      BrsEnableSupportLEDs = false
      BrsEnableSafeContextSupport = true
      BrsEnableMcalTrustedOnly = false
      BrsEnableMultiCoreSupport = false
      BrsEnableSafeWdgSupport = false
      BrsEnableSafeWdgMultiCoreSupport = false
      BrsEnableHLPTestSupport = false
      BrsEnableTcmSupport = false
      BrsEnableExternalWakeup = false
      BrsEnableFblSupport = false
