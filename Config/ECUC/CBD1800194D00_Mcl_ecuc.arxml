AUTOSAR XML (schema 4-2-1)
package /Mcl
  module config Mcl: implementation-config-variant=VARIANT-POST-BUILD, module-description=Mcl_Impl
    CommonPublishedInformation:
      ArReleaseMajorVersion = 4
      ArReleaseMinorVersion = 2
      ArReleaseRevisionVersion = 2
      ModuleId = 255
      SwMajorVersion = 1
      SwMinorVersion = 0
      SwPatchVersion = 0
      VendorId = 43
    MclConfigSet_0 (MclConfigSet)
      DMAChannel_0 (DMAChannel):
        DMAChannelPriority = 0
        DPA = false
        DmaHwChannel = eDMA_0
        DmaSource{0..9} = NOT_USED
        ECP = false
        EMI = false
        MclDMAChannelEnable = false
        MclDMAChannelId = 0
        MclDMAChannelTriggerEnable = false
        MclDmaTransferCompletionNotif = NULL_PTR
      DmaInstance_0 (DmaInstance):
        DmaHwInstance = eDMA_Instance0
        MclEDMAChGroup{0..3}Priority = {0..3}
        MclEDMA_CLM = false
        MclEDMA_CX = false
        MclEDMA_ECX = false
        MclEDMA_EDBG = false
        MclEDMA_ERCA = false
        MclEDMA_ERGA = false
        MclEDMA_HALT = false
        MclEDMA_HOE = false
    MclGeneral:
      EnableDMA = true
      MclDevErrorDetect = true
      MclDisableDemReportErrorStatus = false
      MclDmaNotificationSupported = true
      MclEnableCrossbarSwitch = false
      MclEnableUserModeSupport = false
      MclErrorChecking = true
      MclErrorNotificationDma0 = NULL_PTR
      Mcl_DeInitApi = false
      Mcl_DmaGetChannelErrorStatusApi = false
      Mcl_DmaGetGlobalErrorStatusApi = false
      Mcl_VersionInfoApi = true
      32 x MclIsrAvailable, all with MclIsrEnabled=false:
        MclIsrAvailable_0: MclIsrName=eDMA_0
        MclIsrAvailable_1: MclIsrName=eDMA_1
        MclIsrAvailable_{10..19}: MclIsrName=eDMA_{10..19}
        MclIsrAvailable_2: MclIsrName=eDMA_2
        MclIsrAvailable_{20..29}: MclIsrName=eDMA_{20..29}
        MclIsrAvailable_3: MclIsrName=eDMA_3
        MclIsrAvailable_30: MclIsrName=eDMA_30
        MclIsrAvailable_31: MclIsrName=eDMA_31
        MclIsrAvailable_{4..9}: MclIsrName=eDMA_{4..9}
    MclDemEventParameterRefs:
      MCL_E_DMA_UNRECOGNIZED = AutoCreatedDemEvent_MCL_E_DMA_UNRECOGNIZED
      MCL_E_DMA_PRIORITY = AutoCreatedDemEvent_MCL_E_DMA_PRIORITY
      MCL_E_DMA_INCONSISTENCY = AutoCreatedDemEvent_MCL_E_DMA_INCONSISTENCY
      MCL_E_DMA_ECC = AutoCreatedDemEvent_MCL_E_DMA_ECC
      MCL_E_DMA_DESCRIPTOR = AutoCreatedDemEvent_MCL_E_DMA_DESCRIPTOR
      MCL_E_DMA_BUS = AutoCreatedDemEvent_MCL_E_DMA_BUS
