AUTOSAR XML (schema 4-2-1)
package /ActiveEcuC
  module config J1939Nm: implementation-config-variant=VARIANT-PRE-COMPILE, module-description=J1939Nm_Impl
    J1939NmGeneral:
      J1939NmDevErrorDetect = false
      J1939NmMainFunctionPeriod = 0.01
      J1939NmTxConfirmationTimeout = 1.5
      J1939NmVersionInfoApi = false
      J1939NmNameManagementSupport = false
      J1939NmGatewaySupport = false
      J1939NmRuntimeErrorReport = true
      J1939NmBusOffDelayTickPeriod = 0.01
    J1939NmConfigSet
      CIOM_4d5cd289 (J1939NmNode):
        J1939NmNodeNameArbitraryAddressCapable = false
        J1939NmNodeNameECUInstance = 0
        J1939NmNodeNameFunction = 0
        J1939NmNodeNameFunctionInstance = 0
        J1939NmNodeNameIdentityNumber = 50
        J1939NmNodeNameIndustryGroup = 0
        J1939NmNodeNameManufacturerCode = 0
        J1939NmNodeNameVehicleSystem = 0
        J1939NmNodeNameVehicleSystemInstance = 0
        J1939NmNodePreferredAddress = 49
        J1939NmNodeId = 0
        J1939NmNodeStartUpDelay = true
        J1939NmFirstDynamicAddress = 128
        J1939NmLastDynamicAddress = 247
        J1939NmAcceptsCommandedName = true
        J1939NmNodeChannelRef = Backbone1J1939_54966c1b
        J1939NmNodeChannelRef = FMSNet_J1939_44d89c3b
      Backbone1J1939_54966c1b (J1939NmChannel): J1939NmChannelUsesAddressArbitration=true, J1939NmComMNetworkHandleRef=CN_Backbone1J1939_0b1f4bae
        J1939NmRxPdu_fa509995 (J1939NmRxPdu): J1939NmRxPduId=1, J1939NmRxPduRef=J1939NmRxPdu_fa509995
        J1939NmTxPdu_fa509995 (J1939NmTxPdu): J1939NmTxPduId=1, J1939NmTxPduRef=J1939NmTxPdu_fa509995
      FMSNet_J1939_44d89c3b (J1939NmChannel): J1939NmChannelUsesAddressArbitration=true, J1939NmComMNetworkHandleRef=CN_FMSNet_fce1aae5
        J1939NmRxPdu_2068bfea (J1939NmRxPdu): J1939NmRxPduId=0, J1939NmRxPduRef=J1939NmRxPdu_2068bfea
        J1939NmTxPdu_2068bfea (J1939NmTxPdu): J1939NmTxPduId=0, J1939NmTxPduRef=J1939NmTxPdu_2068bfea
    J1939NmDemEventParameterRefs: J1939NM_E_ADDRESS_LOST=AutoCreatedDemEvent_J1939NM_E_ADDRESS_LOST
