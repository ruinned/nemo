AUTOSAR XML (schema 4-2-1)
package /ActiveEcuC
  module config CanSM: implementation-config-variant=VARIANT-PRE-COMPILE, module-description=CanSM_Impl
    CanSMConfiguration: CanSMModeRequestRepetitionMax=10, CanSMModeRequestRepetitionTime=0.1
      5 x CanSMManagerNetwork, all with CanSMBorCounterL1ToL2=5, CanSMBorTimeL1=1, CanSMBorTimeL2=3, CanSMBorTimeTxEnsured=5, CanSMBorTxConfirmationPolling=false:
        CHNL_17344684: CanSMComMNetworkHandleRef=CN_Backbone1J1939_0b1f4bae
          CT_Backbone1J1939_06c808fa (CanSMController): CanSMControllerId=CT_Backbone1J1939_198bcf1c
          CanSMDemEventParameterRefs:
            CANSM_E_MODE_REQUEST_TIMEOUT = AutoCreatedDemEvent_CHNL_17344684_CANSM_E_MODE_REQUEST_TIMEOUT
            CANSM_E_BUS_OFF = AutoCreatedDemEvent_CHNL_17344684_CANSM_E_BUS_OFF
        CHNL_a6b6a922: CanSMComMNetworkHandleRef=CN_Backbone2_78967e2c
          CT_Backbone2_3ba0d906 (CanSMController): CanSMControllerId=CT_Backbone2_34cfe263
          CanSMDemEventParameterRefs:
            CANSM_E_MODE_REQUEST_TIMEOUT = AutoCreatedDemEvent_CHNL_a6b6a922_CANSM_E_MODE_REQUEST_TIMEOUT
            CANSM_E_BUS_OFF = AutoCreatedDemEvent_CHNL_a6b6a922_CANSM_E_BUS_OFF
        CHNL_e058b4ae: CanSMComMNetworkHandleRef=CN_FMSNet_fce1aae5
          CT_FMSNet_14a6cb35 (CanSMController): CanSMControllerId=CT_FMSNet_119a8706
          CanSMDemEventParameterRefs:
            CANSM_E_MODE_REQUEST_TIMEOUT = AutoCreatedDemEvent_CHNL_e058b4ae_CANSM_E_MODE_REQUEST_TIMEOUT
            CANSM_E_BUS_OFF = AutoCreatedDemEvent_CHNL_e058b4ae_CANSM_E_BUS_OFF
        CHNL_53cce282: CanSMComMNetworkHandleRef=CN_SecuritySubnet_e7a0ee54
          CT_SecuritySubnet_00b0b407 (CanSMController): CanSMControllerId=CT_SecuritySubnet_f5346ae6
          CanSMDemEventParameterRefs:
            CANSM_E_MODE_REQUEST_TIMEOUT = AutoCreatedDemEvent_CHNL_53cce282_CANSM_E_MODE_REQUEST_TIMEOUT
            CANSM_E_BUS_OFF = AutoCreatedDemEvent_CHNL_53cce282_CANSM_E_BUS_OFF
        CHNL_df893ad5: CanSMComMNetworkHandleRef=CN_CabSubnet_9ea693f1
          CT_CabSubnet_7d5dfab2 (CanSMController): CanSMControllerId=CT_CabSubnet_d2ff0fbe
          CanSMDemEventParameterRefs:
            CANSM_E_MODE_REQUEST_TIMEOUT = AutoCreatedDemEvent_CHNL_df893ad5_CANSM_E_MODE_REQUEST_TIMEOUT
            CANSM_E_BUS_OFF = AutoCreatedDemEvent_CHNL_df893ad5_CANSM_E_BUS_OFF
    CanSMGeneral:
      CanSMDevErrorDetect = false
      CanSMMainFunctionTimePeriod = 0.01
      CanSMVersionInfoApi = false
      CanSMBorCheckLevel = false
      CanSMBusOffBegin = J1939Nm_GetBusOffDelay
      CanSMBusOffEnd = J1939Nm_BusOffEnd
      CanSMSetBaudrateApi = false
      CanSMGeneration: CanSMOutOfBoundsWriteSanitizer=false, CanSMOutOfBoundsReadSanitizer=false
