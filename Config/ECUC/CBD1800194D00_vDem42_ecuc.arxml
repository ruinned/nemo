AUTOSAR XML (schema 4-2-1)
package /ActiveEcuC
  module config vDem42: implementation-config-variant=VARIANT-PRE-COMPILE, module-description=vDem42_Impl
