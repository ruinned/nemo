AUTOSAR XML (schema 4-2-1)
package /ActiveEcuC
  module config LinIf: implementation-config-variant=VARIANT-PRE-COMPILE, module-description=LinIf_Impl
    LinIfGeneral:
      LinIfJ2602ResponseToleranceSupport = false
      LinIfCancelTransmitSupported = false
      LinIfDevErrorDetect = false
      LinIfMultipleDriversSupported = false
      LinIfMultipleTrcvDriverSupported = false
      LinIfNcOptionalRequestSupported = true
      LinIfTpSupported = true
      LinIfTrcvDriverSupported = false
      LinIfVersionInfoApi = false
      LinIfEvtFrameSupported = false
      LinIfSporadicFrameSupported = false
      LinIfRuntimeMeasurementSupport = false
      LinIfScheduleEndNotificationSupported = false
      LinIfSafeBswChecks = false
    LinIfGlobalConfig: LinIfTimeBase=0.005
      5 x LinIfChannel, all with LinIfGotoSleepConfirmationUL=LIN_SM, LinIfScheduleRequestConfirmationUL=LIN_SM, LinIfStartupState=SLEEP, LinIfWakeupConfirmationUL=LIN_SM, LinIfWakeupDelay=0.1, LinIfWakeupDelayExternal=0.1:
        CHNL_45618847: LinIfChannelId=2, LinIfChannelRef=CN_LIN00_2cd9a7df, LinIfComMNetworkHandleRef=CN_LIN00_2cd9a7df
          3 x LinIfFrame:
            FT_MasterReq_355bc768_Tx: LinIfChecksumType=CLASSIC, LinIfFrameType=MRF, LinIfLength=8, LinIfPid=60
              LinIfPduDirection
                LinIfInternalPdu
            FT_CIOMtoSlaves1_L1_417ce0d9_Tx: LinIfChecksumType=ENHANCED, LinIfLength=2, LinIfPid=120, LinIfFrameType=UNCONDITIONAL
              LinIfPduDirection
                LinIfTxPdu_61d4a9ba (LinIfTxPdu): LinIfTxPduId=6, LinIfUserTxUL=PDUR, LinIfTxPduRef=CIOMtoSlaves1_L1_oLIN00_09e24f2a_Tx
            FT_CIOMtoSlaves2_FR2_L1_90fdcedf_Tx: LinIfChecksumType=ENHANCED, LinIfLength=8, LinIfPid=186, LinIfFrameType=UNCONDITIONAL
              LinIfPduDirection
                LinIfTxPdu_6bd99233 (LinIfTxPdu): LinIfTxPduId=3, LinIfUserTxUL=PDUR, LinIfTxPduRef=CIOMtoSlaves2_FR2_L1_oLIN00_a56bd28e_Tx
          MasterReq_SlaveResp_03d8aeb9 (LinIfScheduleTable):
            LinIfRunMode = RUN_CONTINUOUS
            LinIfScheduleTableIndex = 1
            LinIfScheduleTableName = 
            LinIfResumePosition = START_FROM_BEGINNING
            LinIfScheduleMode = LINTP_APPLICATIVE_SCHEDULE
            MasterReq_SlaveResp_c885077f (LinIfEntry): LinIfDelay=0.02, LinIfEntryIndex=1, LinIfFrameRef=FT_SlaveResp_9d5cbedc_Rx
            MasterReq_SlaveResp_27d7b19e (LinIfEntry): LinIfDelay=0.02, LinIfEntryIndex=0, LinIfFrameRef=FT_MasterReq_355bc768_Tx
          FT_CIOMtoSlaves2_FR1_L1_82486131_Tx (LinIfFrame): LinIfChecksumType=ENHANCED, LinIfLength=5, LinIfPid=57, LinIfFrameType=UNCONDITIONAL
            LinIfPduDirection
              LinIfTxPdu_af15de2d (LinIfTxPdu): LinIfTxPduId=13, LinIfUserTxUL=PDUR, LinIfTxPduRef=CIOMtoSlaves2_FR1_L1_oLIN00_573c3f76_Tx
          FT_LECM2toCIOM_FR2_L1_4d04a22e_Rx (LinIfFrame): LinIfChecksumType=ENHANCED, LinIfLength=1, LinIfPid=43, LinIfFrameType=UNCONDITIONAL
            LinIfPduDirection
              LinIfRxPdu: LinIfUserRxIndicationUL=PDUR, LinIfRxPduRef=LECM2toCIOM_FR2_L1_oLIN00_a88c28c4_Rx
          3 x LinIfScheduleTable, all with LinIfRunMode=RUN_CONTINUOUS, LinIfScheduleTableName=, LinIfResumePosition=START_FROM_BEGINNING, LinIfScheduleMode=LINTP_APPLICATIVE_SCHEDULE:
            MasterReq_SlaveResp_Table_2_b31cdb33: LinIfScheduleTableIndex=3
              9 x LinIfEntry:
                MasterReq_SlaveResp_Table_2_3ee07bb3: LinIfDelay=0.02, LinIfEntryIndex=3, LinIfFrameRef=FT_LECM2toCIOM_FR1_L1_5fb10dc0_Rx
                MasterReq_SlaveResp_Table_2_da1a1a54: LinIfDelay=0.02, LinIfEntryIndex=6, LinIfFrameRef=FT_CIOMtoSlaves2_FR2_L1_90fdcedf_Tx
                MasterReq_SlaveResp_Table_2_d466a6d1: LinIfDelay=0.02, LinIfEntryIndex=0, LinIfFrameRef=FT_MasterReq_355bc768_Tx
                MasterReq_SlaveResp_Table_2_309cc736: LinIfDelay=0.015, LinIfEntryIndex=5, LinIfFrameRef=FT_LECMBasic2CIOM_L1_c4710275_Rx
                MasterReq_SlaveResp_Table_2_d1b2cd52: LinIfDelay=0.015, LinIfEntryIndex=2, LinIfFrameRef=FT_CIOMtoSlaves2_FR1_L1_82486131_Tx
                MasterReq_SlaveResp_Table_2_dfce71d7: LinIfDelay=0.01, LinIfEntryIndex=4, LinIfFrameRef=FT_LECM2toCIOM_FR2_L1_4d04a22e_Rx
                MasterReq_SlaveResp_Table_2_3548acb5: LinIfDelay=0.015, LinIfEntryIndex=7, LinIfFrameRef=FT_CIOMtoSlaves2_FR3_L1_2841a9ba_Tx
                MasterReq_SlaveResp_Table_2_3b341030: LinIfDelay=0.02, LinIfEntryIndex=1, LinIfFrameRef=FT_SlaveResp_9d5cbedc_Rx
                MasterReq_SlaveResp_Table_2_c33708dd: LinIfDelay=0.015, LinIfEntryIndex=8, LinIfFrameRef=FT_LECM2toCIOM_FR3_L1_f5b8c54b_Rx
            Table_2_b3b6af29: LinIfScheduleTableIndex=5
              19 x LinIfEntry:
                Table_2_1ed19cd0: LinIfDelay=0.015, LinIfEntryIndex=10, LinIfFrameRef=FT_CIOMtoSlaves2_FR1_L1_82486131_Tx
                Table_2_ffff96b4: LinIfDelay=0.01, LinIfEntryIndex=17, LinIfFrameRef=FT_LECM2toCIOM_FR2_L1_4d04a22e_Rx
                Table_2_34743ec8: LinIfDelay=0.015, LinIfEntryIndex=3, LinIfFrameRef=FT_LECMBasic2CIOM_L1_c4710275_Rx
                Table_2_098032dc: LinIfDelay=0.015, LinIfEntryIndex=18, LinIfFrameRef=FT_LECMBasic2CIOM_L1_c4710275_Rx
                Table_2_fa2bfd37: LinIfDelay=0.015, LinIfEntryIndex=15, LinIfFrameRef=FT_CIOMtoSlaves2_FR1_L1_82486131_Tx
                Table_2_26f1fb47: LinIfDelay=0.015, LinIfEntryIndex=9, LinIfFrameRef=FT_CIOMtoSlaves2_FR3_L1_2841a9ba_Tx
                Table_2_f45741b2: LinIfDelay=0.015, LinIfEntryIndex=13, LinIfFrameRef=FT_LECMBasic2CIOM_L1_c4710275_Rx
                Table_2_15794bd6: LinIfDelay=0.015, LinIfEntryIndex=14, LinIfFrameRef=FT_LECM2toCIOM_FR3_L1_f5b8c54b_Rx
                Table_2_db268829: LinIfDelay=0.01, LinIfEntryIndex=2, LinIfFrameRef=FT_LECM2toCIOM_FR2_L1_4d04a22e_Rx
                Table_2_d55a34ac: LinIfDelay=0.02, LinIfEntryIndex=4, LinIfFrameRef=FT_CIOMtoSlaves2_FR2_L1_90fdcedf_Tx
                Table_2_3fdce9ce: LinIfDelay=0.01, LinIfEntryIndex=7, LinIfFrameRef=FT_LECM2toCIOM_FR2_L1_4d04a22e_Rx
                Table_2_10ad2055: LinIfDelay=0.02, LinIfEntryIndex=16, LinIfFrameRef=FT_LECM2toCIOM_FR1_L1_5fb10dc0_Rx
                Table_2_def2e3aa: LinIfDelay=0.015, LinIfEntryIndex=0, LinIfFrameRef=FT_CIOMtoSlaves2_FR1_L1_82486131_Tx
                Table_2_1b05f753: LinIfDelay=0.01, LinIfEntryIndex=12, LinIfFrameRef=FT_LECM2toCIOM_FR2_L1_4d04a22e_Rx
                Table_2_d08e5f2f: LinIfDelay=0.02, LinIfEntryIndex=6, LinIfFrameRef=FT_LECM2toCIOM_FR1_L1_5fb10dc0_Rx
                Table_2_31a0554b: LinIfDelay=0.02, LinIfEntryIndex=1, LinIfFrameRef=FT_LECM2toCIOM_FR1_L1_5fb10dc0_Rx
                Table_2_3a08824d: LinIfDelay=0.015, LinIfEntryIndex=5, LinIfFrameRef=FT_CIOMtoSlaves2_FR1_L1_82486131_Tx
                Table_2_c9a34da6: LinIfDelay=0.015, LinIfEntryIndex=8, LinIfFrameRef=FT_LECMBasic2CIOM_L1_c4710275_Rx
                Table_2_f1832a31: LinIfDelay=0.02, LinIfEntryIndex=11, LinIfFrameRef=FT_LECM2toCIOM_FR1_L1_5fb10dc0_Rx
            Table_1_2abffe93: LinIfScheduleTableIndex=4
              6 x LinIfEntry:
                Table_1_748fc5e3: LinIfDelay=0.01, LinIfEntryIndex=2, LinIfFrameRef=FT_FSP1_Frame_L1_11528ace_Rx
                Table_1_95a1cf87: LinIfDelay=0.015, LinIfEntryIndex=5, LinIfFrameRef=FT_ILCP1toCIOM_L1_c9f6c6bc_Rx
                Table_1_9e091881: LinIfDelay=0.015, LinIfEntryIndex=1, LinIfFrameRef=FT_FSP_1_2_Req_L1_d20f4458_Tx
                Table_1_715bae60: LinIfDelay=0.01, LinIfEntryIndex=0, LinIfFrameRef=FT_Backlight_FuncInd_L1_7f2b7abe_Tx
                Table_1_7af37966: LinIfDelay=0.01, LinIfEntryIndex=4, LinIfFrameRef=FT_CIOMtoSlaves1_L1_417ce0d9_Tx
                Table_1_9bdd7302: LinIfDelay=0.01, LinIfEntryIndex=3, LinIfFrameRef=FT_FSP2_Frame_L1_fa6531cd_Rx
          FT_FSP2_Frame_L1_fa6531cd_Rx (LinIfFrame): LinIfChecksumType=ENHANCED, LinIfLength=2, LinIfPid=3, LinIfFrameType=UNCONDITIONAL
            LinIfPduDirection
              LinIfRxPdu: LinIfUserRxIndicationUL=PDUR, LinIfRxPduRef=FSP2_Frame_L1_oLIN00_b95ec9fd_Rx
          CT_LIN00_ef77645f (LinIfMaster): LinIfClusterTimeBase=0.005, LinIfJitter=0.0005, LinIfLoadBalancingOffset=0
          7 x LinIfFrame:
            FT_Backlight_FuncInd_L1_7f2b7abe_Tx: LinIfChecksumType=ENHANCED, LinIfLength=1, LinIfPid=180, LinIfFrameType=UNCONDITIONAL
              LinIfPduDirection
                LinIfTxPdu_3697d699 (LinIfTxPdu): LinIfTxPduId=10, LinIfUserTxUL=PDUR, LinIfTxPduRef=Backlight_FuncInd_L1_oLIN00_841aab0e_Tx
            FT_FSP_1_2_Req_L1_d20f4458_Tx: LinIfChecksumType=ENHANCED, LinIfLength=4, LinIfPid=245, LinIfFrameType=UNCONDITIONAL
              LinIfPduDirection
                LinIfTxPdu_493e2f86 (LinIfTxPdu): LinIfTxPduId=8, LinIfUserTxUL=PDUR, LinIfTxPduRef=FSP_1_2_Req_L1_oLIN00_bfd0179c_Tx
            FT_FSP1_Frame_L1_11528ace_Rx: LinIfChecksumType=ENHANCED, LinIfLength=2, LinIfPid=66, LinIfFrameType=UNCONDITIONAL
              LinIfPduDirection
                LinIfRxPdu: LinIfUserRxIndicationUL=PDUR, LinIfRxPduRef=FSP1_Frame_L1_oLIN00_7041c142_Rx
            FT_CIOMtoSlaves2_FR3_L1_2841a9ba_Tx: LinIfChecksumType=ENHANCED, LinIfLength=5, LinIfPid=251, LinIfFrameType=UNCONDITIONAL
              LinIfPduDirection
                LinIfTxPdu_3127f2fd (LinIfTxPdu): LinIfTxPduId=9, LinIfUserTxUL=PDUR, LinIfTxPduRef=CIOMtoSlaves2_FR3_L1_oLIN00_42767419_Tx
            FT_LECM2toCIOM_FR3_L1_f5b8c54b_Rx: LinIfChecksumType=ENHANCED, LinIfLength=5, LinIfPid=236, LinIfFrameType=UNCONDITIONAL
              LinIfPduDirection
                LinIfRxPdu: LinIfUserRxIndicationUL=PDUR, LinIfRxPduRef=LECM2toCIOM_FR3_L1_oLIN00_4f918e53_Rx
            FT_FSP2_SwitchDetResp_L1_d6c91baa_Rx: LinIfChecksumType=ENHANCED, LinIfLength=8, LinIfPid=177, LinIfFrameType=UNCONDITIONAL
              LinIfPduDirection
                LinIfRxPdu: LinIfUserRxIndicationUL=PDUR, LinIfRxPduRef=FSP2_SwitchDetResp_L1_oLIN00_8c08f040_Rx
            FT_SlaveResp_9d5cbedc_Rx: LinIfChecksumType=CLASSIC, LinIfFrameType=SRF, LinIfLength=8, LinIfPid=125
              LinIfPduDirection
                LinIfInternalPdu
          MasterReq_SlaveResp_Table_1_2a158a89 (LinIfScheduleTable):
            LinIfRunMode = RUN_CONTINUOUS
            LinIfScheduleTableIndex = 2
            LinIfScheduleTableName = 
            LinIfResumePosition = START_FROM_BEGINNING
            LinIfScheduleMode = LINTP_APPLICATIVE_SCHEDULE
            8 x LinIfEntry:
              MasterReq_SlaveResp_Table_1_9ae1e17f: LinIfDelay=0.015, LinIfEntryIndex=7, LinIfFrameRef=FT_ILCP1toCIOM_L1_c9f6c6bc_Rx
              MasterReq_SlaveResp_Table_1_7e1b8098: LinIfDelay=0.01, LinIfEntryIndex=2, LinIfFrameRef=FT_Backlight_FuncInd_L1_7f2b7abe_Tx
              MasterReq_SlaveResp_Table_1_949d5dfa: LinIfDelay=0.02, LinIfEntryIndex=1, LinIfFrameRef=FT_SlaveResp_9d5cbedc_Rx
              MasterReq_SlaveResp_Table_1_70673c1d: LinIfDelay=0.01, LinIfEntryIndex=4, LinIfFrameRef=FT_FSP1_Frame_L1_11528ace_Rx
              MasterReq_SlaveResp_Table_1_9f358afc: LinIfDelay=0.01, LinIfEntryIndex=5, LinIfFrameRef=FT_FSP2_Frame_L1_fa6531cd_Rx
              MasterReq_SlaveResp_Table_1_75b3579e: LinIfDelay=0.01, LinIfEntryIndex=6, LinIfFrameRef=FT_CIOMtoSlaves1_L1_417ce0d9_Tx
              MasterReq_SlaveResp_Table_1_91493679: LinIfDelay=0.015, LinIfEntryIndex=3, LinIfFrameRef=FT_FSP_1_2_Req_L1_d20f4458_Tx
              MasterReq_SlaveResp_Table_1_7bcfeb1b: LinIfDelay=0.02, LinIfEntryIndex=0, LinIfFrameRef=FT_MasterReq_355bc768_Tx
          Table_e_46b96b7e (LinIfScheduleTable):
            LinIfRunMode = RUN_CONTINUOUS
            LinIfScheduleTableIndex = 6
            LinIfScheduleTableName = 
            LinIfResumePosition = START_FROM_BEGINNING
            LinIfScheduleMode = LINTP_APPLICATIVE_SCHEDULE
            4 x LinIfEntry:
              Table_e_000e9368: LinIfDelay=0.015, LinIfEntryIndex=3, LinIfFrameRef=FT_ILCP1toCIOM_L1_c9f6c6bc_Rx
              Table_e_ea884e0a: LinIfDelay=0.02, LinIfEntryIndex=0, LinIfFrameRef=FT_FSP1_SwitchDetResp_L1_3c4fc6c8_Rx
              Table_e_05daf8eb: LinIfDelay=0.02, LinIfEntryIndex=1, LinIfFrameRef=FT_FSP2_SwitchDetResp_L1_d6c91baa_Rx
              Table_e_ef5c2589: LinIfDelay=0.01, LinIfEntryIndex=2, LinIfFrameRef=FT_CIOMtoSlaves1_L1_417ce0d9_Tx
          3 x LinIfFrame, all with LinIfChecksumType=ENHANCED, LinIfFrameType=UNCONDITIONAL:
            FT_FSP1_SwitchDetResp_L1_3c4fc6c8_Rx: LinIfLength=8, LinIfPid=240
              LinIfPduDirection
                LinIfRxPdu: LinIfUserRxIndicationUL=PDUR, LinIfRxPduRef=FSP1_SwitchDetResp_L1_oLIN00_a6b440c8_Rx
            FT_ILCP1toCIOM_L1_c9f6c6bc_Rx: LinIfLength=3, LinIfPid=139
              LinIfPduDirection
                LinIfRxPdu: LinIfUserRxIndicationUL=PDUR, LinIfRxPduRef=ILCP1toCIOM_L1_oLIN00_dd00be4f_Rx
            FT_LECMBasic2CIOM_L1_c4710275_Rx: LinIfLength=3, LinIfPid=94
              LinIfPduDirection
                LinIfRxPdu: LinIfUserRxIndicationUL=PDUR, LinIfRxPduRef=LECMBasic2CIOM_L1_oLIN00_efdd1437_Rx
          NULLSchedule_CHNL_45618847 (LinIfScheduleTable): LinIfResumePosition=CONTINUE_AT_IT_POINT, LinIfRunMode=RUN_CONTINUOUS, LinIfScheduleMode=LINTP_APPLICATIVE_SCHEDULE, LinIfScheduleTableIndex=0
          FT_LECM2toCIOM_FR1_L1_5fb10dc0_Rx (LinIfFrame): LinIfChecksumType=ENHANCED, LinIfLength=8, LinIfPid=221, LinIfFrameType=UNCONDITIONAL
            LinIfPduDirection
              LinIfRxPdu: LinIfUserRxIndicationUL=PDUR, LinIfRxPduRef=LECM2toCIOM_FR1_L1_oLIN00_5adbc53c_Rx
        CHNL_def0ca51: LinIfChannelId=4, LinIfChannelRef=CN_LIN04_2bb463c6, LinIfComMNetworkHandleRef=CN_LIN04_2bb463c6
          MasterReq_SlaveResp_294c3867 (LinIfScheduleTable):
            LinIfRunMode = RUN_CONTINUOUS
            LinIfScheduleTableIndex = 1
            LinIfScheduleTableName = 
            LinIfResumePosition = START_FROM_BEGINNING
            LinIfScheduleMode = LINTP_APPLICATIVE_SCHEDULE
            MasterReq_SlaveResp_c41c1a6d (LinIfEntry): LinIfDelay=0.02, LinIfEntryIndex=0, LinIfFrameRef=FT_MasterReq_dc33ca8a_Tx
            MasterReq_SlaveResp_2b4eac8c (LinIfEntry): LinIfDelay=0.02, LinIfEntryIndex=1, LinIfFrameRef=FT_SlaveResp_7434b33e_Rx
          FT_CIOMtoSlaves_L5_8632ed67_Tx (LinIfFrame): LinIfChecksumType=ENHANCED, LinIfLength=2, LinIfPid=120, LinIfFrameType=UNCONDITIONAL
            LinIfPduDirection
              LinIfTxPdu_f1527db2 (LinIfTxPdu): LinIfTxPduId=18, LinIfUserTxUL=PDUR, LinIfTxPduRef=CIOMtoSlaves_L5_oLIN04_251caba0_Tx
          3 x LinIfScheduleTable, all with LinIfRunMode=RUN_CONTINUOUS, LinIfScheduleTableName=, LinIfResumePosition=START_FROM_BEGINNING, LinIfScheduleMode=LINTP_APPLICATIVE_SCHEDULE:
            Table_2_aa1a2032: LinIfScheduleTableIndex=5
              3 x LinIfEntry:
                Table_2_ea6a1687: LinIfDelay=0.01, LinIfEntryIndex=1, LinIfFrameRef=FT_Backlight_FuncInd_L5_89c53287_Tx
                Table_2_00eccbe5: LinIfDelay=0.015, LinIfEntryIndex=2, LinIfFrameRef=FT_RCECStoCIOM_L5_a45c9d29_Rx
                Table_2_0538a066: LinIfDelay=0.01, LinIfEntryIndex=0, LinIfFrameRef=FT_CIOMtoSlaves_L5_8632ed67_Tx
            Table_e_5f15e465: LinIfScheduleTableIndex=6
              3 x LinIfEntry:
                Table_e_de10bb27: LinIfDelay=0.01, LinIfEntryIndex=1, LinIfFrameRef=FT_CIOMtoSlaves_L5_8632ed67_Tx
                Table_e_31420dc6: LinIfDelay=0.02, LinIfEntryIndex=0, LinIfFrameRef=FT_FSP1_SwitchDetResp_L5_00bda195_Rx
                Table_e_34966645: LinIfDelay=0.015, LinIfEntryIndex=2, LinIfFrameRef=FT_RCECStoCIOM_L5_a45c9d29_Rx
            MasterReq_SlaveResp_Table_1_b81cce51: LinIfScheduleTableIndex=2
              7 x LinIfEntry:
                MasterReq_SlaveResp_Table_1_55a090db: LinIfDelay=0.01, LinIfEntryIndex=6, LinIfFrameRef=FT_FSP1_Frame_L5_1663ef44_Rx
                MasterReq_SlaveResp_Table_1_5074fb58: LinIfDelay=0.01, LinIfEntryIndex=4, LinIfFrameRef=FT_Backlight_FuncInd_L5_89c53287_Tx
                MasterReq_SlaveResp_Table_1_5e0847dd: LinIfDelay=0.015, LinIfEntryIndex=2, LinIfFrameRef=FT_RCECStoCIOM_L5_a45c9d29_Rx
                MasterReq_SlaveResp_Table_1_5bdc2c5e: LinIfDelay=0.02, LinIfEntryIndex=0, LinIfFrameRef=FT_MasterReq_dc33ca8a_Tx
                MasterReq_SlaveResp_Table_1_bf264db9: LinIfDelay=0.015, LinIfEntryIndex=5, LinIfFrameRef=FT_FSP_1_2_Req_L5_bc641e1e_Tx
                MasterReq_SlaveResp_Table_1_b15af13c: LinIfDelay=0.01, LinIfEntryIndex=3, LinIfFrameRef=FT_CIOMtoSlaves_L5_8632ed67_Tx
                MasterReq_SlaveResp_Table_1_b48e9abf: LinIfDelay=0.02, LinIfEntryIndex=1, LinIfFrameRef=FT_SlaveResp_7434b33e_Rx
          CT_LIN04_e81aa046 (LinIfMaster): LinIfClusterTimeBase=0.005, LinIfJitter=0.0005, LinIfLoadBalancingOffset=0
          7 x LinIfFrame:
            FT_RCECStoCIOM_L5_a45c9d29_Rx: LinIfChecksumType=ENHANCED, LinIfLength=3, LinIfPid=80, LinIfFrameType=UNCONDITIONAL
              LinIfPduDirection
                LinIfRxPdu: LinIfUserRxIndicationUL=PDUR, LinIfRxPduRef=RCECStoCIOM_L5_oLIN04_1ccecc00_Rx
            FT_FSP1_SwitchDetResp_L5_00bda195_Rx: LinIfChecksumType=ENHANCED, LinIfLength=8, LinIfPid=240, LinIfFrameType=UNCONDITIONAL
              LinIfPduDirection
                LinIfRxPdu: LinIfUserRxIndicationUL=PDUR, LinIfRxPduRef=FSP1_SwitchDetResp_L5_oLIN04_75b469c5_Rx
            FT_Backlight_FuncInd_L5_89c53287_Tx: LinIfChecksumType=ENHANCED, LinIfLength=1, LinIfPid=180, LinIfFrameType=UNCONDITIONAL
              LinIfPduDirection
                LinIfTxPdu_383b08fc (LinIfTxPdu): LinIfTxPduId=7, LinIfUserTxUL=PDUR, LinIfTxPduRef=Backlight_FuncInd_L5_oLIN04_571a8203_Tx
            FT_SlaveResp_7434b33e_Rx: LinIfChecksumType=CLASSIC, LinIfFrameType=SRF, LinIfLength=8, LinIfPid=125
              LinIfPduDirection
                LinIfInternalPdu
            FT_FSP_1_2_Req_L5_bc641e1e_Tx: LinIfChecksumType=ENHANCED, LinIfLength=4, LinIfPid=245, LinIfFrameType=UNCONDITIONAL
              LinIfPduDirection
                LinIfTxPdu_5c6eb50c (LinIfTxPdu): LinIfTxPduId=2, LinIfUserTxUL=PDUR, LinIfTxPduRef=FSP_1_2_Req_L5_oLIN04_6cd03e91_Tx
            FT_MasterReq_dc33ca8a_Tx: LinIfChecksumType=CLASSIC, LinIfFrameType=MRF, LinIfLength=8, LinIfPid=60
              LinIfPduDirection
                LinIfInternalPdu
            FT_FSP1_Frame_L5_1663ef44_Rx: LinIfChecksumType=ENHANCED, LinIfLength=2, LinIfPid=66, LinIfFrameType=UNCONDITIONAL
              LinIfPduDirection
                LinIfRxPdu: LinIfUserRxIndicationUL=PDUR, LinIfRxPduRef=FSP1_Frame_L5_oLIN04_a341e84f_Rx
          3 x LinIfScheduleTable, all with LinIfRunMode=RUN_CONTINUOUS, LinIfScheduleMode=LINTP_APPLICATIVE_SCHEDULE:
            MasterReq_SlaveResp_Table_2_21159feb: LinIfScheduleTableIndex=3, LinIfScheduleTableName=, LinIfResumePosition=START_FROM_BEGINNING
              5 x LinIfEntry:
                MasterReq_SlaveResp_Table_2_1b27d775: LinIfDelay=0.02, LinIfEntryIndex=1, LinIfFrameRef=FT_SlaveResp_7434b33e_Rx
                MasterReq_SlaveResp_Table_2_f1a10a17: LinIfDelay=0.01, LinIfEntryIndex=2, LinIfFrameRef=FT_CIOMtoSlaves_L5_8632ed67_Tx
                MasterReq_SlaveResp_Table_2_1ef3bcf6: LinIfDelay=0.01, LinIfEntryIndex=3, LinIfFrameRef=FT_Backlight_FuncInd_L5_89c53287_Tx
                MasterReq_SlaveResp_Table_2_f4756194: LinIfDelay=0.02, LinIfEntryIndex=0, LinIfFrameRef=FT_MasterReq_dc33ca8a_Tx
                MasterReq_SlaveResp_Table_2_ffddb692: LinIfDelay=0.015, LinIfEntryIndex=4, LinIfFrameRef=FT_RCECStoCIOM_L5_a45c9d29_Rx
            NULLSchedule: LinIfResumePosition=CONTINUE_AT_IT_POINT, LinIfScheduleTableIndex=0
            Table_1_33137188: LinIfScheduleTableIndex=4, LinIfScheduleTableName=, LinIfResumePosition=START_FROM_BEGINNING
              6 x LinIfEntry:
                Table_1_401730ce: LinIfDelay=0.015, LinIfEntryIndex=3, LinIfFrameRef=FT_RCECStoCIOM_L5_a45c9d29_Rx
                Table_1_af45862f: LinIfDelay=0.01, LinIfEntryIndex=2, LinIfFrameRef=FT_Backlight_FuncInd_L5_89c53287_Tx
                Table_1_aa91edac: LinIfDelay=0.015, LinIfEntryIndex=0, LinIfFrameRef=FT_RCECStoCIOM_L5_a45c9d29_Rx
                Table_1_45c35b4d: LinIfDelay=0.01, LinIfEntryIndex=1, LinIfFrameRef=FT_CIOMtoSlaves_L5_8632ed67_Tx
                Table_1_4e6b8c4b: LinIfDelay=0.01, LinIfEntryIndex=5, LinIfFrameRef=FT_FSP1_Frame_L5_1663ef44_Rx
                Table_1_a1393aaa: LinIfDelay=0.015, LinIfEntryIndex=4, LinIfFrameRef=FT_FSP_1_2_Req_L5_bc641e1e_Tx
        CHNL_8e3d5be2: LinIfChannelId=0, LinIfChannelRef=CN_LIN01_5bde9749, LinIfComMNetworkHandleRef=CN_LIN01_5bde9749
          4 x LinIfFrame, all with LinIfChecksumType=ENHANCED, LinIfFrameType=UNCONDITIONAL:
            FT_FSP3_Frame_L2_17dde19d_Rx: LinIfLength=2, LinIfPid=196
              LinIfPduDirection
                LinIfRxPdu: LinIfUserRxIndicationUL=PDUR, LinIfRxPduRef=FSP3_Frame_L2_oLIN01_e70e546d_Rx
            FT_FSP4_SwitchDetResp_L2_4f5b1e44_Rx: LinIfLength=8, LinIfPid=115
              LinIfPduDirection
                LinIfRxPdu: LinIfUserRxIndicationUL=PDUR, LinIfRxPduRef=FSP4_SwitchDetResp_L2_oLIN01_76fb096a_Rx
            FT_FSP1_SwitchDetResp_L2_aba17fa3_Rx: LinIfLength=8, LinIfPid=240
              LinIfPduDirection
                LinIfRxPdu: LinIfUserRxIndicationUL=PDUR, LinIfRxPduRef=FSP1_SwitchDetResp_L2_oLIN01_093ed8f2_Rx
            FT_Backlight_FuncInd_L2_da42c80c_Tx: LinIfLength=1, LinIfPid=180
              LinIfPduDirection
                LinIfTxPdu_dc506f0f (LinIfTxPdu): LinIfTxPduId=16, LinIfUserTxUL=PDUR, LinIfTxPduRef=Backlight_FuncInd_L2_oLIN01_2b903334_Tx
          Table_e_dbb68a08 (LinIfScheduleTable):
            LinIfRunMode = RUN_CONTINUOUS
            LinIfScheduleTableIndex = 4
            LinIfScheduleTableName = 
            LinIfResumePosition = START_FROM_BEGINNING
            LinIfScheduleMode = LINTP_APPLICATIVE_SCHEDULE
            4 x LinIfEntry, all with LinIfDelay=0.02:
              Table_e_d9aeb57a: LinIfEntryIndex=2, LinIfFrameRef=FT_FSP3_SwitchDetResp_L2_ae751420_Rx
              Table_e_36fc039b: LinIfEntryIndex=3, LinIfFrameRef=FT_FSP4_SwitchDetResp_L2_4f5b1e44_Rx
              Table_e_dc7adef9: LinIfEntryIndex=0, LinIfFrameRef=FT_FSP1_SwitchDetResp_L2_aba17fa3_Rx
              Table_e_33286818: LinIfEntryIndex=1, LinIfFrameRef=FT_FSP2_SwitchDetResp_L2_4127a2c1_Rx
          3 x LinIfFrame, all with LinIfChecksumType=ENHANCED, LinIfFrameType=UNCONDITIONAL:
            FT_FSP3_SwitchDetResp_L2_ae751420_Rx: LinIfLength=8, LinIfPid=50
              LinIfPduDirection
                LinIfRxPdu: LinIfUserRxIndicationUL=PDUR, LinIfRxPduRef=FSP3_SwitchDetResp_L2_oLIN01_8cc6fa3d_Rx
            FT_FSP2_SwitchDetResp_L2_4127a2c1_Rx: LinIfLength=8, LinIfPid=177
              LinIfPduDirection
                LinIfRxPdu: LinIfUserRxIndicationUL=PDUR, LinIfRxPduRef=FSP2_SwitchDetResp_L2_oLIN01_2382687a_Rx
            FT_FSP_3_4_Req_L2_08b9a97f_Tx: LinIfLength=4, LinIfPid=118
              LinIfPduDirection
                LinIfTxPdu_a807ad91 (LinIfTxPdu): LinIfTxPduId=12, LinIfUserTxUL=PDUR, LinIfTxPduRef=FSP_3_4_Req_L2_oLIN01_a1ddc883_Tx
          Table0_df24d2a0 (LinIfScheduleTable):
            LinIfRunMode = RUN_CONTINUOUS
            LinIfScheduleTableIndex = 3
            LinIfScheduleTableName = 
            LinIfResumePosition = START_FROM_BEGINNING
            LinIfScheduleMode = LINTP_APPLICATIVE_SCHEDULE
            7 x LinIfEntry:
              Table0_a31b007e: LinIfDelay=0.01, LinIfEntryIndex=5, LinIfFrameRef=FT_FSP3_Frame_L2_17dde19d_Rx
              Table0_a8b3d778: LinIfDelay=0.015, LinIfEntryIndex=1, LinIfFrameRef=FT_FSP_1_2_Req_L2_ca2370c5_Tx
              Table0_ad67bcfb: LinIfDelay=0.01, LinIfEntryIndex=3, LinIfFrameRef=FT_FSP1_Frame_L2_132831a0_Rx
              Table0_42350a1a: LinIfDelay=0.015, LinIfEntryIndex=2, LinIfFrameRef=FT_FSP_3_4_Req_L2_08b9a97f_Tx
              Table0_47e16199: LinIfDelay=0.01, LinIfEntryIndex=0, LinIfFrameRef=FT_Backlight_FuncInd_L2_da42c80c_Tx
              Table0_499ddd1c: LinIfDelay=0.01, LinIfEntryIndex=6, LinIfFrameRef=FT_FSP4_Frame_L2_f501fae4_Rx
              Table0_4c49b69f: LinIfDelay=0.01, LinIfEntryIndex=4, LinIfFrameRef=FT_FSP2_Frame_L2_f81f8aa3_Rx
          NULLSchedule_CHNL_8e3d5be2 (LinIfScheduleTable): LinIfResumePosition=CONTINUE_AT_IT_POINT, LinIfRunMode=RUN_CONTINUOUS, LinIfScheduleMode=LINTP_APPLICATIVE_SCHEDULE, LinIfScheduleTableIndex=0
          FT_FSP2_Frame_L2_f81f8aa3_Rx (LinIfFrame): LinIfChecksumType=ENHANCED, LinIfLength=2, LinIfPid=3, LinIfFrameType=UNCONDITIONAL
            LinIfPduDirection
              LinIfRxPdu: LinIfUserRxIndicationUL=PDUR, LinIfRxPduRef=FSP2_Frame_L2_oLIN01_16d451c7_Rx
          CT_LIN01_987054c9 (LinIfMaster): LinIfClusterTimeBase=0.005, LinIfJitter=0.0005, LinIfLoadBalancingOffset=0
          FT_MasterReq_e2b94730_Tx (LinIfFrame): LinIfChecksumType=CLASSIC, LinIfFrameType=MRF, LinIfLength=8, LinIfPid=60
            LinIfPduDirection
              LinIfInternalPdu
          FT_FSP4_Frame_L2_f501fae4_Rx (LinIfFrame): LinIfChecksumType=ENHANCED, LinIfLength=2, LinIfPid=133, LinIfFrameType=UNCONDITIONAL
            LinIfPduDirection
              LinIfRxPdu: LinIfUserRxIndicationUL=PDUR, LinIfRxPduRef=FSP4_Frame_L2_oLIN01_5f9b46f8_Rx
          MasterReq_SlaveResp_Table0_9e3481d6 (LinIfScheduleTable):
            LinIfRunMode = RUN_CONTINUOUS
            LinIfScheduleTableIndex = 2
            LinIfScheduleTableName = 
            LinIfResumePosition = START_FROM_BEGINNING
            LinIfScheduleMode = LINTP_APPLICATIVE_SCHEDULE
            9 x LinIfEntry:
              MasterReq_SlaveResp_Table0_45607835: LinIfDelay=0.01, LinIfEntryIndex=6, LinIfFrameRef=FT_FSP2_Frame_L2_f81f8aa3_Rx
              MasterReq_SlaveResp_Table0_4b1cc4b0: LinIfDelay=0.02, LinIfEntryIndex=0, LinIfFrameRef=FT_MasterReq_e2b94730_Tx
              MasterReq_SlaveResp_Table0_a44e7251: LinIfDelay=0.02, LinIfEntryIndex=1, LinIfFrameRef=FT_SlaveResp_4abe3e84_Rx
              MasterReq_SlaveResp_Table0_afe6a557: LinIfDelay=0.01, LinIfEntryIndex=5, LinIfFrameRef=FT_FSP1_Frame_L2_132831a0_Rx
              MasterReq_SlaveResp_Table0_40b413b6: LinIfDelay=0.015, LinIfEntryIndex=4, LinIfFrameRef=FT_FSP_3_4_Req_L2_08b9a97f_Tx
              MasterReq_SlaveResp_Table0_5c4d6abc: LinIfDelay=0.01, LinIfEntryIndex=8, LinIfFrameRef=FT_FSP4_Frame_L2_f501fae4_Rx
              MasterReq_SlaveResp_Table0_aa32ced4: LinIfDelay=0.01, LinIfEntryIndex=7, LinIfFrameRef=FT_FSP3_Frame_L2_17dde19d_Rx
              MasterReq_SlaveResp_Table0_4ec8af33: LinIfDelay=0.01, LinIfEntryIndex=2, LinIfFrameRef=FT_Backlight_FuncInd_L2_da42c80c_Tx
              MasterReq_SlaveResp_Table0_a19a19d2: LinIfDelay=0.015, LinIfEntryIndex=3, LinIfFrameRef=FT_FSP_1_2_Req_L2_ca2370c5_Tx
          FT_FSP_1_2_Req_L2_ca2370c5_Tx (LinIfFrame): LinIfChecksumType=ENHANCED, LinIfLength=4, LinIfPid=245, LinIfFrameType=UNCONDITIONAL
            LinIfPduDirection
              LinIfTxPdu_a03cc159 (LinIfTxPdu): LinIfTxPduId=11, LinIfUserTxUL=PDUR, LinIfTxPduRef=FSP_1_2_Req_L2_oLIN01_105a8fa6_Tx
          FT_FSP1_Frame_L2_132831a0_Rx (LinIfFrame): LinIfChecksumType=ENHANCED, LinIfLength=2, LinIfPid=66, LinIfFrameType=UNCONDITIONAL
            LinIfPduDirection
              LinIfRxPdu: LinIfUserRxIndicationUL=PDUR, LinIfRxPduRef=FSP1_Frame_L2_oLIN01_dfcb5978_Rx
          MasterReq_SlaveResp_e4c5082e (LinIfScheduleTable):
            LinIfRunMode = RUN_CONTINUOUS
            LinIfScheduleTableIndex = 1
            LinIfScheduleTableName = 
            LinIfResumePosition = START_FROM_BEGINNING
            LinIfScheduleMode = LINTP_APPLICATIVE_SCHEDULE
            MasterReq_SlaveResp_6b132f33 (LinIfEntry): LinIfDelay=0.02, LinIfEntryIndex=1, LinIfFrameRef=FT_SlaveResp_4abe3e84_Rx
            MasterReq_SlaveResp_844199d2 (LinIfEntry): LinIfDelay=0.02, LinIfEntryIndex=0, LinIfFrameRef=FT_MasterReq_e2b94730_Tx
          FT_SlaveResp_4abe3e84_Rx (LinIfFrame): LinIfChecksumType=CLASSIC, LinIfFrameType=SRF, LinIfLength=8, LinIfPid=125
            LinIfPduDirection
              LinIfInternalPdu
        CHNL_c3f5fae9: LinIfChannelId=3, LinIfChannelRef=CN_LIN03_b5d0f665, LinIfComMNetworkHandleRef=CN_LIN03_b5d0f665
          FT_FSP1_SwitchDetResp_L4_5f0d0b34_Rx (LinIfFrame): LinIfChecksumType=ENHANCED, LinIfLength=8, LinIfPid=240, LinIfFrameType=UNCONDITIONAL
            LinIfPduDirection
              LinIfRxPdu: LinIfUserRxIndicationUL=PDUR, LinIfRxPduRef=FSP1_SwitchDetResp_L4_oLIN03_8d5aeec7_Rx
          NULLSchedule_CHNL_c3f5fae9 (LinIfScheduleTable): LinIfResumePosition=CONTINUE_AT_IT_POINT, LinIfRunMode=RUN_CONTINUOUS, LinIfScheduleMode=LINTP_APPLICATIVE_SCHEDULE, LinIfScheduleTableIndex=0
          FT_Backlight_FuncInd_L4_4be0ab29_Tx (LinIfFrame): LinIfChecksumType=ENHANCED, LinIfLength=1, LinIfPid=180, LinIfFrameType=UNCONDITIONAL
            LinIfPduDirection
              LinIfTxPdu_dc4d24aa (LinIfTxPdu): LinIfTxPduId=15, LinIfUserTxUL=PDUR, LinIfTxPduRef=Backlight_FuncInd_L4_oLIN03_aff40501_Tx
          MasterReq_SlaveResp_Table_2_de9a2869 (LinIfScheduleTable):
            LinIfRunMode = RUN_CONTINUOUS
            LinIfScheduleTableIndex = 3
            LinIfScheduleTableName = 
            LinIfResumePosition = START_FROM_BEGINNING
            LinIfScheduleMode = LINTP_APPLICATIVE_SCHEDULE
            8 x LinIfEntry:
              MasterReq_SlaveResp_Table_2_52db1d91: LinIfDelay=0.01, LinIfEntryIndex=2, LinIfFrameRef=FT_CIOMtoSlaves2_L4_d1f45640_Tx
              MasterReq_SlaveResp_Table_2_b85dc0f3: LinIfDelay=0.02, LinIfEntryIndex=1, LinIfFrameRef=FT_SlaveResp_3e0a3875_Rx
              MasterReq_SlaveResp_Table_2_570f7612: LinIfDelay=0.02, LinIfEntryIndex=0, LinIfFrameRef=FT_MasterReq_960d41c1_Tx
              MasterReq_SlaveResp_Table_2_5ca7a114: LinIfDelay=0.015, LinIfEntryIndex=4, LinIfFrameRef=FT_ELCP2toCIOM_L4_2040b135_Rx
              MasterReq_SlaveResp_Table_2_bd89ab70: LinIfDelay=0.01, LinIfEntryIndex=3, LinIfFrameRef=FT_Backlight_FuncInd_L4_4be0ab29_Tx
              MasterReq_SlaveResp_Table_2_5973ca97: LinIfDelay=0.015, LinIfEntryIndex=6, LinIfFrameRef=FT_DLFWtoCIOM_L4_4e464d0e_Rx
              MasterReq_SlaveResp_Table_2_b3f517f5: LinIfDelay=0.015, LinIfEntryIndex=5, LinIfFrameRef=FT_CCFWtoCIOM_L4_41a1d427_Rx
              MasterReq_SlaveResp_Table_2_b6217c76: LinIfDelay=0.015, LinIfEntryIndex=7, LinIfFrameRef=FT_ILCP2toCIOM_L4_0ab52018_Rx
          FT_FSP1_Frame_L4_17dd477c_Rx (LinIfFrame): LinIfChecksumType=ENHANCED, LinIfLength=2, LinIfPid=66, LinIfFrameType=UNCONDITIONAL
            LinIfPduDirection
              LinIfRxPdu: LinIfUserRxIndicationUL=PDUR, LinIfRxPduRef=FSP1_Frame_L4_oLIN03_5baf6f4d_Rx
          Table_e_3ad84ea5 (LinIfScheduleTable):
            LinIfRunMode = RUN_CONTINUOUS
            LinIfScheduleTableIndex = 6
            LinIfScheduleTableName = 
            LinIfResumePosition = START_FROM_BEGINNING
            LinIfScheduleMode = LINTP_APPLICATIVE_SCHEDULE
            3 x LinIfEntry:
              Table_e_b19fff1f: LinIfDelay=0.02, LinIfEntryIndex=0, LinIfFrameRef=FT_FSP1_SwitchDetResp_L4_5f0d0b34_Rx
              Table_e_5ecd49fe: LinIfDelay=0.01, LinIfEntryIndex=1, LinIfFrameRef=FT_CIOMtoSlaves1_L4_c341f9ae_Tx
              Table_e_b44b949c: LinIfDelay=0.015, LinIfEntryIndex=2, LinIfFrameRef=FT_ELCP1toCIOM_L4_cb770a36_Rx
          CT_LIN03_767e35e5 (LinIfMaster): LinIfClusterTimeBase=0.005, LinIfJitter=0.0005, LinIfLoadBalancingOffset=0
          Table_2_cfd78af2 (LinIfScheduleTable):
            LinIfRunMode = RUN_CONTINUOUS
            LinIfScheduleTableIndex = 5
            LinIfScheduleTableName = 
            LinIfResumePosition = START_FROM_BEGINNING
            LinIfScheduleMode = LINTP_APPLICATIVE_SCHEDULE
            6 x LinIfEntry:
              Table_2_85e552bf: LinIfDelay=0.01, LinIfEntryIndex=0, LinIfFrameRef=FT_CIOMtoSlaves2_L4_d1f45640_Tx
              Table_2_8e4d85b9: LinIfDelay=0.015, LinIfEntryIndex=4, LinIfFrameRef=FT_DLFWtoCIOM_L4_4e464d0e_Rx
              Table_2_6ab7e45e: LinIfDelay=0.01, LinIfEntryIndex=1, LinIfFrameRef=FT_Backlight_FuncInd_L4_4be0ab29_Tx
              Table_2_8031393c: LinIfDelay=0.015, LinIfEntryIndex=2, LinIfFrameRef=FT_ELCP2toCIOM_L4_2040b135_Rx
              Table_2_611f3358: LinIfDelay=0.015, LinIfEntryIndex=5, LinIfFrameRef=FT_ILCP2toCIOM_L4_0ab52018_Rx
              Table_2_6f638fdd: LinIfDelay=0.015, LinIfEntryIndex=3, LinIfFrameRef=FT_CCFWtoCIOM_L4_41a1d427_Rx
          FT_CIOMtoSlaves1_L4_c341f9ae_Tx (LinIfFrame): LinIfChecksumType=ENHANCED, LinIfLength=2, LinIfPid=120, LinIfFrameType=UNCONDITIONAL
            LinIfPduDirection
              LinIfTxPdu_1ce2e8ec (LinIfTxPdu): LinIfTxPduId=0, LinIfUserTxUL=PDUR, LinIfTxPduRef=CIOMtoSlaves1_L4_oLIN03_220ce125_Tx
          FT_ELCP2toCIOM_L4_2040b135_Rx (LinIfFrame): LinIfChecksumType=ENHANCED, LinIfLength=3, LinIfPid=163, LinIfFrameType=UNCONDITIONAL
            LinIfPduDirection
              LinIfRxPdu: LinIfUserRxIndicationUL=PDUR, LinIfRxPduRef=ELCP2toCIOM_L4_oLIN03_7701f146_Rx
          Table_1_56dedb48 (LinIfScheduleTable):
            LinIfRunMode = RUN_CONTINUOUS
            LinIfScheduleTableIndex = 4
            LinIfScheduleTableName = 
            LinIfResumePosition = START_FROM_BEGINNING
            LinIfScheduleMode = LINTP_APPLICATIVE_SCHEDULE
            5 x LinIfEntry:
              Table_1_c0cac217: LinIfDelay=0.01, LinIfEntryIndex=3, LinIfFrameRef=FT_FSP1_Frame_L4_17dd477c_Rx
              Table_1_2a4c1f75: LinIfDelay=0.01, LinIfEntryIndex=0, LinIfFrameRef=FT_CIOMtoSlaves1_L4_c341f9ae_Tx
              Table_1_c51ea994: LinIfDelay=0.01, LinIfEntryIndex=1, LinIfFrameRef=FT_Backlight_FuncInd_L4_4be0ab29_Tx
              Table_1_21e4c873: LinIfDelay=0.015, LinIfEntryIndex=4, LinIfFrameRef=FT_ELCP1toCIOM_L4_cb770a36_Rx
              Table_1_2f9874f6: LinIfDelay=0.015, LinIfEntryIndex=2, LinIfFrameRef=FT_FSP_1_2_Req_L4_fa7b19ff_Tx
          FT_CIOMtoSlaves2_L4_d1f45640_Tx (LinIfFrame): LinIfChecksumType=ENHANCED, LinIfLength=2, LinIfPid=186, LinIfFrameType=UNCONDITIONAL
            LinIfPduDirection
              LinIfTxPdu_ee4aa5ca (LinIfTxPdu): LinIfTxPduId=17, LinIfUserTxUL=PDUR, LinIfTxPduRef=CIOMtoSlaves2_L4_oLIN03_d05b0cdd_Tx
          MasterReq_SlaveResp_Table_1_479379d3 (LinIfScheduleTable):
            LinIfRunMode = RUN_CONTINUOUS
            LinIfScheduleTableIndex = 2
            LinIfScheduleTableName = 
            LinIfResumePosition = START_FROM_BEGINNING
            LinIfScheduleMode = LINTP_APPLICATIVE_SCHEDULE
            7 x LinIfEntry:
              MasterReq_SlaveResp_Table_1_f30eecde: LinIfDelay=0.015, LinIfEntryIndex=4, LinIfFrameRef=FT_FSP_1_2_Req_L4_fa7b19ff_Tx
              MasterReq_SlaveResp_Table_1_1220e6ba: LinIfDelay=0.01, LinIfEntryIndex=3, LinIfFrameRef=FT_Backlight_FuncInd_L4_4be0ab29_Tx
              MasterReq_SlaveResp_Table_1_f6da875d: LinIfDelay=0.015, LinIfEntryIndex=6, LinIfFrameRef=FT_ELCP1toCIOM_L4_cb770a36_Rx
              MasterReq_SlaveResp_Table_1_f8a63bd8: LinIfDelay=0.02, LinIfEntryIndex=0, LinIfFrameRef=FT_MasterReq_960d41c1_Tx
              MasterReq_SlaveResp_Table_1_1c5c5a3f: LinIfDelay=0.01, LinIfEntryIndex=5, LinIfFrameRef=FT_FSP1_Frame_L4_17dd477c_Rx
              MasterReq_SlaveResp_Table_1_17f48d39: LinIfDelay=0.02, LinIfEntryIndex=1, LinIfFrameRef=FT_SlaveResp_3e0a3875_Rx
              MasterReq_SlaveResp_Table_1_fd72505b: LinIfDelay=0.01, LinIfEntryIndex=2, LinIfFrameRef=FT_CIOMtoSlaves1_L4_c341f9ae_Tx
          4 x LinIfFrame, all with LinIfChecksumType=ENHANCED, LinIfFrameType=UNCONDITIONAL:
            FT_ILCP2toCIOM_L4_0ab52018_Rx: LinIfLength=3, LinIfPid=32
              LinIfPduDirection
                LinIfRxPdu: LinIfUserRxIndicationUL=PDUR, LinIfRxPduRef=ILCP2toCIOM_L4_oLIN03_3ff118ff_Rx
            FT_CCFWtoCIOM_L4_41a1d427_Rx: LinIfLength=3, LinIfPid=211
              LinIfPduDirection
                LinIfRxPdu: LinIfUserRxIndicationUL=PDUR, LinIfRxPduRef=CCFWtoCIOM_L4_oLIN03_65063ac5_Rx
            FT_DLFWtoCIOM_L4_4e464d0e_Rx: LinIfLength=3, LinIfPid=146
              LinIfPduDirection
                LinIfRxPdu: LinIfUserRxIndicationUL=PDUR, LinIfRxPduRef=DLFWtoCIOM_L4_oLIN03_66a36f0d_Rx
            FT_ELCP1toCIOM_L4_cb770a36_Rx: LinIfLength=4, LinIfPid=142
              LinIfPduDirection
                LinIfRxPdu: LinIfUserRxIndicationUL=PDUR, LinIfRxPduRef=ELCP1toCIOM_L4_oLIN03_be1ef9f9_Rx
          MasterReq_SlaveResp_f18f4341 (LinIfScheduleTable):
            LinIfRunMode = RUN_CONTINUOUS
            LinIfScheduleTableIndex = 1
            LinIfScheduleTableName = 
            LinIfResumePosition = START_FROM_BEGINNING
            LinIfScheduleMode = LINTP_APPLICATIVE_SCHEDULE
            MasterReq_SlaveResp_181ccf0b (LinIfEntry): LinIfDelay=0.02, LinIfEntryIndex=0, LinIfFrameRef=FT_MasterReq_960d41c1_Tx
            MasterReq_SlaveResp_f74e79ea (LinIfEntry): LinIfDelay=0.02, LinIfEntryIndex=1, LinIfFrameRef=FT_SlaveResp_3e0a3875_Rx
          3 x LinIfFrame:
            FT_MasterReq_960d41c1_Tx: LinIfChecksumType=CLASSIC, LinIfFrameType=MRF, LinIfLength=8, LinIfPid=60
              LinIfPduDirection
                LinIfInternalPdu
            FT_SlaveResp_3e0a3875_Rx: LinIfChecksumType=CLASSIC, LinIfFrameType=SRF, LinIfLength=8, LinIfPid=125
              LinIfPduDirection
                LinIfInternalPdu
            FT_FSP_1_2_Req_L4_fa7b19ff_Tx: LinIfChecksumType=ENHANCED, LinIfLength=4, LinIfPid=245, LinIfFrameType=UNCONDITIONAL
              LinIfPduDirection
                LinIfTxPdu_d034dae6 (LinIfTxPdu): LinIfTxPduId=14, LinIfUserTxUL=PDUR, LinIfTxPduRef=FSP_1_2_Req_L4_oLIN03_943eb993_Tx
        CHNL_08a9294c: LinIfChannelId=1, LinIfChannelRef=CN_LIN02_c2d7c6f3, LinIfComMNetworkHandleRef=CN_LIN02_c2d7c6f3
          Table_e_a7d7afd3 (LinIfScheduleTable):
            LinIfRunMode = RUN_CONTINUOUS
            LinIfScheduleTableIndex = 6
            LinIfScheduleTableName = 
            LinIfResumePosition = START_FROM_BEGINNING
            LinIfScheduleMode = LINTP_APPLICATIVE_SCHEDULE
            Table_e_683fd90d (LinIfEntry): LinIfDelay=0.02, LinIfEntryIndex=1, LinIfFrameRef=FT_FSP2_SwitchDetResp_L3_2508ab24_Rx
            Table_e_876d6fec (LinIfEntry): LinIfDelay=0.02, LinIfEntryIndex=0, LinIfFrameRef=FT_FSP1_SwitchDetResp_L3_cf8e7646_Rx
          FT_FSP2_Frame_L3_f9fd8308_Rx (LinIfFrame): LinIfChecksumType=ENHANCED, LinIfLength=2, LinIfPid=3, LinIfFrameType=UNCONDITIONAL
            LinIfPduDirection
              LinIfRxPdu: LinIfUserRxIndicationUL=PDUR, LinIfRxPduRef=FSP2_Frame_L3_oLIN02_3d665e5b_Rx
          Table_1_cbd13a3e (LinIfScheduleTable):
            LinIfRunMode = RUN_CONTINUOUS
            LinIfScheduleTableIndex = 4
            LinIfScheduleTableName = 
            LinIfResumePosition = START_FROM_BEGINNING
            LinIfScheduleMode = LINTP_APPLICATIVE_SCHEDULE
            6 x LinIfEntry:
              Table_1_1cbe8f86: LinIfDelay=0.01, LinIfEntryIndex=0, LinIfFrameRef=FT_Backlight_FuncInd_L3_e9e4dd82_Tx
              Table_1_17165880: LinIfDelay=0.01, LinIfEntryIndex=4, LinIfFrameRef=FT_MastertoTCP_a2bc639c_Tx
              Table_1_f63852e4: LinIfDelay=0.01, LinIfEntryIndex=3, LinIfFrameRef=FT_FSP2_Frame_L3_f9fd8308_Rx
              Table_1_196ae405: LinIfDelay=0.01, LinIfEntryIndex=2, LinIfFrameRef=FT_FSP1_Frame_L3_12ca380b_Rx
              Table_1_f844ee61: LinIfDelay=0.015, LinIfEntryIndex=5, LinIfFrameRef=FT_TCPtoMaster_4ab36a9a_Rx
              Table_1_f3ec3967: LinIfDelay=0.015, LinIfEntryIndex=1, LinIfFrameRef=FT_FSP_1_2_Req_L3_e53ae97b_Tx
          MasterReq_SlaveResp_1692e5d6 (LinIfScheduleTable):
            LinIfRunMode = RUN_CONTINUOUS
            LinIfScheduleTableIndex = 1
            LinIfScheduleTableName = 
            LinIfResumePosition = START_FROM_BEGINNING
            LinIfScheduleMode = LINTP_APPLICATIVE_SCHEDULE
            MasterReq_SlaveResp_54d851a6 (LinIfEntry): LinIfDelay=0.02, LinIfEntryIndex=1, LinIfFrameRef=FT_SlaveResp_e9e8b82d_Rx
            MasterReq_SlaveResp_bb8ae747 (LinIfEntry): LinIfDelay=0.02, LinIfEntryIndex=0, LinIfFrameRef=FT_MasterReq_41efc199_Tx
          3 x LinIfFrame, all with LinIfChecksumType=ENHANCED, LinIfFrameType=UNCONDITIONAL:
            FT_MastertoTCP_a2bc639c_Tx: LinIfLength=2, LinIfPid=46
              LinIfPduDirection
                LinIfTxPdu_36ecc1c9 (LinIfTxPdu): LinIfTxPduId=5, LinIfUserTxUL=PDUR, LinIfTxPduRef=MastertoTCP_oLIN02_7c7ed3d1_Tx
            FT_FSP2_SwitchDetResp_L3_2508ab24_Rx: LinIfLength=8, LinIfPid=177
              LinIfPduDirection
                LinIfRxPdu: LinIfUserRxIndicationUL=PDUR, LinIfRxPduRef=FSP2_SwitchDetResp_L3_oLIN02_083067e6_Rx
            FT_FSP1_SwitchDetResp_L3_cf8e7646_Rx: LinIfLength=8, LinIfPid=240
              LinIfPduDirection
                LinIfRxPdu: LinIfUserRxIndicationUL=PDUR, LinIfRxPduRef=FSP1_SwitchDetResp_L3_oLIN02_228cd76e_Rx
          MasterReq_SlaveResp_Table_1_631128e5 (LinIfScheduleTable):
            LinIfRunMode = RUN_CONTINUOUS
            LinIfScheduleTableIndex = 2
            LinIfScheduleTableName = 
            LinIfResumePosition = START_FROM_BEGINNING
            LinIfScheduleMode = LINTP_APPLICATIVE_SCHEDULE
            8 x LinIfEntry:
              MasterReq_SlaveResp_Table_1_692c3d78: LinIfDelay=0.02, LinIfEntryIndex=1, LinIfFrameRef=FT_SlaveResp_e9e8b82d_Rx
              MasterReq_SlaveResp_Table_1_6cf856fb: LinIfDelay=0.015, LinIfEntryIndex=3, LinIfFrameRef=FT_FSP_1_2_Req_L3_e53ae97b_Tx
              MasterReq_SlaveResp_Table_1_8802371c: LinIfDelay=0.01, LinIfEntryIndex=6, LinIfFrameRef=FT_MastertoTCP_a2bc639c_Tx
              MasterReq_SlaveResp_Table_1_8dd65c9f: LinIfDelay=0.01, LinIfEntryIndex=4, LinIfFrameRef=FT_FSP1_Frame_L3_12ca380b_Rx
              MasterReq_SlaveResp_Table_1_6284ea7e: LinIfDelay=0.01, LinIfEntryIndex=5, LinIfFrameRef=FT_FSP2_Frame_L3_f9fd8308_Rx
              MasterReq_SlaveResp_Table_1_83aae01a: LinIfDelay=0.01, LinIfEntryIndex=2, LinIfFrameRef=FT_Backlight_FuncInd_L3_e9e4dd82_Tx
              MasterReq_SlaveResp_Table_1_675081fd: LinIfDelay=0.015, LinIfEntryIndex=7, LinIfFrameRef=FT_TCPtoMaster_4ab36a9a_Rx
              MasterReq_SlaveResp_Table_1_867e8b99: LinIfDelay=0.02, LinIfEntryIndex=0, LinIfFrameRef=FT_MasterReq_41efc199_Tx
          Table_2_52d86b84 (LinIfScheduleTable):
            LinIfRunMode = RUN_CONTINUOUS
            LinIfScheduleTableIndex = 5
            LinIfScheduleTableName = 
            LinIfResumePosition = START_FROM_BEGINNING
            LinIfScheduleMode = LINTP_APPLICATIVE_SCHEDULE
            3 x LinIfEntry:
              Table_2_5c4574ad: LinIfDelay=0.015, LinIfEntryIndex=1, LinIfFrameRef=FT_FSP_1_2_Req_L3_e53ae97b_Tx
              Table_2_b317c24c: LinIfDelay=0.01, LinIfEntryIndex=0, LinIfFrameRef=FT_Backlight_FuncInd_L3_e9e4dd82_Tx
              Table_2_b6c3a9cf: LinIfDelay=0.01, LinIfEntryIndex=2, LinIfFrameRef=FT_FSP1_Frame_L3_12ca380b_Rx
          4 x LinIfFrame:
            FT_MasterReq_41efc199_Tx: LinIfChecksumType=CLASSIC, LinIfFrameType=MRF, LinIfLength=8, LinIfPid=60
              LinIfPduDirection
                LinIfInternalPdu
            FT_SlaveResp_e9e8b82d_Rx: LinIfChecksumType=CLASSIC, LinIfFrameType=SRF, LinIfLength=8, LinIfPid=125
              LinIfPduDirection
                LinIfInternalPdu
            FT_TCPtoMaster_4ab36a9a_Rx: LinIfChecksumType=ENHANCED, LinIfLength=5, LinIfPid=231, LinIfFrameType=UNCONDITIONAL
              LinIfPduDirection
                LinIfRxPdu: LinIfUserRxIndicationUL=PDUR, LinIfRxPduRef=TCPtoMaster_oLIN02_30042c71_Rx
            FT_FSP_1_2_Req_L3_e53ae97b_Tx: LinIfChecksumType=ENHANCED, LinIfLength=4, LinIfPid=245, LinIfFrameType=UNCONDITIONAL
              LinIfPduDirection
                LinIfTxPdu_3b534005 (LinIfTxPdu): LinIfTxPduId=1, LinIfUserTxUL=PDUR, LinIfTxPduRef=FSP_1_2_Req_L3_oLIN02_3be8803a_Tx
          NULLSchedule_CHNL_08a9294c (LinIfScheduleTable): LinIfResumePosition=CONTINUE_AT_IT_POINT, LinIfRunMode=RUN_CONTINUOUS, LinIfScheduleMode=LINTP_APPLICATIVE_SCHEDULE, LinIfScheduleTableIndex=0
          CT_LIN02_01790573 (LinIfMaster): LinIfClusterTimeBase=0.005, LinIfJitter=0.0005, LinIfLoadBalancingOffset=0
          MasterReq_SlaveResp_Table_2_fa18795f (LinIfScheduleTable):
            LinIfRunMode = RUN_CONTINUOUS
            LinIfScheduleTableIndex = 3
            LinIfScheduleTableName = 
            LinIfResumePosition = START_FROM_BEGINNING
            LinIfScheduleMode = LINTP_APPLICATIVE_SCHEDULE
            5 x LinIfEntry:
              MasterReq_SlaveResp_Table_2_c68570b2: LinIfDelay=0.02, LinIfEntryIndex=1, LinIfFrameRef=FT_SlaveResp_e9e8b82d_Rx
              MasterReq_SlaveResp_Table_2_227f1155: LinIfDelay=0.01, LinIfEntryIndex=4, LinIfFrameRef=FT_FSP1_Frame_L3_12ca380b_Rx
              MasterReq_SlaveResp_Table_2_c3511b31: LinIfDelay=0.015, LinIfEntryIndex=3, LinIfFrameRef=FT_FSP_1_2_Req_L3_e53ae97b_Tx
              MasterReq_SlaveResp_Table_2_2c03add0: LinIfDelay=0.01, LinIfEntryIndex=2, LinIfFrameRef=FT_Backlight_FuncInd_L3_e9e4dd82_Tx
              MasterReq_SlaveResp_Table_2_29d7c653: LinIfDelay=0.02, LinIfEntryIndex=0, LinIfFrameRef=FT_MasterReq_41efc199_Tx
          FT_Backlight_FuncInd_L3_e9e4dd82_Tx (LinIfFrame): LinIfChecksumType=ENHANCED, LinIfLength=1, LinIfPid=180, LinIfFrameType=UNCONDITIONAL
            LinIfPduDirection
              LinIfTxPdu_7c7da1f0 (LinIfTxPdu): LinIfTxPduId=4, LinIfUserTxUL=PDUR, LinIfTxPduRef=Backlight_FuncInd_L3_oLIN02_00223ca8_Tx
          FT_FSP1_Frame_L3_12ca380b_Rx (LinIfFrame): LinIfChecksumType=ENHANCED, LinIfLength=2, LinIfPid=66, LinIfFrameType=UNCONDITIONAL
            LinIfPduDirection
              LinIfRxPdu: LinIfUserRxIndicationUL=PDUR, LinIfRxPduRef=FSP1_Frame_L3_oLIN02_f47956e4_Rx
