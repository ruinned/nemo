AUTOSAR XML (schema 4-2-1)
package /Wdg
  module config Wdg: implementation-config-variant=VARIANT-LINK-TIME, module-description=Wdg_Impl
    CommonPublishedInformation:
      ArReleaseMajorVersion = 4
      ArReleaseMinorVersion = 2
      ArReleaseRevisionVersion = 2
      ModuleId = 102
      SwMajorVersion = 1
      SwMinorVersion = 0
      SwPatchVersion = 0
      VendorApiInfix = 
      VendorId = 43
    WdgClockReferencePoint_0 (WdgClockReferencePoint): WdgClockReference=F40_CLK
    WdgGeneral:
      WdgCallbackNotification{0..2} = NULL_PTR
      WdgDevErrorDetect = false
      WdgDisableAllowed = false
      WdgEnableUserModeSupport = false
      WdgIndex = 0
      WdgIndex1 = 1
      WdgIndex2 = 3
      WdgInitialTimeout = 0
      WdgMaxTimeout = 0
      WdgRunArea = ROM
      WdgTriggerLocation = NULL_PTR
      WdgVersionInfoApi = true
      NonAutosar: WdgDisableDemReportErrorStatus=false
    WdgPublishedInformation: WdgTriggerMode=WDG_BOTH
    WdgSettingsConfig_0 (WdgSettingsConfig): WdgDefaultMode=WDGIF_SLOW_MODE, WdgInstance=SWT0, WdgInterruptContentEnable=true, WdgExternalTriggerCounterRef=GptChannelConfiguration_Wdg
      WdgSettingsFast:
        WdgClockValue = 40000
        WdgHardLockConfiguration = false
        WdgKeyedService = false
        WdgMasterAccessProtectionforMaster{0..7} = true
        WdgOperationMode = ResetOnTimeOut
        WdgResetOnInvalidAccess = SystemReset
        WdgRunsInDebugMode = false
        WdgRunsInStopMode = true
        WdgServiceKeyValue = 0
        WdgSoftLockConfiguration = false
        WdgTimeoutPeriod = 100
        WdgWindowMode = false
        WdgWindowPeriod = 0
        WdgClockSelection = OscillatorClock
        WdgClkSrcRef = WdgClockReferencePoint_0
      WdgSettingsOff: WdgHardLockConfiguration=false, WdgSoftLockConfiguration=false
      WdgSettingsSlow:
        WdgClockSelection = OscillatorClock
        WdgClockValue = 40000
        WdgHardLockConfiguration = false
        WdgKeyedService = false
        WdgMasterAccessProtectionforMaster{0..7} = true
        WdgOperationMode = ResetOnTimeOut
        WdgResetOnInvalidAccess = SystemReset
        WdgRunsInDebugMode = false
        WdgRunsInStopMode = true
        WdgServiceKeyValue = 0
        WdgSoftLockConfiguration = false
        WdgTimeoutPeriod = 1
        WdgWindowMode = false
        WdgWindowPeriod = 0
        WdgClkSrcRef = WdgClockReferencePoint_0
    WdgDemEventParameterRefs:
      WDG_E_UNLOCKED = AutoCreatedDemEvent_WDG_E_UNLOCKED
      WDG_E_MODE_FAILED = AutoCreatedDemEvent_WDG_E_MODE_FAILED
      WDG_E_INVALID_PARAMETER = AutoCreatedDemEvent_WDG_E_INVALID_PARAMETER
      WDG_E_INVALID_CALL = AutoCreatedDemEvent_WDG_E_INVALID_CALL
      WDG_E_FORBIDDEN_INVOCATION = AutoCreatedDemEvent_WDG_E_FORBIDDEN_INVOCATION
      WDG_E_DISABLE_REJECTED = AutoCreatedDemEvent_WDG_E_DISABLE_REJECTED
      WDG_E_CORRUPT_CONFIG = AutoCreatedDemEvent_WDG_E_CORRUPT_CONFIG
