AUTOSAR XML (schema 4-2-1)
package /ActiveEcuC
  module config Cdd: implementation-config-variant=VARIANT-PRE-COMPILE, module-description=Cdd_Impl
    CddComStackContribution
      CddPduRUpperLayerContribution
        20 x CddPduRUpperLayerRxPdu:
          SlaveResp_ELCP1_oLIN03_8611f0b3_Rx: CddPduRUpperLayerHandleId=2, CddPduRUpperLayerPduRef=SlaveResp_ELCP1_oLIN03_8611f0b3_Rx
          SlaveResp_CCFW_oLIN03_d7124ce9_Rx: CddPduRUpperLayerHandleId=0, CddPduRUpperLayerPduRef=SlaveResp_CCFW_oLIN03_d7124ce9_Rx
          SlaveResp_DLFW_oLIN03_0f2202e7_Rx: CddPduRUpperLayerHandleId=1, CddPduRUpperLayerPduRef=SlaveResp_DLFW_oLIN03_0f2202e7_Rx
          SlaveResp_FSP1_L1_oLIN00_620b3198_Rx: CddPduRUpperLayerHandleId=4, CddPduRUpperLayerPduRef=SlaveResp_FSP1_L1_oLIN00_620b3198_Rx
          SlaveResp_FSP1_L2_oLIN01_9b8306ed_Rx: CddPduRUpperLayerHandleId=5, CddPduRUpperLayerPduRef=SlaveResp_FSP1_L2_oLIN01_9b8306ed_Rx
          SlaveResp_FSP1_L3_oLIN02_ce2057c9_Rx: CddPduRUpperLayerHandleId=6, CddPduRUpperLayerPduRef=SlaveResp_FSP1_L3_oLIN02_ce2057c9_Rx
          SlaveResp_FSP1_L4_oLIN03_b3e26e46_Rx: CddPduRUpperLayerHandleId=7, CddPduRUpperLayerPduRef=SlaveResp_FSP1_L4_oLIN03_b3e26e46_Rx
          SlaveResp_FSP1_L5_oLIN04_e12cfb7b_Rx: CddPduRUpperLayerHandleId=8, CddPduRUpperLayerPduRef=SlaveResp_FSP1_L5_oLIN04_e12cfb7b_Rx
          SlaveResp_FSP3_L2_oLIN01_c3efbf2c_Rx: CddPduRUpperLayerHandleId=12, CddPduRUpperLayerPduRef=SlaveResp_FSP3_L2_oLIN01_c3efbf2c_Rx
          SlaveResp_ELCP2_oLIN03_089ef750_Rx: CddPduRUpperLayerHandleId=3, CddPduRUpperLayerPduRef=SlaveResp_ELCP2_oLIN03_089ef750_Rx
          SlaveResp_FSP2_L1_oLIN00_fbe95799_Rx: CddPduRUpperLayerHandleId=9, CddPduRUpperLayerPduRef=SlaveResp_FSP2_L1_oLIN00_fbe95799_Rx
          SlaveResp_FSP2_L2_oLIN01_026160ec_Rx: CddPduRUpperLayerHandleId=10, CddPduRUpperLayerPduRef=SlaveResp_FSP2_L2_oLIN01_026160ec_Rx
          SlaveResp_FSP2_L3_oLIN02_57c231c8_Rx: CddPduRUpperLayerHandleId=11, CddPduRUpperLayerPduRef=SlaveResp_FSP2_L3_oLIN02_57c231c8_Rx
          SlaveResp_FSP4_L2_oLIN01_ead4aaaf_Rx: CddPduRUpperLayerHandleId=13, CddPduRUpperLayerPduRef=SlaveResp_FSP4_L2_oLIN01_ead4aaaf_Rx
          SlaveResp_ILCP1_oLIN00_1a12ec88_Rx: CddPduRUpperLayerHandleId=14, CddPduRUpperLayerPduRef=SlaveResp_ILCP1_oLIN00_1a12ec88_Rx
          SlaveResp_ILCP2_oLIN03_0d94bad1_Rx: CddPduRUpperLayerHandleId=15, CddPduRUpperLayerPduRef=SlaveResp_ILCP2_oLIN03_0d94bad1_Rx
          SlaveResp_LECM2_oLIN00_2afc07d8_Rx: CddPduRUpperLayerHandleId=16, CddPduRUpperLayerPduRef=SlaveResp_LECM2_oLIN00_2afc07d8_Rx
          SlaveResp_LECMBasic_oLIN00_029997c6_Rx: CddPduRUpperLayerHandleId=17, CddPduRUpperLayerPduRef=SlaveResp_LECMBasic_oLIN00_029997c6_Rx
          SlaveResp_RCECS_oLIN04_f9903c90_Rx: CddPduRUpperLayerHandleId=18, CddPduRUpperLayerPduRef=SlaveResp_RCECS_oLIN04_f9903c90_Rx
          SlaveResp_TCP_oLIN02_b3851a34_Rx: CddPduRUpperLayerHandleId=19, CddPduRUpperLayerPduRef=SlaveResp_TCP_oLIN02_b3851a34_Rx
        25 x CddPduRUpperLayerTxPdu:
          MasterReq_CCFW_oLIN03_98357989_Tx: CddPduRUpperLayerHandleId=0, CddPduRUpperLayerPduRef=MasterReq_CCFW_oLIN03_98357989_Tx
          MasterReq_DLFW_oLIN03_40053787_Tx: CddPduRUpperLayerHandleId=1, CddPduRUpperLayerPduRef=MasterReq_DLFW_oLIN03_40053787_Tx
          MasterReq_ELCP1_oLIN03_cbecb6de_Tx: CddPduRUpperLayerHandleId=2, CddPduRUpperLayerPduRef=MasterReq_ELCP1_oLIN03_cbecb6de_Tx
          MasterReq_ELCP2_oLIN03_4563b13d_Tx: CddPduRUpperLayerHandleId=3, CddPduRUpperLayerPduRef=MasterReq_ELCP2_oLIN03_4563b13d_Tx
          MasterReq_FSP1_L1_oLIN00_2de78d2a_Tx: CddPduRUpperLayerHandleId=4, CddPduRUpperLayerPduRef=MasterReq_FSP1_L1_oLIN00_2de78d2a_Tx
          MasterReq_FSP1_L2_oLIN01_d46fba5f_Tx: CddPduRUpperLayerHandleId=5, CddPduRUpperLayerPduRef=MasterReq_FSP1_L2_oLIN01_d46fba5f_Tx
          MasterReq_FSP1_L3_oLIN02_81cceb7b_Tx: CddPduRUpperLayerHandleId=6, CddPduRUpperLayerPduRef=MasterReq_FSP1_L3_oLIN02_81cceb7b_Tx
          MasterReq_FSP1_L4_oLIN03_fc0ed2f4_Tx: CddPduRUpperLayerHandleId=7, CddPduRUpperLayerPduRef=MasterReq_FSP1_L4_oLIN03_fc0ed2f4_Tx
          MasterReq_FSP1_L5_oLIN04_aec047c9_Tx: CddPduRUpperLayerHandleId=8, CddPduRUpperLayerPduRef=MasterReq_FSP1_L5_oLIN04_aec047c9_Tx
          MasterReq_FSP2_L1_oLIN00_b405eb2b_Tx: CddPduRUpperLayerHandleId=9, CddPduRUpperLayerPduRef=MasterReq_FSP2_L1_oLIN00_b405eb2b_Tx
          MasterReq_FSP2_L2_oLIN01_4d8ddc5e_Tx: CddPduRUpperLayerHandleId=10, CddPduRUpperLayerPduRef=MasterReq_FSP2_L2_oLIN01_4d8ddc5e_Tx
          MasterReq_FSP2_L3_oLIN02_182e8d7a_Tx: CddPduRUpperLayerHandleId=11, CddPduRUpperLayerPduRef=MasterReq_FSP2_L3_oLIN02_182e8d7a_Tx
          MasterReq_FSP3_L2_oLIN01_8c03039e_Tx: CddPduRUpperLayerHandleId=12, CddPduRUpperLayerPduRef=MasterReq_FSP3_L2_oLIN01_8c03039e_Tx
          MasterReq_FSP4_L2_oLIN01_a538161d_Tx: CddPduRUpperLayerHandleId=13, CddPduRUpperLayerPduRef=MasterReq_FSP4_L2_oLIN01_a538161d_Tx
          MasterReq_ILCP1_oLIN00_57efaae5_Tx: CddPduRUpperLayerHandleId=14, CddPduRUpperLayerPduRef=MasterReq_ILCP1_oLIN00_57efaae5_Tx
          MasterReq_ILCP2_oLIN03_4069fcbc_Tx: CddPduRUpperLayerHandleId=15, CddPduRUpperLayerPduRef=MasterReq_ILCP2_oLIN03_4069fcbc_Tx
          MasterReq_LECM2_oLIN00_670141b5_Tx: CddPduRUpperLayerHandleId=16, CddPduRUpperLayerPduRef=MasterReq_LECM2_oLIN00_670141b5_Tx
          MasterReq_LECMBasic_oLIN00_16bdebb7_Tx: CddPduRUpperLayerHandleId=17, CddPduRUpperLayerPduRef=MasterReq_LECMBasic_oLIN00_16bdebb7_Tx
          MasterReq_oLIN00_4a2bb011_Tx: CddPduRUpperLayerHandleId=18, CddPduRUpperLayerPduRef=MasterReq_oLIN00_4a2bb011_Tx
          MasterReq_oLIN01_3d2c8087_Tx: CddPduRUpperLayerHandleId=19, CddPduRUpperLayerPduRef=MasterReq_oLIN01_3d2c8087_Tx
          MasterReq_oLIN02_a425d13d_Tx: CddPduRUpperLayerHandleId=20, CddPduRUpperLayerPduRef=MasterReq_oLIN02_a425d13d_Tx
          MasterReq_oLIN03_d322e1ab_Tx: CddPduRUpperLayerHandleId=21, CddPduRUpperLayerPduRef=MasterReq_oLIN03_d322e1ab_Tx
          MasterReq_oLIN04_4d467408_Tx: CddPduRUpperLayerHandleId=22, CddPduRUpperLayerPduRef=MasterReq_oLIN04_4d467408_Tx
          MasterReq_RCECS_oLIN04_b46d7afd_Tx: CddPduRUpperLayerHandleId=23, CddPduRUpperLayerPduRef=MasterReq_RCECS_oLIN04_b46d7afd_Tx
          MasterReq_TCP_oLIN02_4b422897_Tx: CddPduRUpperLayerHandleId=24, CddPduRUpperLayerPduRef=MasterReq_TCP_oLIN02_4b422897_Tx
