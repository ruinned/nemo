[part 1 of 2: package /Dem]
AUTOSAR XML (schema 4-2-1)
package /Dem
  module config Dem: implementation-config-variant=VARIANT-POST-BUILD-LOADABLE, module-description=Dem_Impl
    CommonPublishedInformation:
      ArReleaseMajorVersion = 4
      ArReleaseMinorVersion = 2
      ArReleaseRevisionVersion = 2
      ModuleId = 54
      SwMajorVersion = 1
      SwMinorVersion = 0
      SwPatchVersion = 0
      VendorId = 43
    DemConfigSet
      210 x DemEventParameter, all with DemEventAvailable=true, DemEventTimeSeries=DEM_TIMESERIES_SNAPSHOT_NONE, DemEventAvailableInVariant=true, DemEventLatchTestFailed=false:
        DemEventParameter_0: DemEventId=1, DemEventKind=DEM_EVENT_KIND_SWC
          DemEventClass:
            DemAgingAllowed = false
            DemConsiderPtoStatus = false
            DemEventDestination = DEM_DTC_ORIGIN_PRIMARY_MEMORY
            DemEventPriority = 2
            DemFFPrestorageSupported = false
            DemOperationCycleRef = DemOperationCycle_0
            DemDebounceAlgorithmClass
              DemDebounceCounterBased:
                DemDebounceBehavior = DEM_DEBOUNCE_FREEZE
                DemDebounceCounterDecrementStepSize = 1
                DemDebounceCounterFailedThreshold = 127
                DemDebounceCounterIncrementStepSize = 1
                DemDebounceCounterJumpDown = true
                DemDebounceCounterJumpDownValue = 0
                DemDebounceCounterJumpUp = true
                DemDebounceCounterJumpUpValue = 0
                DemDebounceCounterPassedThreshold = -128
                DemDebounceCounterStorage = false
                DemDebounceContinuous = false
        AutoCreatedDemEvent_ADC_E_TIMEOUT: DemEventId=2, DemEventKind=DEM_EVENT_KIND_BSW
          DemEventClass:
            DemAgingAllowed = false
            DemConsiderPtoStatus = false
            DemEventDestination = DEM_DTC_ORIGIN_PRIMARY_MEMORY
            DemEventPriority = 2
            DemFFPrestorageSupported = false
            DemOperationCycleRef = DemOperationCycle_0
            DemDebounceAlgorithmClass
              DemDebounceCounterBased:
                DemDebounceBehavior = DEM_DEBOUNCE_FREEZE
                DemDebounceCounterDecrementStepSize = 1
                DemDebounceCounterFailedThreshold = 127
                DemDebounceCounterIncrementStepSize = 1
                DemDebounceCounterJumpDown = true
                DemDebounceCounterJumpDownValue = 0
                DemDebounceCounterJumpUp = true
                DemDebounceCounterJumpUpValue = 0
                DemDebounceCounterPassedThreshold = -128
                DemDebounceCounterStorage = false
                DemDebounceContinuous = false
        AutoCreatedDemEvent_CC_DisableDM_CIOM_oCabSubnet_Rx_063a5fbc_BswMReportFailToDemRef: DemEventId=5, DemEventKind=DEM_EVENT_KIND_BSW
          DemEventClass:
            DemAgingAllowed = false
            DemConsiderPtoStatus = false
            DemEventDestination = DEM_DTC_ORIGIN_PRIMARY_MEMORY
            DemEventPriority = 2
            DemFFPrestorageSupported = false
            DemOperationCycleRef = DemOperationCycle_0
            DemDebounceAlgorithmClass
              DemDebounceCounterBased:
                DemDebounceBehavior = DEM_DEBOUNCE_FREEZE
                DemDebounceCounterDecrementStepSize = 1
                DemDebounceCounterFailedThreshold = 127
                DemDebounceCounterIncrementStepSize = 1
                DemDebounceCounterJumpDown = true
                DemDebounceCounterJumpDownValue = 0
                DemDebounceCounterJumpUp = true
                DemDebounceCounterJumpUpValue = 0
                DemDebounceCounterPassedThreshold = -128
                DemDebounceCounterStorage = false
                DemDebounceContinuous = false
        AutoCreatedDemEvent_CC_J1939RmStateSwitch_CN_Backbone1J1939_0b1f4bae_CIOM_4d5cd289_J1939RM_STATE_OFFLINE_BswMReportFa_540060b1: DemEventId=53, DemEventKind=DEM_EVENT_KIND_BSW
          DemEventClass:
            DemAgingAllowed = false
            DemConsiderPtoStatus = false
            DemEventDestination = DEM_DTC_ORIGIN_PRIMARY_MEMORY
            DemEventPriority = 2
            DemFFPrestorageSupported = false
            DemOperationCycleRef = DemOperationCycle_0
            DemDebounceAlgorithmClass
              DemDebounceCounterBased:
                DemDebounceBehavior = DEM_DEBOUNCE_FREEZE
                DemDebounceCounterDecrementStepSize = 1
                DemDebounceCounterFailedThreshold = 127
                DemDebounceCounterIncrementStepSize = 1
                DemDebounceCounterJumpDown = true
                DemDebounceCounterJumpDownValue = 0
                DemDebounceCounterJumpUp = true
                DemDebounceCounterJumpUpValue = 0
                DemDebounceCounterPassedThreshold = -128
                DemDebounceCounterStorage = false
                DemDebounceContinuous = false
        AutoCreatedDemEvent_CC_J1939RmStateSwitch_CN_Backbone1J1939_0b1f4bae_CIOM_4d5cd289_J1939RM_STATE_ONLINE_BswMReportFailToDemRef: DemEventId=54, DemEventKind=DEM_EVENT_KIND_BSW
          DemEventClass:
            DemAgingAllowed = false
            DemConsiderPtoStatus = false
            DemEventDestination = DEM_DTC_ORIGIN_PRIMARY_MEMORY
            DemEventPriority = 2
            DemFFPrestorageSupported = false
            DemOperationCycleRef = DemOperationCycle_0
            DemDebounceAlgorithmClass
              DemDebounceCounterBased:
                DemDebounceBehavior = DEM_DEBOUNCE_FREEZE
                DemDebounceCounterDecrementStepSize = 1
                DemDebounceCounterFailedThreshold = 127
                DemDebounceCounterIncrementStepSize = 1
                DemDebounceCounterJumpDown = true
                DemDebounceCounterJumpDownValue = 0
                DemDebounceCounterJumpUp = true
                DemDebounceCounterJumpUpValue = 0
                DemDebounceCounterPassedThreshold = -128
                DemDebounceCounterStorage = false
                DemDebounceContinuous = false
        AutoCreatedDemEvent_CC_DisablePDUGroup_CIOM_oLIN04_Tx_04202f7b_BswMReportFailToDemRef: DemEventId=25, DemEventKind=DEM_EVENT_KIND_BSW
          DemEventClass:
            DemAgingAllowed = false
            DemConsiderPtoStatus = false
            DemEventDestination = DEM_DTC_ORIGIN_PRIMARY_MEMORY
            DemEventPriority = 2
            DemFFPrestorageSupported = false
            DemOperationCycleRef = DemOperationCycle_0
            DemDebounceAlgorithmClass
              DemDebounceCounterBased:
                DemDebounceBehavior = DEM_DEBOUNCE_FREEZE
                DemDebounceCounterDecrementStepSize = 1
                DemDebounceCounterFailedThreshold = 127
                DemDebounceCounterIncrementStepSize = 1
                DemDebounceCounterJumpDown = true
                DemDebounceCounterJumpDownValue = 0
                DemDebounceCounterJumpUp = true
                DemDebounceCounterJumpUpValue = 0
                DemDebounceCounterPassedThreshold = -128
                DemDebounceCounterStorage = false
                DemDebounceContinuous = false
        AutoCreatedDemEvent_CC_DisablePDUGroup_CIOM_oLIN04_Rx_527a88fd_BswMReportFailToDemRef: DemEventId=24, DemEventKind=DEM_EVENT_KIND_BSW
          DemEventClass:
            DemAgingAllowed = false
            DemConsiderPtoStatus = false
            DemEventDestination = DEM_DTC_ORIGIN_PRIMARY_MEMORY
            DemEventPriority = 2
            DemFFPrestorageSupported = false
            DemOperationCycleRef = DemOperationCycle_0
            DemDebounceAlgorithmClass
              DemDebounceCounterBased:
                DemDebounceBehavior = DEM_DEBOUNCE_FREEZE
                DemDebounceCounterDecrementStepSize = 1
                DemDebounceCounterFailedThreshold = 127
                DemDebounceCounterIncrementStepSize = 1
                DemDebounceCounterJumpDown = true
                DemDebounceCounterJumpDownValue = 0
                DemDebounceCounterJumpUp = true
                DemDebounceCounterJumpUpValue = 0
                DemDebounceCounterPassedThreshold = -128
                DemDebounceCounterStorage = false
                DemDebounceContinuous = false
        AutoCreatedDemEvent_CC_DisablePDUGroup_CIOM_oLIN01_Tx_33fedf49_BswMReportFailToDemRef: DemEventId=19, DemEventKind=DEM_EVENT_KIND_BSW
          DemEventClass:
            DemAgingAllowed = false
            DemConsiderPtoStatus = false
            DemEventDestination = DEM_DTC_ORIGIN_PRIMARY_MEMORY
            DemEventPriority = 2
            DemFFPrestorageSupported = false
            DemOperationCycleRef = DemOperationCycle_0
            DemDebounceAlgorithmClass
              DemDebounceCounterBased:
                DemDebounceBehavior = DEM_DEBOUNCE_FREEZE
                DemDebounceCounterDecrementStepSize = 1
                DemDebounceCounterFailedThreshold = 127
                DemDebounceCounterIncrementStepSize = 1
                DemDebounceCounterJumpDown = true
                DemDebounceCounterJumpDownValue = 0
                DemDebounceCounterJumpUp = true
                DemDebounceCounterJumpUpValue = 0
                DemDebounceCounterPassedThreshold = -128
                DemDebounceCounterStorage = false
                DemDebounceContinuous = false
        AutoCreatedDemEvent_CC_DisablePDUGroup_CIOM_oLIN01_Rx_65a478cf_BswMReportFailToDemRef: DemEventId=18, DemEventKind=DEM_EVENT_KIND_BSW
          DemEventClass:
            DemAgingAllowed = false
            DemConsiderPtoStatus = false
            DemEventDestination = DEM_DTC_ORIGIN_PRIMARY_MEMORY
            DemEventPriority = 2
            DemFFPrestorageSupported = false
            DemOperationCycleRef = DemOperationCycle_0
            DemDebounceAlgorithmClass
              DemDebounceCounterBased:
                DemDebounceBehavior = DEM_DEBOUNCE_FREEZE
                DemDebounceCounterDecrementStepSize = 1
                DemDebounceCounterFailedThreshold = 127
                DemDebounceCounterIncrementStepSize = 1
                DemDebounceCounterJumpDown = true
                DemDebounceCounterJumpDownValue = 0
                DemDebounceCounterJumpUp = true
                DemDebounceCounterJumpUpValue = 0
                DemDebounceCounterPassedThreshold = -128
                DemDebounceCounterStorage = false
                DemDebounceContinuous = false
        AutoCreatedDemEvent_CC_EnablePDUGroup_CIOM_oLIN04_Tx_04202f7b_BswMReportFailToDemRef: DemEventId=50, DemEventKind=DEM_EVENT_KIND_BSW
          DemEventClass:
            DemAgingAllowed = false
            DemConsiderPtoStatus = false
            DemEventDestination = DEM_DTC_ORIGIN_PRIMARY_MEMORY
            DemEventPriority = 2
            DemFFPrestorageSupported = false
            DemOperationCycleRef = DemOperationCycle_0
            DemDebounceAlgorithmClass
              DemDebounceCounterBased:
                DemDebounceBehavior = DEM_DEBOUNCE_FREEZE
                DemDebounceCounterDecrementStepSize = 1
                DemDebounceCounterFailedThreshold = 127
                DemDebounceCounterIncrementStepSize = 1
                DemDebounceCounterJumpDown = true
                DemDebounceCounterJumpDownValue = 0
                DemDebounceCounterJumpUp = true
                DemDebounceCounterJumpUpValue = 0
                DemDebounceCounterPassedThreshold = -128
                DemDebounceCounterStorage = false
                DemDebounceContinuous = false
        AutoCreatedDemEvent_CC_EnablePDUGroup_CIOM_oLIN04_Rx_527a88fd_BswMReportFailToDemRef: DemEventId=49, DemEventKind=DEM_EVENT_KIND_BSW
          DemEventClass:
            DemAgingAllowed = false
            DemConsiderPtoStatus = false
            DemEventDestination = DEM_DTC_ORIGIN_PRIMARY_MEMORY
            DemEventPriority = 2
            DemFFPrestorageSupported = false
            DemOperationCycleRef = DemOperationCycle_0
            DemDebounceAlgorithmClass
              DemDebounceCounterBased:
                DemDebounceBehavior = DEM_DEBOUNCE_FREEZE
                DemDebounceCounterDecrementStepSize = 1
                DemDebounceCounterFailedThreshold = 127
                DemDebounceCounterIncrementStepSize = 1
                DemDebounceCounterJumpDown = true
                DemDebounceCounterJumpDownValue = 0
                DemDebounceCounterJumpUp = true
                DemDebounceCounterJumpUpValue = 0
                DemDebounceCounterPassedThreshold = -128
                DemDebounceCounterStorage = false
                DemDebounceContinuous = false
        AutoCreatedDemEvent_CC_DisableDM_CIOM_oBackbone2_Rx_4e624434_BswMReportFailToDemRef: DemEventId=4, DemEventKind=DEM_EVENT_KIND_BSW
          DemEventClass:
            DemAgingAllowed = false
            DemConsiderPtoStatus = false
            DemEventDestination = DEM_DTC_ORIGIN_PRIMARY_MEMORY
            DemEventPriority = 2
            DemFFPrestorageSupported = false
            DemOperationCycleRef = DemOperationCycle_0
            DemDebounceAlgorithmClass
              DemDebounceCounterBased:
                DemDebounceBehavior = DEM_DEBOUNCE_FREEZE
                DemDebounceCounterDecrementStepSize = 1
                DemDebounceCounterFailedThreshold = 127
                DemDebounceCounterIncrementStepSize = 1
                DemDebounceCounterJumpDown = true
                DemDebounceCounterJumpDownValue = 0
                DemDebounceCounterJumpUp = true
                DemDebounceCounterJumpUpValue = 0
                DemDebounceCounterPassedThreshold = -128
                DemDebounceCounterStorage = false
                DemDebounceContinuous = false
        AutoCreatedDemEvent_CC_EnableDM_CIOM_oBackbone2_Rx_4e624434_BswMReportFailToDemRef: DemEventId=29, DemEventKind=DEM_EVENT_KIND_BSW
          DemEventClass:
            DemAgingAllowed = false
            DemConsiderPtoStatus = false
            DemEventDestination = DEM_DTC_ORIGIN_PRIMARY_MEMORY
            DemEventPriority = 2
            DemFFPrestorageSupported = false
            DemOperationCycleRef = DemOperationCycle_0
            DemDebounceAlgorithmClass
              DemDebounceCounterBased:
                DemDebounceBehavior = DEM_DEBOUNCE_FREEZE
                DemDebounceCounterDecrementStepSize = 1
                DemDebounceCounterFailedThreshold = 127
                DemDebounceCounterIncrementStepSize = 1
                DemDebounceCounterJumpDown = true
                DemDebounceCounterJumpDownValue = 0
                DemDebounceCounterJumpUp = true
                DemDebounceCounterJumpUpValue = 0
                DemDebounceCounterPassedThreshold = -128
                DemDebounceCounterStorage = false
                DemDebounceContinuous = false
        AutoCreatedDemEvent_CC_DisableDM_CIOM_oSecuritySubnet_Rx_3a3c1dbc_BswMReportFailToDemRef: DemEventId=7, DemEventKind=DEM_EVENT_KIND_BSW
          DemEventClass:
            DemAgingAllowed = false
            DemConsiderPtoStatus = false
            DemEventDestination = DEM_DTC_ORIGIN_PRIMARY_MEMORY
            DemEventPriority = 2
            DemFFPrestorageSupported = false
            DemOperationCycleRef = DemOperationCycle_0
            DemDebounceAlgorithmClass
              DemDebounceCounterBased:
                DemDebounceBehavior = DEM_DEBOUNCE_FREEZE
                DemDebounceCounterDecrementStepSize = 1
                DemDebounceCounterFailedThreshold = 127
                DemDebounceCounterIncrementStepSize = 1
                DemDebounceCounterJumpDown = true
                DemDebounceCounterJumpDownValue = 0
                DemDebounceCounterJumpUp = true
                DemDebounceCounterJumpUpValue = 0
                DemDebounceCounterPassedThreshold = -128
                DemDebounceCounterStorage = false
                DemDebounceContinuous = false
        AutoCreatedDemEvent_CC_EnableDM_CIOM_oSecuritySubnet_Rx_3a3c1dbc_BswMReportFailToDemRef: DemEventId=32, DemEventKind=DEM_EVENT_KIND_BSW
          DemEventClass:
            DemAgingAllowed = false
            DemConsiderPtoStatus = false
            DemEventDestination = DEM_DTC_ORIGIN_PRIMARY_MEMORY
            DemEventPriority = 2
            DemFFPrestorageSupported = false
            DemOperationCycleRef = DemOperationCycle_0
            DemDebounceAlgorithmClass
              DemDebounceCounterBased:
                DemDebounceBehavior = DEM_DEBOUNCE_FREEZE
                DemDebounceCounterDecrementStepSize = 1
                DemDebounceCounterFailedThreshold = 127
                DemDebounceCounterIncrementStepSize = 1
                DemDebounceCounterJumpDown = true
                DemDebounceCounterJumpDownValue = 0
                DemDebounceCounterJumpUp = true
                DemDebounceCounterJumpUpValue = 0
                DemDebounceCounterPassedThreshold = -128
                DemDebounceCounterStorage = false
                DemDebounceContinuous = false
        AutoCreatedDemEvent_CC_DisablePDUGroup_CIOM_oCabSubnet_Tx_5060f83a_BswMReportFailToDemRef: DemEventId=13, DemEventKind=DEM_EVENT_KIND_BSW
          DemEventClass:
            DemAgingAllowed = false
            DemConsiderPtoStatus = false
            DemEventDestination = DEM_DTC_ORIGIN_PRIMARY_MEMORY
            DemEventPriority = 2
            DemFFPrestorageSupported = false
            DemOperationCycleRef = DemOperationCycle_0
            DemDebounceAlgorithmClass
              DemDebounceCounterBased:
                DemDebounceBehavior = DEM_DEBOUNCE_FREEZE
                DemDebounceCounterDecrementStepSize = 1
                DemDebounceCounterFailedThreshold = 127
                DemDebounceCounterIncrementStepSize = 1
                DemDebounceCounterJumpDown = true
                DemDebounceCounterJumpDownValue = 0
                DemDebounceCounterJumpUp = true
                DemDebounceCounterJumpUpValue = 0
                DemDebounceCounterPassedThreshold = -128
                DemDebounceCounterStorage = false
                DemDebounceContinuous = false
        AutoCreatedDemEvent_CC_EnablePDUGroup_CIOM_oCabSubnet_Tx_5060f83a_BswMReportFailToDemRef: DemEventId=38, DemEventKind=DEM_EVENT_KIND_BSW
          DemEventClass:
            DemAgingAllowed = false
            DemConsiderPtoStatus = false
            DemEventDestination = DEM_DTC_ORIGIN_PRIMARY_MEMORY
            DemEventPriority = 2
            DemFFPrestorageSupported = false
            DemOperationCycleRef = DemOperationCycle_0
            DemDebounceAlgorithmClass
              DemDebounceCounterBased:
                DemDebounceBehavior = DEM_DEBOUNCE_FREEZE
                DemDebounceCounterDecrementStepSize = 1
                DemDebounceCounterFailedThreshold = 127
                DemDebounceCounterIncrementStepSize = 1
                DemDebounceCounterJumpDown = true
                DemDebounceCounterJumpDownValue = 0
                DemDebounceCounterJumpUp = true
                DemDebounceCounterJumpUpValue = 0
                DemDebounceCounterPassedThreshold = -128
                DemDebounceCounterStorage = false
                DemDebounceContinuous = false
        AutoCreatedDemEvent_CC_EnableDM_CIOM_oCabSubnet_Rx_063a5fbc_BswMReportFailToDemRef: DemEventId=30, DemEventKind=DEM_EVENT_KIND_BSW
          DemEventClass:
            DemAgingAllowed = false
            DemConsiderPtoStatus = false
            DemEventDestination = DEM_DTC_ORIGIN_PRIMARY_MEMORY
            DemEventPriority = 2
            DemFFPrestorageSupported = false
            DemOperationCycleRef = DemOperationCycle_0
            DemDebounceAlgorithmClass
              DemDebounceCounterBased:
                DemDebounceBehavior = DEM_DEBOUNCE_FREEZE
                DemDebounceCounterDecrementStepSize = 1
                DemDebounceCounterFailedThreshold = 127
                DemDebounceCounterIncrementStepSize = 1
                DemDebounceCounterJumpDown = true
                DemDebounceCounterJumpDownValue = 0
                DemDebounceCounterJumpUp = true
                DemDebounceCounterJumpUpValue = 0
                DemDebounceCounterPassedThreshold = -128
                DemDebounceCounterStorage = false
                DemDebounceContinuous = false
        AutoCreatedDemEvent_CC_DisablePDUGroup_CIOM_oBackbone2_Tx_1838e3b2_BswMReportFailToDemRef: DemEventId=11, DemEventKind=DEM_EVENT_KIND_BSW
          DemEventClass:
            DemAgingAllowed = false
            DemConsiderPtoStatus = false
            DemEventDestination = DEM_DTC_ORIGIN_PRIMARY_MEMORY
            DemEventPriority = 2
            DemFFPrestorageSupported = false
            DemOperationCycleRef = DemOperationCycle_0
            DemDebounceAlgorithmClass
              DemDebounceCounterBased:
                DemDebounceBehavior = DEM_DEBOUNCE_FREEZE
                DemDebounceCounterDecrementStepSize = 1
                DemDebounceCounterFailedThreshold = 127
                DemDebounceCounterIncrementStepSize = 1
                DemDebounceCounterJumpDown = true
                DemDebounceCounterJumpDownValue = 0
                DemDebounceCounterJumpUp = true
                DemDebounceCounterJumpUpValue = 0
                DemDebounceCounterPassedThreshold = -128
                DemDebounceCounterStorage = false
                DemDebounceContinuous = false
        AutoCreatedDemEvent_CC_EnablePDUGroup_CIOM_oBackbone2_Tx_1838e3b2_BswMReportFailToDemRef: DemEventId=36, DemEventKind=DEM_EVENT_KIND_BSW
          DemEventClass:
            DemAgingAllowed = false
            DemConsiderPtoStatus = false
            DemEventDestination = DEM_DTC_ORIGIN_PRIMARY_MEMORY
            DemEventPriority = 2
            DemFFPrestorageSupported = false
            DemOperationCycleRef = DemOperationCycle_0
            DemDebounceAlgorithmClass
              DemDebounceCounterBased:
                DemDebounceBehavior = DEM_DEBOUNCE_FREEZE
                DemDebounceCounterDecrementStepSize = 1
                DemDebounceCounterFailedThreshold = 127
                DemDebounceCounterIncrementStepSize = 1
                DemDebounceCounterJumpDown = true
                DemDebounceCounterJumpDownValue = 0
                DemDebounceCounterJumpUp = true
                DemDebounceCounterJumpUpValue = 0
                DemDebounceCounterPassedThreshold = -128
                DemDebounceCounterStorage = false
                DemDebounceContinuous = false
        AutoCreatedDemEvent_CC_DisablePDUGroup_CIOM_oBackbone2_Rx_4e624434_BswMReportFailToDemRef: DemEventId=10, DemEventKind=DEM_EVENT_KIND_BSW
          DemEventClass:
            DemAgingAllowed = false
            DemConsiderPtoStatus = false
            DemEventDestination = DEM_DTC_ORIGIN_PRIMARY_MEMORY
            DemEventPriority = 2
            DemFFPrestorageSupported = false
            DemOperationCycleRef = DemOperationCycle_0
            DemDebounceAlgorithmClass
              DemDebounceCounterBased:
                DemDebounceBehavior = DEM_DEBOUNCE_FREEZE
                DemDebounceCounterDecrementStepSize = 1
                DemDebounceCounterFailedThreshold = 127
                DemDebounceCounterIncrementStepSize = 1
                DemDebounceCounterJumpDown = true
                DemDebounceCounterJumpDownValue = 0
                DemDebounceCounterJumpUp = true
                DemDebounceCounterJumpUpValue = 0
                DemDebounceCounterPassedThreshold = -128
                DemDebounceCounterStorage = false
                DemDebounceContinuous = false
        AutoCreatedDemEvent_CC_EnablePDUGroup_CIOM_oBackbone2_Rx_4e624434_BswMReportFailToDemRef: DemEventId=35, DemEventKind=DEM_EVENT_KIND_BSW
          DemEventClass:
            DemAgingAllowed = false
            DemConsiderPtoStatus = false
            DemEventDestination = DEM_DTC_ORIGIN_PRIMARY_MEMORY
            DemEventPriority = 2
            DemFFPrestorageSupported = false
            DemOperationCycleRef = DemOperationCycle_0
            DemDebounceAlgorithmClass
              DemDebounceCounterBased:
                DemDebounceBehavior = DEM_DEBOUNCE_FREEZE
                DemDebounceCounterDecrementStepSize = 1
                DemDebounceCounterFailedThreshold = 127
                DemDebounceCounterIncrementStepSize = 1
                DemDebounceCounterJumpDown = true
                DemDebounceCounterJumpDownValue = 0
                DemDebounceCounterJumpUp = true
                DemDebounceCounterJumpUpValue = 0
                DemDebounceCounterPassedThreshold = -128
                DemDebounceCounterStorage = false
                DemDebounceContinuous = false
        AutoCreatedDemEvent_CC_DisablePDUGroup_CIOM_oBackbone1J1939_Rx_BC_405bc776_BswMReportFailToDemRef: DemEventId=8, DemEventKind=DEM_EVENT_KIND_BSW
          DemEventClass:
            DemAgingAllowed = false
            DemConsiderPtoStatus = false
            DemEventDestination = DEM_DTC_ORIGIN_PRIMARY_MEMORY
            DemEventPriority = 2
            DemFFPrestorageSupported = false
            DemOperationCycleRef = DemOperationCycle_0
            DemDebounceAlgorithmClass
              DemDebounceCounterBased:
                DemDebounceBehavior = DEM_DEBOUNCE_FREEZE
                DemDebounceCounterDecrementStepSize = 1
                DemDebounceCounterFailedThreshold = 127
                DemDebounceCounterIncrementStepSize = 1
                DemDebounceCounterJumpDown = true
                DemDebounceCounterJumpDownValue = 0
                DemDebounceCounterJumpUp = true
                DemDebounceCounterJumpUpValue = 0
                DemDebounceCounterPassedThreshold = -128
                DemDebounceCounterStorage = false
                DemDebounceContinuous = false
        AutoCreatedDemEvent_CC_EnablePDUGroup_CIOM_oBackbone1J1939_Rx_BC_405bc776_BswMReportFailToDemRef: DemEventId=33, DemEventKind=DEM_EVENT_KIND_BSW
          DemEventClass:
            DemAgingAllowed = false
            DemConsiderPtoStatus = false
            DemEventDestination = DEM_DTC_ORIGIN_PRIMARY_MEMORY
            DemEventPriority = 2
            DemFFPrestorageSupported = false
            DemOperationCycleRef = DemOperationCycle_0
            DemDebounceAlgorithmClass
              DemDebounceCounterBased:
                DemDebounceBehavior = DEM_DEBOUNCE_FREEZE
                DemDebounceCounterDecrementStepSize = 1
                DemDebounceCounterFailedThreshold = 127
                DemDebounceCounterIncrementStepSize = 1
                DemDebounceCounterJumpDown = true
                DemDebounceCounterJumpDownValue = 0
                DemDebounceCounterJumpUp = true
                DemDebounceCounterJumpUpValue = 0
                DemDebounceCounterPassedThreshold = -128
                DemDebounceCounterStorage = false
                DemDebounceContinuous = false
        AutoCreatedDemEvent_CC_EnablePDUGroup_CIOM_oLIN02_Tx_214b70a7_BswMReportFailToDemRef: DemEventId=46, DemEventKind=DEM_EVENT_KIND_BSW
          DemEventClass:
            DemAgingAllowed = false
            DemConsiderPtoStatus = false
            DemEventDestination = DEM_DTC_ORIGIN_PRIMARY_MEMORY
            DemEventPriority = 2
            DemFFPrestorageSupported = false
            DemOperationCycleRef = DemOperationCycle_0
            DemDebounceAlgorithmClass
              DemDebounceCounterBased:
                DemDebounceBehavior = DEM_DEBOUNCE_FREEZE
                DemDebounceCounterDecrementStepSize = 1
                DemDebounceCounterFailedThreshold = 127
                DemDebounceCounterIncrementStepSize = 1
                DemDebounceCounterJumpDown = true
                DemDebounceCounterJumpDownValue = 0
                DemDebounceCounterJumpUp = true
                DemDebounceCounterJumpUpValue = 0
                DemDebounceCounterPassedThreshold = -128
                DemDebounceCounterStorage = false
                DemDebounceContinuous = false
        AutoCreatedDemEvent_CC_EnablePDUGroup_CIOM_oLIN02_Rx_7711d721_BswMReportFailToDemRef: DemEventId=45, DemEventKind=DEM_EVENT_KIND_BSW
          DemEventClass:
            DemAgingAllowed = false
            DemConsiderPtoStatus = false
            DemEventDestination = DEM_DTC_ORIGIN_PRIMARY_MEMORY
            DemEventPriority = 2
            DemFFPrestorageSupported = false
            DemOperationCycleRef = DemOperationCycle_0
            DemDebounceAlgorithmClass
              DemDebounceCounterBased:
                DemDebounceBehavior = DEM_DEBOUNCE_FREEZE
                DemDebounceCounterDecrementStepSize = 1
                DemDebounceCounterFailedThreshold = 127
                DemDebounceCounterIncrementStepSize = 1
                DemDebounceCounterJumpDown = true
                DemDebounceCounterJumpDownValue = 0
                DemDebounceCounterJumpUp = true
                DemDebounceCounterJumpUpValue = 0
                DemDebounceCounterPassedThreshold = -128
                DemDebounceCounterStorage = false
                DemDebounceContinuous = false
        AutoCreatedDemEvent_CC_EnablePDUGroup_CIOM_oLIN01_Tx_33fedf49_BswMReportFailToDemRef: DemEventId=44, DemEventKind=DEM_EVENT_KIND_BSW
          DemEventClass:
            DemAgingAllowed = false
            DemConsiderPtoStatus = false
            DemEventDestination = DEM_DTC_ORIGIN_PRIMARY_MEMORY
            DemEventPriority = 2
            DemFFPrestorageSupported = false
            DemOperationCycleRef = DemOperationCycle_0
            DemDebounceAlgorithmClass
              DemDebounceCounterBased:
                DemDebounceBehavior = DEM_DEBOUNCE_FREEZE
                DemDebounceCounterDecrementStepSize = 1
                DemDebounceCounterFailedThreshold = 127
                DemDebounceCounterIncrementStepSize = 1
                DemDebounceCounterJumpDown = true
                DemDebounceCounterJumpDownValue = 0
                DemDebounceCounterJumpUp = true
                DemDebounceCounterJumpUpValue = 0
                DemDebounceCounterPassedThreshold = -128
                DemDebounceCounterStorage = false
                DemDebounceContinuous = false
        AutoCreatedDemEvent_CC_EnablePDUGroup_CIOM_oLIN01_Rx_65a478cf_BswMReportFailToDemRef: DemEventId=43, DemEventKind=DEM_EVENT_KIND_BSW
          DemEventClass:
            DemAgingAllowed = false
            DemConsiderPtoStatus = false
            DemEventDestination = DEM_DTC_ORIGIN_PRIMARY_MEMORY
            DemEventPriority = 2
            DemFFPrestorageSupported = false
            DemOperationCycleRef = DemOperationCycle_0
            DemDebounceAlgorithmClass
              DemDebounceCounterBased:
                DemDebounceBehavior = DEM_DEBOUNCE_FREEZE
                DemDebounceCounterDecrementStepSize = 1
                DemDebounceCounterFailedThreshold = 127
                DemDebounceCounterIncrementStepSize = 1
                DemDebounceCounterJumpDown = true
                DemDebounceCounterJumpDownValue = 0
                DemDebounceCounterJumpUp = true
                DemDebounceCounterJumpUpValue = 0
                DemDebounceCounterPassedThreshold = -128
                DemDebounceCounterStorage = false
                DemDebounceContinuous = false
        AutoCreatedDemEvent_CC_DisablePDUGroup_CIOM_oLIN03_Tx_99f717c2_BswMReportFailToDemRef: DemEventId=23, DemEventKind=DEM_EVENT_KIND_BSW
          DemEventClass:
            DemAgingAllowed = false
            DemConsiderPtoStatus = false
            DemEventDestination = DEM_DTC_ORIGIN_PRIMARY_MEMORY
            DemEventPriority = 2
            DemFFPrestorageSupported = false
            DemOperationCycleRef = DemOperationCycle_0
            DemDebounceAlgorithmClass
              DemDebounceCounterBased:
                DemDebounceBehavior = DEM_DEBOUNCE_FREEZE
                DemDebounceCounterDecrementStepSize = 1
                DemDebounceCounterFailedThreshold = 127
                DemDebounceCounterIncrementStepSize = 1
                DemDebounceCounterJumpDown = true
                DemDebounceCounterJumpDownValue = 0
                DemDebounceCounterJumpUp = true
                DemDebounceCounterJumpUpValue = 0
                DemDebounceCounterPassedThreshold = -128
                DemDebounceCounterStorage = false
                DemDebounceContinuous = false
        AutoCreatedDemEvent_CC_DisablePDUGroup_CIOM_oLIN03_Rx_cfadb044_BswMReportFailToDemRef: DemEventId=22, DemEventKind=DEM_EVENT_KIND_BSW
          DemEventClass:
            DemAgingAllowed = false
            DemConsiderPtoStatus = false
            DemEventDestination = DEM_DTC_ORIGIN_PRIMARY_MEMORY
            DemEventPriority = 2
            DemFFPrestorageSupported = false
            DemOperationCycleRef = DemOperationCycle_0
            DemDebounceAlgorithmClass
              DemDebounceCounterBased:
                DemDebounceBehavior = DEM_DEBOUNCE_FREEZE
                DemDebounceCounterDecrementStepSize = 1
                DemDebounceCounterFailedThreshold = 127
                DemDebounceCounterIncrementStepSize = 1
                DemDebounceCounterJumpDown = true
                DemDebounceCounterJumpDownValue = 0
                DemDebounceCounterJumpUp = true
                DemDebounceCounterJumpUpValue = 0
                DemDebounceCounterPassedThreshold = -128
                DemDebounceCounterStorage = false
                DemDebounceContinuous = false
        AutoCreatedDemEvent_CC_DisableDM_CIOM_oFMSNet_Rx_BC_dd2c1510_BswMReportFailToDemRef: DemEventId=6, DemEventKind=DEM_EVENT_KIND_BSW
          DemEventClass:
            DemAgingAllowed = false
            DemConsiderPtoStatus = false
            DemEventDestination = DEM_DTC_ORIGIN_PRIMARY_MEMORY
            DemEventPriority = 2
            DemFFPrestorageSupported = false
            DemOperationCycleRef = DemOperationCycle_0
            DemDebounceAlgorithmClass
              DemDebounceCounterBased:
                DemDebounceBehavior = DEM_DEBOUNCE_FREEZE
                DemDebounceCounterDecrementStepSize = 1
                DemDebounceCounterFailedThreshold = 127
                DemDebounceCounterIncrementStepSize = 1
                DemDebounceCounterJumpDown = true
                DemDebounceCounterJumpDownValue = 0
                DemDebounceCounterJumpUp = true
                DemDebounceCounterJumpUpValue = 0
                DemDebounceCounterPassedThreshold = -128
                DemDebounceCounterStorage = false
                DemDebounceContinuous = false
        AutoCreatedDemEvent_CC_EnableDM_CIOM_oFMSNet_Rx_BC_dd2c1510_BswMReportFailToDemRef: DemEventId=31, DemEventKind=DEM_EVENT_KIND_BSW
          DemEventClass:
            DemAgingAllowed = false
            DemConsiderPtoStatus = false
            DemEventDestination = DEM_DTC_ORIGIN_PRIMARY_MEMORY
            DemEventPriority = 2
            DemFFPrestorageSupported = false
            DemOperationCycleRef = DemOperationCycle_0
            DemDebounceAlgorithmClass
              DemDebounceCounterBased:
                DemDebounceBehavior = DEM_DEBOUNCE_FREEZE
                DemDebounceCounterDecrementStepSize = 1
                DemDebounceCounterFailedThreshold = 127
                DemDebounceCounterIncrementStepSize = 1
                DemDebounceCounterJumpDown = true
                DemDebounceCounterJumpDownValue = 0
                DemDebounceCounterJumpUp = true
                DemDebounceCounterJumpUpValue = 0
                DemDebounceCounterPassedThreshold = -128
                DemDebounceCounterStorage = false
                DemDebounceContinuous = false
        AutoCreatedDemEvent_CC_EnablePDUGroup_CIOM_oLIN03_Tx_99f717c2_BswMReportFailToDemRef: DemEventId=48, DemEventKind=DEM_EVENT_KIND_BSW
          DemEventClass:
            DemAgingAllowed = false
            DemConsiderPtoStatus = false
            DemEventDestination = DEM_DTC_ORIGIN_PRIMARY_MEMORY
            DemEventPriority = 2
            DemFFPrestorageSupported = false
            DemOperationCycleRef = DemOperationCycle_0
            DemDebounceAlgorithmClass
              DemDebounceCounterBased:
                DemDebounceBehavior = DEM_DEBOUNCE_FREEZE
                DemDebounceCounterDecrementStepSize = 1
                DemDebounceCounterFailedThreshold = 127
                DemDebounceCounterIncrementStepSize = 1
                DemDebounceCounterJumpDown = true
                DemDebounceCounterJumpDownValue = 0
                DemDebounceCounterJumpUp = true
                DemDebounceCounterJumpUpValue = 0
                DemDebounceCounterPassedThreshold = -128
                DemDebounceCounterStorage = false
                DemDebounceContinuous = false
        AutoCreatedDemEvent_CC_EnablePDUGroup_CIOM_oLIN03_Rx_cfadb044_BswMReportFailToDemRef: DemEventId=47, DemEventKind=DEM_EVENT_KIND_BSW
          DemEventClass:
            DemAgingAllowed = false
            DemConsiderPtoStatus = false
            DemEventDestination = DEM_DTC_ORIGIN_PRIMARY_MEMORY
            DemEventPriority = 2
            DemFFPrestorageSupported = false
            DemOperationCycleRef = DemOperationCycle_0
            DemDebounceAlgorithmClass
              DemDebounceCounterBased:
                DemDebounceBehavior = DEM_DEBOUNCE_FREEZE
                DemDebounceCounterDecrementStepSize = 1
                DemDebounceCounterFailedThreshold = 127
                DemDebounceCounterIncrementStepSize = 1
                DemDebounceCounterJumpDown = true
                DemDebounceCounterJumpDownValue = 0
                DemDebounceCounterJumpUp = true
                DemDebounceCounterJumpUpValue = 0
                DemDebounceCounterPassedThreshold = -128
                DemDebounceCounterStorage = false
                DemDebounceContinuous = false
        AutoCreatedDemEvent_CC_DisablePDUGroup_CIOM_oLIN02_Tx_214b70a7_BswMReportFailToDemRef: DemEventId=21, DemEventKind=DEM_EVENT_KIND_BSW
          DemEventClass:
            DemAgingAllowed = false
            DemConsiderPtoStatus = false
            DemEventDestination = DEM_DTC_ORIGIN_PRIMARY_MEMORY
            DemEventPriority = 2
            DemFFPrestorageSupported = false
            DemOperationCycleRef = DemOperationCycle_0
            DemDebounceAlgorithmClass
              DemDebounceCounterBased:
                DemDebounceBehavior = DEM_DEBOUNCE_FREEZE
                DemDebounceCounterDecrementStepSize = 1
                DemDebounceCounterFailedThreshold = 127
                DemDebounceCounterIncrementStepSize = 1
                DemDebounceCounterJumpDown = true
                DemDebounceCounterJumpDownValue = 0
                DemDebounceCounterJumpUp = true
                DemDebounceCounterJumpUpValue = 0
                DemDebounceCounterPassedThreshold = -128
                DemDebounceCounterStorage = false
                DemDebounceContinuous = false
        AutoCreatedDemEvent_CC_DisablePDUGroup_CIOM_oLIN02_Rx_7711d721_BswMReportFailToDemRef: DemEventId=20, DemEventKind=DEM_EVENT_KIND_BSW
          DemEventClass:
            DemAgingAllowed = false
            DemConsiderPtoStatus = false
            DemEventDestination = DEM_DTC_ORIGIN_PRIMARY_MEMORY
            DemEventPriority = 2
            DemFFPrestorageSupported = false
            DemOperationCycleRef = DemOperationCycle_0
            DemDebounceAlgorithmClass
              DemDebounceCounterBased:
                DemDebounceBehavior = DEM_DEBOUNCE_FREEZE
                DemDebounceCounterDecrementStepSize = 1
                DemDebounceCounterFailedThreshold = 127
                DemDebounceCounterIncrementStepSize = 1
                DemDebounceCounterJumpDown = true
                DemDebounceCounterJumpDownValue = 0
                DemDebounceCounterJumpUp = true
                DemDebounceCounterJumpUpValue = 0
                DemDebounceCounterPassedThreshold = -128
                DemDebounceCounterStorage = false
                DemDebounceContinuous = false
        AutoCreatedDemEvent_CC_DisablePDUGroup_CIOM_oCabSubnet_Rx_063a5fbc_BswMReportFailToDemRef: DemEventId=12, DemEventKind=DEM_EVENT_KIND_BSW
          DemEventClass:
            DemAgingAllowed = false
            DemConsiderPtoStatus = false
            DemEventDestination = DEM_DTC_ORIGIN_PRIMARY_MEMORY
            DemEventPriority = 2
            DemFFPrestorageSupported = false
            DemOperationCycleRef = DemOperationCycle_0
            DemDebounceAlgorithmClass
              DemDebounceCounterBased:
                DemDebounceBehavior = DEM_DEBOUNCE_FREEZE
                DemDebounceCounterDecrementStepSize = 1
                DemDebounceCounterFailedThreshold = 127
                DemDebounceCounterIncrementStepSize = 1
                DemDebounceCounterJumpDown = true
                DemDebounceCounterJumpDownValue = 0
                DemDebounceCounterJumpUp = true
                DemDebounceCounterJumpUpValue = 0
                DemDebounceCounterPassedThreshold = -128
                DemDebounceCounterStorage = false
                DemDebounceContinuous = false
        AutoCreatedDemEvent_CC_EnablePDUGroup_CIOM_oCabSubnet_Rx_063a5fbc_BswMReportFailToDemRef: DemEventId=37, DemEventKind=DEM_EVENT_KIND_BSW
          DemEventClass:
            DemAgingAllowed = false
            DemConsiderPtoStatus = false
            DemEventDestination = DEM_DTC_ORIGIN_PRIMARY_MEMORY
            DemEventPriority = 2
            DemFFPrestorageSupported = false
            DemOperationCycleRef = DemOperationCycle_0
            DemDebounceAlgorithmClass
              DemDebounceCounterBased:
                DemDebounceBehavior = DEM_DEBOUNCE_FREEZE
                DemDebounceCounterDecrementStepSize = 1
                DemDebounceCounterFailedThreshold = 127
                DemDebounceCounterIncrementStepSize = 1
                DemDebounceCounterJumpDown = true
                DemDebounceCounterJumpDownValue = 0
                DemDebounceCounterJumpUp = true
                DemDebounceCounterJumpUpValue = 0
                DemDebounceCounterPassedThreshold = -128
                DemDebounceCounterStorage = false
                DemDebounceContinuous = false
        AutoCreatedDemEvent_CC_DisablePDUGroup_CIOM_oFMSNet_Rx_BC_dd2c1510_BswMReportFailToDemRef: DemEventId=14, DemEventKind=DEM_EVENT_KIND_BSW
          DemEventClass:
            DemAgingAllowed = false
            DemConsiderPtoStatus = false
            DemEventDestination = DEM_DTC_ORIGIN_PRIMARY_MEMORY
            DemEventPriority = 2
            DemFFPrestorageSupported = false
            DemOperationCycleRef = DemOperationCycle_0
            DemDebounceAlgorithmClass
              DemDebounceCounterBased:
                DemDebounceBehavior = DEM_DEBOUNCE_FREEZE
                DemDebounceCounterDecrementStepSize = 1
                DemDebounceCounterFailedThreshold = 127
                DemDebounceCounterIncrementStepSize = 1
                DemDebounceCounterJumpDown = true
                DemDebounceCounterJumpDownValue = 0
                DemDebounceCounterJumpUp = true
                DemDebounceCounterJumpUpValue = 0
                DemDebounceCounterPassedThreshold = -128
                DemDebounceCounterStorage = false
                DemDebounceContinuous = false
        AutoCreatedDemEvent_CC_EnablePDUGroup_CIOM_oFMSNet_Rx_BC_dd2c1510_BswMReportFailToDemRef: DemEventId=39, DemEventKind=DEM_EVENT_KIND_BSW
          DemEventClass:
            DemAgingAllowed = false
            DemConsiderPtoStatus = false
            DemEventDestination = DEM_DTC_ORIGIN_PRIMARY_MEMORY
            DemEventPriority = 2
            DemFFPrestorageSupported = false
            DemOperationCycleRef = DemOperationCycle_0
            DemDebounceAlgorithmClass
              DemDebounceCounterBased:
                DemDebounceBehavior = DEM_DEBOUNCE_FREEZE
                DemDebounceCounterDecrementStepSize = 1
                DemDebounceCounterFailedThreshold = 127
                DemDebounceCounterIncrementStepSize = 1
                DemDebounceCounterJumpDown = true
                DemDebounceCounterJumpDownValue = 0
                DemDebounceCounterJumpUp = true
                DemDebounceCounterJumpUpValue = 0
                DemDebounceCounterPassedThreshold = -128
                DemDebounceCounterStorage = false
                DemDebounceContinuous = false
        AutoCreatedDemEvent_CC_DisablePDUGroup_CIOM_oSecuritySubnet_Rx_3a3c1dbc_BswMReportFailToDemRef: DemEventId=26, DemEventKind=DEM_EVENT_KIND_BSW
          DemEventClass:
            DemAgingAllowed = false
            DemConsiderPtoStatus = false
            DemEventDestination = DEM_DTC_ORIGIN_PRIMARY_MEMORY
            DemEventPriority = 2
            DemFFPrestorageSupported = false
            DemOperationCycleRef = DemOperationCycle_0
            DemDebounceAlgorithmClass
              DemDebounceCounterBased:
                DemDebounceBehavior = DEM_DEBOUNCE_FREEZE
                DemDebounceCounterDecrementStepSize = 1
                DemDebounceCounterFailedThreshold = 127
                DemDebounceCounterIncrementStepSize = 1
                DemDebounceCounterJumpDown = true
                DemDebounceCounterJumpDownValue = 0
                DemDebounceCounterJumpUp = true
                DemDebounceCounterJumpUpValue = 0
                DemDebounceCounterPassedThreshold = -128
                DemDebounceCounterStorage = false
                DemDebounceContinuous = false
        AutoCreatedDemEvent_CC_EnablePDUGroup_CIOM_oSecuritySubnet_Rx_3a3c1dbc_BswMReportFailToDemRef: DemEventId=51, DemEventKind=DEM_EVENT_KIND_BSW
          DemEventClass:
            DemAgingAllowed = false
            DemConsiderPtoStatus = false
            DemEventDestination = DEM_DTC_ORIGIN_PRIMARY_MEMORY
            DemEventPriority = 2
            DemFFPrestorageSupported = false
            DemOperationCycleRef = DemOperationCycle_0
            DemDebounceAlgorithmClass
              DemDebounceCounterBased:
                DemDebounceBehavior = DEM_DEBOUNCE_FREEZE
                DemDebounceCounterDecrementStepSize = 1
                DemDebounceCounterFailedThreshold = 127
                DemDebounceCounterIncrementStepSize = 1
                DemDebounceCounterJumpDown = true
                DemDebounceCounterJumpDownValue = 0
                DemDebounceCounterJumpUp = true
                DemDebounceCounterJumpUpValue = 0
                DemDebounceCounterPassedThreshold = -128
                DemDebounceCounterStorage = false
                DemDebounceContinuous = false
        AutoCreatedDemEvent_CC_DisablePDUGroup_CIOM_oFMSNet_Tx_0x31_BC_38fc8c7d_BswMReportFailToDemRef: DemEventId=15, DemEventKind=DEM_EVENT_KIND_BSW
          DemEventClass:
            DemAgingAllowed = false
            DemConsiderPtoStatus = false
            DemEventDestination = DEM_DTC_ORIGIN_PRIMARY_MEMORY
            DemEventPriority = 2
            DemFFPrestorageSupported = false
            DemOperationCycleRef = DemOperationCycle_0
            DemDebounceAlgorithmClass
              DemDebounceCounterBased:
                DemDebounceBehavior = DEM_DEBOUNCE_FREEZE
                DemDebounceCounterDecrementStepSize = 1
                DemDebounceCounterFailedThreshold = 127
                DemDebounceCounterIncrementStepSize = 1
                DemDebounceCounterJumpDown = true
                DemDebounceCounterJumpDownValue = 0
                DemDebounceCounterJumpUp = true
                DemDebounceCounterJumpUpValue = 0
                DemDebounceCounterPassedThreshold = -128
                DemDebounceCounterStorage = false
                DemDebounceContinuous = false
        AutoCreatedDemEvent_CC_EnablePDUGroup_CIOM_oFMSNet_Tx_0x31_BC_38fc8c7d_BswMReportFailToDemRef: DemEventId=40, DemEventKind=DEM_EVENT_KIND_BSW
          DemEventClass:
            DemAgingAllowed = false
            DemConsiderPtoStatus = false
            DemEventDestination = DEM_DTC_ORIGIN_PRIMARY_MEMORY
            DemEventPriority = 2
            DemFFPrestorageSupported = false
            DemOperationCycleRef = DemOperationCycle_0
            DemDebounceAlgorithmClass
              DemDebounceCounterBased:
                DemDebounceBehavior = DEM_DEBOUNCE_FREEZE
                DemDebounceCounterDecrementStepSize = 1
                DemDebounceCounterFailedThreshold = 127
                DemDebounceCounterIncrementStepSize = 1
                DemDebounceCounterJumpDown = true
                DemDebounceCounterJumpDownValue = 0
                DemDebounceCounterJumpUp = true
                DemDebounceCounterJumpUpValue = 0
                DemDebounceCounterPassedThreshold = -128
                DemDebounceCounterStorage = false
                DemDebounceContinuous = false
        AutoCreatedDemEvent_CC_DisablePDUGroup_CIOM_oSecuritySubnet_Tx_6c66ba3a_BswMReportFailToDemRef: DemEventId=27, DemEventKind=DEM_EVENT_KIND_BSW
          DemEventClass:
            DemAgingAllowed = false
            DemConsiderPtoStatus = false
            DemEventDestination = DEM_DTC_ORIGIN_PRIMARY_MEMORY
            DemEventPriority = 2
            DemFFPrestorageSupported = false
            DemOperationCycleRef = DemOperationCycle_0
            DemDebounceAlgorithmClass
              DemDebounceCounterBased:
                DemDebounceBehavior = DEM_DEBOUNCE_FREEZE
                DemDebounceCounterDecrementStepSize = 1
                DemDebounceCounterFailedThreshold = 127
                DemDebounceCounterIncrementStepSize = 1
                DemDebounceCounterJumpDown = true
                DemDebounceCounterJumpDownValue = 0
                DemDebounceCounterJumpUp = true
                DemDebounceCounterJumpUpValue = 0
                DemDebounceCounterPassedThreshold = -128
                DemDebounceCounterStorage = false
                DemDebounceContinuous = false
        AutoCreatedDemEvent_CC_EnablePDUGroup_CIOM_oSecuritySubnet_Tx_6c66ba3a_BswMReportFailToDemRef: DemEventId=52, DemEventKind=DEM_EVENT_KIND_BSW
          DemEventClass:
            DemAgingAllowed = false
            DemConsiderPtoStatus = false
            DemEventDestination = DEM_DTC_ORIGIN_PRIMARY_MEMORY
            DemEventPriority = 2
            DemFFPrestorageSupported = false
            DemOperationCycleRef = DemOperationCycle_0
            DemDebounceAlgorithmClass
              DemDebounceCounterBased:
                DemDebounceBehavior = DEM_DEBOUNCE_FREEZE
                DemDebounceCounterDecrementStepSize = 1
                DemDebounceCounterFailedThreshold = 127
                DemDebounceCounterIncrementStepSize = 1
                DemDebounceCounterJumpDown = true
                DemDebounceCounterJumpDownValue = 0
                DemDebounceCounterJumpUp = true
                DemDebounceCounterJumpUpValue = 0
                DemDebounceCounterPassedThreshold = -128
                DemDebounceCounterStorage = false
                DemDebounceContinuous = false
        AutoCreatedDemEvent_CC_DisablePDUGroup_CIOM_oLIN00_Tx_8b42b82c_BswMReportFailToDemRef: DemEventId=17, DemEventKind=DEM_EVENT_KIND_BSW
          DemEventClass:
            DemAgingAllowed = false
            DemConsiderPtoStatus = false
            DemEventDestination = DEM_DTC_ORIGIN_PRIMARY_MEMORY
            DemEventPriority = 2
            DemFFPrestorageSupported = false
            DemOperationCycleRef = DemOperationCycle_0
            DemDebounceAlgorithmClass
              DemDebounceCounterBased:
                DemDebounceBehavior = DEM_DEBOUNCE_FREEZE
                DemDebounceCounterDecrementStepSize = 1
                DemDebounceCounterFailedThreshold = 127
                DemDebounceCounterIncrementStepSize = 1
                DemDebounceCounterJumpDown = true
                DemDebounceCounterJumpDownValue = 0
                DemDebounceCounterJumpUp = true
                DemDebounceCounterJumpUpValue = 0
                DemDebounceCounterPassedThreshold = -128
                DemDebounceCounterStorage = false
                DemDebounceContinuous = false
        AutoCreatedDemEvent_CC_EnablePDUGroup_CIOM_oLIN00_Rx_dd181faa_BswMReportFailToDemRef: DemEventId=41, DemEventKind=DEM_EVENT_KIND_BSW
          DemEventClass:
            DemAgingAllowed = false
            DemConsiderPtoStatus = false
            DemEventDestination = DEM_DTC_ORIGIN_PRIMARY_MEMORY
            DemEventPriority = 2
            DemFFPrestorageSupported = false
            DemOperationCycleRef = DemOperationCycle_0
            DemDebounceAlgorithmClass
              DemDebounceCounterBased:
                DemDebounceBehavior = DEM_DEBOUNCE_FREEZE
                DemDebounceCounterDecrementStepSize = 1
                DemDebounceCounterFailedThreshold = 127
                DemDebounceCounterIncrementStepSize = 1
                DemDebounceCounterJumpDown = true
                DemDebounceCounterJumpDownValue = 0
                DemDebounceCounterJumpUp = true
                DemDebounceCounterJumpUpValue = 0
                DemDebounceCounterPassedThreshold = -128
                DemDebounceCounterStorage = false
                DemDebounceContinuous = false
        AutoCreatedDemEvent_ESH_Action_ComMCheckPendingRequests_BswMReportFailToDemRef: DemEventId=94, DemEventKind=DEM_EVENT_KIND_BSW
          DemEventClass:
            DemAgingAllowed = false
            DemConsiderPtoStatus = false
            DemEventDestination = DEM_DTC_ORIGIN_PRIMARY_MEMORY
            DemEventPriority = 2
            DemFFPrestorageSupported = false
            DemOperationCycleRef = DemOperationCycle_0
            DemDebounceAlgorithmClass
              DemDebounceCounterBased:
                DemDebounceBehavior = DEM_DEBOUNCE_FREEZE
                DemDebounceCounterDecrementStepSize = 1
                DemDebounceCounterFailedThreshold = 127
                DemDebounceCounterIncrementStepSize = 1
                DemDebounceCounterJumpDown = true
                DemDebounceCounterJumpDownValue = 0
                DemDebounceCounterJumpUp = true
                DemDebounceCounterJumpUpValue = 0
                DemDebounceCounterPassedThreshold = -128
                DemDebounceCounterStorage = false
                DemDebounceContinuous = false
        AutoCreatedDemEvent_CC_DisableDM_CIOM_oBackbone1J1939_Rx_BC_405bc776_BswMReportFailToDemRef: DemEventId=3, DemEventKind=DEM_EVENT_KIND_BSW
          DemEventClass:
            DemAgingAllowed = false
            DemConsiderPtoStatus = false
            DemEventDestination = DEM_DTC_ORIGIN_PRIMARY_MEMORY
            DemEventPriority = 2
            DemFFPrestorageSupported = false
            DemOperationCycleRef = DemOperationCycle_0
            DemDebounceAlgorithmClass
              DemDebounceCounterBased:
                DemDebounceBehavior = DEM_DEBOUNCE_FREEZE
                DemDebounceCounterDecrementStepSize = 1
                DemDebounceCounterFailedThreshold = 127
                DemDebounceCounterIncrementStepSize = 1
                DemDebounceCounterJumpDown = true
                DemDebounceCounterJumpDownValue = 0
                DemDebounceCounterJumpUp = true
                DemDebounceCounterJumpUpValue = 0
                DemDebounceCounterPassedThreshold = -128
                DemDebounceCounterStorage = false
                DemDebounceContinuous = false
        AutoCreatedDemEvent_CC_DisablePDUGroup_CIOM_oLIN00_Rx_dd181faa_BswMReportFailToDemRef: DemEventId=16, DemEventKind=DEM_EVENT_KIND_BSW
          DemEventClass:
            DemAgingAllowed = false
            DemConsiderPtoStatus = false
            DemEventDestination = DEM_DTC_ORIGIN_PRIMARY_MEMORY
            DemEventPriority = 2
            DemFFPrestorageSupported = false
            DemOperationCycleRef = DemOperationCycle_0
            DemDebounceAlgorithmClass
              DemDebounceCounterBased:
                DemDebounceBehavior = DEM_DEBOUNCE_FREEZE
                DemDebounceCounterDecrementStepSize = 1
                DemDebounceCounterFailedThreshold = 127
                DemDebounceCounterIncrementStepSize = 1
                DemDebounceCounterJumpDown = true
                DemDebounceCounterJumpDownValue = 0
                DemDebounceCounterJumpUp = true
                DemDebounceCounterJumpUpValue = 0
                DemDebounceCounterPassedThreshold = -128
                DemDebounceCounterStorage = false
                DemDebounceContinuous = false
        AutoCreatedDemEvent_CC_EnablePDUGroup_CIOM_oLIN00_Tx_8b42b82c_BswMReportFailToDemRef: DemEventId=42, DemEventKind=DEM_EVENT_KIND_BSW
          DemEventClass:
            DemAgingAllowed = false
            DemConsiderPtoStatus = false
            DemEventDestination = DEM_DTC_ORIGIN_PRIMARY_MEMORY
            DemEventPriority = 2
            DemFFPrestorageSupported = false
            DemOperationCycleRef = DemOperationCycle_0
            DemDebounceAlgorithmClass
              DemDebounceCounterBased:
                DemDebounceBehavior = DEM_DEBOUNCE_FREEZE
                DemDebounceCounterDecrementStepSize = 1
                DemDebounceCounterFailedThreshold = 127
                DemDebounceCounterIncrementStepSize = 1
                DemDebounceCounterJumpDown = true
                DemDebounceCounterJumpDownValue = 0
                DemDebounceCounterJumpUp = true
                DemDebounceCounterJumpUpValue = 0
                DemDebounceCounterPassedThreshold = -128
                DemDebounceCounterStorage = false
                DemDebounceContinuous = false
        AutoCreatedDemEvent_ESH_Action_EnterExclusiveArea_BswMReportFailToDemRef: DemEventId=121, DemEventKind=DEM_EVENT_KIND_BSW
          DemEventClass:
            DemAgingAllowed = false
            DemConsiderPtoStatus = false
            DemEventDestination = DEM_DTC_ORIGIN_PRIMARY_MEMORY
            DemEventPriority = 2
            DemFFPrestorageSupported = false
            DemOperationCycleRef = DemOperationCycle_0
            DemDebounceAlgorithmClass
              DemDebounceCounterBased:
                DemDebounceBehavior = DEM_DEBOUNCE_FREEZE
                DemDebounceCounterDecrementStepSize = 1
                DemDebounceCounterFailedThreshold = 127
                DemDebounceCounterIncrementStepSize = 1
                DemDebounceCounterJumpDown = true
                DemDebounceCounterJumpDownValue = 0
                DemDebounceCounterJumpUp = true
                DemDebounceCounterJumpUpValue = 0
                DemDebounceCounterPassedThreshold = -128
                DemDebounceCounterStorage = false
                DemDebounceContinuous = false
        AutoCreatedDemEvent_ESH_RunToPostRunNested_BswMReportFailToDemRef: DemEventId=150, DemEventKind=DEM_EVENT_KIND_BSW
          DemEventClass:
            DemAgingAllowed = false
            DemConsiderPtoStatus = false
            DemEventDestination = DEM_DTC_ORIGIN_PRIMARY_MEMORY
            DemEventPriority = 2
            DemFFPrestorageSupported = false
            DemOperationCycleRef = DemOperationCycle_0
            DemDebounceAlgorithmClass
              DemDebounceCounterBased:
                DemDebounceBehavior = DEM_DEBOUNCE_FREEZE
                DemDebounceCounterDecrementStepSize = 1
                DemDebounceCounterFailedThreshold = 127
                DemDebounceCounterIncrementStepSize = 1
                DemDebounceCounterJumpDown = true
                DemDebounceCounterJumpDownValue = 0
                DemDebounceCounterJumpUp = true
                DemDebounceCounterJumpUpValue = 0
                DemDebounceCounterPassedThreshold = -128
                DemDebounceCounterStorage = false
                DemDebounceContinuous = false
        AutoCreatedDemEvent_CC_EnableDM_CIOM_oBackbone1J1939_Rx_BC_405bc776_BswMReportFailToDemRef: DemEventId=28, DemEventKind=DEM_EVENT_KIND_BSW
          DemEventClass:
            DemAgingAllowed = false
            DemConsiderPtoStatus = false
            DemEventDestination = DEM_DTC_ORIGIN_PRIMARY_MEMORY
            DemEventPriority = 2
            DemFFPrestorageSupported = false
            DemOperationCycleRef = DemOperationCycle_0
            DemDebounceAlgorithmClass
              DemDebounceCounterBased:
                DemDebounceBehavior = DEM_DEBOUNCE_FREEZE
                DemDebounceCounterDecrementStepSize = 1
                DemDebounceCounterFailedThreshold = 127
                DemDebounceCounterIncrementStepSize = 1
                DemDebounceCounterJumpDown = true
                DemDebounceCounterJumpDownValue = 0
                DemDebounceCounterJumpUp = true
                DemDebounceCounterJumpUpValue = 0
                DemDebounceCounterPassedThreshold = -128
                DemDebounceCounterStorage = false
                DemDebounceContinuous = false
        AutoCreatedDemEvent_CC_DisablePDUGroup_CIOM_oBackbone1J1939_Tx_0x31_BC_3782f500_BswMReportFailToDemRef: DemEventId=9, DemEventKind=DEM_EVENT_KIND_BSW
          DemEventClass:
            DemAgingAllowed = false
            DemConsiderPtoStatus = false
            DemEventDestination = DEM_DTC_ORIGIN_PRIMARY_MEMORY
            DemEventPriority = 2
            DemFFPrestorageSupported = false
            DemOperationCycleRef = DemOperationCycle_0
            DemDebounceAlgorithmClass
              DemDebounceCounterBased:
                DemDebounceBehavior = DEM_DEBOUNCE_FREEZE
                DemDebounceCounterDecrementStepSize = 1
                DemDebounceCounterFailedThreshold = 127
                DemDebounceCounterIncrementStepSize = 1
                DemDebounceCounterJumpDown = true
                DemDebounceCounterJumpDownValue = 0
                DemDebounceCounterJumpUp = true
                DemDebounceCounterJumpUpValue = 0
                DemDebounceCounterPassedThreshold = -128
                DemDebounceCounterStorage = false
                DemDebounceContinuous = false
        AutoCreatedDemEvent_CC_J1939RmStateSwitch_CN_FMSNet_fce1aae5_CIOM_3a3d59b1_J1939RM_STATE_OFFLINE_BswMReportFailToDemRef: DemEventId=55, DemEventKind=DEM_EVENT_KIND_BSW
          DemEventClass:
            DemAgingAllowed = false
            DemConsiderPtoStatus = false
            DemEventDestination = DEM_DTC_ORIGIN_PRIMARY_MEMORY
            DemEventPriority = 2
            DemFFPrestorageSupported = false
            DemOperationCycleRef = DemOperationCycle_0
            DemDebounceAlgorithmClass
              DemDebounceCounterBased:
                DemDebounceBehavior = DEM_DEBOUNCE_FREEZE
                DemDebounceCounterDecrementStepSize = 1
                DemDebounceCounterFailedThreshold = 127
                DemDebounceCounterIncrementStepSize = 1
                DemDebounceCounterJumpDown = true
                DemDebounceCounterJumpDownValue = 0
                DemDebounceCounterJumpUp = true
                DemDebounceCounterJumpUpValue = 0
                DemDebounceCounterPassedThreshold = -128
                DemDebounceCounterStorage = false
                DemDebounceContinuous = false
        AutoCreatedDemEvent_CC_EnablePDUGroup_CIOM_oBackbone1J1939_Tx_0x31_BC_3782f500_BswMReportFailToDemRef: DemEventId=34, DemEventKind=DEM_EVENT_KIND_BSW
          DemEventClass:
            DemAgingAllowed = false
            DemConsiderPtoStatus = false
            DemEventDestination = DEM_DTC_ORIGIN_PRIMARY_MEMORY
            DemEventPriority = 2
            DemFFPrestorageSupported = false
            DemOperationCycleRef = DemOperationCycle_0
            DemDebounceAlgorithmClass
              DemDebounceCounterBased:
                DemDebounceBehavior = DEM_DEBOUNCE_FREEZE
                DemDebounceCounterDecrementStepSize = 1
                DemDebounceCounterFailedThreshold = 127
                DemDebounceCounterIncrementStepSize = 1
                DemDebounceCounterJumpDown = true
                DemDebounceCounterJumpDownValue = 0
                DemDebounceCounterJumpUp = true
                DemDebounceCounterJumpUpValue = 0
                DemDebounceCounterPassedThreshold = -128
                DemDebounceCounterStorage = false
                DemDebounceContinuous = false
        AutoCreatedDemEvent_CC_J1939RmStateSwitch_CN_FMSNet_fce1aae5_CIOM_3a3d59b1_J1939RM_STATE_ONLINE_BswMReportFailToDemRef: DemEventId=56, DemEventKind=DEM_EVENT_KIND_BSW
          DemEventClass:
            DemAgingAllowed = false
            DemConsiderPtoStatus = false
            DemEventDestination = DEM_DTC_ORIGIN_PRIMARY_MEMORY
            DemEventPriority = 2
            DemFFPrestorageSupported = false
            DemOperationCycleRef = DemOperationCycle_0
            DemDebounceAlgorithmClass
              DemDebounceCounterBased:
                DemDebounceBehavior = DEM_DEBOUNCE_FREEZE
                DemDebounceCounterDecrementStepSize = 1
                DemDebounceCounterFailedThreshold = 127
                DemDebounceCounterIncrementStepSize = 1
                DemDebounceCounterJumpDown = true
                DemDebounceCounterJumpDownValue = 0
                DemDebounceCounterJumpUp = true
                DemDebounceCounterJumpUpValue = 0
                DemDebounceCounterPassedThreshold = -128
                DemDebounceCounterStorage = false
                DemDebounceContinuous = false
        AutoCreatedDemEvent_ESH_Action_CancelNvMWriteAll_BswMReportFailToDemRef: DemEventId=71, DemEventKind=DEM_EVENT_KIND_BSW
          DemEventClass:
            DemAgingAllowed = false
            DemConsiderPtoStatus = false
            DemEventDestination = DEM_DTC_ORIGIN_PRIMARY_MEMORY
            DemEventPriority = 2
            DemFFPrestorageSupported = false
            DemOperationCycleRef = DemOperationCycle_0
            DemDebounceAlgorithmClass
              DemDebounceCounterBased:
                DemDebounceBehavior = DEM_DEBOUNCE_FREEZE
                DemDebounceCounterDecrementStepSize = 1
                DemDebounceCounterFailedThreshold = 127
                DemDebounceCounterIncrementStepSize = 1
                DemDebounceCounterJumpDown = true
                DemDebounceCounterJumpDownValue = 0
                DemDebounceCounterJumpUp = true
                DemDebounceCounterJumpUpValue = 0
                DemDebounceCounterPassedThreshold = -128
                DemDebounceCounterStorage = false
                DemDebounceContinuous = false
        AutoCreatedDemEvent_ESH_Action_CancelWriteAllTimer_Start_BswMReportFailToDemRef: DemEventId=72, DemEventKind=DEM_EVENT_KIND_BSW
          DemEventClass:
            DemAgingAllowed = false
            DemConsiderPtoStatus = false
            DemEventDestination = DEM_DTC_ORIGIN_PRIMARY_MEMORY
            DemEventPriority = 2
            DemFFPrestorageSupported = false
            DemOperationCycleRef = DemOperationCycle_0
            DemDebounceAlgorithmClass
              DemDebounceCounterBased:
                DemDebounceBehavior = DEM_DEBOUNCE_FREEZE
                DemDebounceCounterDecrementStepSize = 1
                DemDebounceCounterFailedThreshold = 127
                DemDebounceCounterIncrementStepSize = 1
                DemDebounceCounterJumpDown = true
                DemDebounceCounterJumpDownValue = 0
                DemDebounceCounterJumpUp = true
                DemDebounceCounterJumpUpValue = 0
                DemDebounceCounterPassedThreshold = -128
                DemDebounceCounterStorage = false
                DemDebounceContinuous = false
        AutoCreatedDemEvent_ESH_Action_CancelWriteAllTimer_Stop_BswMReportFailToDemRef: DemEventId=73, DemEventKind=DEM_EVENT_KIND_BSW
          DemEventClass:
            DemAgingAllowed = false
            DemConsiderPtoStatus = false
            DemEventDestination = DEM_DTC_ORIGIN_PRIMARY_MEMORY
            DemEventPriority = 2
            DemFFPrestorageSupported = false
            DemOperationCycleRef = DemOperationCycle_0
            DemDebounceAlgorithmClass
              DemDebounceCounterBased:
                DemDebounceBehavior = DEM_DEBOUNCE_FREEZE
                DemDebounceCounterDecrementStepSize = 1
                DemDebounceCounterFailedThreshold = 127
                DemDebounceCounterIncrementStepSize = 1
                DemDebounceCounterJumpDown = true
                DemDebounceCounterJumpDownValue = 0
                DemDebounceCounterJumpUp = true
                DemDebounceCounterJumpUpValue = 0
                DemDebounceCounterPassedThreshold = -128
                DemDebounceCounterStorage = false
                DemDebounceContinuous = false
        AutoCreatedDemEvent_ESH_Action_ComMAllow_CN_Backbone1J1939_0b1f4bae_BswMReportFailToDemRef: DemEventId=74, DemEventKind=DEM_EVENT_KIND_BSW
          DemEventClass:
            DemAgingAllowed = false
            DemConsiderPtoStatus = false
            DemEventDestination = DEM_DTC_ORIGIN_PRIMARY_MEMORY
            DemEventPriority = 2
            DemFFPrestorageSupported = false
            DemOperationCycleRef = DemOperationCycle_0
            DemDebounceAlgorithmClass
              DemDebounceCounterBased:
                DemDebounceBehavior = DEM_DEBOUNCE_FREEZE
                DemDebounceCounterDecrementStepSize = 1
                DemDebounceCounterFailedThreshold = 127
                DemDebounceCounterIncrementStepSize = 1
                DemDebounceCounterJumpDown = true
                DemDebounceCounterJumpDownValue = 0
                DemDebounceCounterJumpUp = true
                DemDebounceCounterJumpUpValue = 0
                DemDebounceCounterPassedThreshold = -128
                DemDebounceCounterStorage = false
                DemDebounceContinuous = false
        AutoCreatedDemEvent_ESH_Action_ComMAllow_CN_Backbone1J1939_0b1f4bae_BswMReportFailToDemRef_1: DemEventId=75, DemEventKind=DEM_EVENT_KIND_BSW
          DemEventClass:
            DemAgingAllowed = false
            DemConsiderPtoStatus = false
            DemEventDestination = DEM_DTC_ORIGIN_PRIMARY_MEMORY
            DemEventPriority = 2
            DemFFPrestorageSupported = false
            DemOperationCycleRef = DemOperationCycle_0
            DemDebounceAlgorithmClass
              DemDebounceCounterBased:
                DemDebounceBehavior = DEM_DEBOUNCE_FREEZE
                DemDebounceCounterDecrementStepSize = 1
                DemDebounceCounterFailedThreshold = 127
                DemDebounceCounterIncrementStepSize = 1
                DemDebounceCounterJumpDown = true
                DemDebounceCounterJumpDownValue = 0
                DemDebounceCounterJumpUp = true
                DemDebounceCounterJumpUpValue = 0
                DemDebounceCounterPassedThreshold = -128
                DemDebounceCounterStorage = false
                DemDebounceContinuous = false
        AutoCreatedDemEvent_ESH_Action_ComMAllow_CN_Backbone2_78967e2c_BswMReportFailToDemRef: DemEventId=76, DemEventKind=DEM_EVENT_KIND_BSW
          DemEventClass:
            DemAgingAllowed = false
            DemConsiderPtoStatus = false
            DemEventDestination = DEM_DTC_ORIGIN_PRIMARY_MEMORY
            DemEventPriority = 2
            DemFFPrestorageSupported = false
            DemOperationCycleRef = DemOperationCycle_0
            DemDebounceAlgorithmClass
              DemDebounceCounterBased:
                DemDebounceBehavior = DEM_DEBOUNCE_FREEZE
                DemDebounceCounterDecrementStepSize = 1
                DemDebounceCounterFailedThreshold = 127
                DemDebounceCounterIncrementStepSize = 1
                DemDebounceCounterJumpDown = true
                DemDebounceCounterJumpDownValue = 0
                DemDebounceCounterJumpUp = true
                DemDebounceCounterJumpUpValue = 0
                DemDebounceCounterPassedThreshold = -128
                DemDebounceCounterStorage = false
                DemDebounceContinuous = false
        AutoCreatedDemEvent_ESH_Action_ComMAllow_CN_Backbone2_78967e2c_BswMReportFailToDemRef_1: DemEventId=77, DemEventKind=DEM_EVENT_KIND_BSW
          DemEventClass:
            DemAgingAllowed = false
            DemConsiderPtoStatus = false
            DemEventDestination = DEM_DTC_ORIGIN_PRIMARY_MEMORY
            DemEventPriority = 2
            DemFFPrestorageSupported = false
            DemOperationCycleRef = DemOperationCycle_0
            DemDebounceAlgorithmClass
              DemDebounceCounterBased:
                DemDebounceBehavior = DEM_DEBOUNCE_FREEZE
                DemDebounceCounterDecrementStepSize = 1
                DemDebounceCounterFailedThreshold = 127
                DemDebounceCounterIncrementStepSize = 1
                DemDebounceCounterJumpDown = true
                DemDebounceCounterJumpDownValue = 0
                DemDebounceCounterJumpUp = true
                DemDebounceCounterJumpUpValue = 0
                DemDebounceCounterPassedThreshold = -128
                DemDebounceCounterStorage = false
                DemDebounceContinuous = false
        AutoCreatedDemEvent_ESH_Action_ComMAllow_CN_CabSubnet_9ea693f1_BswMReportFailToDemRef: DemEventId=78, DemEventKind=DEM_EVENT_KIND_BSW
          DemEventClass:
            DemAgingAllowed = false
            DemConsiderPtoStatus = false
            DemEventDestination = DEM_DTC_ORIGIN_PRIMARY_MEMORY
            DemEventPriority = 2
            DemFFPrestorageSupported = false
            DemOperationCycleRef = DemOperationCycle_0
            DemDebounceAlgorithmClass
              DemDebounceCounterBased:
                DemDebounceBehavior = DEM_DEBOUNCE_FREEZE
                DemDebounceCounterDecrementStepSize = 1
                DemDebounceCounterFailedThreshold = 127
                DemDebounceCounterIncrementStepSize = 1
                DemDebounceCounterJumpDown = true
                DemDebounceCounterJumpDownValue = 0
                DemDebounceCounterJumpUp = true
                DemDebounceCounterJumpUpValue = 0
                DemDebounceCounterPassedThreshold = -128
                DemDebounceCounterStorage = false
                DemDebounceContinuous = false
        AutoCreatedDemEvent_ESH_Action_ComMAllow_CN_CabSubnet_9ea693f1_BswMReportFailToDemRef_1: DemEventId=79, DemEventKind=DEM_EVENT_KIND_BSW
          DemEventClass:
            DemAgingAllowed = false
            DemConsiderPtoStatus = false
            DemEventDestination = DEM_DTC_ORIGIN_PRIMARY_MEMORY
            DemEventPriority = 2
            DemFFPrestorageSupported = false
            DemOperationCycleRef = DemOperationCycle_0
            DemDebounceAlgorithmClass
              DemDebounceCounterBased:
                DemDebounceBehavior = DEM_DEBOUNCE_FREEZE
                DemDebounceCounterDecrementStepSize = 1
                DemDebounceCounterFailedThreshold = 127
                DemDebounceCounterIncrementStepSize = 1
                DemDebounceCounterJumpDown = true
                DemDebounceCounterJumpDownValue = 0
                DemDebounceCounterJumpUp = true
                DemDebounceCounterJumpUpValue = 0
                DemDebounceCounterPassedThreshold = -128
                DemDebounceCounterStorage = false
                DemDebounceContinuous = false
        AutoCreatedDemEvent_ESH_Action_ComMAllow_CN_FMSNet_fce1aae5_BswMReportFailToDemRef: DemEventId=80, DemEventKind=DEM_EVENT_KIND_BSW
          DemEventClass:
            DemAgingAllowed = false
            DemConsiderPtoStatus = false
            DemEventDestination = DEM_DTC_ORIGIN_PRIMARY_MEMORY
            DemEventPriority = 2
            DemFFPrestorageSupported = false
            DemOperationCycleRef = DemOperationCycle_0
            DemDebounceAlgorithmClass
              DemDebounceCounterBased:
                DemDebounceBehavior = DEM_DEBOUNCE_FREEZE
                DemDebounceCounterDecrementStepSize = 1
                DemDebounceCounterFailedThreshold = 127
                DemDebounceCounterIncrementStepSize = 1
                DemDebounceCounterJumpDown = true
                DemDebounceCounterJumpDownValue = 0
                DemDebounceCounterJumpUp = true
                DemDebounceCounterJumpUpValue = 0
                DemDebounceCounterPassedThreshold = -128
                DemDebounceCounterStorage = false
                DemDebounceContinuous = false
        AutoCreatedDemEvent_ESH_Action_ComMAllow_CN_FMSNet_fce1aae5_BswMReportFailToDemRef_1: DemEventId=81, DemEventKind=DEM_EVENT_KIND_BSW
          DemEventClass:
            DemAgingAllowed = false
            DemConsiderPtoStatus = false
            DemEventDestination = DEM_DTC_ORIGIN_PRIMARY_MEMORY
            DemEventPriority = 2
            DemFFPrestorageSupported = false
            DemOperationCycleRef = DemOperationCycle_0
            DemDebounceAlgorithmClass
              DemDebounceCounterBased:
                DemDebounceBehavior = DEM_DEBOUNCE_FREEZE
                DemDebounceCounterDecrementStepSize = 1
                DemDebounceCounterFailedThreshold = 127
                DemDebounceCounterIncrementStepSize = 1
                DemDebounceCounterJumpDown = true
                DemDebounceCounterJumpDownValue = 0
                DemDebounceCounterJumpUp = true
                DemDebounceCounterJumpUpValue = 0
                DemDebounceCounterPassedThreshold = -128
                DemDebounceCounterStorage = false
                DemDebounceContinuous = false
        AutoCreatedDemEvent_ESH_Action_ComMAllow_CN_LIN00_2cd9a7df_BswMReportFailToDemRef: DemEventId=82, DemEventKind=DEM_EVENT_KIND_BSW
          DemEventClass:
            DemAgingAllowed = false
            DemConsiderPtoStatus = false
            DemEventDestination = DEM_DTC_ORIGIN_PRIMARY_MEMORY
            DemEventPriority = 2
            DemFFPrestorageSupported = false
            DemOperationCycleRef = DemOperationCycle_0
            DemDebounceAlgorithmClass
              DemDebounceCounterBased:
                DemDebounceBehavior = DEM_DEBOUNCE_FREEZE
                DemDebounceCounterDecrementStepSize = 1
                DemDebounceCounterFailedThreshold = 127
                DemDebounceCounterIncrementStepSize = 1
                DemDebounceCounterJumpDown = true
                DemDebounceCounterJumpDownValue = 0
                DemDebounceCounterJumpUp = true
                DemDebounceCounterJumpUpValue = 0
                DemDebounceCounterPassedThreshold = -128
                DemDebounceCounterStorage = false
                DemDebounceContinuous = false
        AutoCreatedDemEvent_ESH_Action_ComMAllow_CN_LIN00_2cd9a7df_BswMReportFailToDemRef_1: DemEventId=83, DemEventKind=DEM_EVENT_KIND_BSW
          DemEventClass:
            DemAgingAllowed = false
            DemConsiderPtoStatus = false
            DemEventDestination = DEM_DTC_ORIGIN_PRIMARY_MEMORY
            DemEventPriority = 2
            DemFFPrestorageSupported = false
            DemOperationCycleRef = DemOperationCycle_0
            DemDebounceAlgorithmClass
              DemDebounceCounterBased:
                DemDebounceBehavior = DEM_DEBOUNCE_FREEZE
                DemDebounceCounterDecrementStepSize = 1
                DemDebounceCounterFailedThreshold = 127
                DemDebounceCounterIncrementStepSize = 1
                DemDebounceCounterJumpDown = true
                DemDebounceCounterJumpDownValue = 0
                DemDebounceCounterJumpUp = true
                DemDebounceCounterJumpUpValue = 0
                DemDebounceCounterPassedThreshold = -128
                DemDebounceCounterStorage = false
                DemDebounceContinuous = false
        AutoCreatedDemEvent_ESH_Action_ComMAllow_CN_LIN01_5bde9749_BswMReportFailToDemRef: DemEventId=84, DemEventKind=DEM_EVENT_KIND_BSW
          DemEventClass:
            DemAgingAllowed = false
            DemConsiderPtoStatus = false
            DemEventDestination = DEM_DTC_ORIGIN_PRIMARY_MEMORY
            DemEventPriority = 2
            DemFFPrestorageSupported = false
            DemOperationCycleRef = DemOperationCycle_0
            DemDebounceAlgorithmClass
              DemDebounceCounterBased:
                DemDebounceBehavior = DEM_DEBOUNCE_FREEZE
                DemDebounceCounterDecrementStepSize = 1
                DemDebounceCounterFailedThreshold = 127
                DemDebounceCounterIncrementStepSize = 1
                DemDebounceCounterJumpDown = true
                DemDebounceCounterJumpDownValue = 0
                DemDebounceCounterJumpUp = true
                DemDebounceCounterJumpUpValue = 0
                DemDebounceCounterPassedThreshold = -128
                DemDebounceCounterStorage = false
                DemDebounceContinuous = false
        AutoCreatedDemEvent_ESH_Action_ComMAllow_CN_LIN01_5bde9749_BswMReportFailToDemRef_1: DemEventId=85, DemEventKind=DEM_EVENT_KIND_BSW
          DemEventClass:
            DemAgingAllowed = false
            DemConsiderPtoStatus = false
            DemEventDestination = DEM_DTC_ORIGIN_PRIMARY_MEMORY
            DemEventPriority = 2
            DemFFPrestorageSupported = false
            DemOperationCycleRef = DemOperationCycle_0
            DemDebounceAlgorithmClass
              DemDebounceCounterBased:
                DemDebounceBehavior = DEM_DEBOUNCE_FREEZE
                DemDebounceCounterDecrementStepSize = 1
                DemDebounceCounterFailedThreshold = 127
                DemDebounceCounterIncrementStepSize = 1
                DemDebounceCounterJumpDown = true
                DemDebounceCounterJumpDownValue = 0
                DemDebounceCounterJumpUp = true
                DemDebounceCounterJumpUpValue = 0
                DemDebounceCounterPassedThreshold = -128
                DemDebounceCounterStorage = false
                DemDebounceContinuous = false
        AutoCreatedDemEvent_ESH_Action_ComMAllow_CN_LIN02_c2d7c6f3_BswMReportFailToDemRef: DemEventId=86, DemEventKind=DEM_EVENT_KIND_BSW
          DemEventClass:
            DemAgingAllowed = false
            DemConsiderPtoStatus = false
            DemEventDestination = DEM_DTC_ORIGIN_PRIMARY_MEMORY
            DemEventPriority = 2
            DemFFPrestorageSupported = false
            DemOperationCycleRef = DemOperationCycle_0
            DemDebounceAlgorithmClass
              DemDebounceCounterBased:
                DemDebounceBehavior = DEM_DEBOUNCE_FREEZE
                DemDebounceCounterDecrementStepSize = 1
                DemDebounceCounterFailedThreshold = 127
                DemDebounceCounterIncrementStepSize = 1
                DemDebounceCounterJumpDown = true
                DemDebounceCounterJumpDownValue = 0
                DemDebounceCounterJumpUp = true
                DemDebounceCounterJumpUpValue = 0
                DemDebounceCounterPassedThreshold = -128
                DemDebounceCounterStorage = false
                DemDebounceContinuous = false
        AutoCreatedDemEvent_ESH_Action_ComMAllow_CN_LIN02_c2d7c6f3_BswMReportFailToDemRef_1: DemEventId=87, DemEventKind=DEM_EVENT_KIND_BSW
          DemEventClass:
            DemAgingAllowed = false
            DemConsiderPtoStatus = false
            DemEventDestination = DEM_DTC_ORIGIN_PRIMARY_MEMORY
            DemEventPriority = 2
            DemFFPrestorageSupported = false
            DemOperationCycleRef = DemOperationCycle_0
            DemDebounceAlgorithmClass
              DemDebounceCounterBased:
                DemDebounceBehavior = DEM_DEBOUNCE_FREEZE
                DemDebounceCounterDecrementStepSize = 1
                DemDebounceCounterFailedThreshold = 127
                DemDebounceCounterIncrementStepSize = 1
                DemDebounceCounterJumpDown = true
                DemDebounceCounterJumpDownValue = 0
                DemDebounceCounterJumpUp = true
                DemDebounceCounterJumpUpValue = 0
                DemDebounceCounterPassedThreshold = -128
                DemDebounceCounterStorage = false
                DemDebounceContinuous = false
        AutoCreatedDemEvent_ESH_Action_ComMAllow_CN_LIN03_b5d0f665_BswMReportFailToDemRef: DemEventId=88, DemEventKind=DEM_EVENT_KIND_BSW
          DemEventClass:
            DemAgingAllowed = false
            DemConsiderPtoStatus = false
            DemEventDestination = DEM_DTC_ORIGIN_PRIMARY_MEMORY
            DemEventPriority = 2
            DemFFPrestorageSupported = false
            DemOperationCycleRef = DemOperationCycle_0
            DemDebounceAlgorithmClass
              DemDebounceCounterBased:
                DemDebounceBehavior = DEM_DEBOUNCE_FREEZE
                DemDebounceCounterDecrementStepSize = 1
                DemDebounceCounterFailedThreshold = 127
                DemDebounceCounterIncrementStepSize = 1
                DemDebounceCounterJumpDown = true
                DemDebounceCounterJumpDownValue = 0
                DemDebounceCounterJumpUp = true
                DemDebounceCounterJumpUpValue = 0
                DemDebounceCounterPassedThreshold = -128
                DemDebounceCounterStorage = false
                DemDebounceContinuous = false
        AutoCreatedDemEvent_ESH_Action_ComMAllow_CN_LIN03_b5d0f665_BswMReportFailToDemRef_1: DemEventId=89, DemEventKind=DEM_EVENT_KIND_BSW
          DemEventClass:
            DemAgingAllowed = false
            DemConsiderPtoStatus = false
            DemEventDestination = DEM_DTC_ORIGIN_PRIMARY_MEMORY
            DemEventPriority = 2
            DemFFPrestorageSupported = false
            DemOperationCycleRef = DemOperationCycle_0
            DemDebounceAlgorithmClass
              DemDebounceCounterBased:
                DemDebounceBehavior = DEM_DEBOUNCE_FREEZE
                DemDebounceCounterDecrementStepSize = 1
                DemDebounceCounterFailedThreshold = 127
                DemDebounceCounterIncrementStepSize = 1
                DemDebounceCounterJumpDown = true
                DemDebounceCounterJumpDownValue = 0
                DemDebounceCounterJumpUp = true
                DemDebounceCounterJumpUpValue = 0
                DemDebounceCounterPassedThreshold = -128
                DemDebounceCounterStorage = false
                DemDebounceContinuous = false
        AutoCreatedDemEvent_ESH_Action_ComMAllow_CN_LIN04_2bb463c6_BswMReportFailToDemRef: DemEventId=90, DemEventKind=DEM_EVENT_KIND_BSW
          DemEventClass:
            DemAgingAllowed = false
            DemConsiderPtoStatus = false
            DemEventDestination = DEM_DTC_ORIGIN_PRIMARY_MEMORY
            DemEventPriority = 2
            DemFFPrestorageSupported = false
            DemOperationCycleRef = DemOperationCycle_0
            DemDebounceAlgorithmClass
              DemDebounceCounterBased:
                DemDebounceBehavior = DEM_DEBOUNCE_FREEZE
                DemDebounceCounterDecrementStepSize = 1
                DemDebounceCounterFailedThreshold = 127
                DemDebounceCounterIncrementStepSize = 1
                DemDebounceCounterJumpDown = true
                DemDebounceCounterJumpDownValue = 0
                DemDebounceCounterJumpUp = true
                DemDebounceCounterJumpUpValue = 0
                DemDebounceCounterPassedThreshold = -128
                DemDebounceCounterStorage = false
                DemDebounceContinuous = false
        AutoCreatedDemEvent_ESH_Action_ComMAllow_CN_LIN04_2bb463c6_BswMReportFailToDemRef_1: DemEventId=91, DemEventKind=DEM_EVENT_KIND_BSW
          DemEventClass:
            DemAgingAllowed = false
            DemConsiderPtoStatus = false
            DemEventDestination = DEM_DTC_ORIGIN_PRIMARY_MEMORY
            DemEventPriority = 2
            DemFFPrestorageSupported = false
            DemOperationCycleRef = DemOperationCycle_0
            DemDebounceAlgorithmClass
              DemDebounceCounterBased:
                DemDebounceBehavior = DEM_DEBOUNCE_FREEZE
                DemDebounceCounterDecrementStepSize = 1
                DemDebounceCounterFailedThreshold = 127
                DemDebounceCounterIncrementStepSize = 1
                DemDebounceCounterJumpDown = true
                DemDebounceCounterJumpDownValue = 0
                DemDebounceCounterJumpUp = true
                DemDebounceCounterJumpUpValue = 0
                DemDebounceCounterPassedThreshold = -128
                DemDebounceCounterStorage = false
                DemDebounceContinuous = false
        AutoCreatedDemEvent_ESH_Action_ComMAllow_CN_SecuritySubnet_e7a0ee54_BswMReportFailToDemRef: DemEventId=92, DemEventKind=DEM_EVENT_KIND_BSW
          DemEventClass:
            DemAgingAllowed = false
            DemConsiderPtoStatus = false
            DemEventDestination = DEM_DTC_ORIGIN_PRIMARY_MEMORY
            DemEventPriority = 2
            DemFFPrestorageSupported = false
            DemOperationCycleRef = DemOperationCycle_0
            DemDebounceAlgorithmClass
              DemDebounceCounterBased:
                DemDebounceBehavior = DEM_DEBOUNCE_FREEZE
                DemDebounceCounterDecrementStepSize = 1
                DemDebounceCounterFailedThreshold = 127
                DemDebounceCounterIncrementStepSize = 1
                DemDebounceCounterJumpDown = true
                DemDebounceCounterJumpDownValue = 0
                DemDebounceCounterJumpUp = true
                DemDebounceCounterJumpUpValue = 0
                DemDebounceCounterPassedThreshold = -128
                DemDebounceCounterStorage = false
                DemDebounceContinuous = false
        AutoCreatedDemEvent_ESH_Action_ComMAllow_CN_SecuritySubnet_e7a0ee54_BswMReportFailToDemRef_1: DemEventId=93, DemEventKind=DEM_EVENT_KIND_BSW
          DemEventClass:
            DemAgingAllowed = false
            DemConsiderPtoStatus = false
            DemEventDestination = DEM_DTC_ORIGIN_PRIMARY_MEMORY
            DemEventPriority = 2
            DemFFPrestorageSupported = false
            DemOperationCycleRef = DemOperationCycle_0
            DemDebounceAlgorithmClass
              DemDebounceCounterBased:
                DemDebounceBehavior = DEM_DEBOUNCE_FREEZE
                DemDebounceCounterDecrementStepSize = 1
                DemDebounceCounterFailedThreshold = 127
                DemDebounceCounterIncrementStepSize = 1
                DemDebounceCounterJumpDown = true
                DemDebounceCounterJumpDownValue = 0
                DemDebounceCounterJumpUp = true
                DemDebounceCounterJumpUpValue = 0
                DemDebounceCounterPassedThreshold = -128
                DemDebounceCounterStorage = false
                DemDebounceContinuous = false
        AutoCreatedDemEvent_ESH_Action_ComMCheckPendingRequests_BswMReportFailToDemRef_1: DemEventId=95, DemEventKind=DEM_EVENT_KIND_BSW
          DemEventClass:
            DemAgingAllowed = false
            DemConsiderPtoStatus = false
            DemEventDestination = DEM_DTC_ORIGIN_PRIMARY_MEMORY
            DemEventPriority = 2
            DemFFPrestorageSupported = false
            DemOperationCycleRef = DemOperationCycle_0
            DemDebounceAlgorithmClass
              DemDebounceCounterBased:
                DemDebounceBehavior = DEM_DEBOUNCE_FREEZE
                DemDebounceCounterDecrementStepSize = 1
                DemDebounceCounterFailedThreshold = 127
                DemDebounceCounterIncrementStepSize = 1
                DemDebounceCounterJumpDown = true
                DemDebounceCounterJumpDownValue = 0
                DemDebounceCounterJumpUp = true
                DemDebounceCounterJumpUpValue = 0
                DemDebounceCounterPassedThreshold = -128
                DemDebounceCounterStorage = false
                DemDebounceContinuous = false
        AutoCreatedDemEvent_ESH_Action_ComMCheckPendingRequests_BswMReportFailToDemRef_2: DemEventId=96, DemEventKind=DEM_EVENT_KIND_BSW
          DemEventClass:
            DemAgingAllowed = false
            DemConsiderPtoStatus = false
            DemEventDestination = DEM_DTC_ORIGIN_PRIMARY_MEMORY
            DemEventPriority = 2
            DemFFPrestorageSupported = false
            DemOperationCycleRef = DemOperationCycle_0
            DemDebounceAlgorithmClass
              DemDebounceCounterBased:
                DemDebounceBehavior = DEM_DEBOUNCE_FREEZE
                DemDebounceCounterDecrementStepSize = 1
                DemDebounceCounterFailedThreshold = 127
                DemDebounceCounterIncrementStepSize = 1
                DemDebounceCounterJumpDown = true
                DemDebounceCounterJumpDownValue = 0
                DemDebounceCounterJumpUp = true
                DemDebounceCounterJumpUpValue = 0
                DemDebounceCounterPassedThreshold = -128
                DemDebounceCounterStorage = false
                DemDebounceContinuous = false
        AutoCreatedDemEvent_ESH_Action_ComMDisallow_CN_Backbone1J1939_0b1f4bae_BswMReportFailToDemRef: DemEventId=97, DemEventKind=DEM_EVENT_KIND_BSW
          DemEventClass:
            DemAgingAllowed = false
            DemConsiderPtoStatus = false
            DemEventDestination = DEM_DTC_ORIGIN_PRIMARY_MEMORY
            DemEventPriority = 2
            DemFFPrestorageSupported = false
            DemOperationCycleRef = DemOperationCycle_0
            DemDebounceAlgorithmClass
              DemDebounceCounterBased:
                DemDebounceBehavior = DEM_DEBOUNCE_FREEZE
                DemDebounceCounterDecrementStepSize = 1
                DemDebounceCounterFailedThreshold = 127
                DemDebounceCounterIncrementStepSize = 1
                DemDebounceCounterJumpDown = true
                DemDebounceCounterJumpDownValue = 0
                DemDebounceCounterJumpUp = true
                DemDebounceCounterJumpUpValue = 0
                DemDebounceCounterPassedThreshold = -128
                DemDebounceCounterStorage = false
                DemDebounceContinuous = false
        AutoCreatedDemEvent_ESH_Action_ComMDisallow_CN_Backbone2_78967e2c_BswMReportFailToDemRef: DemEventId=98, DemEventKind=DEM_EVENT_KIND_BSW
          DemEventClass:
            DemAgingAllowed = false
            DemConsiderPtoStatus = false
            DemEventDestination = DEM_DTC_ORIGIN_PRIMARY_MEMORY
            DemEventPriority = 2
            DemFFPrestorageSupported = false
            DemOperationCycleRef = DemOperationCycle_0
            DemDebounceAlgorithmClass
              DemDebounceCounterBased:
                DemDebounceBehavior = DEM_DEBOUNCE_FREEZE
                DemDebounceCounterDecrementStepSize = 1
                DemDebounceCounterFailedThreshold = 127
                DemDebounceCounterIncrementStepSize = 1
                DemDebounceCounterJumpDown = true
                DemDebounceCounterJumpDownValue = 0
                DemDebounceCounterJumpUp = true
                DemDebounceCounterJumpUpValue = 0
                DemDebounceCounterPassedThreshold = -128
                DemDebounceCounterStorage = false
                DemDebounceContinuous = false
        AutoCreatedDemEvent_ESH_Action_ComMDisallow_CN_CabSubnet_9ea693f1_BswMReportFailToDemRef: DemEventId=99, DemEventKind=DEM_EVENT_KIND_BSW
          DemEventClass:
            DemAgingAllowed = false
            DemConsiderPtoStatus = false
            DemEventDestination = DEM_DTC_ORIGIN_PRIMARY_MEMORY
            DemEventPriority = 2
            DemFFPrestorageSupported = false
            DemOperationCycleRef = DemOperationCycle_0
            DemDebounceAlgorithmClass
              DemDebounceCounterBased:
                DemDebounceBehavior = DEM_DEBOUNCE_FREEZE
                DemDebounceCounterDecrementStepSize = 1
                DemDebounceCounterFailedThreshold = 127
                DemDebounceCounterIncrementStepSize = 1
                DemDebounceCounterJumpDown = true
                DemDebounceCounterJumpDownValue = 0
                DemDebounceCounterJumpUp = true
                DemDebounceCounterJumpUpValue = 0
                DemDebounceCounterPassedThreshold = -128
                DemDebounceCounterStorage = false
                DemDebounceContinuous = false
        AutoCreatedDemEvent_ESH_Action_ComMDisallow_CN_FMSNet_fce1aae5_BswMReportFailToDemRef: DemEventId=100, DemEventKind=DEM_EVENT_KIND_BSW
          DemEventClass:
            DemAgingAllowed = false
            DemConsiderPtoStatus = false
            DemEventDestination = DEM_DTC_ORIGIN_PRIMARY_MEMORY
            DemEventPriority = 2
            DemFFPrestorageSupported = false
            DemOperationCycleRef = DemOperationCycle_0
            DemDebounceAlgorithmClass
              DemDebounceCounterBased:
                DemDebounceBehavior = DEM_DEBOUNCE_FREEZE
                DemDebounceCounterDecrementStepSize = 1
                DemDebounceCounterFailedThreshold = 127
                DemDebounceCounterIncrementStepSize = 1
                DemDebounceCounterJumpDown = true
                DemDebounceCounterJumpDownValue = 0
                DemDebounceCounterJumpUp = true
                DemDebounceCounterJumpUpValue = 0
                DemDebounceCounterPassedThreshold = -128
                DemDebounceCounterStorage = false
                DemDebounceContinuous = false
        AutoCreatedDemEvent_ESH_Action_ComMDisallow_CN_LIN00_2cd9a7df_BswMReportFailToDemRef: DemEventId=101, DemEventKind=DEM_EVENT_KIND_BSW
          DemEventClass:
            DemAgingAllowed = false
            DemConsiderPtoStatus = false
            DemEventDestination = DEM_DTC_ORIGIN_PRIMARY_MEMORY
            DemEventPriority = 2
            DemFFPrestorageSupported = false
            DemOperationCycleRef = DemOperationCycle_0
            DemDebounceAlgorithmClass
              DemDebounceCounterBased:
                DemDebounceBehavior = DEM_DEBOUNCE_FREEZE
                DemDebounceCounterDecrementStepSize = 1
                DemDebounceCounterFailedThreshold = 127
                DemDebounceCounterIncrementStepSize = 1
                DemDebounceCounterJumpDown = true
                DemDebounceCounterJumpDownValue = 0
                DemDebounceCounterJumpUp = true
                DemDebounceCounterJumpUpValue = 0
                DemDebounceCounterPassedThreshold = -128
                DemDebounceCounterStorage = false
                DemDebounceContinuous = false
        AutoCreatedDemEvent_ESH_Action_ComMDisallow_CN_LIN01_5bde9749_BswMReportFailToDemRef: DemEventId=102, DemEventKind=DEM_EVENT_KIND_BSW
          DemEventClass:
            DemAgingAllowed = false
            DemConsiderPtoStatus = false
            DemEventDestination = DEM_DTC_ORIGIN_PRIMARY_MEMORY
            DemEventPriority = 2
            DemFFPrestorageSupported = false
            DemOperationCycleRef = DemOperationCycle_0
            DemDebounceAlgorithmClass
              DemDebounceCounterBased:
                DemDebounceBehavior = DEM_DEBOUNCE_FREEZE
                DemDebounceCounterDecrementStepSize = 1
                DemDebounceCounterFailedThreshold = 127
                DemDebounceCounterIncrementStepSize = 1
                DemDebounceCounterJumpDown = true
                DemDebounceCounterJumpDownValue = 0
                DemDebounceCounterJumpUp = true
                DemDebounceCounterJumpUpValue = 0
                DemDebounceCounterPassedThreshold = -128
                DemDebounceCounterStorage = false
                DemDebounceContinuous = false
        AutoCreatedDemEvent_ESH_Action_ComMDisallow_CN_LIN02_c2d7c6f3_BswMReportFailToDemRef: DemEventId=103, DemEventKind=DEM_EVENT_KIND_BSW
          DemEventClass:
            DemAgingAllowed = false
            DemConsiderPtoStatus = false
            DemEventDestination = DEM_DTC_ORIGIN_PRIMARY_MEMORY
            DemEventPriority = 2
            DemFFPrestorageSupported = false
            DemOperationCycleRef = DemOperationCycle_0
            DemDebounceAlgorithmClass
              DemDebounceCounterBased:
                DemDebounceBehavior = DEM_DEBOUNCE_FREEZE
                DemDebounceCounterDecrementStepSize = 1
                DemDebounceCounterFailedThreshold = 127
                DemDebounceCounterIncrementStepSize = 1
                DemDebounceCounterJumpDown = true
                DemDebounceCounterJumpDownValue = 0
                DemDebounceCounterJumpUp = true
                DemDebounceCounterJumpUpValue = 0
                DemDebounceCounterPassedThreshold = -128
                DemDebounceCounterStorage = false
                DemDebounceContinuous = false
        AutoCreatedDemEvent_ESH_Action_ComMDisallow_CN_LIN03_b5d0f665_BswMReportFailToDemRef: DemEventId=104, DemEventKind=DEM_EVENT_KIND_BSW
          DemEventClass:
            DemAgingAllowed = false
            DemConsiderPtoStatus = false
            DemEventDestination = DEM_DTC_ORIGIN_PRIMARY_MEMORY
            DemEventPriority = 2
            DemFFPrestorageSupported = false
            DemOperationCycleRef = DemOperationCycle_0
            DemDebounceAlgorithmClass
              DemDebounceCounterBased:
                DemDebounceBehavior = DEM_DEBOUNCE_FREEZE
                DemDebounceCounterDecrementStepSize = 1
                DemDebounceCounterFailedThreshold = 127
                DemDebounceCounterIncrementStepSize = 1
                DemDebounceCounterJumpDown = true
                DemDebounceCounterJumpDownValue = 0
                DemDebounceCounterJumpUp = true
                DemDebounceCounterJumpUpValue = 0
                DemDebounceCounterPassedThreshold = -128
                DemDebounceCounterStorage = false
                DemDebounceContinuous = false
        AutoCreatedDemEvent_ESH_Action_ComMDisallow_CN_LIN04_2bb463c6_BswMReportFailToDemRef: DemEventId=105, DemEventKind=DEM_EVENT_KIND_BSW
          DemEventClass:
            DemAgingAllowed = false
            DemConsiderPtoStatus = false
            DemEventDestination = DEM_DTC_ORIGIN_PRIMARY_MEMORY
            DemEventPriority = 2
            DemFFPrestorageSupported = false
            DemOperationCycleRef = DemOperationCycle_0
            DemDebounceAlgorithmClass
              DemDebounceCounterBased:
                DemDebounceBehavior = DEM_DEBOUNCE_FREEZE
                DemDebounceCounterDecrementStepSize = 1
                DemDebounceCounterFailedThreshold = 127
                DemDebounceCounterIncrementStepSize = 1
                DemDebounceCounterJumpDown = true
                DemDebounceCounterJumpDownValue = 0
                DemDebounceCounterJumpUp = true
                DemDebounceCounterJumpUpValue = 0
                DemDebounceCounterPassedThreshold = -128
                DemDebounceCounterStorage = false
                DemDebounceContinuous = false
        AutoCreatedDemEvent_ESH_Action_ComMDisallow_CN_SecuritySubnet_e7a0ee54_BswMReportFailToDemRef: DemEventId=106, DemEventKind=DEM_EVENT_KIND_BSW
          DemEventClass:
            DemAgingAllowed = false
            DemConsiderPtoStatus = false
            DemEventDestination = DEM_DTC_ORIGIN_PRIMARY_MEMORY
            DemEventPriority = 2
            DemFFPrestorageSupported = false
            DemOperationCycleRef = DemOperationCycle_0
            DemDebounceAlgorithmClass
              DemDebounceCounterBased:
                DemDebounceBehavior = DEM_DEBOUNCE_FREEZE
                DemDebounceCounterDecrementStepSize = 1
                DemDebounceCounterFailedThreshold = 127
                DemDebounceCounterIncrementStepSize = 1
                DemDebounceCounterJumpDown = true
                DemDebounceCounterJumpDownValue = 0
                DemDebounceCounterJumpUp = true
                DemDebounceCounterJumpUpValue = 0
                DemDebounceCounterPassedThreshold = -128
                DemDebounceCounterStorage = false
                DemDebounceContinuous = false
        AutoCreatedDemEvent_ESH_Action_DemInit_BswMReportFailToDemRef: DemEventId=107, DemEventKind=DEM_EVENT_KIND_BSW
          DemEventClass:
            DemAgingAllowed = false
            DemConsiderPtoStatus = false
            DemEventDestination = DEM_DTC_ORIGIN_PRIMARY_MEMORY
            DemEventPriority = 2
            DemFFPrestorageSupported = false
            DemOperationCycleRef = DemOperationCycle_0
            DemDebounceAlgorithmClass
              DemDebounceCounterBased:
                DemDebounceBehavior = DEM_DEBOUNCE_FREEZE
                DemDebounceCounterDecrementStepSize = 1
                DemDebounceCounterFailedThreshold = 127
                DemDebounceCounterIncrementStepSize = 1
                DemDebounceCounterJumpDown = true
                DemDebounceCounterJumpDownValue = 0
                DemDebounceCounterJumpUp = true
                DemDebounceCounterJumpUpValue = 0
                DemDebounceCounterPassedThreshold = -128
                DemDebounceCounterStorage = false
                DemDebounceContinuous = false
        AutoCreatedDemEvent_ESH_Action_DemInitialized_BswMReportFailToDemRef: DemEventId=108, DemEventKind=DEM_EVENT_KIND_BSW
          DemEventClass:
            DemAgingAllowed = false
            DemConsiderPtoStatus = false
            DemEventDestination = DEM_DTC_ORIGIN_PRIMARY_MEMORY
            DemEventPriority = 2
            DemFFPrestorageSupported = false
            DemOperationCycleRef = DemOperationCycle_0
            DemDebounceAlgorithmClass
              DemDebounceCounterBased:
                DemDebounceBehavior = DEM_DEBOUNCE_FREEZE
                DemDebounceCounterDecrementStepSize = 1
                DemDebounceCounterFailedThreshold = 127
                DemDebounceCounterIncrementStepSize = 1
                DemDebounceCounterJumpDown = true
                DemDebounceCounterJumpDownValue = 0
                DemDebounceCounterJumpUp = true
                DemDebounceCounterJumpUpValue = 0
                DemDebounceCounterPassedThreshold = -128
                DemDebounceCounterStorage = false
                DemDebounceContinuous = false
        AutoCreatedDemEvent_ESH_Action_DemNotInitialized_BswMReportFailToDemRef: DemEventId=109, DemEventKind=DEM_EVENT_KIND_BSW
          DemEventClass:
            DemAgingAllowed = false
            DemConsiderPtoStatus = false
            DemEventDestination = DEM_DTC_ORIGIN_PRIMARY_MEMORY
            DemEventPriority = 2
            DemFFPrestorageSupported = false
            DemOperationCycleRef = DemOperationCycle_0
            DemDebounceAlgorithmClass
              DemDebounceCounterBased:
                DemDebounceBehavior = DEM_DEBOUNCE_FREEZE
                DemDebounceCounterDecrementStepSize = 1
                DemDebounceCounterFailedThreshold = 127
                DemDebounceCounterIncrementStepSize = 1
                DemDebounceCounterJumpDown = true
                DemDebounceCounterJumpDownValue = 0
                DemDebounceCounterJumpUp = true
                DemDebounceCounterJumpUpValue = 0
                DemDebounceCounterPassedThreshold = -128
                DemDebounceCounterStorage = false
                DemDebounceContinuous = false
        AutoCreatedDemEvent_ESH_Action_DemShutdown_BswMReportFailToDemRef: DemEventId=110, DemEventKind=DEM_EVENT_KIND_BSW
          DemEventClass:
            DemAgingAllowed = false
            DemConsiderPtoStatus = false
            DemEventDestination = DEM_DTC_ORIGIN_PRIMARY_MEMORY
            DemEventPriority = 2
            DemFFPrestorageSupported = false
            DemOperationCycleRef = DemOperationCycle_0
            DemDebounceAlgorithmClass
              DemDebounceCounterBased:
                DemDebounceBehavior = DEM_DEBOUNCE_FREEZE
                DemDebounceCounterDecrementStepSize = 1
                DemDebounceCounterFailedThreshold = 127
                DemDebounceCounterIncrementStepSize = 1
                DemDebounceCounterJumpDown = true
                DemDebounceCounterJumpDownValue = 0
                DemDebounceCounterJumpUp = true
                DemDebounceCounterJumpUpValue = 0
                DemDebounceCounterPassedThreshold = -128
                DemDebounceCounterStorage = false
                DemDebounceContinuous = false
        AutoCreatedDemEvent_ESH_Action_ESH_PostRun_BswMReportFailToDemRef: DemEventId=111, DemEventKind=DEM_EVENT_KIND_BSW
          DemEventClass:
            DemAgingAllowed = false
            DemConsiderPtoStatus = false
            DemEventDestination = DEM_DTC_ORIGIN_PRIMARY_MEMORY
            DemEventPriority = 2
            DemFFPrestorageSupported = false
            DemOperationCycleRef = DemOperationCycle_0
            DemDebounceAlgorithmClass
              DemDebounceCounterBased:
                DemDebounceBehavior = DEM_DEBOUNCE_FREEZE
                DemDebounceCounterDecrementStepSize = 1
                DemDebounceCounterFailedThreshold = 127
                DemDebounceCounterIncrementStepSize = 1
                DemDebounceCounterJumpDown = true
                DemDebounceCounterJumpDownValue = 0
                DemDebounceCounterJumpUp = true
                DemDebounceCounterJumpUpValue = 0
                DemDebounceCounterPassedThreshold = -128
                DemDebounceCounterStorage = false
                DemDebounceContinuous = false
        AutoCreatedDemEvent_ESH_Action_ESH_PrepShutdown_BswMReportFailToDemRef: DemEventId=112, DemEventKind=DEM_EVENT_KIND_BSW
          DemEventClass:
            DemAgingAllowed = false
            DemConsiderPtoStatus = false
            DemEventDestination = DEM_DTC_ORIGIN_PRIMARY_MEMORY
            DemEventPriority = 2
            DemFFPrestorageSupported = false
            DemOperationCycleRef = DemOperationCycle_0
            DemDebounceAlgorithmClass
              DemDebounceCounterBased:
                DemDebounceBehavior = DEM_DEBOUNCE_FREEZE
                DemDebounceCounterDecrementStepSize = 1
                DemDebounceCounterFailedThreshold = 127
                DemDebounceCounterIncrementStepSize = 1
                DemDebounceCounterJumpDown = true
                DemDebounceCounterJumpDownValue = 0
                DemDebounceCounterJumpUp = true
                DemDebounceCounterJumpUpValue = 0
                DemDebounceCounterPassedThreshold = -128
                DemDebounceCounterStorage = false
                DemDebounceContinuous = false
        AutoCreatedDemEvent_ESH_Action_ESH_PrepShutdown_BswMReportFailToDemRef_1: DemEventId=113, DemEventKind=DEM_EVENT_KIND_BSW
          DemEventClass:
            DemAgingAllowed = false
            DemConsiderPtoStatus = false
            DemEventDestination = DEM_DTC_ORIGIN_PRIMARY_MEMORY
            DemEventPriority = 2
            DemFFPrestorageSupported = false
            DemOperationCycleRef = DemOperationCycle_0
            DemDebounceAlgorithmClass
              DemDebounceCounterBased:
                DemDebounceBehavior = DEM_DEBOUNCE_FREEZE
                DemDebounceCounterDecrementStepSize = 1
                DemDebounceCounterFailedThreshold = 127
                DemDebounceCounterIncrementStepSize = 1
                DemDebounceCounterJumpDown = true
                DemDebounceCounterJumpDownValue = 0
                DemDebounceCounterJumpUp = true
                DemDebounceCounterJumpUpValue = 0
                DemDebounceCounterPassedThreshold = -128
                DemDebounceCounterStorage = false
                DemDebounceContinuous = false
        AutoCreatedDemEvent_ESH_Action_ESH_Run_BswMReportFailToDemRef: DemEventId=114, DemEventKind=DEM_EVENT_KIND_BSW
          DemEventClass:
            DemAgingAllowed = false
            DemConsiderPtoStatus = false
            DemEventDestination = DEM_DTC_ORIGIN_PRIMARY_MEMORY
            DemEventPriority = 2
            DemFFPrestorageSupported = false
            DemOperationCycleRef = DemOperationCycle_0
            DemDebounceAlgorithmClass
              DemDebounceCounterBased:
                DemDebounceBehavior = DEM_DEBOUNCE_FREEZE
                DemDebounceCounterDecrementStepSize = 1
                DemDebounceCounterFailedThreshold = 127
                DemDebounceCounterIncrementStepSize = 1
                DemDebounceCounterJumpDown = true
                DemDebounceCounterJumpDownValue = 0
                DemDebounceCounterJumpUp = true
                DemDebounceCounterJumpUpValue = 0
                DemDebounceCounterPassedThreshold = -128
                DemDebounceCounterStorage = false
                DemDebounceContinuous = false
        AutoCreatedDemEvent_ESH_Action_ESH_Run_BswMReportFailToDemRef_1: DemEventId=115, DemEventKind=DEM_EVENT_KIND_BSW
          DemEventClass:
            DemAgingAllowed = false
            DemConsiderPtoStatus = false
            DemEventDestination = DEM_DTC_ORIGIN_PRIMARY_MEMORY
            DemEventPriority = 2
            DemFFPrestorageSupported = false
            DemOperationCycleRef = DemOperationCycle_0
            DemDebounceAlgorithmClass
              DemDebounceCounterBased:
                DemDebounceBehavior = DEM_DEBOUNCE_FREEZE
                DemDebounceCounterDecrementStepSize = 1
                DemDebounceCounterFailedThreshold = 127
                DemDebounceCounterIncrementStepSize = 1
                DemDebounceCounterJumpDown = true
                DemDebounceCounterJumpDownValue = 0
                DemDebounceCounterJumpUp = true
                DemDebounceCounterJumpUpValue = 0
                DemDebounceCounterPassedThreshold = -128
                DemDebounceCounterStorage = false
                DemDebounceContinuous = false
        AutoCreatedDemEvent_ESH_Action_ESH_WaitForNvm_BswMReportFailToDemRef: DemEventId=116, DemEventKind=DEM_EVENT_KIND_BSW
          DemEventClass:
            DemAgingAllowed = false
            DemConsiderPtoStatus = false
            DemEventDestination = DEM_DTC_ORIGIN_PRIMARY_MEMORY
            DemEventPriority = 2
            DemFFPrestorageSupported = false
            DemOperationCycleRef = DemOperationCycle_0
            DemDebounceAlgorithmClass
              DemDebounceCounterBased:
                DemDebounceBehavior = DEM_DEBOUNCE_FREEZE
                DemDebounceCounterDecrementStepSize = 1
                DemDebounceCounterFailedThreshold = 127
                DemDebounceCounterIncrementStepSize = 1
                DemDebounceCounterJumpDown = true
                DemDebounceCounterJumpDownValue = 0
                DemDebounceCounterJumpUp = true
                DemDebounceCounterJumpUpValue = 0
                DemDebounceCounterPassedThreshold = -128
                DemDebounceCounterStorage = false
                DemDebounceContinuous = false
        AutoCreatedDemEvent_ESH_Action_ESH_Wakeup_BswMReportFailToDemRef: DemEventId=117, DemEventKind=DEM_EVENT_KIND_BSW
          DemEventClass:
            DemAgingAllowed = false
            DemConsiderPtoStatus = false
            DemEventDestination = DEM_DTC_ORIGIN_PRIMARY_MEMORY
            DemEventPriority = 2
            DemFFPrestorageSupported = false
            DemOperationCycleRef = DemOperationCycle_0
            DemDebounceAlgorithmClass
              DemDebounceCounterBased:
                DemDebounceBehavior = DEM_DEBOUNCE_FREEZE
                DemDebounceCounterDecrementStepSize = 1
                DemDebounceCounterFailedThreshold = 127
                DemDebounceCounterIncrementStepSize = 1
                DemDebounceCounterJumpDown = true
                DemDebounceCounterJumpDownValue = 0
                DemDebounceCounterJumpUp = true
                DemDebounceCounterJumpUpValue = 0
                DemDebounceCounterPassedThreshold = -128
                DemDebounceCounterStorage = false
                DemDebounceContinuous = false
        AutoCreatedDemEvent_ESH_Action_ESH_Wakeup_BswMReportFailToDemRef_1: DemEventId=118, DemEventKind=DEM_EVENT_KIND_BSW
          DemEventClass:
            DemAgingAllowed = false
            DemConsiderPtoStatus = false
            DemEventDestination = DEM_DTC_ORIGIN_PRIMARY_MEMORY
            DemEventPriority = 2
            DemFFPrestorageSupported = false
            DemOperationCycleRef = DemOperationCycle_0
            DemDebounceAlgorithmClass
              DemDebounceCounterBased:
                DemDebounceBehavior = DEM_DEBOUNCE_FREEZE
                DemDebounceCounterDecrementStepSize = 1
                DemDebounceCounterFailedThreshold = 127
                DemDebounceCounterIncrementStepSize = 1
                DemDebounceCounterJumpDown = true
                DemDebounceCounterJumpDownValue = 0
                DemDebounceCounterJumpUp = true
                DemDebounceCounterJumpUpValue = 0
                DemDebounceCounterPassedThreshold = -128
                DemDebounceCounterStorage = false
                DemDebounceContinuous = false
        AutoCreatedDemEvent_ESH_Action_EcuMClearValidatedWakeupEvents_BswMReportFailToDemRef: DemEventId=119, DemEventKind=DEM_EVENT_KIND_BSW
          DemEventClass:
            DemAgingAllowed = false
            DemConsiderPtoStatus = false
            DemEventDestination = DEM_DTC_ORIGIN_PRIMARY_MEMORY
            DemEventPriority = 2
            DemFFPrestorageSupported = false
            DemOperationCycleRef = DemOperationCycle_0
            DemDebounceAlgorithmClass
              DemDebounceCounterBased:
                DemDebounceBehavior = DEM_DEBOUNCE_FREEZE
                DemDebounceCounterDecrementStepSize = 1
                DemDebounceCounterFailedThreshold = 127
                DemDebounceCounterIncrementStepSize = 1
                DemDebounceCounterJumpDown = true
                DemDebounceCounterJumpDownValue = 0
                DemDebounceCounterJumpUp = true
                DemDebounceCounterJumpUpValue = 0
                DemDebounceCounterPassedThreshold = -128
                DemDebounceCounterStorage = false
                DemDebounceContinuous = false
        AutoCreatedDemEvent_ESH_Action_EcuMGoToSelectedShutdownTarget_BswMReportFailToDemRef: DemEventId=120, DemEventKind=DEM_EVENT_KIND_BSW
          DemEventClass:
            DemAgingAllowed = false
            DemConsiderPtoStatus = false
            DemEventDestination = DEM_DTC_ORIGIN_PRIMARY_MEMORY
            DemEventPriority = 2
            DemFFPrestorageSupported = false
            DemOperationCycleRef = DemOperationCycle_0
            DemDebounceAlgorithmClass
              DemDebounceCounterBased:
                DemDebounceBehavior = DEM_DEBOUNCE_FREEZE
                DemDebounceCounterDecrementStepSize = 1
                DemDebounceCounterFailedThreshold = 127
                DemDebounceCounterIncrementStepSize = 1
                DemDebounceCounterJumpDown = true
                DemDebounceCounterJumpDownValue = 0
                DemDebounceCounterJumpUp = true
                DemDebounceCounterJumpUpValue = 0
                DemDebounceCounterPassedThreshold = -128
                DemDebounceCounterStorage = false
                DemDebounceContinuous = false
