AUTOSAR XML (schema 4-2-1)
package /ActiveEcuC
  module config LinSM: implementation-config-variant=VARIANT-PRE-COMPILE, module-description=LinSM_Impl
    LinSMConfigSet
      5 x LinSMChannel, all with LinSMConfirmationTimeout=1, LinSMSleepSupport=true, LinSMTransceiverHandling=false:
        CHNL_45618847: LinSMComMNetworkHandleRef=CN_LIN00_2cd9a7df
          7 x LinSMSchedule:
            Table_2_b3b6af29: LinSMScheduleIndex=5, LinSMScheduleIndexRef=Table_2_b3b6af29
            MasterReq_SlaveResp_03d8aeb9: LinSMScheduleIndex=1, LinSMScheduleIndexRef=MasterReq_SlaveResp_03d8aeb9
            MasterReq_SlaveResp_Table_2_b31cdb33: LinSMScheduleIndex=3, LinSMScheduleIndexRef=MasterReq_SlaveResp_Table_2_b31cdb33
            MasterReq_SlaveResp_Table_1_2a158a89: LinSMScheduleIndex=2, LinSMScheduleIndexRef=MasterReq_SlaveResp_Table_1_2a158a89
            Table_e_46b96b7e: LinSMScheduleIndex=6, LinSMScheduleIndexRef=Table_e_46b96b7e
            CHNL_45618847_32a17f26: LinSMScheduleIndex=0, LinSMScheduleIndexRef=NULLSchedule_CHNL_45618847
            Table_1_2abffe93: LinSMScheduleIndex=4, LinSMScheduleIndexRef=Table_1_2abffe93
        CHNL_8e3d5be2: LinSMComMNetworkHandleRef=CN_LIN01_5bde9749
          5 x LinSMSchedule:
            MasterReq_SlaveResp_e4c5082e: LinSMScheduleIndex=1, LinSMScheduleIndexRef=MasterReq_SlaveResp_e4c5082e
            CHNL_8e3d5be2_a66eb9f7: LinSMScheduleIndex=0, LinSMScheduleIndexRef=NULLSchedule_CHNL_8e3d5be2
            Table_e_dbb68a08: LinSMScheduleIndex=4, LinSMScheduleIndexRef=Table_e_dbb68a08
            Table0_df24d2a0: LinSMScheduleIndex=3, LinSMScheduleIndexRef=Table0_df24d2a0
            MasterReq_SlaveResp_Table0_9e3481d6: LinSMScheduleIndex=2, LinSMScheduleIndexRef=MasterReq_SlaveResp_Table0_9e3481d6
        CHNL_def0ca51: LinSMComMNetworkHandleRef=CN_LIN04_2bb463c6
          7 x LinSMSchedule:
            CHNL_def0ca51_faa54df8: LinSMScheduleIndex=0, LinSMScheduleIndexRef=NULLSchedule
            MasterReq_SlaveResp_Table_1_b81cce51: LinSMScheduleIndex=2, LinSMScheduleIndexRef=MasterReq_SlaveResp_Table_1_b81cce51
            Table_2_aa1a2032: LinSMScheduleIndex=5, LinSMScheduleIndexRef=Table_2_aa1a2032
            MasterReq_SlaveResp_Table_2_21159feb: LinSMScheduleIndex=3, LinSMScheduleIndexRef=MasterReq_SlaveResp_Table_2_21159feb
            MasterReq_SlaveResp_294c3867: LinSMScheduleIndex=1, LinSMScheduleIndexRef=MasterReq_SlaveResp_294c3867
            Table_1_33137188: LinSMScheduleIndex=4, LinSMScheduleIndexRef=Table_1_33137188
            Table_e_5f15e465: LinSMScheduleIndex=6, LinSMScheduleIndexRef=Table_e_5f15e465
        CHNL_08a9294c: LinSMComMNetworkHandleRef=CN_LIN02_c2d7c6f3
          7 x LinSMSchedule:
            MasterReq_SlaveResp_Table_2_fa18795f: LinSMScheduleIndex=3, LinSMScheduleIndexRef=MasterReq_SlaveResp_Table_2_fa18795f
            CHNL_08a9294c_f4be7c2c: LinSMScheduleIndex=0, LinSMScheduleIndexRef=NULLSchedule_CHNL_08a9294c
            Table_1_cbd13a3e: LinSMScheduleIndex=4, LinSMScheduleIndexRef=Table_1_cbd13a3e
            Table_2_52d86b84: LinSMScheduleIndex=5, LinSMScheduleIndexRef=Table_2_52d86b84
            MasterReq_SlaveResp_1692e5d6: LinSMScheduleIndex=1, LinSMScheduleIndexRef=MasterReq_SlaveResp_1692e5d6
            MasterReq_SlaveResp_Table_1_631128e5: LinSMScheduleIndex=2, LinSMScheduleIndexRef=MasterReq_SlaveResp_Table_1_631128e5
            Table_e_a7d7afd3: LinSMScheduleIndex=6, LinSMScheduleIndexRef=Table_e_a7d7afd3
        CHNL_c3f5fae9: LinSMComMNetworkHandleRef=CN_LIN03_b5d0f665
          7 x LinSMSchedule:
            CHNL_c3f5fae9_fb3b3248: LinSMScheduleIndex=0, LinSMScheduleIndexRef=NULLSchedule_CHNL_c3f5fae9
            Table_2_cfd78af2: LinSMScheduleIndex=5, LinSMScheduleIndexRef=Table_2_cfd78af2
            MasterReq_SlaveResp_Table_2_de9a2869: LinSMScheduleIndex=3, LinSMScheduleIndexRef=MasterReq_SlaveResp_Table_2_de9a2869
            MasterReq_SlaveResp_f18f4341: LinSMScheduleIndex=1, LinSMScheduleIndexRef=MasterReq_SlaveResp_f18f4341
            MasterReq_SlaveResp_Table_1_479379d3: LinSMScheduleIndex=2, LinSMScheduleIndexRef=MasterReq_SlaveResp_Table_1_479379d3
            Table_1_56dedb48: LinSMScheduleIndex=4, LinSMScheduleIndexRef=Table_1_56dedb48
            Table_e_3ad84ea5: LinSMScheduleIndex=6, LinSMScheduleIndexRef=Table_e_3ad84ea5
    LinSMGeneral: LinSMDevErrorDetect=false, LinSMMainProcessingPeriod=0.01, LinSMVersionInfoApi=false
      LinSMGeneration: LinSMOutOfBoundsWriteSanitizer=false, LinSMOutOfBoundsReadSanitizer=false, LinSMShortSymbols=false
