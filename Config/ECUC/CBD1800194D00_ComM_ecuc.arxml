AUTOSAR XML (schema 4-2-1)
package /ActiveEcuC
  module config ComM: implementation-config-variant=VARIANT-PRE-COMPILE, module-description=ComM_Impl
    ComMGeneral:
      ComMPncIdCounting = COMM_PNC_ID_COUNT_FROM_NM_MESSAGE
      ComMPncSupport = false
      ComMPncToChannelRoutingLimitationEnabled = false
      ComMDevErrorDetect = false
      ComMEcuGroupClassification = 3
      ComMModeLimitationEnabled = false
      ComMSynchronousWakeUp = false
      ComMTMinFullComModeDuration = 5
      ComMVersionInfoApi = false
      ComMWakeupInhibitionEnabled = false
      ComMSafeBswChecks = false
      ComMNmPassiveModeEnable = false
      ComMGeneration: ComMOutOfBoundsWriteSanitizer=false, ComMOutOfBoundsReadSanitizer=false
    ComMConfigSet: ComMPncEnabled=false
      CN_Backbone1J1939_0b1f4bae (ComMChannel):
        ComMBusType = COMM_BUS_TYPE_CAN
        ComMChannelId = 3
        ComMFullCommRequestNotificationEnabled = false
        ComMMainFunctionPeriod = 0.02
        ComMNoCom = false
        ComMNoWakeup = false
        ComMNetworkManagement: ComMNmVariant=FULL, ComMPncNmRequest=false
        CN_Backbone1J1939_c3614447 (ComMUserPerChannel): ComMUserChannel=CN_Backbone1J1939_2a22de3d
      CN_LIN00_ace1a6ba (ComMUser): ComMUserIdentifier=5, ComMUserModeNotification=false
      CN_LIN00_2cd9a7df (ComMChannel):
        ComMBusType = COMM_BUS_TYPE_LIN
        ComMChannelId = 5
        ComMFullCommRequestNotificationEnabled = false
        ComMMainFunctionPeriod = 0.02
        ComMNoCom = false
        ComMNoWakeup = false
        CN_LIN00_932ca8ee (ComMUserPerChannel): ComMUserChannel=CN_LIN00_ace1a6ba
        ComMNetworkManagement: ComMNmVariant=NONE, ComMPncNmRequest=false
      4 x ComMUser, all with ComMUserModeNotification=false:
        CN_Backbone1J1939_2a22de3d: ComMUserIdentifier=3
        CN_Backbone2_3f947ba3: ComMUserIdentifier=0
        CN_LIN04_a50a06c0: ComMUserIdentifier=9
        CN_LIN02_a8147687: ComMUserIdentifier=7
      CN_LIN02_c2d7c6f3 (ComMChannel):
        ComMBusType = COMM_BUS_TYPE_LIN
        ComMChannelId = 7
        ComMFullCommRequestNotificationEnabled = false
        ComMMainFunctionPeriod = 0.02
        ComMNoCom = false
        ComMNoWakeup = false
        ComMNetworkManagement: ComMNmVariant=NONE, ComMPncNmRequest=false
        CN_LIN02_59e2de62 (ComMUserPerChannel): ComMUserChannel=CN_LIN02_a8147687
      CN_SecuritySubnet_7cec9a61 (ComMUser): ComMUserIdentifier=2, ComMUserModeNotification=false
      3 x ComMChannel, all with ComMFullCommRequestNotificationEnabled=false, ComMMainFunctionPeriod=0.02, ComMNoCom=false, ComMNoWakeup=false:
        CN_LIN04_2bb463c6: ComMBusType=COMM_BUS_TYPE_LIN, ComMChannelId=9
          ComMNetworkManagement: ComMNmVariant=NONE, ComMPncNmRequest=false
          CN_LIN04_ddc143b7 (ComMUserPerChannel): ComMUserChannel=CN_LIN04_a50a06c0
        CN_CabSubnet_9ea693f1: ComMBusType=COMM_BUS_TYPE_CAN, ComMChannelId=1
          ComMNetworkManagement: ComMNmVariant=FULL, ComMPncNmRequest=false
          CN_CabSubnet_d1eb8b90 (ComMUserPerChannel): ComMUserChannel=CN_CabSubnet_aa77b0b0
        CN_LIN03_b5d0f665: ComMBusType=COMM_BUS_TYPE_LIN, ComMChannelId=8
          ComMNetworkManagement: ComMNmVariant=NONE, ComMPncNmRequest=false
          CN_LIN03_3c85e524 (ComMUserPerChannel): ComMUserChannel=CN_LIN03_47d61db9
      CN_CabSubnet_aa77b0b0 (ComMUser): ComMUserIdentifier=1, ComMUserModeNotification=false
      CN_LIN01_4323cd84 (ComMUser): ComMUserIdentifier=6, ComMUserModeNotification=false
      CN_Backbone2_78967e2c (ComMChannel):
        ComMBusType = COMM_BUS_TYPE_CAN
        ComMChannelId = 0
        ComMFullCommRequestNotificationEnabled = false
        ComMMainFunctionPeriod = 0.02
        ComMNoCom = false
        ComMNoWakeup = false
        ComMNetworkManagement: ComMNmVariant=FULL, ComMPncNmRequest=false
        CN_Backbone2_974f57f7 (ComMUserPerChannel): ComMUserChannel=CN_Backbone2_3f947ba3
      CN_LIN01_5bde9749 (ComMChannel):
        ComMBusType = COMM_BUS_TYPE_LIN
        ComMChannelId = 6
        ComMFullCommRequestNotificationEnabled = false
        ComMMainFunctionPeriod = 0.02
        ComMNoCom = false
        ComMNoWakeup = false
        CN_LIN01_f64b93a8 (ComMUserPerChannel): ComMUserChannel=CN_LIN01_4323cd84
        ComMNetworkManagement: ComMNmVariant=NONE, ComMPncNmRequest=false
      CN_LIN03_47d61db9 (ComMUser): ComMUserIdentifier=8, ComMUserModeNotification=false
      CN_FMSNet_fce1aae5 (ComMChannel):
        ComMBusType = COMM_BUS_TYPE_CAN
        ComMChannelId = 4
        ComMFullCommRequestNotificationEnabled = false
        ComMMainFunctionPeriod = 0.02
        ComMNoCom = false
        ComMNoWakeup = false
        ComMNetworkManagement: ComMNmVariant=FULL, ComMPncNmRequest=false
        CN_FMSNet_6312f0e6 (ComMUserPerChannel): ComMUserChannel=CN_FMSNet_05490e3d
      CN_SecuritySubnet_e7a0ee54 (ComMChannel):
        ComMBusType = COMM_BUS_TYPE_CAN
        ComMChannelId = 2
        ComMFullCommRequestNotificationEnabled = false
        ComMMainFunctionPeriod = 0.02
        ComMNoCom = false
        ComMNoWakeup = false
        CN_SecuritySubnet_cc1ef902 (ComMUserPerChannel): ComMUserChannel=CN_SecuritySubnet_7cec9a61
        ComMNetworkManagement: ComMNmVariant=FULL, ComMPncNmRequest=false
      CN_FMSNet_05490e3d (ComMUser): ComMUserIdentifier=4, ComMUserModeNotification=false
