AUTOSAR XML (schema 4-2-1)
package /Gpt
  module config Gpt: implementation-config-variant=VARIANT-POST-BUILD, module-description=Gpt_Impl
    CommonPublishedInformation:
      ArReleaseMajorVersion = 4
      ArReleaseMinorVersion = 2
      ArReleaseRevisionVersion = 2
      ModuleId = 100
      SwMajorVersion = 1
      SwMinorVersion = 0
      SwPatchVersion = 0
      VendorId = 43
    GptChannelConfigSet
      GptChannelConfiguration_Wdg (GptChannelConfiguration):
        GptChannelId = 0
        GptChannelMode = GPT_CH_MODE_CONTINUOUS
        GptChannelPrescaler = 1
        GptChannelTickFrequency = 40000000
        GptChannelTickValueMax = 4294967295
        GptEnableWakeup = false
        GptFreezeEnable = true
        GptHwChannel = PIT_0_CH_0
        GptNotification = Wdg_Cbk_GptNotification0
        GptChannelPrescalerAlternate = 1
        GptStmChannelClkSrc = GPT_STM_SYSTEMCLOCK
        GptRtcChannelClkSrc = RTC_GPT_CLKSRC_XOSC
        GptChannelClkSrcRef = GptClockReferencePoint_0
    GptConfigurationOfOptApiServices:
      GptDeinitApi = true
      GptEnableDisableNotificationApi = true
      GptPredefTimerFunctionalityApi = false
      GptTimeElapsedApi = true
      GptTimeRemainingApi = true
      GptVersionInfoApi = true
      GptWakeupFunctionalityApi = true
    GptDriverConfiguration:
      GptDevErrorDetect = true
      GptDisableDemReportErrorStatus = false
      GptPredefTimer100us32bitEnable = false
      GptPredefTimer1usEnablingGrade = GPT_PREDEF_TIMER_1US_DISABLED
      GptRegisterLockingMode = NO_REGISTER_LOCKING
      GptReportWakeupSource = true
      GptTimeout = 65535
      GptClockReferencePoint_0 (GptClockReferencePoint): GptClockReference=F40_CLK
    45 x GptHwConfiguration:
      GptHwConfiguration_0: GptChannelIsUsed=false, GptIsrEnable=false, GptIsrHwId=EMIOS_0_CH_0
      GptHwConfiguration_1: GptChannelIsUsed=false, GptIsrEnable=false, GptIsrHwId=EMIOS_0_CH_1
      GptHwConfiguration_10: GptChannelIsUsed=false, GptIsrEnable=false, GptIsrHwId=EMIOS_0_CH_22
      GptHwConfiguration_11: GptChannelIsUsed=false, GptIsrEnable=false, GptIsrHwId=EMIOS_0_CH_23
      GptHwConfiguration_12: GptChannelIsUsed=false, GptIsrEnable=false, GptIsrHwId=EMIOS_0_CH_24
      GptHwConfiguration_13: GptChannelIsUsed=false, GptIsrEnable=false, GptIsrHwId=EMIOS_1_CH_0
      GptHwConfiguration_14: GptChannelIsUsed=false, GptIsrEnable=false, GptIsrHwId=EMIOS_1_CH_8
      GptHwConfiguration_15: GptChannelIsUsed=false, GptIsrEnable=false, GptIsrHwId=EMIOS_1_CH_16
      GptHwConfiguration_16: GptChannelIsUsed=false, GptIsrEnable=false, GptIsrHwId=EMIOS_1_CH_22
      GptHwConfiguration_17: GptChannelIsUsed=false, GptIsrEnable=false, GptIsrHwId=EMIOS_1_CH_23
      GptHwConfiguration_18: GptChannelIsUsed=false, GptIsrEnable=false, GptIsrHwId=EMIOS_1_CH_24
      GptHwConfiguration_19: GptChannelIsUsed=false, GptIsrEnable=false, GptIsrHwId=PIT_0_CH_RTI
      GptHwConfiguration_2: GptChannelIsUsed=false, GptIsrEnable=false, GptIsrHwId=EMIOS_0_CH_2
      GptHwConfiguration_20: GptChannelIsUsed=true, GptIsrEnable=true, GptIsrHwId=PIT_0_CH_0
      GptHwConfiguration_21: GptChannelIsUsed=false, GptIsrEnable=false, GptIsrHwId=PIT_0_CH_1
      GptHwConfiguration_22: GptChannelIsUsed=false, GptIsrEnable=false, GptIsrHwId=PIT_0_CH_2
      GptHwConfiguration_23: GptChannelIsUsed=false, GptIsrEnable=false, GptIsrHwId=PIT_0_CH_3
      GptHwConfiguration_24: GptChannelIsUsed=false, GptIsrEnable=false, GptIsrHwId=PIT_0_CH_4
      GptHwConfiguration_25: GptChannelIsUsed=false, GptIsrEnable=false, GptIsrHwId=PIT_0_CH_5
      GptHwConfiguration_26: GptChannelIsUsed=false, GptIsrEnable=false, GptIsrHwId=PIT_0_CH_6
      GptHwConfiguration_27: GptChannelIsUsed=false, GptIsrEnable=false, GptIsrHwId=PIT_0_CH_7
      GptHwConfiguration_28: GptChannelIsUsed=false, GptIsrEnable=false, GptIsrHwId=PIT_0_CH_8
      GptHwConfiguration_29: GptChannelIsUsed=false, GptIsrEnable=false, GptIsrHwId=PIT_0_CH_9
      GptHwConfiguration_3: GptChannelIsUsed=false, GptIsrEnable=false, GptIsrHwId=EMIOS_0_CH_3
      GptHwConfiguration_30: GptChannelIsUsed=false, GptIsrEnable=false, GptIsrHwId=PIT_0_CH_10
      GptHwConfiguration_31: GptChannelIsUsed=false, GptIsrEnable=false, GptIsrHwId=PIT_0_CH_11
      GptHwConfiguration_32: GptChannelIsUsed=false, GptIsrEnable=false, GptIsrHwId=PIT_0_CH_12
      GptHwConfiguration_33: GptChannelIsUsed=false, GptIsrEnable=false, GptIsrHwId=PIT_0_CH_13
      GptHwConfiguration_34: GptChannelIsUsed=false, GptIsrEnable=false, GptIsrHwId=PIT_0_CH_14
      GptHwConfiguration_35: GptChannelIsUsed=false, GptIsrEnable=false, GptIsrHwId=PIT_0_CH_15
      GptHwConfiguration_36: GptChannelIsUsed=false, GptIsrEnable=false, GptIsrHwId=STM_0_CH_0
      GptHwConfiguration_37: GptChannelIsUsed=false, GptIsrEnable=false, GptIsrHwId=STM_0_CH_1
      GptHwConfiguration_38: GptChannelIsUsed=false, GptIsrEnable=false, GptIsrHwId=STM_0_CH_2
      GptHwConfiguration_39: GptChannelIsUsed=false, GptIsrEnable=false, GptIsrHwId=STM_0_CH_3
      GptHwConfiguration_4: GptChannelIsUsed=false, GptIsrEnable=false, GptIsrHwId=EMIOS_0_CH_4
      GptHwConfiguration_40: GptChannelIsUsed=false, GptIsrEnable=false, GptIsrHwId=STM_1_CH_0
      GptHwConfiguration_41: GptChannelIsUsed=false, GptIsrEnable=false, GptIsrHwId=STM_1_CH_1
      GptHwConfiguration_42: GptChannelIsUsed=false, GptIsrEnable=false, GptIsrHwId=STM_1_CH_2
      GptHwConfiguration_43: GptChannelIsUsed=false, GptIsrEnable=false, GptIsrHwId=STM_1_CH_3
      GptHwConfiguration_44: GptChannelIsUsed=false, GptIsrEnable=false, GptIsrHwId=RTC_0_CH_0
      GptHwConfiguration_{5..8}: GptChannelIsUsed=false, GptIsrEnable=false, GptIsrHwId=EMIOS_0_CH_{5..8}
      GptHwConfiguration_9: GptChannelIsUsed=false, GptIsrEnable=false, GptIsrHwId=EMIOS_0_CH_16
    GptNonAUTOSAR: GptEnableDualClockMode=false, GptEnableUserModeSupport=false, GptRtcStandbyWakeupSupport=false
    GptPredefTimerConfiguration
    GptDemEventParameterRefs: GPT_E_TIMEOUT=AutoCreatedDemEvent_GPT_E_TIMEOUT
