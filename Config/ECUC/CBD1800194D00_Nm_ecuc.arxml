AUTOSAR XML (schema 4-2-1)
package /ActiveEcuC
  module config Nm: implementation-config-variant=VARIANT-PRE-COMPILE, module-description=Nm_Impl
    CN_Backbone1J1939_0b1f4bae (NmChannelConfig): NmChannelId=3, NmChannelSleepMaster=false, NmStateReportEnabled=false, NmSynchronizingNetwork=false, NmComMChannelRef=CN_Backbone1J1939_0b1f4bae
      Backbone1J1939_54966c1b (NmBusType)
        NmStandardBusNmConfig: NmStandardBusType=NM_BUSNM_J1939NM  # Backbone1J1939
    NmGlobalConfig
      NmGlobalFeatures:
        NmNodeIdEnabled = true
        NmBusSynchronizationEnabled = false
        NmCarWakeUpRxEnabled = false
        NmComControlEnabled = false
        NmComUserDataSupport = false
        NmCoordinatorSupportEnabled = false
        NmNodeDetectionEnabled = false
        NmPduRxIndicationEnabled = false
        NmRemoteSleepIndEnabled = false
        NmRepeatMsgIndEnabled = false
        NmStateChangeIndEnabled = false
        NmUserDataEnabled = false
        NmMacroLayerEnabled = false
        NmCoordinatorSyncSupport = false
        NmRuntimeMeasurementSupport = false
        NmCoordinatorRequestChannelsInBusSleep = false
        NmCoordinatorPassiveStartUpForwarding = false
        NmPassiveModeEnabled = false
      NmGeneration:
        NmOutOfBoundsWriteSanitizer = false
        NmOutOfBoundsReadSanitizer = false
        NmShortSymbols = false
        NmInterfacesForDeactivatedData = false
        NmReferringKeysInComments = false
      NmGlobalProperties: NmDevErrorDetect=true, NmVersionInfoApi=false, NmSafeBswChecks=false
      NmGlobalConstants
    4 x NmChannelConfig, all with NmChannelSleepMaster=false, NmStateReportEnabled=false, NmSynchronizingNetwork=false:
      CN_SecuritySubnet_e7a0ee54: NmChannelId=2, NmComMChannelRef=CN_SecuritySubnet_e7a0ee54
        SecuritySubnet_CAN_c9b1ce65 (NmBusType)
          NmStandardBusNmConfig: NmStandardBusType=NM_BUSNM_CANNM  # SecuritySubnet_CAN
      CN_Backbone2_78967e2c: NmChannelId=0, NmComMChannelRef=CN_Backbone2_78967e2c
        Backbone2_CAN_f911ddd5 (NmBusType)
          NmStandardBusNmConfig: NmStandardBusType=NM_BUSNM_CANNM  # Backbone2_CAN
      CN_FMSNet_fce1aae5: NmChannelId=4, NmComMChannelRef=CN_FMSNet_fce1aae5
        FMSNet_J1939_44d89c3b (NmBusType)
          NmStandardBusNmConfig: NmStandardBusType=NM_BUSNM_J1939NM  # FMSNet_J1939
      CN_CabSubnet_9ea693f1: NmChannelId=1, NmComMChannelRef=CN_CabSubnet_9ea693f1
        CabSubnet_CAN_1a3a8edc (NmBusType)
          NmStandardBusNmConfig: NmStandardBusType=NM_BUSNM_CANNM  # CabSubnet_CAN
