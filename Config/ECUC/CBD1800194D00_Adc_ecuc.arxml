AUTOSAR XML (schema 4-2-1)
package /Adc
  module config Adc: implementation-config-variant=VARIANT-POST-BUILD, module-description=Adc_Impl
    AdcConfigSet
      AdcHwUnit_0 (AdcHwUnit):
        AdcAltPowerDownDelay = 15
        AdcAltPrescale = 2
        AdcAutoClockOff = false
        AdcBypassSampling = false
        AdcHwUnitId = ADC0
        AdcLogicalUnitId = 0
        AdcMuxDelay = 15
        AdcPowerDownDelay = 15
        AdcPresamplingInternalSignal{0..2} = VSS_HV
        AdcTransferType = ADC_INTERRUPT
        14 x AdcChannel, all with AdcEnablePresampling=false, AdcEnableThresholds=false, AdcWdogNotification=NULL_PTR:
          AdcChannel_PB10: AdcChannelId=AN_7, AdcLogicalChannelId=2
          AdcChannel_PB8: AdcChannelId=AN_4, AdcLogicalChannelId=1
          AdcChannel_PB9: AdcChannelId=AN_3, AdcLogicalChannelId=0
          AdcChannel_PF0: AdcChannelId=AN_8, AdcLogicalChannelId=3
          AdcChannel_PF1: AdcChannelId=AN_11, AdcLogicalChannelId=4
          AdcChannel_PF2: AdcChannelId=AN_12, AdcLogicalChannelId=5
          AdcChannel_PF3: AdcChannelId=AN_32, AdcLogicalChannelId=6
          AdcChannel_PF4: AdcChannelId=AN_33, AdcLogicalChannelId=7
          AdcChannel_PF5: AdcChannelId=AN_34, AdcLogicalChannelId=8
          AdcChannel_PF6: AdcChannelId=AN_35, AdcLogicalChannelId=9
          AdcChannel_PF7: AdcChannelId=AN_38, AdcLogicalChannelId=10
          AdcChannel_PI14: AdcChannelId=AN_50, AdcLogicalChannelId=13
          AdcChannel_PJ1: AdcChannelId=AN_43, AdcLogicalChannelId=12
          AdcChannel_PJ3: AdcChannelId=AN_39, AdcLogicalChannelId=11
        AdcGroup_Adc0 (AdcGroup):
          AdcEnableChDisableChGroup = false
          AdcEnableDoubleBuffering = false
          AdcExtraNotification = NULL_PTR
          AdcGroupAccessMode = ADC_ACCESS_MODE_SINGLE
          AdcGroupConversionMode = ADC_CONV_MODE_ONESHOT
          AdcGroupConversionType = ADC_CONV_TYPE_NORMAL
          AdcGroupId = 0
          AdcGroupTriggSrc = ADC_TRIGG_SRC_SW
          AdcMultipleHardwareTriggerGroup = false
          AdcStreamingBufferMode = ADC_STREAM_BUFFER_LINEAR
          AdcStreamingNumSamples = 1
          AdcWithoutInterrupts = false
          AdcNotification = IohwAb_Adc0Group0_EndOfNotification
          AdcGroupDefinition = AdcChannel_PB9
          AdcGroupDefinition = AdcChannel_PB8
          AdcGroupDefinition = AdcChannel_PB10
          AdcGroupDefinition = AdcChannel_PF{0..7}
          AdcGroupDefinition = AdcChannel_PJ3
          AdcGroupDefinition = AdcChannel_PJ1
          AdcGroupDefinition = AdcChannel_PI14
          AdcGroupDefinition = AdcChannel_PB12
          AdcGroupDefinition = AdcChannel_PB13
          AdcAlternateGroupConvTimings: AdcAltGroupSamplingDuration=8, AdcAltGroupSamplingDuration1=8, AdcAltGroupSamplingDuration2=8
          AdcGroupConversionConfiguration: AdcSamplingDuration=8, AdcSamplingDuration1=8, AdcSamplingDuration2=8
        AdcChannel_PB12 (AdcChannel): AdcChannelId=AN_64, AdcEnablePresampling=false, AdcEnableThresholds=false, AdcLogicalChannelId=14, AdcWdogNotification=NULL_PTR
        AdcChannel_PB13 (AdcChannel): AdcChannelId=AN_72, AdcEnablePresampling=false, AdcEnableThresholds=false, AdcLogicalChannelId=15, AdcWdogNotification=NULL_PTR
      AdcHwUnit_1 (AdcHwUnit):
        AdcAltPowerDownDelay = 15
        AdcAltPrescale = 2
        AdcAutoClockOff = false
        AdcBypassSampling = false
        AdcHwUnitId = ADC1
        AdcLogicalUnitId = 1
        AdcMuxDelay = 15
        AdcPowerDownDelay = 15
        AdcPresamplingInternalSignal{0..2} = VSS_HV
        AdcTransferType = ADC_INTERRUPT
        16 x AdcChannel, all with AdcEnablePresampling=false, AdcEnableThresholds=false, AdcWdogNotification=NULL_PTR:
          AdcChannel_PA8: AdcChannelId=AN_43, AdcLogicalChannelId=11
          AdcChannel_PA9: AdcChannelId=AN_44, AdcLogicalChannelId=12
          AdcChannel_PB4: AdcChannelId=AN_9, AdcLogicalChannelId=6
          AdcChannel_PB5: AdcChannelId=AN_10, AdcLogicalChannelId=7
          AdcChannel_PB6: AdcChannelId=AN_11, AdcLogicalChannelId=8
          AdcChannel_PD10: AdcChannelId=AN_14, AdcLogicalChannelId=9
          AdcChannel_PD2: AdcChannelId=AN_2, AdcLogicalChannelId=0
          AdcChannel_PD3: AdcChannelId=AN_3, AdcLogicalChannelId=1
          AdcChannel_PD4: AdcChannelId=AN_4, AdcLogicalChannelId=2
          AdcChannel_PD5: AdcChannelId=AN_5, AdcLogicalChannelId=3
          AdcChannel_PD7: AdcChannelId=AN_7, AdcLogicalChannelId=4
          AdcChannel_PD8: AdcChannelId=AN_8, AdcLogicalChannelId=5
          AdcChannel_PE13: AdcChannelId=AN_88, AdcLogicalChannelId=16
          AdcChannel_PF14: AdcChannelId=AN_80, AdcLogicalChannelId=15
          AdcChannel_PF15: AdcChannelId=AN_72, AdcLogicalChannelId=14
          AdcChannel_PG0: AdcChannelId=AN_64, AdcLogicalChannelId=13
        AdcGroup_Adc1 (AdcGroup):
          AdcEnableChDisableChGroup = false
          AdcEnableDoubleBuffering = false
          AdcExtraNotification = NULL_PTR
          AdcGroupAccessMode = ADC_ACCESS_MODE_SINGLE
          AdcGroupConversionMode = ADC_CONV_MODE_ONESHOT
          AdcGroupConversionType = ADC_CONV_TYPE_NORMAL
          AdcGroupId = 1
          AdcGroupTriggSrc = ADC_TRIGG_SRC_SW
          AdcMultipleHardwareTriggerGroup = false
          AdcStreamingBufferMode = ADC_STREAM_BUFFER_LINEAR
          AdcStreamingNumSamples = 1
          AdcWithoutInterrupts = false
          AdcNotification = IohwAb_Adc1Group0_EndOfNotification
          AdcGroupDefinition = AdcChannel_PD{2..5}
          AdcGroupDefinition = AdcChannel_PD7
          AdcGroupDefinition = AdcChannel_PD8
          AdcGroupDefinition = AdcChannel_PB{4..6}
          AdcGroupDefinition = AdcChannel_PD10
          AdcGroupDefinition = AdcChannel_PA{7..9}
          AdcGroupDefinition = AdcChannel_PG0
          AdcGroupDefinition = AdcChannel_PF15
          AdcGroupDefinition = AdcChannel_PF14
          AdcGroupDefinition = AdcChannel_PE13
          AdcAlternateGroupConvTimings: AdcAltGroupSamplingDuration=8, AdcAltGroupSamplingDuration1=8, AdcAltGroupSamplingDuration2=8
          AdcGroupConversionConfiguration: AdcSamplingDuration=8, AdcSamplingDuration1=8, AdcSamplingDuration2=8
        AdcChannel_PA7 (AdcChannel): AdcChannelId=AN_42, AdcEnablePresampling=false, AdcEnableThresholds=false, AdcLogicalChannelId=10, AdcWdogNotification=NULL_PTR
    AdcGeneral:
      AdcDeInitApi = true
      AdcDevErrorDetect = true
      AdcEnableLimitCheck = true
      AdcEnableQueuing = true
      AdcEnableStartStopGroupApi = true
      AdcGrpNotifCapability = true
      AdcHwTriggerApi = false
      AdcPriorityImplementation = ADC_PRIORITY_NONE
      AdcPriorityQueueMaxDepth = 1
      AdcReadGroupApi = true
      AdcResultAlignment = ADC_ALIGN_RIGHT
      AdcTimeout = 65535
      AdcVersionInfoApi = true
    4 x AdcInterrupt:
      AdcInterrupt_0: AdcInterruptEnable=true, AdcInterruptSource=ADC0_EOC
      AdcInterrupt_1: AdcInterruptEnable=false, AdcInterruptSource=ADC0_WD
      AdcInterrupt_2: AdcInterruptEnable=true, AdcInterruptSource=ADC1_EOC
      AdcInterrupt_3: AdcInterruptEnable=false, AdcInterruptSource=ADC1_WD
    AdcPublishedInformation: AdcChannelValueSigned=false, AdcGroupFirstChannelFixed=false, AdcMaxChannelResolution=12
    CommonPublishedInformation:
      ArReleaseMajorVersion = 4
      ArReleaseMinorVersion = 2
      ArReleaseRevisionVersion = 2
      ModuleId = 123
      SwMajorVersion = 1
      SwMinorVersion = 0
      SwPatchVersion = 0
      VendorApiInfix = 
      VendorId = 43
    NonAutosar:
      AdcBypassConsistencyLoop = false
      AdcConvTimeOnce = false
      AdcDisableDemReportErrorStatus = false
      AdcEnableCalibration = false
      AdcEnableChDisableChApi = false
      AdcEnableCtuControlModeApi = false
      AdcEnableCtuTrigNonAutosarApi = false
      AdcEnableDmaTrasferMode = false
      AdcEnableDoubleBufferingOptimization = false
      AdcEnableDualClockMode = false
      AdcEnableGroupDependentChannelNames = false
      AdcEnableInitialNotification = false
      AdcEnableMultiHardwareTrigger = false
      AdcEnableSetChannel = false
      AdcEnableThresholdConfiguration = false
      AdcEnableUserModeSupport = false
      AdcEnableWatchdogFunctionality = false
      AdcGetInjectedConvStatusApi = false
      AdcHardwareQueueMaxDepth = 1
      AdcOptimizeOneShotHwTriggerConversions = false
      AdcPreSamplingOnce = false
      AdcSetModeApi = false
      AdcUseHardwareNormalGroups = false
      AdcUseSoftwareInjectedGroups = false
      BctuEnableDmaTrasferMode = false
