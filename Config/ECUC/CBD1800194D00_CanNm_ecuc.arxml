AUTOSAR XML (schema 4-2-1)
package /ActiveEcuC
  module config CanNm: implementation-config-variant=VARIANT-PRE-COMPILE, module-description=CanNm_Impl
    CanNmGlobalConfig:
      CanNmPnEiraCalcEnabled = false
      CanNmBusLoadReductionEnabled = false
      CanNmBusSynchronizationEnabled = false
      CanNmComUserDataSupport = false
      CanNmCoordinatorSyncSupport = false
      CanNmDevErrorDetect = false
      CanNmImmediateTxconfEnabled = false
      CanNmMainFunctionPeriod = 0.005
      CanNmPassiveModeEnabled = false
      CanNmPduRxIndicationEnabled = false
      CanNmRemoteSleepIndEnabled = false
      CanNmStateChangeIndEnabled = false
      CanNmUserDataEnabled = false
      CanNmVersionInfoApi = false
      CanNmDisableTxErrReport = false
      CanNmApiOptimization = false
      CanNmCanIfRangeConfigDLCCheck = true
      CanNmRuntimeMeasurementSupport = false
      CanNmSafeBswChecks = false
      3 x CanNmChannelConfig, all with CanNmNodeId=64, CanNmBusLoadReductionActive=false, CanNmCarWakeUpRxEnabled=false, CanNmImmediateNmTransmissions=0, CanNmMsgCycleOffset=0, CanNmMsgReducedTime=0.08, CanNmPduCbvPosition=CANNM_PDU_OFF, CanNmRemoteSleepIndTime=0.5, CanNmUserDataLength=0, CanNmActiveWakeupBitEnabled=false, CanNmNodeDetectionEnabled=false, CanNmRepeatMsgIndEnabled=false, CanNmImmediateRestartEnabled=false, CanNmComControlEnabled=false, CanNmPnEnabled=false, CanNmPnEraCalcEnabled=false, CanNmPnHandleMultipleNetworkRequests=false:
        Backbone2_CAN_f911ddd5: CanNmMsgCycleTime=0.2, CanNmRepeatMessageTime=0.3, CanNmTimeoutTime=5, CanNmWaitBusSleepTime=0.75, CanNmMsgTimeoutTime=0.06, CanNmPduNidPosition=CANNM_PDU_BYTE_0, CanNmNodeIdEnabled=true, CanNmComMNetworkHandleRef=CN_Backbone2_78967e2c
          NmAsr_CIOM_BB2_oBackbone2_a8a5afaa_Tx (CanNmTxPdu): CanNmTxConfirmationPduId=0, CanNmTxPduRef=NmAsr_CIOM_BB2_oBackbone2_a8a5afaa_Tx
          Backbone2_CAN_f911ddd5_Rx (CanNmRxPdu): CanNmRxPduId=0, CanNmRxPduRef=CIOM_9582cf37_Rx
        CabSubnet_CAN_1a3a8edc: CanNmMsgCycleTime=0.2, CanNmRepeatMessageTime=0.3, CanNmTimeoutTime=5, CanNmWaitBusSleepTime=0.75, CanNmMsgTimeoutTime=0.06, CanNmPduNidPosition=CANNM_PDU_OFF, CanNmNodeIdEnabled=false, CanNmComMNetworkHandleRef=CN_CabSubnet_9ea693f1
          NmAsr_CIOM_Cab_oCabSubnet_2c086e5c_Tx (CanNmTxPdu): CanNmTxConfirmationPduId=1, CanNmTxPduRef=NmAsr_CIOM_Cab_oCabSubnet_2c086e5c_Tx
          CabSubnet_CAN_1a3a8edc_Rx (CanNmRxPdu): CanNmRxPduId=1, CanNmRxPduRef=CIOM_70e7b3d8_Rx
        SecuritySubnet_CAN_c9b1ce65: CanNmMsgCycleTime=0.02, CanNmRepeatMessageTime=0.06, CanNmTimeoutTime=0.06, CanNmWaitBusSleepTime=0.06, CanNmMsgTimeoutTime=0.015, CanNmPduNidPosition=CANNM_PDU_OFF, CanNmNodeIdEnabled=false, CanNmComMNetworkHandleRef=CN_SecuritySubnet_e7a0ee54
          NmAsr_CIOM_Sec_oSecuritySubnet_2d797674_Tx (CanNmTxPdu): CanNmTxConfirmationPduId=2, CanNmTxPduRef=NmAsr_CIOM_Sec_oSecuritySubnet_2d797674_Tx
          SecuritySubnet_CAN_c9b1ce65_Rx (CanNmRxPdu): CanNmRxPduId=2, CanNmRxPduRef=CIOM_0632302a_Rx
      CanNmGeneration: CanNmOutOfBoundsWriteSanitizer=false, CanNmOutOfBoundsReadSanitizer=false, CanNmInterfacesForDeactivatedData=false
