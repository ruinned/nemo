AUTOSAR XML (schema 4-2-1)
package /MICROSAR
  bsw implementation LinTp_Impl: programming-language=C, sw-version=5.02.00, used-code-generator=DaVinci Configurator, vendor-id=30, ar-release-version=4.00.03
package /MICROSAR/LinIf_ib_bswmd/BswModuleDescriptions
  bsw module description LinTp
    bsw internal behavior LinTpBehavior
