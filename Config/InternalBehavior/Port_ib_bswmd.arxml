AUTOSAR XML (schema 4-2-1)
package /TS_T2D35M10I0R0/Port_ib_bswmd/BswModuleDescriptions
  bsw module description Port
    bsw internal behavior PortBehavior
      31 x exclusive area:
        PORT_EXCLUSIVE_AREA_{00..30}
