AUTOSAR XML (schema 4-2-1)
package /TS_T2D35M10I0R0/Pwm_ib_bswmd/BswModuleDescriptions
  bsw module description Pwm
    bsw internal behavior PwmBehavior
      65 x exclusive area:
        PWM_EXCLUSIVE_AREA_{00..64}
