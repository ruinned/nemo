AUTOSAR XML (schema 4-2-1)
package /MICROSAR/J1939Rm_ib_bswmd/BswModuleDescriptions
  bsw module description J1939Rm: provided-entrys=J1939Rm_MainFunction
    bsw internal behavior J1939RmBehavior
      4 x exclusive area:
        J1939RM_EXCLUSIVE_AREA_TXPDULOCK  # Used to protect access to Tx PDUs.
        J1939RM_EXCLUSIVE_AREA_ACKQUEUELOCK  # Used to protect access to the Acknowledgement message queue.
        J1939RM_EXCLUSIVE_AREA_REQQUEUELOCK  # Used to protect access to the Request message queue.
        J1939RM_EXCLUSIVE_AREA_REQ2QUEUELOCK  # Used to protect access to the Request2 message queue.
      bsw schedulable entity J1939Rm_MainFunction: implemented-entry=J1939Rm_MainFunction
      bsw timing event J1939Rm_MainFunctionTimingEvent0: starts-on-event=J1939Rm_MainFunction, period=0.01
  bsw module entry J1939Rm_MainFunction: call-type=SCHEDULED, execution-context=TASK
