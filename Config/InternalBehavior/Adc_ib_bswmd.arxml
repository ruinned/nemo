AUTOSAR XML (schema 4-2-1)
package /TS_T2D35M10I0R0/Adc_ib_bswmd/BswModuleDescriptions
  bsw module description Adc
    bsw internal behavior AdcBehavior
      65 x exclusive area:
        ADC_EXCLUSIVE_AREA_{00..64}
