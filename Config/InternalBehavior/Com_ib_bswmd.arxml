AUTOSAR XML (schema 4-2-1)
package /MICROSAR
  bsw implementation Com_Impl: programming-language=C, sw-version=14.00.01, used-code-generator=DaVinci Configurator, vendor-id=30, ar-release-version=4.00.03
package /MICROSAR/Com_ib_bswmd/BswModuleDescriptions
  bsw module description Com: provided-entrys=[Com_MainFunctionTx, Com_MainFunctionRx, Com_MainFunctionRouteSignals]
    bsw internal behavior ComBehavior
      exclusive area COM_EXCLUSIVE_AREA_TX  # This critical section protects Tx ressources that can be accessed from various contexts. Therefore the critical section enclosed with COM_EXCLUSIVE_AREA_TX should never be interrupted by any Com API which accesses Tx ressources. For more details, see DocTechRef.
      exclusive area COM_EXCLUSIVE_AREA_RX  # This critical section protects Rx ressources that can be accessed from various contexts.Therefore the critical section enclosed with COM_EXCLUSIVE_AREA_RX should never be interrupted by any Com API which accesses Rx ressources. For more details, see DocTechRef.
      exclusive area COM_EXCLUSIVE_AREA_BOTH  # This critical section protects Rx and Tx ressources that are being accessed in context of Com_MainFunctionRouteSignals for signal gateway routings or description routings with configured deferred description source. For more details, see DocTechRef.
      bsw schedulable entity Com_MainFunctionTx: implemented-entry=Com_MainFunctionTx
      bsw schedulable entity Com_MainFunctionRx: implemented-entry=Com_MainFunctionRx
      bsw schedulable entity Com_MainFunctionRouteSignals: implemented-entry=Com_MainFunctionRouteSignals
      bsw timing event Com_MainFunctionTxTimingEvent0: starts-on-event=Com_MainFunctionTx, period=0.005
      bsw timing event Com_MainFunctionRxTimingEvent0: starts-on-event=Com_MainFunctionRx, period=0.01
      bsw timing event Com_MainFunctionRouteSignalsTimingEvent0: starts-on-event=Com_MainFunctionRouteSignals, period=0.01
  bsw module entry Com_MainFunctionTx: call-type=SCHEDULED, execution-context=TASK
  bsw module entry Com_MainFunctionRx: call-type=SCHEDULED, execution-context=TASK
  bsw module entry Com_MainFunctionRouteSignals: call-type=SCHEDULED, execution-context=TASK
