AUTOSAR XML (schema 4-2-1)
package /MICROSAR/IoHwAb_ib_bswmd/BswModuleDescriptions
  bsw module description IoHwAb: provided-entrys=IoHwAb_MainFunction_IoHwAbSchedulable
    bsw internal behavior IoHwAbBehavior
      exclusive area IOHWAB_EXCLUSIVE_AREA_0
  bsw module entry IoHwAb_MainFunction_IoHwAbSchedulable: call-type=SCHEDULED, execution-context=TASK
