AUTOSAR XML (schema 4-2-1)
package /MICROSAR
  bsw implementation Issm_Impl: programming-language=C, sw-version=3.04.00, used-code-generator=DaVinci Configurator, vendor-id=30, ar-release-version=4.00.03
package /MICROSAR/Issm_ib_bswmd/BswModuleDescriptions
  bsw module description Issm: provided-entrys=Issm_MainFunction
    bsw internal behavior IssmBehavior
      exclusive area ISSM_EXCLUSIVE_AREA_0  # Must lock global interrupts.
      bsw schedulable entity Issm_MainFunction: implemented-entry=Issm_MainFunction
      bsw timing event Issm_MainFunctionTimingEvent0: starts-on-event=Issm_MainFunction, period=0.01
  bsw module entry Issm_MainFunction: call-type=SCHEDULED, execution-context=TASK
