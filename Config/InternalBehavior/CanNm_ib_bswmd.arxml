AUTOSAR XML (schema 4-2-1)
package /MICROSAR
  bsw implementation CanNm_Impl: programming-language=C, sw-version=7.02.01, used-code-generator=DaVinci Configurator, vendor-id=30, ar-release-version=4.00.03
package /MICROSAR/CanNm_ib_bswmd/BswModuleDescriptions
  bsw module description CanNm: provided-entrys=CanNm_MainFunction
    bsw internal behavior CanNmBehavior
      6 x exclusive area:
        CANNM_EXCLUSIVE_AREA_0  # No interruption by any interrupt allowed (i.e. global interrupt locks)
        CANNM_EXCLUSIVE_AREA_1  # No interruption of CanNm_MainFunction by CanNm_SetUserData, CanNm_SetCoordBits or CanNm_SetDiagGwReqId allowed
        CANNM_EXCLUSIVE_AREA_2  # No interruption of CanNm_SetUserData by CanNm_MainFunction allowed
        CANNM_EXCLUSIVE_AREA_3  # No interruption of CanNm_SetCoordBits by CanNm_MainFunction allowed
        CANNM_EXCLUSIVE_AREA_4  # No interruption of CanNm_RxIndication by CanNm_GetUserData or CanNm_GetPduData allowed
        CANNM_EXCLUSIVE_AREA_5  # No interruption of CanNm_GetUserData or CanNm_GetPduData by CanNm_RxIndication allowed
      bsw schedulable entity CanNm_MainFunction: implemented-entry=CanNm_MainFunction
      bsw timing event CanNm_MainFunctionTimingEvent0: starts-on-event=CanNm_MainFunction, period=0.005
  bsw module entry CanNm_MainFunction: call-type=SCHEDULED, execution-context=TASK
