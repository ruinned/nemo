AUTOSAR XML (schema 4-2-1)
package /MICROSAR/J1939Nm_ib_bswmd/BswModuleDescriptions
  bsw module description J1939Nm: provided-entrys=J1939Nm_MainFunction
    bsw internal behavior J1939NmBehavior
      exclusive area RxPduLock  # Used to protect access to Rx PDUs.
      exclusive area TxPduLock  # Used to protect access to Tx PDUs.
      bsw schedulable entity J1939Nm_MainFunction: implemented-entry=J1939Nm_MainFunction
      bsw timing event J1939Nm_MainFunctionTimingEvent0: starts-on-event=J1939Nm_MainFunction, period=0.01
  bsw module entry J1939Nm_MainFunction: call-type=SCHEDULED, execution-context=TASK
