AUTOSAR XML (schema 4-2-1)
package /TS_T2D35M10I0R0/Dio_ib_bswmd/BswModuleDescriptions
  bsw module description Dio
    bsw internal behavior DioBehavior
      31 x exclusive area:
        DIO_EXCLUSIVE_AREA_{00..30}
