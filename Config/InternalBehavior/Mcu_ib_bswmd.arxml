AUTOSAR XML (schema 4-2-1)
package /TS_T2D35M10I0R0/Mcu_ib_bswmd/BswModuleDescriptions
  bsw module description Mcu
    bsw internal behavior McuBehavior
      31 x exclusive area:
        MCU_EXCLUSIVE_AREA_{00..30}
