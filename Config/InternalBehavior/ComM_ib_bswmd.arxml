AUTOSAR XML (schema 4-2-1)
package /MICROSAR
  bsw implementation ComM_Impl: programming-language=C, sw-version=9.00.01, used-code-generator=DaVinci Configurator, vendor-id=30, ar-release-version=4.00.03
package /MICROSAR/ComM_ib_bswmd/BswModuleDescriptions
  bsw module description ComM
    provided-entrys:
      ComM_MainFunction_0
      ComM_MainFunction_1
      ComM_MainFunction_3
      ComM_MainFunction_5
      ComM_MainFunction_7
      ComM_MainFunction_9
      ComM_MainFunction_8
      ComM_MainFunction_6
      ComM_MainFunction_4
      ComM_MainFunction_2
    bsw internal behavior ComMBehavior
      exclusive area COMM_EXCLUSIVE_AREA_0
      exclusive area COMM_EXCLUSIVE_AREA_1
      10 x bsw schedulable entity:
        ComM_MainFunction_0: implemented-entry=ComM_MainFunction_0
        ComM_MainFunction_1: implemented-entry=ComM_MainFunction_1
        ComM_MainFunction_3: implemented-entry=ComM_MainFunction_3
        ComM_MainFunction_5: implemented-entry=ComM_MainFunction_5
        ComM_MainFunction_7: implemented-entry=ComM_MainFunction_7
        ComM_MainFunction_9: implemented-entry=ComM_MainFunction_9
        ComM_MainFunction_8: implemented-entry=ComM_MainFunction_8
        ComM_MainFunction_6: implemented-entry=ComM_MainFunction_6
        ComM_MainFunction_4: implemented-entry=ComM_MainFunction_4
        ComM_MainFunction_2: implemented-entry=ComM_MainFunction_2
      10 x bsw timing event, all with period=0.02:
        ComM_MainFunction_0TimingEvent0: starts-on-event=ComM_MainFunction_0
        ComM_MainFunction_1TimingEvent0: starts-on-event=ComM_MainFunction_1
        ComM_MainFunction_3TimingEvent0: starts-on-event=ComM_MainFunction_3
        ComM_MainFunction_5TimingEvent0: starts-on-event=ComM_MainFunction_5
        ComM_MainFunction_7TimingEvent0: starts-on-event=ComM_MainFunction_7
        ComM_MainFunction_9TimingEvent0: starts-on-event=ComM_MainFunction_9
        ComM_MainFunction_8TimingEvent0: starts-on-event=ComM_MainFunction_8
        ComM_MainFunction_6TimingEvent0: starts-on-event=ComM_MainFunction_6
        ComM_MainFunction_4TimingEvent0: starts-on-event=ComM_MainFunction_4
        ComM_MainFunction_2TimingEvent0: starts-on-event=ComM_MainFunction_2
  10 x bsw module entry, all with call-type=SCHEDULED, execution-context=TASK:
    ComM_MainFunction_0
    ComM_MainFunction_1
    ComM_MainFunction_3
    ComM_MainFunction_5
    ComM_MainFunction_7
    ComM_MainFunction_9
    ComM_MainFunction_8
    ComM_MainFunction_6
    ComM_MainFunction_4
    ComM_MainFunction_2
