AUTOSAR XML (schema 4-2-1)
package /MICROSAR
  16 x bsw implementation, all with programming-language=C, vendor-id=30:
    BswM_Impl: sw-version=10.03.00, used-code-generator=DaVinci Configurator, ar-release-version=4.00.03, behavior=BswMBehavior
    CanIf_Impl: sw-version=6.16.01, used-code-generator=cMSR, ar-release-version=4.00.03, behavior=CanIf_Behavior
    CanNm_Impl: sw-version=7.02.01, used-code-generator=DaVinci Configurator, ar-release-version=4.00.03, behavior=CanNmBehavior
    CanSM_Impl: sw-version=2.13.01, used-code-generator=DaVinci Configurator, ar-release-version=4.00.03, behavior=CanSMBehavior
    CanTp_Impl: sw-version=3.03.02, used-code-generator=DaVinci Configurator, ar-release-version=4.00.03, behavior=CanTpBehavior
    Com_Impl: sw-version=14.00.01, used-code-generator=DaVinci Configurator, ar-release-version=4.00.03, behavior=ComBehavior
    ComM_Impl: sw-version=9.00.01, used-code-generator=DaVinci Configurator, ar-release-version=4.00.03, behavior=ComMBehavior
    EcuM_Impl: sw-version=8.00.02, used-code-generator=DaVinci Configurator, ar-release-version=4.00.03, behavior=EcuMBehavior
    Fee_Impl: sw-version=8.01.06, used-code-generator=DaVinci Configurator, ar-release-version=4.00.03, behavior=FeeBehavior
    Issm_Impl: sw-version=3.04.00, used-code-generator=DaVinci Configurator, ar-release-version=4.00.03, behavior=IssmBehavior
    LinIf_Impl: sw-version=5.02.00, used-code-generator=DaVinci Configurator, ar-release-version=4.00.03, behavior=LinIfBehavior
    LinTp_Impl: sw-version=5.02.00, used-code-generator=DaVinci Configurator, ar-release-version=4.00.03, behavior=LinTpBehavior
    LinSM_Impl: sw-version=5.02.00, used-code-generator=DaVinci Configurator, ar-release-version=4.00.03, behavior=LinSMBehavior
    Nm_Impl: sw-version=11.00.01, used-code-generator=DaVinci Configurator, ar-release-version=4.00.03, behavior=NmBehavior
    NvM_Impl: sw-version=5.07.01, used-code-generator=DaVinci Configurator, ar-release-version=4.00.03, behavior=NvMBehavior
    PduR_Impl: sw-version=11.05.00, used-code-generator=DaVinci Configurator, ar-release-version=4.01.02, behavior=PduRBehavior
package /MICROSAR/Lin_Mpc56xx
  bsw implementation Lin_Impl: programming-language=C, used-code-generator=DaVinci Configurator, vendor-id=30, ar-release-version=4.00.03, behavior=LinBehavior
package /MICROSAR/Lin_Mpc56xx/Lin_ib_bswmd/BswModuleDescriptions
  bsw module description Lin
    bsw internal behavior LinBehavior
package /MICROSAR/BswM_ib_bswmd/BswModuleDescriptions
  bsw module description BswM
    bsw internal behavior BswMBehavior
      exclusive area BSWM_EXCLUSIVE_AREA_0
      bsw schedulable entity BswM_MainFunction: implemented-entry=BswM_MainFunction
      bsw timing event BswM_MainFunctionTimingEvent0: starts-on-event=BswM_MainFunction, period=0.01
  bsw module entry BswM_MainFunction: call-type=SCHEDULED, execution-context=TASK
package /MICROSAR/CanIf_ib_bswmd/BswModuleDescriptions
  bsw module description CanIf
    bsw internal behavior CanIf_Behavior
      8 x exclusive area:
        CANIF_EXCLUSIVE_AREA_{0..7}
package /MICROSAR/CanNm_ib_bswmd/BswModuleDescriptions
  bsw module description CanNm
    bsw internal behavior CanNmBehavior
      6 x exclusive area:
        CANNM_EXCLUSIVE_AREA_0  # No interruption by any interrupt allowed (i.e. global interrupt locks)
        CANNM_EXCLUSIVE_AREA_1  # No interruption of CanNm_MainFunction by CanNm_SetUserData, CanNm_SetCoordBits or CanNm_SetDiagGwReqId allowed
        CANNM_EXCLUSIVE_AREA_2  # No interruption of CanNm_SetUserData by CanNm_MainFunction allowed
        CANNM_EXCLUSIVE_AREA_3  # No interruption of CanNm_SetCoordBits by CanNm_MainFunction allowed
        CANNM_EXCLUSIVE_AREA_4  # No interruption of CanNm_RxIndication by CanNm_GetUserData or CanNm_GetPduData allowed
        CANNM_EXCLUSIVE_AREA_5  # No interruption of CanNm_GetUserData or CanNm_GetPduData by CanNm_RxIndication allowed
      bsw schedulable entity CanNm_MainFunction: implemented-entry=CanNm_MainFunction
      bsw timing event CanNm_MainFunctionTimingEvent0: starts-on-event=CanNm_MainFunction, period=0.005
  bsw module entry CanNm_MainFunction: call-type=SCHEDULED, execution-context=TASK
package /MICROSAR/CanSM_ib_bswmd/BswModuleDescriptions
  bsw module description CanSM
    bsw internal behavior CanSMBehavior
      6 x exclusive area:
        CANSM_EXCLUSIVE_AREA_{1..6}
      bsw schedulable entity CanSM_MainFunction: implemented-entry=CanSM_MainFunction
      bsw timing event CanSM_MainFunctionTimingEvent0: starts-on-event=CanSM_MainFunction, period=0.01
  bsw module entry CanSM_MainFunction: call-type=SCHEDULED, execution-context=TASK
package /MICROSAR/CanTp_ib_bswmd/BswModuleDescriptions
  bsw module description CanTp
    bsw internal behavior CanTpBehavior
      exclusive area CANTP_EXCLUSIVE_AREA_0
      bsw schedulable entity CanTp_MainFunction: implemented-entry=CanTp_MainFunction
      bsw timing event CanTp_MainFunctionTimingEvent0: starts-on-event=CanTp_MainFunction, period=0.005
  bsw module entry CanTp_MainFunction: call-type=SCHEDULED, execution-context=TASK
package /MICROSAR/ComM_ib_bswmd/BswModuleDescriptions
  bsw module description ComM
    bsw internal behavior ComMBehavior
      exclusive area COMM_EXCLUSIVE_AREA_0
      exclusive area COMM_EXCLUSIVE_AREA_1
      10 x bsw schedulable entity:
        ComM_MainFunction_0: implemented-entry=ComM_MainFunction_0
        ComM_MainFunction_1: implemented-entry=ComM_MainFunction_1
        ComM_MainFunction_3: implemented-entry=ComM_MainFunction_3
        ComM_MainFunction_5: implemented-entry=ComM_MainFunction_5
        ComM_MainFunction_7: implemented-entry=ComM_MainFunction_7
        ComM_MainFunction_9: implemented-entry=ComM_MainFunction_9
        ComM_MainFunction_8: implemented-entry=ComM_MainFunction_8
        ComM_MainFunction_6: implemented-entry=ComM_MainFunction_6
        ComM_MainFunction_4: implemented-entry=ComM_MainFunction_4
        ComM_MainFunction_2: implemented-entry=ComM_MainFunction_2
      10 x bsw timing event, all with period=0.02:
        ComM_MainFunction_0TimingEvent0: starts-on-event=ComM_MainFunction_0
        ComM_MainFunction_1TimingEvent0: starts-on-event=ComM_MainFunction_1
        ComM_MainFunction_3TimingEvent0: starts-on-event=ComM_MainFunction_3
        ComM_MainFunction_5TimingEvent0: starts-on-event=ComM_MainFunction_5
        ComM_MainFunction_7TimingEvent0: starts-on-event=ComM_MainFunction_7
        ComM_MainFunction_9TimingEvent0: starts-on-event=ComM_MainFunction_9
        ComM_MainFunction_8TimingEvent0: starts-on-event=ComM_MainFunction_8
        ComM_MainFunction_6TimingEvent0: starts-on-event=ComM_MainFunction_6
        ComM_MainFunction_4TimingEvent0: starts-on-event=ComM_MainFunction_4
        ComM_MainFunction_2TimingEvent0: starts-on-event=ComM_MainFunction_2
  10 x bsw module entry, all with call-type=SCHEDULED, execution-context=TASK:
    ComM_MainFunction_0
    ComM_MainFunction_1
    ComM_MainFunction_3
    ComM_MainFunction_5
    ComM_MainFunction_7
    ComM_MainFunction_9
    ComM_MainFunction_8
    ComM_MainFunction_6
    ComM_MainFunction_4
    ComM_MainFunction_2
package /MICROSAR/Com_ib_bswmd/BswModuleDescriptions
  bsw module description Com
    bsw internal behavior ComBehavior
      exclusive area COM_EXCLUSIVE_AREA_TX  # This critical section protects Tx ressources that can be accessed from various contexts. Therefore the critical section enclosed with COM_EXCLUSIVE_AREA_TX should never be interrupted by any Com API which accesses Tx ressources. For more details, see DocTechRef.
      exclusive area COM_EXCLUSIVE_AREA_RX  # This critical section protects Rx ressources that can be accessed from various contexts.Therefore the critical section enclosed with COM_EXCLUSIVE_AREA_RX should never be interrupted by any Com API which accesses Rx ressources. For more details, see DocTechRef.
      exclusive area COM_EXCLUSIVE_AREA_BOTH  # This critical section protects Rx and Tx ressources that are being accessed in context of Com_MainFunctionRouteSignals for signal gateway routings or description routings with configured deferred description source. For more details, see DocTechRef.
      bsw schedulable entity Com_MainFunctionTx: implemented-entry=Com_MainFunctionTx
      bsw schedulable entity Com_MainFunctionRx: implemented-entry=Com_MainFunctionRx
      bsw schedulable entity Com_MainFunctionRouteSignals: implemented-entry=Com_MainFunctionRouteSignals
      bsw timing event Com_MainFunctionTxTimingEvent0: starts-on-event=Com_MainFunctionTx, period=0.005
      bsw timing event Com_MainFunctionRxTimingEvent0: starts-on-event=Com_MainFunctionRx, period=0.01
      bsw timing event Com_MainFunctionRouteSignalsTimingEvent0: starts-on-event=Com_MainFunctionRouteSignals, period=0.01
  bsw module entry Com_MainFunctionTx: call-type=SCHEDULED, execution-context=TASK
  bsw module entry Com_MainFunctionRx: call-type=SCHEDULED, execution-context=TASK
  bsw module entry Com_MainFunctionRouteSignals: call-type=SCHEDULED, execution-context=TASK
package /MICROSAR/EcuM_ib_bswmd/BswModuleDescriptions
  bsw module description EcuM
    bsw internal behavior EcuMBehavior
      exclusive area ECUM_EXCLUSIVE_AREA_0  # This exclusive area shall disable all wake up interrupts to prevent overwriting of some global variables.
      exclusive area ECUM_EXCLUSIVE_AREA_1  # This exclusive area is only used in case of multi core and if the the EcuM is configured to handle also the slave cores. It must be configured as a spinlock to allow access to some variables simultaneously from multiple cores.
      exclusive area ECUM_EXCLUSIVE_AREA_2  # This exclusive area is used for accessing the clock variable. It shall disable GPT interrupts and task changes. Only necessary if 32 Bit access is not atomic and Alarm Clock is present.
      bsw schedulable entity EcuM_MainFunction: implemented-entry=EcuM_MainFunction
      bsw timing event EcuM_MainFunctionTimingEvent0: starts-on-event=EcuM_MainFunction, period=0.1
  bsw module entry EcuM_MainFunction: call-type=SCHEDULED, execution-context=TASK
package /MICROSAR/Fee_ib_bswmd/BswModuleDescriptions
  bsw module description Fee
    bsw internal behavior FeeBehavior
      exclusive area FEE_EXCLUSIVE_AREA_0
      bsw schedulable entity Fee_MainFunction: implemented-entry=Fee_MainFunction
      bsw timing event Fee_MainFunctionTimingEvent0: starts-on-event=Fee_MainFunction, period=0.005
  bsw module entry Fee_MainFunction: call-type=SCHEDULED, execution-context=TASK
package /MICROSAR/Issm_ib_bswmd/BswModuleDescriptions
  bsw module description Issm
    bsw internal behavior IssmBehavior
      exclusive area ISSM_EXCLUSIVE_AREA_0  # Must lock global interrupts.
      bsw schedulable entity Issm_MainFunction: implemented-entry=Issm_MainFunction
      bsw timing event Issm_MainFunctionTimingEvent0: starts-on-event=Issm_MainFunction, period=0.01
  bsw module entry Issm_MainFunction: call-type=SCHEDULED, execution-context=TASK
package /MICROSAR/LinIf_ib_bswmd/BswModuleDescriptions
  bsw module description LinIf
    bsw internal behavior LinIfBehavior
      exclusive area LINIF_EXCLUSIVE_AREA_0  # Exclusive area for LinIf channel main function
      exclusive area LINIF_EXCLUSIVE_AREA_1  # Exclusive area for asynchronous API functions
      bsw schedulable entity LinIf_MainFunction: implemented-entry=LinIf_MainFunction
      bsw timing event LinIf_MainFunctionTimingEvent0: starts-on-event=LinIf_MainFunction, period=0.005
  bsw module entry LinIf_MainFunction: call-type=SCHEDULED, execution-context=TASK
  bsw module description LinTp
    bsw internal behavior LinTpBehavior
package /MICROSAR/LinSM_ib_bswmd/BswModuleDescriptions
  bsw module description LinSM
    bsw internal behavior LinSMBehavior
      4 x exclusive area:
        LINSM_EXCLUSIVE_AREA_0  # Must lock task interrupts, if LinIf_MainFunction(), LinSM_MainFunction() or BswM action BswMLinScheduleSwitch priority level is higher than the level of ComM_MainFunction().
        LINSM_EXCLUSIVE_AREA_1  # Must lock task interrupts, if ComM_MainFunction(), LinSM_MainFunction() or BswM action BswMLinScheduleSwitch priority level is higher than the level of LinIf_MainFunction().
        LINSM_EXCLUSIVE_AREA_2  # Must lock task interrupts, if ComM_MainFunction(), LinIf_MainFunction() or BswM action BswMLinScheduleSwitch priority level is higher than the level of LinSM_MainFunction().
        LINSM_EXCLUSIVE_AREA_3  # Must lock task interrupts, if ComM_MainFunction(), LinIf_MainFunction() or LinSM_MainFunction() interrupt priority level is higher than the level of the BswM action BswMLinScheduleSwitch.
      bsw schedulable entity LinSM_MainFunction: implemented-entry=LinSM_MainFunction
      bsw timing event LinSM_MainFunctionTimingEvent0: starts-on-event=LinSM_MainFunction, period=0.01
  bsw module entry LinSM_MainFunction: call-type=SCHEDULED, execution-context=TASK
package /MICROSAR/Nm_ib_bswmd/BswModuleDescriptions
  bsw module description Nm
    bsw internal behavior NmBehavior
      exclusive area NM_EXCLUSIVE_AREA_0  # No interruption by any interrupt allowed
      exclusive area NM_EXCLUSIVE_AREA_1  # Interrupt locks are required if any of these functions are executed in an interrupt context: Nm_NetworkMode, Nm_PrepareBusSleepMode, Nm_BusSleepMode, Nm_RemoteSleepIndication, Nm_RemoteSleepCancellation, Nm_CoordReadyToSleepIndication, Nm_CoordReadyToSleepCancellation
package /MICROSAR/NvM_ib_bswmd/BswModuleDescriptions
  bsw module description NvM
    bsw internal behavior NvMBehavior
      exclusive area NVM_EXCLUSIVE_AREA_0
      bsw schedulable entity NvM_MainFunction: implemented-entry=NvM_MainFunction
      bsw timing event NvM_MainFunctionTimingEvent0: starts-on-event=NvM_MainFunction, period=0.01
  bsw module entry NvM_MainFunction: call-type=SCHEDULED, execution-context=TASK
package /MICROSAR/PduR_ib_bswmd/BswModuleDescriptions
  bsw module description PduR
    bsw internal behavior PduRBehavior
      exclusive area PDUR_EXCLUSIVE_AREA_0
