[part 2 of 5: package /MICROSAR/Dem_swc/ComponentTypes]
AUTOSAR XML (schema 4-2-1)
package /MICROSAR/Dem_swc/ComponentTypes  (continued)
  service sw component type DemSatellite_OsApplication_Untrusted_Core0: category=SERVICE_COMPONENT  (continued)
    behavior DemSatellite_OsApplication_Untrusted_Core0InternalBehavior: handle-termination-and-restart=NO-SUPPORT, included-data-type-set=data-type=[Dem_EventIdType, Dem_RatioIdType, Dem_EventStatusType, Dem_UdsStatusByteType, Dem_DTCFormatType, Dem_InitMonitorReasonType, Dem_OperationCycleStateType, Dem_DTCStatusMaskType, Dem_IndicatorStatusType, Dem_MaxDataValueType, Dem_DTCKindType, Dem_DTCGroupType, Dem_IumprDenomCondIdType, Dem_IumprDenomCondStatusType, Dem_DebounceResetStatusType, Dem_DebouncingStateType, Dem_IumprReadinessGroupType, Dem_DTRControlType, Dem_DTCSeverityType, Dem_MonitorStatusType]  (continued)
      2354 x operation invoked event:  (continued)
        OpEventGetEventStatus_GetEventStatus_EvtInfo_AutoCreatedDemEvent_INIT_Action_Nm_Init_BswMReportFailToDemRef: start-on-event=DemSatellite_OsApplication_Untrusted_Core0InternalBehavior/GetEventStatus, operation=EvtInfo_AutoCreatedDemEvent_INIT_Action_Nm_Init_BswMReportFailToDemRef.GetEventStatus
        OpEventGetEventStatus_GetEventStatus_EvtInfo_AutoCreatedDemEvent_INIT_Action_NvMReadAll_BswMReportFailToDemRef: start-on-event=DemSatellite_OsApplication_Untrusted_Core0InternalBehavior/GetEventStatus, operation=EvtInfo_AutoCreatedDemEvent_INIT_Action_NvMReadAll_BswMReportFailToDemRef.GetEventStatus
        OpEventGetEventStatus_GetEventStatus_EvtInfo_AutoCreatedDemEvent_INIT_Action_NvM_Init_BswMReportFailToDemRef: start-on-event=DemSatellite_OsApplication_Untrusted_Core0InternalBehavior/GetEventStatus, operation=EvtInfo_AutoCreatedDemEvent_INIT_Action_NvM_Init_BswMReportFailToDemRef.GetEventStatus
        OpEventGetEventStatus_GetEventStatus_EvtInfo_AutoCreatedDemEvent_INIT_Action_PduR_Init_BswMReportFailToDemRef: start-on-event=DemSatellite_OsApplication_Untrusted_Core0InternalBehavior/GetEventStatus, operation=EvtInfo_AutoCreatedDemEvent_INIT_Action_PduR_Init_BswMReportFailToDemRef.GetEventStatus
        OpEventGetEventStatus_GetEventStatus_EvtInfo_AutoCreatedDemEvent_INIT_Action_RteStart_BswMReportFailToDemRef: start-on-event=DemSatellite_OsApplication_Untrusted_Core0InternalBehavior/GetEventStatus, operation=EvtInfo_AutoCreatedDemEvent_INIT_Action_RteStart_BswMReportFailToDemRef.GetEventStatus
        OpEventGetEventStatus_GetEventStatus_EvtInfo_AutoCreatedDemEvent_CHNL_17344684_CANSM_E_MODE_REQUEST_TIMEOUT: start-on-event=DemSatellite_OsApplication_Untrusted_Core0InternalBehavior/GetEventStatus, operation=EvtInfo_AutoCreatedDemEvent_CHNL_17344684_CANSM_E_MODE_REQUEST_TIMEOUT.GetEventStatus
        OpEventGetEventStatus_GetEventStatus_EvtInfo_AutoCreatedDemEvent_CHNL_17344684_CANSM_E_BUS_OFF: start-on-event=DemSatellite_OsApplication_Untrusted_Core0InternalBehavior/GetEventStatus, operation=EvtInfo_AutoCreatedDemEvent_CHNL_17344684_CANSM_E_BUS_OFF.GetEventStatus
        OpEventGetEventStatus_GetEventStatus_EvtInfo_AutoCreatedDemEvent_CHNL_53cce282_CANSM_E_MODE_REQUEST_TIMEOUT: start-on-event=DemSatellite_OsApplication_Untrusted_Core0InternalBehavior/GetEventStatus, operation=EvtInfo_AutoCreatedDemEvent_CHNL_53cce282_CANSM_E_MODE_REQUEST_TIMEOUT.GetEventStatus
        OpEventGetEventStatus_GetEventStatus_EvtInfo_AutoCreatedDemEvent_CHNL_53cce282_CANSM_E_BUS_OFF: start-on-event=DemSatellite_OsApplication_Untrusted_Core0InternalBehavior/GetEventStatus, operation=EvtInfo_AutoCreatedDemEvent_CHNL_53cce282_CANSM_E_BUS_OFF.GetEventStatus
        OpEventGetEventStatus_GetEventStatus_EvtInfo_AutoCreatedDemEvent_CHNL_a6b6a922_CANSM_E_MODE_REQUEST_TIMEOUT: start-on-event=DemSatellite_OsApplication_Untrusted_Core0InternalBehavior/GetEventStatus, operation=EvtInfo_AutoCreatedDemEvent_CHNL_a6b6a922_CANSM_E_MODE_REQUEST_TIMEOUT.GetEventStatus
        OpEventGetEventStatus_GetEventStatus_EvtInfo_AutoCreatedDemEvent_CHNL_a6b6a922_CANSM_E_BUS_OFF: start-on-event=DemSatellite_OsApplication_Untrusted_Core0InternalBehavior/GetEventStatus, operation=EvtInfo_AutoCreatedDemEvent_CHNL_a6b6a922_CANSM_E_BUS_OFF.GetEventStatus
        OpEventGetEventStatus_GetEventStatus_EvtInfo_AutoCreatedDemEvent_CHNL_df893ad5_CANSM_E_MODE_REQUEST_TIMEOUT: start-on-event=DemSatellite_OsApplication_Untrusted_Core0InternalBehavior/GetEventStatus, operation=EvtInfo_AutoCreatedDemEvent_CHNL_df893ad5_CANSM_E_MODE_REQUEST_TIMEOUT.GetEventStatus
        OpEventGetEventStatus_GetEventStatus_EvtInfo_AutoCreatedDemEvent_CHNL_df893ad5_CANSM_E_BUS_OFF: start-on-event=DemSatellite_OsApplication_Untrusted_Core0InternalBehavior/GetEventStatus, operation=EvtInfo_AutoCreatedDemEvent_CHNL_df893ad5_CANSM_E_BUS_OFF.GetEventStatus
        OpEventGetEventStatus_GetEventStatus_EvtInfo_AutoCreatedDemEvent_CHNL_e058b4ae_CANSM_E_MODE_REQUEST_TIMEOUT: start-on-event=DemSatellite_OsApplication_Untrusted_Core0InternalBehavior/GetEventStatus, operation=EvtInfo_AutoCreatedDemEvent_CHNL_e058b4ae_CANSM_E_MODE_REQUEST_TIMEOUT.GetEventStatus
        OpEventGetEventStatus_GetEventStatus_EvtInfo_AutoCreatedDemEvent_CHNL_e058b4ae_CANSM_E_BUS_OFF: start-on-event=DemSatellite_OsApplication_Untrusted_Core0InternalBehavior/GetEventStatus, operation=EvtInfo_AutoCreatedDemEvent_CHNL_e058b4ae_CANSM_E_BUS_OFF.GetEventStatus
        OpEventGetEventStatus_GetEventStatus_EvtInfo_AutoCreatedDemEvent_ECUM_E_RAM_CHECK_FAILED: start-on-event=DemSatellite_OsApplication_Untrusted_Core0InternalBehavior/GetEventStatus, operation=EvtInfo_AutoCreatedDemEvent_ECUM_E_RAM_CHECK_FAILED.GetEventStatus
        OpEventGetEventStatus_GetEventStatus_EvtInfo_AutoCreatedDemEvent_ECUM_E_IMPROPER_CALLER: start-on-event=DemSatellite_OsApplication_Untrusted_Core0InternalBehavior/GetEventStatus, operation=EvtInfo_AutoCreatedDemEvent_ECUM_E_IMPROPER_CALLER.GetEventStatus
        OpEventGetEventStatus_GetEventStatus_EvtInfo_AutoCreatedDemEvent_ECUM_E_CONFIGURATION_DATA_INCONSISTENT: start-on-event=DemSatellite_OsApplication_Untrusted_Core0InternalBehavior/GetEventStatus, operation=EvtInfo_AutoCreatedDemEvent_ECUM_E_CONFIGURATION_DATA_INCONSISTENT.GetEventStatus
        OpEventGetEventStatus_GetEventStatus_EvtInfo_AutoCreatedDemEvent_ECUM_E_ALL_RUN_REQUESTS_KILLED: start-on-event=DemSatellite_OsApplication_Untrusted_Core0InternalBehavior/GetEventStatus, operation=EvtInfo_AutoCreatedDemEvent_ECUM_E_ALL_RUN_REQUESTS_KILLED.GetEventStatus
        OpEventGetEventStatus_GetEventStatus_EvtInfo_AutoCreatedDemEvent_FLS_E_WRITE_FAILED: start-on-event=DemSatellite_OsApplication_Untrusted_Core0InternalBehavior/GetEventStatus, operation=EvtInfo_AutoCreatedDemEvent_FLS_E_WRITE_FAILED.GetEventStatus
        OpEventGetEventStatus_GetEventStatus_EvtInfo_AutoCreatedDemEvent_FLS_E_UNEXPECTED_FLASH_ID: start-on-event=DemSatellite_OsApplication_Untrusted_Core0InternalBehavior/GetEventStatus, operation=EvtInfo_AutoCreatedDemEvent_FLS_E_UNEXPECTED_FLASH_ID.GetEventStatus
        OpEventGetEventStatus_GetEventStatus_EvtInfo_AutoCreatedDemEvent_FLS_E_READ_FAILED: start-on-event=DemSatellite_OsApplication_Untrusted_Core0InternalBehavior/GetEventStatus, operation=EvtInfo_AutoCreatedDemEvent_FLS_E_READ_FAILED.GetEventStatus
        OpEventGetEventStatus_GetEventStatus_EvtInfo_AutoCreatedDemEvent_FLS_E_ERASE_FAILED: start-on-event=DemSatellite_OsApplication_Untrusted_Core0InternalBehavior/GetEventStatus, operation=EvtInfo_AutoCreatedDemEvent_FLS_E_ERASE_FAILED.GetEventStatus
        OpEventGetEventStatus_GetEventStatus_EvtInfo_AutoCreatedDemEvent_FLS_E_COMPARE_FAILED: start-on-event=DemSatellite_OsApplication_Untrusted_Core0InternalBehavior/GetEventStatus, operation=EvtInfo_AutoCreatedDemEvent_FLS_E_COMPARE_FAILED.GetEventStatus
        OpEventGetEventStatus_GetEventStatus_EvtInfo_AutoCreatedDemEvent_GPT_E_TIMEOUT: start-on-event=DemSatellite_OsApplication_Untrusted_Core0InternalBehavior/GetEventStatus, operation=EvtInfo_AutoCreatedDemEvent_GPT_E_TIMEOUT.GetEventStatus
        OpEventGetEventStatus_GetEventStatus_EvtInfo_AutoCreatedDemEvent_J1939NM_E_ADDRESS_LOST: start-on-event=DemSatellite_OsApplication_Untrusted_Core0InternalBehavior/GetEventStatus, operation=EvtInfo_AutoCreatedDemEvent_J1939NM_E_ADDRESS_LOST.GetEventStatus
        OpEventGetEventStatus_GetEventStatus_EvtInfo_AutoCreatedDemEvent_J1939TpConfiguration_J1939TP_E_COMMUNICATION: start-on-event=DemSatellite_OsApplication_Untrusted_Core0InternalBehavior/GetEventStatus, operation=EvtInfo_AutoCreatedDemEvent_J1939TpConfiguration_J1939TP_E_COMMUNICATION.GetEventStatus
        OpEventGetEventStatus_GetEventStatus_EvtInfo_AutoCreatedDemEvent_LIN_E_TIMEOUT: start-on-event=DemSatellite_OsApplication_Untrusted_Core0InternalBehavior/GetEventStatus, operation=EvtInfo_AutoCreatedDemEvent_LIN_E_TIMEOUT.GetEventStatus
        OpEventGetEventStatus_GetEventStatus_EvtInfo_AutoCreatedDemEvent_MCL_E_DMA_UNRECOGNIZED: start-on-event=DemSatellite_OsApplication_Untrusted_Core0InternalBehavior/GetEventStatus, operation=EvtInfo_AutoCreatedDemEvent_MCL_E_DMA_UNRECOGNIZED.GetEventStatus
        OpEventGetEventStatus_GetEventStatus_EvtInfo_AutoCreatedDemEvent_MCL_E_DMA_PRIORITY: start-on-event=DemSatellite_OsApplication_Untrusted_Core0InternalBehavior/GetEventStatus, operation=EvtInfo_AutoCreatedDemEvent_MCL_E_DMA_PRIORITY.GetEventStatus
        OpEventGetEventStatus_GetEventStatus_EvtInfo_AutoCreatedDemEvent_MCL_E_DMA_INCONSISTENCY: start-on-event=DemSatellite_OsApplication_Untrusted_Core0InternalBehavior/GetEventStatus, operation=EvtInfo_AutoCreatedDemEvent_MCL_E_DMA_INCONSISTENCY.GetEventStatus
        OpEventGetEventStatus_GetEventStatus_EvtInfo_AutoCreatedDemEvent_MCL_E_DMA_ECC: start-on-event=DemSatellite_OsApplication_Untrusted_Core0InternalBehavior/GetEventStatus, operation=EvtInfo_AutoCreatedDemEvent_MCL_E_DMA_ECC.GetEventStatus
        OpEventGetEventStatus_GetEventStatus_EvtInfo_AutoCreatedDemEvent_MCL_E_DMA_DESCRIPTOR: start-on-event=DemSatellite_OsApplication_Untrusted_Core0InternalBehavior/GetEventStatus, operation=EvtInfo_AutoCreatedDemEvent_MCL_E_DMA_DESCRIPTOR.GetEventStatus
        OpEventGetEventStatus_GetEventStatus_EvtInfo_AutoCreatedDemEvent_MCL_E_DMA_BUS: start-on-event=DemSatellite_OsApplication_Untrusted_Core0InternalBehavior/GetEventStatus, operation=EvtInfo_AutoCreatedDemEvent_MCL_E_DMA_BUS.GetEventStatus
        OpEventGetEventStatus_GetEventStatus_EvtInfo_AutoCreatedDemEvent_MCU_E_TIMEOUT_FAILURE: start-on-event=DemSatellite_OsApplication_Untrusted_Core0InternalBehavior/GetEventStatus, operation=EvtInfo_AutoCreatedDemEvent_MCU_E_TIMEOUT_FAILURE.GetEventStatus
        OpEventGetEventStatus_GetEventStatus_EvtInfo_AutoCreatedDemEvent_MCU_E_SSCM_CER_FAILURE: start-on-event=DemSatellite_OsApplication_Untrusted_Core0InternalBehavior/GetEventStatus, operation=EvtInfo_AutoCreatedDemEvent_MCU_E_SSCM_CER_FAILURE.GetEventStatus
        OpEventGetEventStatus_GetEventStatus_EvtInfo_AutoCreatedDemEvent_MCU_E_INVALIDMODE_CONFIG: start-on-event=DemSatellite_OsApplication_Untrusted_Core0InternalBehavior/GetEventStatus, operation=EvtInfo_AutoCreatedDemEvent_MCU_E_INVALIDMODE_CONFIG.GetEventStatus
        OpEventGetEventStatus_GetEventStatus_EvtInfo_AutoCreatedDemEvent_MCU_E_CLOCK_FAILURE: start-on-event=DemSatellite_OsApplication_Untrusted_Core0InternalBehavior/GetEventStatus, operation=EvtInfo_AutoCreatedDemEvent_MCU_E_CLOCK_FAILURE.GetEventStatus
        OpEventGetEventStatus_GetEventStatus_EvtInfo_AutoCreatedDemEvent_NVM_E_WRONG_BLOCK_ID: start-on-event=DemSatellite_OsApplication_Untrusted_Core0InternalBehavior/GetEventStatus, operation=EvtInfo_AutoCreatedDemEvent_NVM_E_WRONG_BLOCK_ID.GetEventStatus
        OpEventGetEventStatus_GetEventStatus_EvtInfo_AutoCreatedDemEvent_NVM_E_WRITE_PROTECTED: start-on-event=DemSatellite_OsApplication_Untrusted_Core0InternalBehavior/GetEventStatus, operation=EvtInfo_AutoCreatedDemEvent_NVM_E_WRITE_PROTECTED.GetEventStatus
        OpEventGetEventStatus_GetEventStatus_EvtInfo_AutoCreatedDemEvent_NVM_E_VERIFY_FAILED: start-on-event=DemSatellite_OsApplication_Untrusted_Core0InternalBehavior/GetEventStatus, operation=EvtInfo_AutoCreatedDemEvent_NVM_E_VERIFY_FAILED.GetEventStatus
        OpEventGetEventStatus_GetEventStatus_EvtInfo_AutoCreatedDemEvent_NVM_E_REQ_FAILED: start-on-event=DemSatellite_OsApplication_Untrusted_Core0InternalBehavior/GetEventStatus, operation=EvtInfo_AutoCreatedDemEvent_NVM_E_REQ_FAILED.GetEventStatus
        OpEventGetEventStatus_GetEventStatus_EvtInfo_AutoCreatedDemEvent_NVM_E_QUEUE_OVERFLOW: start-on-event=DemSatellite_OsApplication_Untrusted_Core0InternalBehavior/GetEventStatus, operation=EvtInfo_AutoCreatedDemEvent_NVM_E_QUEUE_OVERFLOW.GetEventStatus
        OpEventGetEventStatus_GetEventStatus_EvtInfo_AutoCreatedDemEvent_NVM_E_LOSS_OF_REDUNDANCY: start-on-event=DemSatellite_OsApplication_Untrusted_Core0InternalBehavior/GetEventStatus, operation=EvtInfo_AutoCreatedDemEvent_NVM_E_LOSS_OF_REDUNDANCY.GetEventStatus
        OpEventGetEventStatus_GetEventStatus_EvtInfo_AutoCreatedDemEvent_NVM_E_INTEGRITY_FAILED: start-on-event=DemSatellite_OsApplication_Untrusted_Core0InternalBehavior/GetEventStatus, operation=EvtInfo_AutoCreatedDemEvent_NVM_E_INTEGRITY_FAILED.GetEventStatus
        OpEventGetEventStatus_GetEventStatus_EvtInfo_AutoCreatedDemEvent_SPI_E_HARDWARE_ERROR: start-on-event=DemSatellite_OsApplication_Untrusted_Core0InternalBehavior/GetEventStatus, operation=EvtInfo_AutoCreatedDemEvent_SPI_E_HARDWARE_ERROR.GetEventStatus
        OpEventGetEventStatus_GetEventStatus_EvtInfo_AutoCreatedDemEvent_SpiDriver_SPI_E_HARDWARE_ERROR: start-on-event=DemSatellite_OsApplication_Untrusted_Core0InternalBehavior/GetEventStatus, operation=EvtInfo_AutoCreatedDemEvent_SpiDriver_SPI_E_HARDWARE_ERROR.GetEventStatus
        OpEventGetEventStatus_GetEventStatus_EvtInfo_AutoCreatedDemEvent_WDG_E_UNLOCKED: start-on-event=DemSatellite_OsApplication_Untrusted_Core0InternalBehavior/GetEventStatus, operation=EvtInfo_AutoCreatedDemEvent_WDG_E_UNLOCKED.GetEventStatus
        OpEventGetEventStatus_GetEventStatus_EvtInfo_AutoCreatedDemEvent_WDG_E_MODE_FAILED: start-on-event=DemSatellite_OsApplication_Untrusted_Core0InternalBehavior/GetEventStatus, operation=EvtInfo_AutoCreatedDemEvent_WDG_E_MODE_FAILED.GetEventStatus
        OpEventGetEventStatus_GetEventStatus_EvtInfo_AutoCreatedDemEvent_WDG_E_INVALID_PARAMETER: start-on-event=DemSatellite_OsApplication_Untrusted_Core0InternalBehavior/GetEventStatus, operation=EvtInfo_AutoCreatedDemEvent_WDG_E_INVALID_PARAMETER.GetEventStatus
        OpEventGetEventStatus_GetEventStatus_EvtInfo_AutoCreatedDemEvent_WDG_E_INVALID_CALL: start-on-event=DemSatellite_OsApplication_Untrusted_Core0InternalBehavior/GetEventStatus, operation=EvtInfo_AutoCreatedDemEvent_WDG_E_INVALID_CALL.GetEventStatus
        OpEventGetEventStatus_GetEventStatus_EvtInfo_AutoCreatedDemEvent_WDG_E_FORBIDDEN_INVOCATION: start-on-event=DemSatellite_OsApplication_Untrusted_Core0InternalBehavior/GetEventStatus, operation=EvtInfo_AutoCreatedDemEvent_WDG_E_FORBIDDEN_INVOCATION.GetEventStatus
        OpEventGetEventStatus_GetEventStatus_EvtInfo_AutoCreatedDemEvent_WDG_E_DISABLE_REJECTED: start-on-event=DemSatellite_OsApplication_Untrusted_Core0InternalBehavior/GetEventStatus, operation=EvtInfo_AutoCreatedDemEvent_WDG_E_DISABLE_REJECTED.GetEventStatus
        OpEventGetEventStatus_GetEventStatus_EvtInfo_AutoCreatedDemEvent_WDG_E_CORRUPT_CONFIG: start-on-event=DemSatellite_OsApplication_Untrusted_Core0InternalBehavior/GetEventStatus, operation=EvtInfo_AutoCreatedDemEvent_WDG_E_CORRUPT_CONFIG.GetEventStatus
        OpEventGetEventFailed_GetEventFailed_EvtInfo_AutoCreatedDemEvent_ADC_E_TIMEOUT: start-on-event=DemSatellite_OsApplication_Untrusted_Core0InternalBehavior/GetEventFailed, operation=EvtInfo_AutoCreatedDemEvent_ADC_E_TIMEOUT.GetEventFailed
        OpEventGetEventFailed_GetEventFailed_EvtInfo_AutoCreatedDemEvent_CC_DisableDM_CIOM_oCabSubnet_Rx_063a5fbc_BswMReportFailToDemRef: start-on-event=DemSatellite_OsApplication_Untrusted_Core0InternalBehavior/GetEventFailed, operation=EvtInfo_AutoCreatedDemEvent_CC_DisableDM_CIOM_oCabSubnet_Rx_063a5fbc_BswMReportFailToDemRef.GetEventFailed
        OpEventGetEventFailed_GetEventFailed_EvtInfo_AutoCreatedDemEvent_CC_J1939RmStateSwitch_CN_Backbone1J1939_0b1f4bae_CIOM_a176826a: start-on-event=DemSatellite_OsApplication_Untrusted_Core0InternalBehavior/GetEventFailed, operation=EvtInfo_AutoCreatedDemEvent_CC_J1939RmStateSwitch_CN_Backbone1J1939_0b1f4bae_CIOM_4d5cd289_J1939RM_STATE_OFFLINE_BswMRe_5a5b15b8.GetEventFailed
        OpEventGetEventFailed_GetEventFailed_EvtInfo_AutoCreatedDemEvent_CC_J1939RmStateSwitch_CN_Backbone1J1939_0b1f4bae_CIOM_dc29b2f9: start-on-event=DemSatellite_OsApplication_Untrusted_Core0InternalBehavior/GetEventFailed, operation=EvtInfo_AutoCreatedDemEvent_CC_J1939RmStateSwitch_CN_Backbone1J1939_0b1f4bae_CIOM_4d5cd289_J1939RM_STATE_ONLINE_BswMRep_ec959aed.GetEventFailed
        OpEventGetEventFailed_GetEventFailed_EvtInfo_AutoCreatedDemEvent_CC_DisablePDUGroup_CIOM_oLIN04_Tx_04202f7b_BswMReportF_aae332e1: start-on-event=DemSatellite_OsApplication_Untrusted_Core0InternalBehavior/GetEventFailed, operation=EvtInfo_AutoCreatedDemEvent_CC_DisablePDUGroup_CIOM_oLIN04_Tx_04202f7b_BswMReportFailToDemRef.GetEventFailed
        OpEventGetEventFailed_GetEventFailed_EvtInfo_AutoCreatedDemEvent_CC_DisablePDUGroup_CIOM_oLIN04_Rx_527a88fd_BswMReportF_6341571f: start-on-event=DemSatellite_OsApplication_Untrusted_Core0InternalBehavior/GetEventFailed, operation=EvtInfo_AutoCreatedDemEvent_CC_DisablePDUGroup_CIOM_oLIN04_Rx_527a88fd_BswMReportFailToDemRef.GetEventFailed
        OpEventGetEventFailed_GetEventFailed_EvtInfo_AutoCreatedDemEvent_CC_DisablePDUGroup_CIOM_oLIN01_Tx_33fedf49_BswMReportF_d15b9b98: start-on-event=DemSatellite_OsApplication_Untrusted_Core0InternalBehavior/GetEventFailed, operation=EvtInfo_AutoCreatedDemEvent_CC_DisablePDUGroup_CIOM_oLIN01_Tx_33fedf49_BswMReportFailToDemRef.GetEventFailed
        OpEventGetEventFailed_GetEventFailed_EvtInfo_AutoCreatedDemEvent_CC_DisablePDUGroup_CIOM_oLIN01_Rx_65a478cf_BswMReportF_ef6b3112: start-on-event=DemSatellite_OsApplication_Untrusted_Core0InternalBehavior/GetEventFailed, operation=EvtInfo_AutoCreatedDemEvent_CC_DisablePDUGroup_CIOM_oLIN01_Rx_65a478cf_BswMReportFailToDemRef.GetEventFailed
        OpEventGetEventFailed_GetEventFailed_EvtInfo_AutoCreatedDemEvent_CC_EnablePDUGroup_CIOM_oLIN04_Tx_04202f7b_BswMReportFa_5c106b7a: start-on-event=DemSatellite_OsApplication_Untrusted_Core0InternalBehavior/GetEventFailed, operation=EvtInfo_AutoCreatedDemEvent_CC_EnablePDUGroup_CIOM_oLIN04_Tx_04202f7b_BswMReportFailToDemRef.GetEventFailed
        OpEventGetEventFailed_GetEventFailed_EvtInfo_AutoCreatedDemEvent_CC_EnablePDUGroup_CIOM_oLIN04_Rx_527a88fd_BswMReportFa_95b20e84: start-on-event=DemSatellite_OsApplication_Untrusted_Core0InternalBehavior/GetEventFailed, operation=EvtInfo_AutoCreatedDemEvent_CC_EnablePDUGroup_CIOM_oLIN04_Rx_527a88fd_BswMReportFailToDemRef.GetEventFailed
        OpEventGetEventFailed_GetEventFailed_EvtInfo_AutoCreatedDemEvent_CC_DisableDM_CIOM_oBackbone2_Rx_4e624434_BswMReportFailToDemRef: start-on-event=DemSatellite_OsApplication_Untrusted_Core0InternalBehavior/GetEventFailed, operation=EvtInfo_AutoCreatedDemEvent_CC_DisableDM_CIOM_oBackbone2_Rx_4e624434_BswMReportFailToDemRef.GetEventFailed
        OpEventGetEventFailed_GetEventFailed_EvtInfo_AutoCreatedDemEvent_CC_EnableDM_CIOM_oBackbone2_Rx_4e624434_BswMReportFailToDemRef: start-on-event=DemSatellite_OsApplication_Untrusted_Core0InternalBehavior/GetEventFailed, operation=EvtInfo_AutoCreatedDemEvent_CC_EnableDM_CIOM_oBackbone2_Rx_4e624434_BswMReportFailToDemRef.GetEventFailed
        OpEventGetEventFailed_GetEventFailed_EvtInfo_AutoCreatedDemEvent_CC_DisableDM_CIOM_oSecuritySubnet_Rx_3a3c1dbc_BswMRepo_12755238: start-on-event=DemSatellite_OsApplication_Untrusted_Core0InternalBehavior/GetEventFailed, operation=EvtInfo_AutoCreatedDemEvent_CC_DisableDM_CIOM_oSecuritySubnet_Rx_3a3c1dbc_BswMReportFailToDemRef.GetEventFailed
        OpEventGetEventFailed_GetEventFailed_EvtInfo_AutoCreatedDemEvent_CC_EnableDM_CIOM_oSecuritySubnet_Rx_3a3c1dbc_BswMRepor_acfe4064: start-on-event=DemSatellite_OsApplication_Untrusted_Core0InternalBehavior/GetEventFailed, operation=EvtInfo_AutoCreatedDemEvent_CC_EnableDM_CIOM_oSecuritySubnet_Rx_3a3c1dbc_BswMReportFailToDemRef.GetEventFailed
        OpEventGetEventFailed_GetEventFailed_EvtInfo_AutoCreatedDemEvent_CC_DisablePDUGroup_CIOM_oCabSubnet_Tx_5060f83a_BswMRep_0da1fa51: start-on-event=DemSatellite_OsApplication_Untrusted_Core0InternalBehavior/GetEventFailed, operation=EvtInfo_AutoCreatedDemEvent_CC_DisablePDUGroup_CIOM_oCabSubnet_Tx_5060f83a_BswMReportFailToDemRef.GetEventFailed
        OpEventGetEventFailed_GetEventFailed_EvtInfo_AutoCreatedDemEvent_CC_EnablePDUGroup_CIOM_oCabSubnet_Tx_5060f83a_BswMRepo_6fc26c9c: start-on-event=DemSatellite_OsApplication_Untrusted_Core0InternalBehavior/GetEventFailed, operation=EvtInfo_AutoCreatedDemEvent_CC_EnablePDUGroup_CIOM_oCabSubnet_Tx_5060f83a_BswMReportFailToDemRef.GetEventFailed
        OpEventGetEventFailed_GetEventFailed_EvtInfo_AutoCreatedDemEvent_CC_EnableDM_CIOM_oCabSubnet_Rx_063a5fbc_BswMReportFailToDemRef: start-on-event=DemSatellite_OsApplication_Untrusted_Core0InternalBehavior/GetEventFailed, operation=EvtInfo_AutoCreatedDemEvent_CC_EnableDM_CIOM_oCabSubnet_Rx_063a5fbc_BswMReportFailToDemRef.GetEventFailed
        OpEventGetEventFailed_GetEventFailed_EvtInfo_AutoCreatedDemEvent_CC_DisablePDUGroup_CIOM_oBackbone2_Tx_1838e3b2_BswMRep_6ffc677f: start-on-event=DemSatellite_OsApplication_Untrusted_Core0InternalBehavior/GetEventFailed, operation=EvtInfo_AutoCreatedDemEvent_CC_DisablePDUGroup_CIOM_oBackbone2_Tx_1838e3b2_BswMReportFailToDemRef.GetEventFailed
        OpEventGetEventFailed_GetEventFailed_EvtInfo_AutoCreatedDemEvent_CC_EnablePDUGroup_CIOM_oBackbone2_Tx_1838e3b2_BswMRepo_0d9ff1b2: start-on-event=DemSatellite_OsApplication_Untrusted_Core0InternalBehavior/GetEventFailed, operation=EvtInfo_AutoCreatedDemEvent_CC_EnablePDUGroup_CIOM_oBackbone2_Tx_1838e3b2_BswMReportFailToDemRef.GetEventFailed
        OpEventGetEventFailed_GetEventFailed_EvtInfo_AutoCreatedDemEvent_CC_DisablePDUGroup_CIOM_oBackbone2_Rx_4e624434_BswMRep_9a88c6f5: start-on-event=DemSatellite_OsApplication_Untrusted_Core0InternalBehavior/GetEventFailed, operation=EvtInfo_AutoCreatedDemEvent_CC_DisablePDUGroup_CIOM_oBackbone2_Rx_4e624434_BswMReportFailToDemRef.GetEventFailed
        OpEventGetEventFailed_GetEventFailed_EvtInfo_AutoCreatedDemEvent_CC_EnablePDUGroup_CIOM_oBackbone2_Rx_4e624434_BswMRepo_f8eb5038: start-on-event=DemSatellite_OsApplication_Untrusted_Core0InternalBehavior/GetEventFailed, operation=EvtInfo_AutoCreatedDemEvent_CC_EnablePDUGroup_CIOM_oBackbone2_Rx_4e624434_BswMReportFailToDemRef.GetEventFailed
        OpEventGetEventFailed_GetEventFailed_EvtInfo_AutoCreatedDemEvent_CC_DisablePDUGroup_CIOM_oBackbone1J1939_Rx_BC_405bc776_c3bef512: start-on-event=DemSatellite_OsApplication_Untrusted_Core0InternalBehavior/GetEventFailed, operation=EvtInfo_AutoCreatedDemEvent_CC_DisablePDUGroup_CIOM_oBackbone1J1939_Rx_BC_405bc776_BswMReportFailToDemRef.GetEventFailed
        OpEventGetEventFailed_GetEventFailed_EvtInfo_AutoCreatedDemEvent_CC_EnablePDUGroup_CIOM_oBackbone1J1939_Rx_BC_405bc776_c397bd2b: start-on-event=DemSatellite_OsApplication_Untrusted_Core0InternalBehavior/GetEventFailed, operation=EvtInfo_AutoCreatedDemEvent_CC_EnablePDUGroup_CIOM_oBackbone1J1939_Rx_BC_405bc776_BswMReportFailToDemRef.GetEventFailed
        OpEventGetEventFailed_GetEventFailed_EvtInfo_AutoCreatedDemEvent_CC_EnablePDUGroup_CIOM_oLIN02_Tx_214b70a7_BswMReportFa_c638a110: start-on-event=DemSatellite_OsApplication_Untrusted_Core0InternalBehavior/GetEventFailed, operation=EvtInfo_AutoCreatedDemEvent_CC_EnablePDUGroup_CIOM_oLIN02_Tx_214b70a7_BswMReportFailToDemRef.GetEventFailed
        OpEventGetEventFailed_GetEventFailed_EvtInfo_AutoCreatedDemEvent_CC_EnablePDUGroup_CIOM_oLIN02_Rx_7711d721_BswMReportFa_10f26272: start-on-event=DemSatellite_OsApplication_Untrusted_Core0InternalBehavior/GetEventFailed, operation=EvtInfo_AutoCreatedDemEvent_CC_EnablePDUGroup_CIOM_oLIN02_Rx_7711d721_BswMReportFailToDemRef.GetEventFailed
        OpEventGetEventFailed_GetEventFailed_EvtInfo_AutoCreatedDemEvent_CC_EnablePDUGroup_CIOM_oLIN01_Tx_33fedf49_BswMReportFa_27a8c203: start-on-event=DemSatellite_OsApplication_Untrusted_Core0InternalBehavior/GetEventFailed, operation=EvtInfo_AutoCreatedDemEvent_CC_EnablePDUGroup_CIOM_oLIN01_Tx_33fedf49_BswMReportFailToDemRef.GetEventFailed
        OpEventGetEventFailed_GetEventFailed_EvtInfo_AutoCreatedDemEvent_CC_EnablePDUGroup_CIOM_oLIN01_Rx_65a478cf_BswMReportFa_19986889: start-on-event=DemSatellite_OsApplication_Untrusted_Core0InternalBehavior/GetEventFailed, operation=EvtInfo_AutoCreatedDemEvent_CC_EnablePDUGroup_CIOM_oLIN01_Rx_65a478cf_BswMReportFailToDemRef.GetEventFailed
        OpEventGetEventFailed_GetEventFailed_EvtInfo_AutoCreatedDemEvent_CC_DisablePDUGroup_CIOM_oLIN03_Tx_99f717c2_BswMReportF_a2312843: start-on-event=DemSatellite_OsApplication_Untrusted_Core0InternalBehavior/GetEventFailed, operation=EvtInfo_AutoCreatedDemEvent_CC_DisablePDUGroup_CIOM_oLIN03_Tx_99f717c2_BswMReportFailToDemRef.GetEventFailed
        OpEventGetEventFailed_GetEventFailed_EvtInfo_AutoCreatedDemEvent_CC_DisablePDUGroup_CIOM_oLIN03_Rx_cfadb044_BswMReportF_9b9c4dbd: start-on-event=DemSatellite_OsApplication_Untrusted_Core0InternalBehavior/GetEventFailed, operation=EvtInfo_AutoCreatedDemEvent_CC_DisablePDUGroup_CIOM_oLIN03_Rx_cfadb044_BswMReportFailToDemRef.GetEventFailed
        OpEventGetEventFailed_GetEventFailed_EvtInfo_AutoCreatedDemEvent_CC_DisableDM_CIOM_oFMSNet_Rx_BC_dd2c1510_BswMReportFailToDemRef: start-on-event=DemSatellite_OsApplication_Untrusted_Core0InternalBehavior/GetEventFailed, operation=EvtInfo_AutoCreatedDemEvent_CC_DisableDM_CIOM_oFMSNet_Rx_BC_dd2c1510_BswMReportFailToDemRef.GetEventFailed
        OpEventGetEventFailed_GetEventFailed_EvtInfo_AutoCreatedDemEvent_CC_EnableDM_CIOM_oFMSNet_Rx_BC_dd2c1510_BswMReportFailToDemRef: start-on-event=DemSatellite_OsApplication_Untrusted_Core0InternalBehavior/GetEventFailed, operation=EvtInfo_AutoCreatedDemEvent_CC_EnableDM_CIOM_oFMSNet_Rx_BC_dd2c1510_BswMReportFailToDemRef.GetEventFailed
        OpEventGetEventFailed_GetEventFailed_EvtInfo_AutoCreatedDemEvent_CC_EnablePDUGroup_CIOM_oLIN03_Tx_99f717c2_BswMReportFa_54c271d8: start-on-event=DemSatellite_OsApplication_Untrusted_Core0InternalBehavior/GetEventFailed, operation=EvtInfo_AutoCreatedDemEvent_CC_EnablePDUGroup_CIOM_oLIN03_Tx_99f717c2_BswMReportFailToDemRef.GetEventFailed
        OpEventGetEventFailed_GetEventFailed_EvtInfo_AutoCreatedDemEvent_CC_EnablePDUGroup_CIOM_oLIN03_Rx_cfadb044_BswMReportFa_6d6f1426: start-on-event=DemSatellite_OsApplication_Untrusted_Core0InternalBehavior/GetEventFailed, operation=EvtInfo_AutoCreatedDemEvent_CC_EnablePDUGroup_CIOM_oLIN03_Rx_cfadb044_BswMReportFailToDemRef.GetEventFailed
        OpEventGetEventFailed_GetEventFailed_EvtInfo_AutoCreatedDemEvent_CC_DisablePDUGroup_CIOM_oLIN02_Tx_214b70a7_BswMReportF_30cbf88b: start-on-event=DemSatellite_OsApplication_Untrusted_Core0InternalBehavior/GetEventFailed, operation=EvtInfo_AutoCreatedDemEvent_CC_DisablePDUGroup_CIOM_oLIN02_Tx_214b70a7_BswMReportFailToDemRef.GetEventFailed
        OpEventGetEventFailed_GetEventFailed_EvtInfo_AutoCreatedDemEvent_CC_DisablePDUGroup_CIOM_oLIN02_Rx_7711d721_BswMReportF_e6013be9: start-on-event=DemSatellite_OsApplication_Untrusted_Core0InternalBehavior/GetEventFailed, operation=EvtInfo_AutoCreatedDemEvent_CC_DisablePDUGroup_CIOM_oLIN02_Rx_7711d721_BswMReportFailToDemRef.GetEventFailed
        OpEventGetEventFailed_GetEventFailed_EvtInfo_AutoCreatedDemEvent_CC_DisablePDUGroup_CIOM_oCabSubnet_Rx_063a5fbc_BswMRep_fddccc7b: start-on-event=DemSatellite_OsApplication_Untrusted_Core0InternalBehavior/GetEventFailed, operation=EvtInfo_AutoCreatedDemEvent_CC_DisablePDUGroup_CIOM_oCabSubnet_Rx_063a5fbc_BswMReportFailToDemRef.GetEventFailed
        OpEventGetEventFailed_GetEventFailed_EvtInfo_AutoCreatedDemEvent_CC_EnablePDUGroup_CIOM_oCabSubnet_Rx_063a5fbc_BswMRepo_9fbf5ab6: start-on-event=DemSatellite_OsApplication_Untrusted_Core0InternalBehavior/GetEventFailed, operation=EvtInfo_AutoCreatedDemEvent_CC_EnablePDUGroup_CIOM_oCabSubnet_Rx_063a5fbc_BswMReportFailToDemRef.GetEventFailed
        OpEventGetEventFailed_GetEventFailed_EvtInfo_AutoCreatedDemEvent_CC_DisablePDUGroup_CIOM_oFMSNet_Rx_BC_dd2c1510_BswMRep_b52b54a6: start-on-event=DemSatellite_OsApplication_Untrusted_Core0InternalBehavior/GetEventFailed, operation=EvtInfo_AutoCreatedDemEvent_CC_DisablePDUGroup_CIOM_oFMSNet_Rx_BC_dd2c1510_BswMReportFailToDemRef.GetEventFailed
        OpEventGetEventFailed_GetEventFailed_EvtInfo_AutoCreatedDemEvent_CC_EnablePDUGroup_CIOM_oFMSNet_Rx_BC_dd2c1510_BswMRepo_d748c26b: start-on-event=DemSatellite_OsApplication_Untrusted_Core0InternalBehavior/GetEventFailed, operation=EvtInfo_AutoCreatedDemEvent_CC_EnablePDUGroup_CIOM_oFMSNet_Rx_BC_dd2c1510_BswMReportFailToDemRef.GetEventFailed
        OpEventGetEventFailed_GetEventFailed_EvtInfo_AutoCreatedDemEvent_CC_DisablePDUGroup_CIOM_oSecuritySubnet_Rx_3a3c1dbc_Bs_0fc9ad1a: start-on-event=DemSatellite_OsApplication_Untrusted_Core0InternalBehavior/GetEventFailed, operation=EvtInfo_AutoCreatedDemEvent_CC_DisablePDUGroup_CIOM_oSecuritySubnet_Rx_3a3c1dbc_BswMReportFailToDemRef.GetEventFailed
        OpEventGetEventFailed_GetEventFailed_EvtInfo_AutoCreatedDemEvent_CC_EnablePDUGroup_CIOM_oSecuritySubnet_Rx_3a3c1dbc_Bsw_9b3d4354: start-on-event=DemSatellite_OsApplication_Untrusted_Core0InternalBehavior/GetEventFailed, operation=EvtInfo_AutoCreatedDemEvent_CC_EnablePDUGroup_CIOM_oSecuritySubnet_Rx_3a3c1dbc_BswMReportFailToDemRef.GetEventFailed
        OpEventGetEventFailed_GetEventFailed_EvtInfo_AutoCreatedDemEvent_CC_DisablePDUGroup_CIOM_oFMSNet_Tx_0x31_BC_38fc8c7d_Bs_20ab0017: start-on-event=DemSatellite_OsApplication_Untrusted_Core0InternalBehavior/GetEventFailed, operation=EvtInfo_AutoCreatedDemEvent_CC_DisablePDUGroup_CIOM_oFMSNet_Tx_0x31_BC_38fc8c7d_BswMReportFailToDemRef.GetEventFailed
        OpEventGetEventFailed_GetEventFailed_EvtInfo_AutoCreatedDemEvent_CC_EnablePDUGroup_CIOM_oFMSNet_Tx_0x31_BC_38fc8c7d_Bsw_b45fee59: start-on-event=DemSatellite_OsApplication_Untrusted_Core0InternalBehavior/GetEventFailed, operation=EvtInfo_AutoCreatedDemEvent_CC_EnablePDUGroup_CIOM_oFMSNet_Tx_0x31_BC_38fc8c7d_BswMReportFailToDemRef.GetEventFailed
        OpEventGetEventFailed_GetEventFailed_EvtInfo_AutoCreatedDemEvent_CC_DisablePDUGroup_CIOM_oSecuritySubnet_Tx_6c66ba3a_Bs_c1161f7b: start-on-event=DemSatellite_OsApplication_Untrusted_Core0InternalBehavior/GetEventFailed, operation=EvtInfo_AutoCreatedDemEvent_CC_DisablePDUGroup_CIOM_oSecuritySubnet_Tx_6c66ba3a_BswMReportFailToDemRef.GetEventFailed
        OpEventGetEventFailed_GetEventFailed_EvtInfo_AutoCreatedDemEvent_CC_EnablePDUGroup_CIOM_oSecuritySubnet_Tx_6c66ba3a_Bsw_55e2f135: start-on-event=DemSatellite_OsApplication_Untrusted_Core0InternalBehavior/GetEventFailed, operation=EvtInfo_AutoCreatedDemEvent_CC_EnablePDUGroup_CIOM_oSecuritySubnet_Tx_6c66ba3a_BswMReportFailToDemRef.GetEventFailed
        OpEventGetEventFailed_GetEventFailed_EvtInfo_AutoCreatedDemEvent_CC_DisablePDUGroup_CIOM_oLIN00_Tx_8b42b82c_BswMReportF_b152f5e2: start-on-event=DemSatellite_OsApplication_Untrusted_Core0InternalBehavior/GetEventFailed, operation=EvtInfo_AutoCreatedDemEvent_CC_DisablePDUGroup_CIOM_oLIN00_Tx_8b42b82c_BswMReportFailToDemRef.GetEventFailed
        OpEventGetEventFailed_GetEventFailed_EvtInfo_AutoCreatedDemEvent_CC_EnablePDUGroup_CIOM_oLIN00_Rx_dd181faa_BswMReportFa_c655deda: start-on-event=DemSatellite_OsApplication_Untrusted_Core0InternalBehavior/GetEventFailed, operation=EvtInfo_AutoCreatedDemEvent_CC_EnablePDUGroup_CIOM_oLIN00_Rx_dd181faa_BswMReportFailToDemRef.GetEventFailed
        OpEventGetEventFailed_GetEventFailed_EvtInfo_AutoCreatedDemEvent_ESH_Action_ComMCheckPendingRequests_BswMReportFailToDemRef: start-on-event=DemSatellite_OsApplication_Untrusted_Core0InternalBehavior/GetEventFailed, operation=EvtInfo_AutoCreatedDemEvent_ESH_Action_ComMCheckPendingRequests_BswMReportFailToDemRef.GetEventFailed
        OpEventGetEventFailed_GetEventFailed_EvtInfo_AutoCreatedDemEvent_CC_DisableDM_CIOM_oBackbone1J1939_Rx_BC_405bc776_BswMR_a9846554: start-on-event=DemSatellite_OsApplication_Untrusted_Core0InternalBehavior/GetEventFailed, operation=EvtInfo_AutoCreatedDemEvent_CC_DisableDM_CIOM_oBackbone1J1939_Rx_BC_405bc776_BswMReportFailToDemRef.GetEventFailed
        OpEventGetEventFailed_GetEventFailed_EvtInfo_AutoCreatedDemEvent_CC_DisablePDUGroup_CIOM_oLIN00_Rx_dd181faa_BswMReportF_30a68741: start-on-event=DemSatellite_OsApplication_Untrusted_Core0InternalBehavior/GetEventFailed, operation=EvtInfo_AutoCreatedDemEvent_CC_DisablePDUGroup_CIOM_oLIN00_Rx_dd181faa_BswMReportFailToDemRef.GetEventFailed
        OpEventGetEventFailed_GetEventFailed_EvtInfo_AutoCreatedDemEvent_CC_EnablePDUGroup_CIOM_oLIN00_Tx_8b42b82c_BswMReportFa_47a1ac79: start-on-event=DemSatellite_OsApplication_Untrusted_Core0InternalBehavior/GetEventFailed, operation=EvtInfo_AutoCreatedDemEvent_CC_EnablePDUGroup_CIOM_oLIN00_Tx_8b42b82c_BswMReportFailToDemRef.GetEventFailed
        OpEventGetEventFailed_GetEventFailed_EvtInfo_AutoCreatedDemEvent_ESH_Action_EnterExclusiveArea_BswMReportFailToDemRef: start-on-event=DemSatellite_OsApplication_Untrusted_Core0InternalBehavior/GetEventFailed, operation=EvtInfo_AutoCreatedDemEvent_ESH_Action_EnterExclusiveArea_BswMReportFailToDemRef.GetEventFailed
        OpEventGetEventFailed_GetEventFailed_EvtInfo_AutoCreatedDemEvent_ESH_RunToPostRunNested_BswMReportFailToDemRef: start-on-event=DemSatellite_OsApplication_Untrusted_Core0InternalBehavior/GetEventFailed, operation=EvtInfo_AutoCreatedDemEvent_ESH_RunToPostRunNested_BswMReportFailToDemRef.GetEventFailed
        OpEventGetEventFailed_GetEventFailed_EvtInfo_AutoCreatedDemEvent_CC_EnableDM_CIOM_oBackbone1J1939_Rx_BC_405bc776_BswMRe_cebc9845: start-on-event=DemSatellite_OsApplication_Untrusted_Core0InternalBehavior/GetEventFailed, operation=EvtInfo_AutoCreatedDemEvent_CC_EnableDM_CIOM_oBackbone1J1939_Rx_BC_405bc776_BswMReportFailToDemRef.GetEventFailed
        OpEventGetEventFailed_GetEventFailed_EvtInfo_AutoCreatedDemEvent_CC_DisablePDUGroup_CIOM_oBackbone1J1939_Tx_0x31_BC_378_c70ed005: start-on-event=DemSatellite_OsApplication_Untrusted_Core0InternalBehavior/GetEventFailed, operation=EvtInfo_AutoCreatedDemEvent_CC_DisablePDUGroup_CIOM_oBackbone1J1939_Tx_0x31_BC_3782f500_BswMReportFailToDemRef.GetEventFailed
        OpEventGetEventFailed_GetEventFailed_EvtInfo_AutoCreatedDemEvent_CC_J1939RmStateSwitch_CN_FMSNet_fce1aae5_CIOM_3a3d59b1_03a98359: start-on-event=DemSatellite_OsApplication_Untrusted_Core0InternalBehavior/GetEventFailed, operation=EvtInfo_AutoCreatedDemEvent_CC_J1939RmStateSwitch_CN_FMSNet_fce1aae5_CIOM_3a3d59b1_J1939RM_STATE_OFFLINE_BswMReportFailToDemRef.GetEventFailed
        OpEventGetEventFailed_GetEventFailed_EvtInfo_AutoCreatedDemEvent_CC_EnablePDUGroup_CIOM_oBackbone1J1939_Tx_0x31_BC_3782_0203074f: start-on-event=DemSatellite_OsApplication_Untrusted_Core0InternalBehavior/GetEventFailed, operation=EvtInfo_AutoCreatedDemEvent_CC_EnablePDUGroup_CIOM_oBackbone1J1939_Tx_0x31_BC_3782f500_BswMReportFailToDemRef.GetEventFailed
        OpEventGetEventFailed_GetEventFailed_EvtInfo_AutoCreatedDemEvent_CC_J1939RmStateSwitch_CN_FMSNet_fce1aae5_CIOM_3a3d59b1_c527f55b: start-on-event=DemSatellite_OsApplication_Untrusted_Core0InternalBehavior/GetEventFailed, operation=EvtInfo_AutoCreatedDemEvent_CC_J1939RmStateSwitch_CN_FMSNet_fce1aae5_CIOM_3a3d59b1_J1939RM_STATE_ONLINE_BswMReportFailToDemRef.GetEventFailed
        OpEventGetEventFailed_GetEventFailed_EvtInfo_AutoCreatedDemEvent_ESH_Action_CancelNvMWriteAll_BswMReportFailToDemRef: start-on-event=DemSatellite_OsApplication_Untrusted_Core0InternalBehavior/GetEventFailed, operation=EvtInfo_AutoCreatedDemEvent_ESH_Action_CancelNvMWriteAll_BswMReportFailToDemRef.GetEventFailed
        OpEventGetEventFailed_GetEventFailed_EvtInfo_AutoCreatedDemEvent_ESH_Action_CancelWriteAllTimer_Start_BswMReportFailToDemRef: start-on-event=DemSatellite_OsApplication_Untrusted_Core0InternalBehavior/GetEventFailed, operation=EvtInfo_AutoCreatedDemEvent_ESH_Action_CancelWriteAllTimer_Start_BswMReportFailToDemRef.GetEventFailed
        OpEventGetEventFailed_GetEventFailed_EvtInfo_AutoCreatedDemEvent_ESH_Action_CancelWriteAllTimer_Stop_BswMReportFailToDemRef: start-on-event=DemSatellite_OsApplication_Untrusted_Core0InternalBehavior/GetEventFailed, operation=EvtInfo_AutoCreatedDemEvent_ESH_Action_CancelWriteAllTimer_Stop_BswMReportFailToDemRef.GetEventFailed
        OpEventGetEventFailed_GetEventFailed_EvtInfo_AutoCreatedDemEvent_ESH_Action_ComMAllow_CN_Backbone1J1939_0b1f4bae_BswMRe_509ea352: start-on-event=DemSatellite_OsApplication_Untrusted_Core0InternalBehavior/GetEventFailed, operation=EvtInfo_AutoCreatedDemEvent_ESH_Action_ComMAllow_CN_Backbone1J1939_0b1f4bae_BswMReportFailToDemRef.GetEventFailed
        OpEventGetEventFailed_GetEventFailed_EvtInfo_AutoCreatedDemEvent_ESH_Action_ComMAllow_CN_Backbone1J1939_0b1f4bae_BswMRe_ea76ce44: start-on-event=DemSatellite_OsApplication_Untrusted_Core0InternalBehavior/GetEventFailed, operation=EvtInfo_AutoCreatedDemEvent_ESH_Action_ComMAllow_CN_Backbone1J1939_0b1f4bae_BswMReportFailToDemRef_1.GetEventFailed
        OpEventGetEventFailed_GetEventFailed_EvtInfo_AutoCreatedDemEvent_ESH_Action_ComMAllow_CN_Backbone2_78967e2c_BswMReportF_7a6af875: start-on-event=DemSatellite_OsApplication_Untrusted_Core0InternalBehavior/GetEventFailed, operation=EvtInfo_AutoCreatedDemEvent_ESH_Action_ComMAllow_CN_Backbone2_78967e2c_BswMReportFailToDemRef.GetEventFailed
        OpEventGetEventFailed_GetEventFailed_EvtInfo_AutoCreatedDemEvent_ESH_Action_ComMAllow_CN_Backbone2_78967e2c_BswMReportF_cc0adea9: start-on-event=DemSatellite_OsApplication_Untrusted_Core0InternalBehavior/GetEventFailed, operation=EvtInfo_AutoCreatedDemEvent_ESH_Action_ComMAllow_CN_Backbone2_78967e2c_BswMReportFailToDemRef_1.GetEventFailed
        OpEventGetEventFailed_GetEventFailed_EvtInfo_AutoCreatedDemEvent_ESH_Action_ComMAllow_CN_CabSubnet_9ea693f1_BswMReportF_a7a8ce03: start-on-event=DemSatellite_OsApplication_Untrusted_Core0InternalBehavior/GetEventFailed, operation=EvtInfo_AutoCreatedDemEvent_ESH_Action_ComMAllow_CN_CabSubnet_9ea693f1_BswMReportFailToDemRef.GetEventFailed
        OpEventGetEventFailed_GetEventFailed_EvtInfo_AutoCreatedDemEvent_ESH_Action_ComMAllow_CN_CabSubnet_9ea693f1_BswMReportF_7ad54882: start-on-event=DemSatellite_OsApplication_Untrusted_Core0InternalBehavior/GetEventFailed, operation=EvtInfo_AutoCreatedDemEvent_ESH_Action_ComMAllow_CN_CabSubnet_9ea693f1_BswMReportFailToDemRef_1.GetEventFailed
        OpEventGetEventFailed_GetEventFailed_EvtInfo_AutoCreatedDemEvent_ESH_Action_ComMAllow_CN_FMSNet_fce1aae5_BswMReportFailToDemRef: start-on-event=DemSatellite_OsApplication_Untrusted_Core0InternalBehavior/GetEventFailed, operation=EvtInfo_AutoCreatedDemEvent_ESH_Action_ComMAllow_CN_FMSNet_fce1aae5_BswMReportFailToDemRef.GetEventFailed
        OpEventGetEventFailed_GetEventFailed_EvtInfo_AutoCreatedDemEvent_ESH_Action_ComMAllow_CN_FMSNet_fce1aae5_BswMReportFail_3c2ca7fb: start-on-event=DemSatellite_OsApplication_Untrusted_Core0InternalBehavior/GetEventFailed, operation=EvtInfo_AutoCreatedDemEvent_ESH_Action_ComMAllow_CN_FMSNet_fce1aae5_BswMReportFailToDemRef_1.GetEventFailed
        OpEventGetEventFailed_GetEventFailed_EvtInfo_AutoCreatedDemEvent_ESH_Action_ComMAllow_CN_LIN00_2cd9a7df_BswMReportFailToDemRef: start-on-event=DemSatellite_OsApplication_Untrusted_Core0InternalBehavior/GetEventFailed, operation=EvtInfo_AutoCreatedDemEvent_ESH_Action_ComMAllow_CN_LIN00_2cd9a7df_BswMReportFailToDemRef.GetEventFailed
        OpEventGetEventFailed_GetEventFailed_EvtInfo_AutoCreatedDemEvent_ESH_Action_ComMAllow_CN_LIN00_2cd9a7df_BswMReportFailToDemRef_1: start-on-event=DemSatellite_OsApplication_Untrusted_Core0InternalBehavior/GetEventFailed, operation=EvtInfo_AutoCreatedDemEvent_ESH_Action_ComMAllow_CN_LIN00_2cd9a7df_BswMReportFailToDemRef_1.GetEventFailed
        OpEventGetEventFailed_GetEventFailed_EvtInfo_AutoCreatedDemEvent_ESH_Action_ComMAllow_CN_LIN01_5bde9749_BswMReportFailToDemRef: start-on-event=DemSatellite_OsApplication_Untrusted_Core0InternalBehavior/GetEventFailed, operation=EvtInfo_AutoCreatedDemEvent_ESH_Action_ComMAllow_CN_LIN01_5bde9749_BswMReportFailToDemRef.GetEventFailed
        OpEventGetEventFailed_GetEventFailed_EvtInfo_AutoCreatedDemEvent_ESH_Action_ComMAllow_CN_LIN01_5bde9749_BswMReportFailToDemRef_1: start-on-event=DemSatellite_OsApplication_Untrusted_Core0InternalBehavior/GetEventFailed, operation=EvtInfo_AutoCreatedDemEvent_ESH_Action_ComMAllow_CN_LIN01_5bde9749_BswMReportFailToDemRef_1.GetEventFailed
        OpEventGetEventFailed_GetEventFailed_EvtInfo_AutoCreatedDemEvent_ESH_Action_ComMAllow_CN_LIN02_c2d7c6f3_BswMReportFailToDemRef: start-on-event=DemSatellite_OsApplication_Untrusted_Core0InternalBehavior/GetEventFailed, operation=EvtInfo_AutoCreatedDemEvent_ESH_Action_ComMAllow_CN_LIN02_c2d7c6f3_BswMReportFailToDemRef.GetEventFailed
        OpEventGetEventFailed_GetEventFailed_EvtInfo_AutoCreatedDemEvent_ESH_Action_ComMAllow_CN_LIN02_c2d7c6f3_BswMReportFailToDemRef_1: start-on-event=DemSatellite_OsApplication_Untrusted_Core0InternalBehavior/GetEventFailed, operation=EvtInfo_AutoCreatedDemEvent_ESH_Action_ComMAllow_CN_LIN02_c2d7c6f3_BswMReportFailToDemRef_1.GetEventFailed
        OpEventGetEventFailed_GetEventFailed_EvtInfo_AutoCreatedDemEvent_ESH_Action_ComMAllow_CN_LIN03_b5d0f665_BswMReportFailToDemRef: start-on-event=DemSatellite_OsApplication_Untrusted_Core0InternalBehavior/GetEventFailed, operation=EvtInfo_AutoCreatedDemEvent_ESH_Action_ComMAllow_CN_LIN03_b5d0f665_BswMReportFailToDemRef.GetEventFailed
        OpEventGetEventFailed_GetEventFailed_EvtInfo_AutoCreatedDemEvent_ESH_Action_ComMAllow_CN_LIN03_b5d0f665_BswMReportFailToDemRef_1: start-on-event=DemSatellite_OsApplication_Untrusted_Core0InternalBehavior/GetEventFailed, operation=EvtInfo_AutoCreatedDemEvent_ESH_Action_ComMAllow_CN_LIN03_b5d0f665_BswMReportFailToDemRef_1.GetEventFailed
        OpEventGetEventFailed_GetEventFailed_EvtInfo_AutoCreatedDemEvent_ESH_Action_ComMAllow_CN_LIN04_2bb463c6_BswMReportFailToDemRef: start-on-event=DemSatellite_OsApplication_Untrusted_Core0InternalBehavior/GetEventFailed, operation=EvtInfo_AutoCreatedDemEvent_ESH_Action_ComMAllow_CN_LIN04_2bb463c6_BswMReportFailToDemRef.GetEventFailed
        OpEventGetEventFailed_GetEventFailed_EvtInfo_AutoCreatedDemEvent_ESH_Action_ComMAllow_CN_LIN04_2bb463c6_BswMReportFailToDemRef_1: start-on-event=DemSatellite_OsApplication_Untrusted_Core0InternalBehavior/GetEventFailed, operation=EvtInfo_AutoCreatedDemEvent_ESH_Action_ComMAllow_CN_LIN04_2bb463c6_BswMReportFailToDemRef_1.GetEventFailed
        OpEventGetEventFailed_GetEventFailed_EvtInfo_AutoCreatedDemEvent_ESH_Action_ComMAllow_CN_SecuritySubnet_e7a0ee54_BswMRe_fe142294: start-on-event=DemSatellite_OsApplication_Untrusted_Core0InternalBehavior/GetEventFailed, operation=EvtInfo_AutoCreatedDemEvent_ESH_Action_ComMAllow_CN_SecuritySubnet_e7a0ee54_BswMReportFailToDemRef.GetEventFailed
        OpEventGetEventFailed_GetEventFailed_EvtInfo_AutoCreatedDemEvent_ESH_Action_ComMAllow_CN_SecuritySubnet_e7a0ee54_BswMRe_ed69a3b0: start-on-event=DemSatellite_OsApplication_Untrusted_Core0InternalBehavior/GetEventFailed, operation=EvtInfo_AutoCreatedDemEvent_ESH_Action_ComMAllow_CN_SecuritySubnet_e7a0ee54_BswMReportFailToDemRef_1.GetEventFailed
        OpEventGetEventFailed_GetEventFailed_EvtInfo_AutoCreatedDemEvent_ESH_Action_ComMCheckPendingRequests_BswMReportFailToDemRef_1: start-on-event=DemSatellite_OsApplication_Untrusted_Core0InternalBehavior/GetEventFailed, operation=EvtInfo_AutoCreatedDemEvent_ESH_Action_ComMCheckPendingRequests_BswMReportFailToDemRef_1.GetEventFailed
        OpEventGetEventFailed_GetEventFailed_EvtInfo_AutoCreatedDemEvent_ESH_Action_ComMCheckPendingRequests_BswMReportFailToDemRef_2: start-on-event=DemSatellite_OsApplication_Untrusted_Core0InternalBehavior/GetEventFailed, operation=EvtInfo_AutoCreatedDemEvent_ESH_Action_ComMCheckPendingRequests_BswMReportFailToDemRef_2.GetEventFailed
        OpEventGetEventFailed_GetEventFailed_EvtInfo_AutoCreatedDemEvent_ESH_Action_ComMDisallow_CN_Backbone1J1939_0b1f4bae_Bsw_879a9c53: start-on-event=DemSatellite_OsApplication_Untrusted_Core0InternalBehavior/GetEventFailed, operation=EvtInfo_AutoCreatedDemEvent_ESH_Action_ComMDisallow_CN_Backbone1J1939_0b1f4bae_BswMReportFailToDemRef.GetEventFailed
        OpEventGetEventFailed_GetEventFailed_EvtInfo_AutoCreatedDemEvent_ESH_Action_ComMDisallow_CN_Backbone2_78967e2c_BswMRepo_f308ae68: start-on-event=DemSatellite_OsApplication_Untrusted_Core0InternalBehavior/GetEventFailed, operation=EvtInfo_AutoCreatedDemEvent_ESH_Action_ComMDisallow_CN_Backbone2_78967e2c_BswMReportFailToDemRef.GetEventFailed
        OpEventGetEventFailed_GetEventFailed_EvtInfo_AutoCreatedDemEvent_ESH_Action_ComMDisallow_CN_CabSubnet_9ea693f1_BswMRepo_2eca981e: start-on-event=DemSatellite_OsApplication_Untrusted_Core0InternalBehavior/GetEventFailed, operation=EvtInfo_AutoCreatedDemEvent_ESH_Action_ComMDisallow_CN_CabSubnet_9ea693f1_BswMReportFailToDemRef.GetEventFailed
        OpEventGetEventFailed_GetEventFailed_EvtInfo_AutoCreatedDemEvent_ESH_Action_ComMDisallow_CN_FMSNet_fce1aae5_BswMReportF_81495b4c: start-on-event=DemSatellite_OsApplication_Untrusted_Core0InternalBehavior/GetEventFailed, operation=EvtInfo_AutoCreatedDemEvent_ESH_Action_ComMDisallow_CN_FMSNet_fce1aae5_BswMReportFailToDemRef.GetEventFailed
        OpEventGetEventFailed_GetEventFailed_EvtInfo_AutoCreatedDemEvent_ESH_Action_ComMDisallow_CN_LIN00_2cd9a7df_BswMReportFa_c63ade4e: start-on-event=DemSatellite_OsApplication_Untrusted_Core0InternalBehavior/GetEventFailed, operation=EvtInfo_AutoCreatedDemEvent_ESH_Action_ComMDisallow_CN_LIN00_2cd9a7df_BswMReportFailToDemRef.GetEventFailed
        OpEventGetEventFailed_GetEventFailed_EvtInfo_AutoCreatedDemEvent_ESH_Action_ComMDisallow_CN_LIN01_5bde9749_BswMReportFa_fe8a5992: start-on-event=DemSatellite_OsApplication_Untrusted_Core0InternalBehavior/GetEventFailed, operation=EvtInfo_AutoCreatedDemEvent_ESH_Action_ComMDisallow_CN_LIN01_5bde9749_BswMReportFailToDemRef.GetEventFailed
        OpEventGetEventFailed_GetEventFailed_EvtInfo_AutoCreatedDemEvent_ESH_Action_ComMDisallow_CN_LIN02_c2d7c6f3_BswMReportFa_03f7a5f6: start-on-event=DemSatellite_OsApplication_Untrusted_Core0InternalBehavior/GetEventFailed, operation=EvtInfo_AutoCreatedDemEvent_ESH_Action_ComMDisallow_CN_LIN02_c2d7c6f3_BswMReportFailToDemRef.GetEventFailed
        OpEventGetEventFailed_GetEventFailed_EvtInfo_AutoCreatedDemEvent_ESH_Action_ComMDisallow_CN_LIN03_b5d0f665_BswMReportFa_d603197c: start-on-event=DemSatellite_OsApplication_Untrusted_Core0InternalBehavior/GetEventFailed, operation=EvtInfo_AutoCreatedDemEvent_ESH_Action_ComMDisallow_CN_LIN03_b5d0f665_BswMReportFailToDemRef.GetEventFailed
        OpEventGetEventFailed_GetEventFailed_EvtInfo_AutoCreatedDemEvent_ESH_Action_ComMDisallow_CN_LIN04_2bb463c6_BswMReportFa_294de6aa: start-on-event=DemSatellite_OsApplication_Untrusted_Core0InternalBehavior/GetEventFailed, operation=EvtInfo_AutoCreatedDemEvent_ESH_Action_ComMDisallow_CN_LIN04_2bb463c6_BswMReportFailToDemRef.GetEventFailed
        OpEventGetEventFailed_GetEventFailed_EvtInfo_AutoCreatedDemEvent_ESH_Action_ComMDisallow_CN_SecuritySubnet_e7a0ee54_Bsw_29101d95: start-on-event=DemSatellite_OsApplication_Untrusted_Core0InternalBehavior/GetEventFailed, operation=EvtInfo_AutoCreatedDemEvent_ESH_Action_ComMDisallow_CN_SecuritySubnet_e7a0ee54_BswMReportFailToDemRef.GetEventFailed
        OpEventGetEventFailed_GetEventFailed_EvtInfo_AutoCreatedDemEvent_ESH_Action_DemInit_BswMReportFailToDemRef: start-on-event=DemSatellite_OsApplication_Untrusted_Core0InternalBehavior/GetEventFailed, operation=EvtInfo_AutoCreatedDemEvent_ESH_Action_DemInit_BswMReportFailToDemRef.GetEventFailed
        OpEventGetEventFailed_GetEventFailed_EvtInfo_AutoCreatedDemEvent_ESH_Action_DemInitialized_BswMReportFailToDemRef: start-on-event=DemSatellite_OsApplication_Untrusted_Core0InternalBehavior/GetEventFailed, operation=EvtInfo_AutoCreatedDemEvent_ESH_Action_DemInitialized_BswMReportFailToDemRef.GetEventFailed
        OpEventGetEventFailed_GetEventFailed_EvtInfo_AutoCreatedDemEvent_ESH_Action_DemNotInitialized_BswMReportFailToDemRef: start-on-event=DemSatellite_OsApplication_Untrusted_Core0InternalBehavior/GetEventFailed, operation=EvtInfo_AutoCreatedDemEvent_ESH_Action_DemNotInitialized_BswMReportFailToDemRef.GetEventFailed
        OpEventGetEventFailed_GetEventFailed_EvtInfo_AutoCreatedDemEvent_ESH_Action_DemShutdown_BswMReportFailToDemRef: start-on-event=DemSatellite_OsApplication_Untrusted_Core0InternalBehavior/GetEventFailed, operation=EvtInfo_AutoCreatedDemEvent_ESH_Action_DemShutdown_BswMReportFailToDemRef.GetEventFailed
        OpEventGetEventFailed_GetEventFailed_EvtInfo_AutoCreatedDemEvent_ESH_Action_ESH_PostRun_BswMReportFailToDemRef: start-on-event=DemSatellite_OsApplication_Untrusted_Core0InternalBehavior/GetEventFailed, operation=EvtInfo_AutoCreatedDemEvent_ESH_Action_ESH_PostRun_BswMReportFailToDemRef.GetEventFailed
        OpEventGetEventFailed_GetEventFailed_EvtInfo_AutoCreatedDemEvent_ESH_Action_ESH_PrepShutdown_BswMReportFailToDemRef: start-on-event=DemSatellite_OsApplication_Untrusted_Core0InternalBehavior/GetEventFailed, operation=EvtInfo_AutoCreatedDemEvent_ESH_Action_ESH_PrepShutdown_BswMReportFailToDemRef.GetEventFailed
        OpEventGetEventFailed_GetEventFailed_EvtInfo_AutoCreatedDemEvent_ESH_Action_ESH_PrepShutdown_BswMReportFailToDemRef_1: start-on-event=DemSatellite_OsApplication_Untrusted_Core0InternalBehavior/GetEventFailed, operation=EvtInfo_AutoCreatedDemEvent_ESH_Action_ESH_PrepShutdown_BswMReportFailToDemRef_1.GetEventFailed
        OpEventGetEventFailed_GetEventFailed_EvtInfo_AutoCreatedDemEvent_ESH_Action_ESH_Run_BswMReportFailToDemRef: start-on-event=DemSatellite_OsApplication_Untrusted_Core0InternalBehavior/GetEventFailed, operation=EvtInfo_AutoCreatedDemEvent_ESH_Action_ESH_Run_BswMReportFailToDemRef.GetEventFailed
        OpEventGetEventFailed_GetEventFailed_EvtInfo_AutoCreatedDemEvent_ESH_Action_ESH_Run_BswMReportFailToDemRef_1: start-on-event=DemSatellite_OsApplication_Untrusted_Core0InternalBehavior/GetEventFailed, operation=EvtInfo_AutoCreatedDemEvent_ESH_Action_ESH_Run_BswMReportFailToDemRef_1.GetEventFailed
        OpEventGetEventFailed_GetEventFailed_EvtInfo_AutoCreatedDemEvent_ESH_Action_ESH_WaitForNvm_BswMReportFailToDemRef: start-on-event=DemSatellite_OsApplication_Untrusted_Core0InternalBehavior/GetEventFailed, operation=EvtInfo_AutoCreatedDemEvent_ESH_Action_ESH_WaitForNvm_BswMReportFailToDemRef.GetEventFailed
        OpEventGetEventFailed_GetEventFailed_EvtInfo_AutoCreatedDemEvent_ESH_Action_ESH_Wakeup_BswMReportFailToDemRef: start-on-event=DemSatellite_OsApplication_Untrusted_Core0InternalBehavior/GetEventFailed, operation=EvtInfo_AutoCreatedDemEvent_ESH_Action_ESH_Wakeup_BswMReportFailToDemRef.GetEventFailed
        OpEventGetEventFailed_GetEventFailed_EvtInfo_AutoCreatedDemEvent_ESH_Action_ESH_Wakeup_BswMReportFailToDemRef_1: start-on-event=DemSatellite_OsApplication_Untrusted_Core0InternalBehavior/GetEventFailed, operation=EvtInfo_AutoCreatedDemEvent_ESH_Action_ESH_Wakeup_BswMReportFailToDemRef_1.GetEventFailed
        OpEventGetEventFailed_GetEventFailed_EvtInfo_AutoCreatedDemEvent_ESH_Action_EcuMClearValidatedWakeupEvents_BswMReportFa_cf1dabdb: start-on-event=DemSatellite_OsApplication_Untrusted_Core0InternalBehavior/GetEventFailed, operation=EvtInfo_AutoCreatedDemEvent_ESH_Action_EcuMClearValidatedWakeupEvents_BswMReportFailToDemRef.GetEventFailed
        OpEventGetEventFailed_GetEventFailed_EvtInfo_AutoCreatedDemEvent_ESH_Action_EcuMGoToSelectedShutdownTarget_BswMReportFa_6e571b0d: start-on-event=DemSatellite_OsApplication_Untrusted_Core0InternalBehavior/GetEventFailed, operation=EvtInfo_AutoCreatedDemEvent_ESH_Action_EcuMGoToSelectedShutdownTarget_BswMReportFailToDemRef.GetEventFailed
        OpEventGetEventFailed_GetEventFailed_EvtInfo_AutoCreatedDemEvent_ESH_Action_EnterExclusiveArea_BswMReportFailToDemRef_1: start-on-event=DemSatellite_OsApplication_Untrusted_Core0InternalBehavior/GetEventFailed, operation=EvtInfo_AutoCreatedDemEvent_ESH_Action_EnterExclusiveArea_BswMReportFailToDemRef_1.GetEventFailed
        OpEventGetEventFailed_GetEventFailed_EvtInfo_AutoCreatedDemEvent_ESH_Action_ExitExclusiveArea_BswMReportFailToDemRef: start-on-event=DemSatellite_OsApplication_Untrusted_Core0InternalBehavior/GetEventFailed, operation=EvtInfo_AutoCreatedDemEvent_ESH_Action_ExitExclusiveArea_BswMReportFailToDemRef.GetEventFailed
        OpEventGetEventFailed_GetEventFailed_EvtInfo_AutoCreatedDemEvent_ESH_Action_NvMWriteAll_BswMReportFailToDemRef: start-on-event=DemSatellite_OsApplication_Untrusted_Core0InternalBehavior/GetEventFailed, operation=EvtInfo_AutoCreatedDemEvent_ESH_Action_NvMWriteAll_BswMReportFailToDemRef.GetEventFailed
        OpEventGetEventFailed_GetEventFailed_EvtInfo_AutoCreatedDemEvent_ESH_Action_OnEnterPostRun_BswMReportFailToDemRef: start-on-event=DemSatellite_OsApplication_Untrusted_Core0InternalBehavior/GetEventFailed, operation=EvtInfo_AutoCreatedDemEvent_ESH_Action_OnEnterPostRun_BswMReportFailToDemRef.GetEventFailed
        OpEventGetEventFailed_GetEventFailed_EvtInfo_AutoCreatedDemEvent_ESH_Action_OnEnterPrepShutdown_BswMReportFailToDemRef: start-on-event=DemSatellite_OsApplication_Untrusted_Core0InternalBehavior/GetEventFailed, operation=EvtInfo_AutoCreatedDemEvent_ESH_Action_OnEnterPrepShutdown_BswMReportFailToDemRef.GetEventFailed
        OpEventGetEventFailed_GetEventFailed_EvtInfo_AutoCreatedDemEvent_ESH_Action_OnEnterPrepShutdown_BswMReportFailToDemRef_1: start-on-event=DemSatellite_OsApplication_Untrusted_Core0InternalBehavior/GetEventFailed, operation=EvtInfo_AutoCreatedDemEvent_ESH_Action_OnEnterPrepShutdown_BswMReportFailToDemRef_1.GetEventFailed
        OpEventGetEventFailed_GetEventFailed_EvtInfo_AutoCreatedDemEvent_ESH_Action_OnEnterRun_BswMReportFailToDemRef: start-on-event=DemSatellite_OsApplication_Untrusted_Core0InternalBehavior/GetEventFailed, operation=EvtInfo_AutoCreatedDemEvent_ESH_Action_OnEnterRun_BswMReportFailToDemRef.GetEventFailed
        OpEventGetEventFailed_GetEventFailed_EvtInfo_AutoCreatedDemEvent_ESH_Action_OnEnterRun_BswMReportFailToDemRef_1: start-on-event=DemSatellite_OsApplication_Untrusted_Core0InternalBehavior/GetEventFailed, operation=EvtInfo_AutoCreatedDemEvent_ESH_Action_OnEnterRun_BswMReportFailToDemRef_1.GetEventFailed
        OpEventGetEventFailed_GetEventFailed_EvtInfo_AutoCreatedDemEvent_ESH_Action_OnEnterShutdown_BswMReportFailToDemRef: start-on-event=DemSatellite_OsApplication_Untrusted_Core0InternalBehavior/GetEventFailed, operation=EvtInfo_AutoCreatedDemEvent_ESH_Action_OnEnterShutdown_BswMReportFailToDemRef.GetEventFailed
        OpEventGetEventFailed_GetEventFailed_EvtInfo_AutoCreatedDemEvent_ESH_Action_OnEnterWaitForNvm_BswMReportFailToDemRef: start-on-event=DemSatellite_OsApplication_Untrusted_Core0InternalBehavior/GetEventFailed, operation=EvtInfo_AutoCreatedDemEvent_ESH_Action_OnEnterWaitForNvm_BswMReportFailToDemRef.GetEventFailed
        OpEventGetEventFailed_GetEventFailed_EvtInfo_AutoCreatedDemEvent_ESH_Action_OnEnterWakeup_BswMReportFailToDemRef: start-on-event=DemSatellite_OsApplication_Untrusted_Core0InternalBehavior/GetEventFailed, operation=EvtInfo_AutoCreatedDemEvent_ESH_Action_OnEnterWakeup_BswMReportFailToDemRef.GetEventFailed
        OpEventGetEventFailed_GetEventFailed_EvtInfo_AutoCreatedDemEvent_ESH_Action_OnEnterWakeup_BswMReportFailToDemRef_1: start-on-event=DemSatellite_OsApplication_Untrusted_Core0InternalBehavior/GetEventFailed, operation=EvtInfo_AutoCreatedDemEvent_ESH_Action_OnEnterWakeup_BswMReportFailToDemRef_1.GetEventFailed
        OpEventGetEventFailed_GetEventFailed_EvtInfo_AutoCreatedDemEvent_ESH_Action_SelfRunRequestTimer_Start_BswMReportFailToDemRef: start-on-event=DemSatellite_OsApplication_Untrusted_Core0InternalBehavior/GetEventFailed, operation=EvtInfo_AutoCreatedDemEvent_ESH_Action_SelfRunRequestTimer_Start_BswMReportFailToDemRef.GetEventFailed
        OpEventGetEventFailed_GetEventFailed_EvtInfo_AutoCreatedDemEvent_ESH_Action_SelfRunRequestTimer_Start_BswMReportFailToDemRef_1: start-on-event=DemSatellite_OsApplication_Untrusted_Core0InternalBehavior/GetEventFailed, operation=EvtInfo_AutoCreatedDemEvent_ESH_Action_SelfRunRequestTimer_Start_BswMReportFailToDemRef_1.GetEventFailed
        OpEventGetEventFailed_GetEventFailed_EvtInfo_AutoCreatedDemEvent_ESH_Action_SwitchPostRun_BswMReportFailToDemRef: start-on-event=DemSatellite_OsApplication_Untrusted_Core0InternalBehavior/GetEventFailed, operation=EvtInfo_AutoCreatedDemEvent_ESH_Action_SwitchPostRun_BswMReportFailToDemRef.GetEventFailed
        OpEventGetEventFailed_GetEventFailed_EvtInfo_AutoCreatedDemEvent_ESH_Action_SwitchRun_BswMReportFailToDemRef: start-on-event=DemSatellite_OsApplication_Untrusted_Core0InternalBehavior/GetEventFailed, operation=EvtInfo_AutoCreatedDemEvent_ESH_Action_SwitchRun_BswMReportFailToDemRef.GetEventFailed
        OpEventGetEventFailed_GetEventFailed_EvtInfo_AutoCreatedDemEvent_ESH_Action_SwitchRun_BswMReportFailToDemRef_1: start-on-event=DemSatellite_OsApplication_Untrusted_Core0InternalBehavior/GetEventFailed, operation=EvtInfo_AutoCreatedDemEvent_ESH_Action_SwitchRun_BswMReportFailToDemRef_1.GetEventFailed
        OpEventGetEventFailed_GetEventFailed_EvtInfo_AutoCreatedDemEvent_ESH_Action_SwitchShutdown_BswMReportFailToDemRef: start-on-event=DemSatellite_OsApplication_Untrusted_Core0InternalBehavior/GetEventFailed, operation=EvtInfo_AutoCreatedDemEvent_ESH_Action_SwitchShutdown_BswMReportFailToDemRef.GetEventFailed
        OpEventGetEventFailed_GetEventFailed_EvtInfo_AutoCreatedDemEvent_ESH_Action_SwitchShutdown_BswMReportFailToDemRef_1: start-on-event=DemSatellite_OsApplication_Untrusted_Core0InternalBehavior/GetEventFailed, operation=EvtInfo_AutoCreatedDemEvent_ESH_Action_SwitchShutdown_BswMReportFailToDemRef_1.GetEventFailed
        OpEventGetEventFailed_GetEventFailed_EvtInfo_AutoCreatedDemEvent_ESH_Action_SwitchWakeup_BswMReportFailToDemRef: start-on-event=DemSatellite_OsApplication_Untrusted_Core0InternalBehavior/GetEventFailed, operation=EvtInfo_AutoCreatedDemEvent_ESH_Action_SwitchWakeup_BswMReportFailToDemRef.GetEventFailed
        OpEventGetEventFailed_GetEventFailed_EvtInfo_AutoCreatedDemEvent_ESH_Action_SwitchWakeup_BswMReportFailToDemRef_1: start-on-event=DemSatellite_OsApplication_Untrusted_Core0InternalBehavior/GetEventFailed, operation=EvtInfo_AutoCreatedDemEvent_ESH_Action_SwitchWakeup_BswMReportFailToDemRef_1.GetEventFailed
        OpEventGetEventFailed_GetEventFailed_EvtInfo_AutoCreatedDemEvent_ESH_Action_WriteAllTimer_Start_BswMReportFailToDemRef: start-on-event=DemSatellite_OsApplication_Untrusted_Core0InternalBehavior/GetEventFailed, operation=EvtInfo_AutoCreatedDemEvent_ESH_Action_WriteAllTimer_Start_BswMReportFailToDemRef.GetEventFailed
        OpEventGetEventFailed_GetEventFailed_EvtInfo_AutoCreatedDemEvent_ESH_Action_WriteAllTimer_Stop_BswMReportFailToDemRef: start-on-event=DemSatellite_OsApplication_Untrusted_Core0InternalBehavior/GetEventFailed, operation=EvtInfo_AutoCreatedDemEvent_ESH_Action_WriteAllTimer_Stop_BswMReportFailToDemRef.GetEventFailed
        OpEventGetEventFailed_GetEventFailed_EvtInfo_AutoCreatedDemEvent_ESH_Action_WriteAllTimer_Stop_BswMReportFailToDemRef_1: start-on-event=DemSatellite_OsApplication_Untrusted_Core0InternalBehavior/GetEventFailed, operation=EvtInfo_AutoCreatedDemEvent_ESH_Action_WriteAllTimer_Stop_BswMReportFailToDemRef_1.GetEventFailed
        OpEventGetEventFailed_GetEventFailed_EvtInfo_AutoCreatedDemEvent_ESH_DemInit_BswMReportFailToDemRef: start-on-event=DemSatellite_OsApplication_Untrusted_Core0InternalBehavior/GetEventFailed, operation=EvtInfo_AutoCreatedDemEvent_ESH_DemInit_BswMReportFailToDemRef.GetEventFailed
        OpEventGetEventFailed_GetEventFailed_EvtInfo_AutoCreatedDemEvent_ESH_PostRunNested_BswMReportFailToDemRef: start-on-event=DemSatellite_OsApplication_Untrusted_Core0InternalBehavior/GetEventFailed, operation=EvtInfo_AutoCreatedDemEvent_ESH_PostRunNested_BswMReportFailToDemRef.GetEventFailed
        OpEventGetEventFailed_GetEventFailed_EvtInfo_AutoCreatedDemEvent_ESH_PostRunToPrepNested_BswMReportFailToDemRef: start-on-event=DemSatellite_OsApplication_Untrusted_Core0InternalBehavior/GetEventFailed, operation=EvtInfo_AutoCreatedDemEvent_ESH_PostRunToPrepNested_BswMReportFailToDemRef.GetEventFailed
        OpEventGetEventFailed_GetEventFailed_EvtInfo_AutoCreatedDemEvent_ESH_Action_ExitExclusiveArea_BswMReportFailToDemRef_1: start-on-event=DemSatellite_OsApplication_Untrusted_Core0InternalBehavior/GetEventFailed, operation=EvtInfo_AutoCreatedDemEvent_ESH_Action_ExitExclusiveArea_BswMReportFailToDemRef_1.GetEventFailed
        OpEventGetEventFailed_GetEventFailed_EvtInfo_AutoCreatedDemEvent_INIT_Action_BrsHw_EnableHwAccess_BswMReportFailToDemRef: start-on-event=DemSatellite_OsApplication_Untrusted_Core0InternalBehavior/GetEventFailed, operation=EvtInfo_AutoCreatedDemEvent_INIT_Action_BrsHw_EnableHwAccess_BswMReportFailToDemRef.GetEventFailed
        OpEventGetEventFailed_GetEventFailed_EvtInfo_AutoCreatedDemEvent_INIT_Action_CanIf_Init_BswMReportFailToDemRef: start-on-event=DemSatellite_OsApplication_Untrusted_Core0InternalBehavior/GetEventFailed, operation=EvtInfo_AutoCreatedDemEvent_INIT_Action_CanIf_Init_BswMReportFailToDemRef.GetEventFailed
        OpEventGetEventFailed_GetEventFailed_EvtInfo_AutoCreatedDemEvent_INIT_Action_CanNm_Init_BswMReportFailToDemRef: start-on-event=DemSatellite_OsApplication_Untrusted_Core0InternalBehavior/GetEventFailed, operation=EvtInfo_AutoCreatedDemEvent_INIT_Action_CanNm_Init_BswMReportFailToDemRef.GetEventFailed
        OpEventGetEventFailed_GetEventFailed_EvtInfo_AutoCreatedDemEvent_INIT_Action_CanSM_Init_BswMReportFailToDemRef: start-on-event=DemSatellite_OsApplication_Untrusted_Core0InternalBehavior/GetEventFailed, operation=EvtInfo_AutoCreatedDemEvent_INIT_Action_CanSM_Init_BswMReportFailToDemRef.GetEventFailed
        OpEventGetEventFailed_GetEventFailed_EvtInfo_AutoCreatedDemEvent_INIT_Action_CanTp_Init_BswMReportFailToDemRef: start-on-event=DemSatellite_OsApplication_Untrusted_Core0InternalBehavior/GetEventFailed, operation=EvtInfo_AutoCreatedDemEvent_INIT_Action_CanTp_Init_BswMReportFailToDemRef.GetEventFailed
        OpEventGetEventFailed_GetEventFailed_EvtInfo_AutoCreatedDemEvent_INIT_Action_Can_Init_BswMReportFailToDemRef: start-on-event=DemSatellite_OsApplication_Untrusted_Core0InternalBehavior/GetEventFailed, operation=EvtInfo_AutoCreatedDemEvent_INIT_Action_Can_Init_BswMReportFailToDemRef.GetEventFailed
        OpEventGetEventFailed_GetEventFailed_EvtInfo_AutoCreatedDemEvent_INIT_Action_ComM_Init_BswMReportFailToDemRef: start-on-event=DemSatellite_OsApplication_Untrusted_Core0InternalBehavior/GetEventFailed, operation=EvtInfo_AutoCreatedDemEvent_INIT_Action_ComM_Init_BswMReportFailToDemRef.GetEventFailed
        OpEventGetEventFailed_GetEventFailed_EvtInfo_AutoCreatedDemEvent_INIT_Action_Com_Init_BswMReportFailToDemRef: start-on-event=DemSatellite_OsApplication_Untrusted_Core0InternalBehavior/GetEventFailed, operation=EvtInfo_AutoCreatedDemEvent_INIT_Action_Com_Init_BswMReportFailToDemRef.GetEventFailed
        OpEventGetEventFailed_GetEventFailed_EvtInfo_AutoCreatedDemEvent_INIT_Action_Dcm_Init_BswMReportFailToDemRef: start-on-event=DemSatellite_OsApplication_Untrusted_Core0InternalBehavior/GetEventFailed, operation=EvtInfo_AutoCreatedDemEvent_INIT_Action_Dcm_Init_BswMReportFailToDemRef.GetEventFailed
        OpEventGetEventFailed_GetEventFailed_EvtInfo_AutoCreatedDemEvent_INIT_Action_Dem_Init_BswMReportFailToDemRef: start-on-event=DemSatellite_OsApplication_Untrusted_Core0InternalBehavior/GetEventFailed, operation=EvtInfo_AutoCreatedDemEvent_INIT_Action_Dem_Init_BswMReportFailToDemRef.GetEventFailed
        OpEventGetEventFailed_GetEventFailed_EvtInfo_AutoCreatedDemEvent_INIT_Action_EnableInterrupts_BswMReportFailToDemRef: start-on-event=DemSatellite_OsApplication_Untrusted_Core0InternalBehavior/GetEventFailed, operation=EvtInfo_AutoCreatedDemEvent_INIT_Action_EnableInterrupts_BswMReportFailToDemRef.GetEventFailed
        OpEventGetEventFailed_GetEventFailed_EvtInfo_AutoCreatedDemEvent_INIT_Action_Fee_Init_BswMReportFailToDemRef: start-on-event=DemSatellite_OsApplication_Untrusted_Core0InternalBehavior/GetEventFailed, operation=EvtInfo_AutoCreatedDemEvent_INIT_Action_Fee_Init_BswMReportFailToDemRef.GetEventFailed
        OpEventGetEventFailed_GetEventFailed_EvtInfo_AutoCreatedDemEvent_INIT_Action_Issm_Init_BswMReportFailToDemRef: start-on-event=DemSatellite_OsApplication_Untrusted_Core0InternalBehavior/GetEventFailed, operation=EvtInfo_AutoCreatedDemEvent_INIT_Action_Issm_Init_BswMReportFailToDemRef.GetEventFailed
        OpEventGetEventFailed_GetEventFailed_EvtInfo_AutoCreatedDemEvent_INIT_Action_J1939Nm_Init_BswMReportFailToDemRef: start-on-event=DemSatellite_OsApplication_Untrusted_Core0InternalBehavior/GetEventFailed, operation=EvtInfo_AutoCreatedDemEvent_INIT_Action_J1939Nm_Init_BswMReportFailToDemRef.GetEventFailed
        OpEventGetEventFailed_GetEventFailed_EvtInfo_AutoCreatedDemEvent_INIT_Action_J1939Rm_Init_BswMReportFailToDemRef: start-on-event=DemSatellite_OsApplication_Untrusted_Core0InternalBehavior/GetEventFailed, operation=EvtInfo_AutoCreatedDemEvent_INIT_Action_J1939Rm_Init_BswMReportFailToDemRef.GetEventFailed
        OpEventGetEventFailed_GetEventFailed_EvtInfo_AutoCreatedDemEvent_INIT_Action_J1939Tp_Init_BswMReportFailToDemRef: start-on-event=DemSatellite_OsApplication_Untrusted_Core0InternalBehavior/GetEventFailed, operation=EvtInfo_AutoCreatedDemEvent_INIT_Action_J1939Tp_Init_BswMReportFailToDemRef.GetEventFailed
        OpEventGetEventFailed_GetEventFailed_EvtInfo_AutoCreatedDemEvent_INIT_Action_LinIf_Init_BswMReportFailToDemRef: start-on-event=DemSatellite_OsApplication_Untrusted_Core0InternalBehavior/GetEventFailed, operation=EvtInfo_AutoCreatedDemEvent_INIT_Action_LinIf_Init_BswMReportFailToDemRef.GetEventFailed
        OpEventGetEventFailed_GetEventFailed_EvtInfo_AutoCreatedDemEvent_INIT_Action_LinSM_Init_BswMReportFailToDemRef: start-on-event=DemSatellite_OsApplication_Untrusted_Core0InternalBehavior/GetEventFailed, operation=EvtInfo_AutoCreatedDemEvent_INIT_Action_LinSM_Init_BswMReportFailToDemRef.GetEventFailed
        OpEventGetEventFailed_GetEventFailed_EvtInfo_AutoCreatedDemEvent_INIT_Action_LinTp_Init_BswMReportFailToDemRef: start-on-event=DemSatellite_OsApplication_Untrusted_Core0InternalBehavior/GetEventFailed, operation=EvtInfo_AutoCreatedDemEvent_INIT_Action_LinTp_Init_BswMReportFailToDemRef.GetEventFailed
        OpEventGetEventFailed_GetEventFailed_EvtInfo_AutoCreatedDemEvent_INIT_Action_Lin_Init_BswMReportFailToDemRef: start-on-event=DemSatellite_OsApplication_Untrusted_Core0InternalBehavior/GetEventFailed, operation=EvtInfo_AutoCreatedDemEvent_INIT_Action_Lin_Init_BswMReportFailToDemRef.GetEventFailed
        OpEventGetEventFailed_GetEventFailed_EvtInfo_AutoCreatedDemEvent_INIT_Action_Nm_Init_BswMReportFailToDemRef: start-on-event=DemSatellite_OsApplication_Untrusted_Core0InternalBehavior/GetEventFailed, operation=EvtInfo_AutoCreatedDemEvent_INIT_Action_Nm_Init_BswMReportFailToDemRef.GetEventFailed
        OpEventGetEventFailed_GetEventFailed_EvtInfo_AutoCreatedDemEvent_INIT_Action_NvMReadAll_BswMReportFailToDemRef: start-on-event=DemSatellite_OsApplication_Untrusted_Core0InternalBehavior/GetEventFailed, operation=EvtInfo_AutoCreatedDemEvent_INIT_Action_NvMReadAll_BswMReportFailToDemRef.GetEventFailed
        OpEventGetEventFailed_GetEventFailed_EvtInfo_AutoCreatedDemEvent_INIT_Action_NvM_Init_BswMReportFailToDemRef: start-on-event=DemSatellite_OsApplication_Untrusted_Core0InternalBehavior/GetEventFailed, operation=EvtInfo_AutoCreatedDemEvent_INIT_Action_NvM_Init_BswMReportFailToDemRef.GetEventFailed
        OpEventGetEventFailed_GetEventFailed_EvtInfo_AutoCreatedDemEvent_INIT_Action_PduR_Init_BswMReportFailToDemRef: start-on-event=DemSatellite_OsApplication_Untrusted_Core0InternalBehavior/GetEventFailed, operation=EvtInfo_AutoCreatedDemEvent_INIT_Action_PduR_Init_BswMReportFailToDemRef.GetEventFailed
        OpEventGetEventFailed_GetEventFailed_EvtInfo_AutoCreatedDemEvent_INIT_Action_RteStart_BswMReportFailToDemRef: start-on-event=DemSatellite_OsApplication_Untrusted_Core0InternalBehavior/GetEventFailed, operation=EvtInfo_AutoCreatedDemEvent_INIT_Action_RteStart_BswMReportFailToDemRef.GetEventFailed
        OpEventGetEventFailed_GetEventFailed_EvtInfo_AutoCreatedDemEvent_CHNL_17344684_CANSM_E_MODE_REQUEST_TIMEOUT: start-on-event=DemSatellite_OsApplication_Untrusted_Core0InternalBehavior/GetEventFailed, operation=EvtInfo_AutoCreatedDemEvent_CHNL_17344684_CANSM_E_MODE_REQUEST_TIMEOUT.GetEventFailed
        OpEventGetEventFailed_GetEventFailed_EvtInfo_AutoCreatedDemEvent_CHNL_17344684_CANSM_E_BUS_OFF: start-on-event=DemSatellite_OsApplication_Untrusted_Core0InternalBehavior/GetEventFailed, operation=EvtInfo_AutoCreatedDemEvent_CHNL_17344684_CANSM_E_BUS_OFF.GetEventFailed
        OpEventGetEventFailed_GetEventFailed_EvtInfo_AutoCreatedDemEvent_CHNL_53cce282_CANSM_E_MODE_REQUEST_TIMEOUT: start-on-event=DemSatellite_OsApplication_Untrusted_Core0InternalBehavior/GetEventFailed, operation=EvtInfo_AutoCreatedDemEvent_CHNL_53cce282_CANSM_E_MODE_REQUEST_TIMEOUT.GetEventFailed
        OpEventGetEventFailed_GetEventFailed_EvtInfo_AutoCreatedDemEvent_CHNL_53cce282_CANSM_E_BUS_OFF: start-on-event=DemSatellite_OsApplication_Untrusted_Core0InternalBehavior/GetEventFailed, operation=EvtInfo_AutoCreatedDemEvent_CHNL_53cce282_CANSM_E_BUS_OFF.GetEventFailed
        OpEventGetEventFailed_GetEventFailed_EvtInfo_AutoCreatedDemEvent_CHNL_a6b6a922_CANSM_E_MODE_REQUEST_TIMEOUT: start-on-event=DemSatellite_OsApplication_Untrusted_Core0InternalBehavior/GetEventFailed, operation=EvtInfo_AutoCreatedDemEvent_CHNL_a6b6a922_CANSM_E_MODE_REQUEST_TIMEOUT.GetEventFailed
        OpEventGetEventFailed_GetEventFailed_EvtInfo_AutoCreatedDemEvent_CHNL_a6b6a922_CANSM_E_BUS_OFF: start-on-event=DemSatellite_OsApplication_Untrusted_Core0InternalBehavior/GetEventFailed, operation=EvtInfo_AutoCreatedDemEvent_CHNL_a6b6a922_CANSM_E_BUS_OFF.GetEventFailed
        OpEventGetEventFailed_GetEventFailed_EvtInfo_AutoCreatedDemEvent_CHNL_df893ad5_CANSM_E_MODE_REQUEST_TIMEOUT: start-on-event=DemSatellite_OsApplication_Untrusted_Core0InternalBehavior/GetEventFailed, operation=EvtInfo_AutoCreatedDemEvent_CHNL_df893ad5_CANSM_E_MODE_REQUEST_TIMEOUT.GetEventFailed
        OpEventGetEventFailed_GetEventFailed_EvtInfo_AutoCreatedDemEvent_CHNL_df893ad5_CANSM_E_BUS_OFF: start-on-event=DemSatellite_OsApplication_Untrusted_Core0InternalBehavior/GetEventFailed, operation=EvtInfo_AutoCreatedDemEvent_CHNL_df893ad5_CANSM_E_BUS_OFF.GetEventFailed
        OpEventGetEventFailed_GetEventFailed_EvtInfo_AutoCreatedDemEvent_CHNL_e058b4ae_CANSM_E_MODE_REQUEST_TIMEOUT: start-on-event=DemSatellite_OsApplication_Untrusted_Core0InternalBehavior/GetEventFailed, operation=EvtInfo_AutoCreatedDemEvent_CHNL_e058b4ae_CANSM_E_MODE_REQUEST_TIMEOUT.GetEventFailed
        OpEventGetEventFailed_GetEventFailed_EvtInfo_AutoCreatedDemEvent_CHNL_e058b4ae_CANSM_E_BUS_OFF: start-on-event=DemSatellite_OsApplication_Untrusted_Core0InternalBehavior/GetEventFailed, operation=EvtInfo_AutoCreatedDemEvent_CHNL_e058b4ae_CANSM_E_BUS_OFF.GetEventFailed
        OpEventGetEventFailed_GetEventFailed_EvtInfo_AutoCreatedDemEvent_ECUM_E_RAM_CHECK_FAILED: start-on-event=DemSatellite_OsApplication_Untrusted_Core0InternalBehavior/GetEventFailed, operation=EvtInfo_AutoCreatedDemEvent_ECUM_E_RAM_CHECK_FAILED.GetEventFailed
        OpEventGetEventFailed_GetEventFailed_EvtInfo_AutoCreatedDemEvent_ECUM_E_IMPROPER_CALLER: start-on-event=DemSatellite_OsApplication_Untrusted_Core0InternalBehavior/GetEventFailed, operation=EvtInfo_AutoCreatedDemEvent_ECUM_E_IMPROPER_CALLER.GetEventFailed
        OpEventGetEventFailed_GetEventFailed_EvtInfo_AutoCreatedDemEvent_ECUM_E_CONFIGURATION_DATA_INCONSISTENT: start-on-event=DemSatellite_OsApplication_Untrusted_Core0InternalBehavior/GetEventFailed, operation=EvtInfo_AutoCreatedDemEvent_ECUM_E_CONFIGURATION_DATA_INCONSISTENT.GetEventFailed
        OpEventGetEventFailed_GetEventFailed_EvtInfo_AutoCreatedDemEvent_ECUM_E_ALL_RUN_REQUESTS_KILLED: start-on-event=DemSatellite_OsApplication_Untrusted_Core0InternalBehavior/GetEventFailed, operation=EvtInfo_AutoCreatedDemEvent_ECUM_E_ALL_RUN_REQUESTS_KILLED.GetEventFailed
        OpEventGetEventFailed_GetEventFailed_EvtInfo_AutoCreatedDemEvent_FLS_E_WRITE_FAILED: start-on-event=DemSatellite_OsApplication_Untrusted_Core0InternalBehavior/GetEventFailed, operation=EvtInfo_AutoCreatedDemEvent_FLS_E_WRITE_FAILED.GetEventFailed
        OpEventGetEventFailed_GetEventFailed_EvtInfo_AutoCreatedDemEvent_FLS_E_UNEXPECTED_FLASH_ID: start-on-event=DemSatellite_OsApplication_Untrusted_Core0InternalBehavior/GetEventFailed, operation=EvtInfo_AutoCreatedDemEvent_FLS_E_UNEXPECTED_FLASH_ID.GetEventFailed
        OpEventGetEventFailed_GetEventFailed_EvtInfo_AutoCreatedDemEvent_FLS_E_READ_FAILED: start-on-event=DemSatellite_OsApplication_Untrusted_Core0InternalBehavior/GetEventFailed, operation=EvtInfo_AutoCreatedDemEvent_FLS_E_READ_FAILED.GetEventFailed
        OpEventGetEventFailed_GetEventFailed_EvtInfo_AutoCreatedDemEvent_FLS_E_ERASE_FAILED: start-on-event=DemSatellite_OsApplication_Untrusted_Core0InternalBehavior/GetEventFailed, operation=EvtInfo_AutoCreatedDemEvent_FLS_E_ERASE_FAILED.GetEventFailed
        OpEventGetEventFailed_GetEventFailed_EvtInfo_AutoCreatedDemEvent_FLS_E_COMPARE_FAILED: start-on-event=DemSatellite_OsApplication_Untrusted_Core0InternalBehavior/GetEventFailed, operation=EvtInfo_AutoCreatedDemEvent_FLS_E_COMPARE_FAILED.GetEventFailed
        OpEventGetEventFailed_GetEventFailed_EvtInfo_AutoCreatedDemEvent_GPT_E_TIMEOUT: start-on-event=DemSatellite_OsApplication_Untrusted_Core0InternalBehavior/GetEventFailed, operation=EvtInfo_AutoCreatedDemEvent_GPT_E_TIMEOUT.GetEventFailed
        OpEventGetEventFailed_GetEventFailed_EvtInfo_AutoCreatedDemEvent_J1939NM_E_ADDRESS_LOST: start-on-event=DemSatellite_OsApplication_Untrusted_Core0InternalBehavior/GetEventFailed, operation=EvtInfo_AutoCreatedDemEvent_J1939NM_E_ADDRESS_LOST.GetEventFailed
        OpEventGetEventFailed_GetEventFailed_EvtInfo_AutoCreatedDemEvent_J1939TpConfiguration_J1939TP_E_COMMUNICATION: start-on-event=DemSatellite_OsApplication_Untrusted_Core0InternalBehavior/GetEventFailed, operation=EvtInfo_AutoCreatedDemEvent_J1939TpConfiguration_J1939TP_E_COMMUNICATION.GetEventFailed
        OpEventGetEventFailed_GetEventFailed_EvtInfo_AutoCreatedDemEvent_LIN_E_TIMEOUT: start-on-event=DemSatellite_OsApplication_Untrusted_Core0InternalBehavior/GetEventFailed, operation=EvtInfo_AutoCreatedDemEvent_LIN_E_TIMEOUT.GetEventFailed
        OpEventGetEventFailed_GetEventFailed_EvtInfo_AutoCreatedDemEvent_MCL_E_DMA_UNRECOGNIZED: start-on-event=DemSatellite_OsApplication_Untrusted_Core0InternalBehavior/GetEventFailed, operation=EvtInfo_AutoCreatedDemEvent_MCL_E_DMA_UNRECOGNIZED.GetEventFailed
        OpEventGetEventFailed_GetEventFailed_EvtInfo_AutoCreatedDemEvent_MCL_E_DMA_PRIORITY: start-on-event=DemSatellite_OsApplication_Untrusted_Core0InternalBehavior/GetEventFailed, operation=EvtInfo_AutoCreatedDemEvent_MCL_E_DMA_PRIORITY.GetEventFailed
        OpEventGetEventFailed_GetEventFailed_EvtInfo_AutoCreatedDemEvent_MCL_E_DMA_INCONSISTENCY: start-on-event=DemSatellite_OsApplication_Untrusted_Core0InternalBehavior/GetEventFailed, operation=EvtInfo_AutoCreatedDemEvent_MCL_E_DMA_INCONSISTENCY.GetEventFailed
        OpEventGetEventFailed_GetEventFailed_EvtInfo_AutoCreatedDemEvent_MCL_E_DMA_ECC: start-on-event=DemSatellite_OsApplication_Untrusted_Core0InternalBehavior/GetEventFailed, operation=EvtInfo_AutoCreatedDemEvent_MCL_E_DMA_ECC.GetEventFailed
        OpEventGetEventFailed_GetEventFailed_EvtInfo_AutoCreatedDemEvent_MCL_E_DMA_DESCRIPTOR: start-on-event=DemSatellite_OsApplication_Untrusted_Core0InternalBehavior/GetEventFailed, operation=EvtInfo_AutoCreatedDemEvent_MCL_E_DMA_DESCRIPTOR.GetEventFailed
        OpEventGetEventFailed_GetEventFailed_EvtInfo_AutoCreatedDemEvent_MCL_E_DMA_BUS: start-on-event=DemSatellite_OsApplication_Untrusted_Core0InternalBehavior/GetEventFailed, operation=EvtInfo_AutoCreatedDemEvent_MCL_E_DMA_BUS.GetEventFailed
        OpEventGetEventFailed_GetEventFailed_EvtInfo_AutoCreatedDemEvent_MCU_E_TIMEOUT_FAILURE: start-on-event=DemSatellite_OsApplication_Untrusted_Core0InternalBehavior/GetEventFailed, operation=EvtInfo_AutoCreatedDemEvent_MCU_E_TIMEOUT_FAILURE.GetEventFailed
        OpEventGetEventFailed_GetEventFailed_EvtInfo_AutoCreatedDemEvent_MCU_E_SSCM_CER_FAILURE: start-on-event=DemSatellite_OsApplication_Untrusted_Core0InternalBehavior/GetEventFailed, operation=EvtInfo_AutoCreatedDemEvent_MCU_E_SSCM_CER_FAILURE.GetEventFailed
        OpEventGetEventFailed_GetEventFailed_EvtInfo_AutoCreatedDemEvent_MCU_E_INVALIDMODE_CONFIG: start-on-event=DemSatellite_OsApplication_Untrusted_Core0InternalBehavior/GetEventFailed, operation=EvtInfo_AutoCreatedDemEvent_MCU_E_INVALIDMODE_CONFIG.GetEventFailed
        OpEventGetEventFailed_GetEventFailed_EvtInfo_AutoCreatedDemEvent_MCU_E_CLOCK_FAILURE: start-on-event=DemSatellite_OsApplication_Untrusted_Core0InternalBehavior/GetEventFailed, operation=EvtInfo_AutoCreatedDemEvent_MCU_E_CLOCK_FAILURE.GetEventFailed
        OpEventGetEventFailed_GetEventFailed_EvtInfo_AutoCreatedDemEvent_NVM_E_WRONG_BLOCK_ID: start-on-event=DemSatellite_OsApplication_Untrusted_Core0InternalBehavior/GetEventFailed, operation=EvtInfo_AutoCreatedDemEvent_NVM_E_WRONG_BLOCK_ID.GetEventFailed
        OpEventGetEventFailed_GetEventFailed_EvtInfo_AutoCreatedDemEvent_NVM_E_WRITE_PROTECTED: start-on-event=DemSatellite_OsApplication_Untrusted_Core0InternalBehavior/GetEventFailed, operation=EvtInfo_AutoCreatedDemEvent_NVM_E_WRITE_PROTECTED.GetEventFailed
        OpEventGetEventFailed_GetEventFailed_EvtInfo_AutoCreatedDemEvent_NVM_E_VERIFY_FAILED: start-on-event=DemSatellite_OsApplication_Untrusted_Core0InternalBehavior/GetEventFailed, operation=EvtInfo_AutoCreatedDemEvent_NVM_E_VERIFY_FAILED.GetEventFailed
        OpEventGetEventFailed_GetEventFailed_EvtInfo_AutoCreatedDemEvent_NVM_E_REQ_FAILED: start-on-event=DemSatellite_OsApplication_Untrusted_Core0InternalBehavior/GetEventFailed, operation=EvtInfo_AutoCreatedDemEvent_NVM_E_REQ_FAILED.GetEventFailed
        OpEventGetEventFailed_GetEventFailed_EvtInfo_AutoCreatedDemEvent_NVM_E_QUEUE_OVERFLOW: start-on-event=DemSatellite_OsApplication_Untrusted_Core0InternalBehavior/GetEventFailed, operation=EvtInfo_AutoCreatedDemEvent_NVM_E_QUEUE_OVERFLOW.GetEventFailed
        OpEventGetEventFailed_GetEventFailed_EvtInfo_AutoCreatedDemEvent_NVM_E_LOSS_OF_REDUNDANCY: start-on-event=DemSatellite_OsApplication_Untrusted_Core0InternalBehavior/GetEventFailed, operation=EvtInfo_AutoCreatedDemEvent_NVM_E_LOSS_OF_REDUNDANCY.GetEventFailed
        OpEventGetEventFailed_GetEventFailed_EvtInfo_AutoCreatedDemEvent_NVM_E_INTEGRITY_FAILED: start-on-event=DemSatellite_OsApplication_Untrusted_Core0InternalBehavior/GetEventFailed, operation=EvtInfo_AutoCreatedDemEvent_NVM_E_INTEGRITY_FAILED.GetEventFailed
        OpEventGetEventFailed_GetEventFailed_EvtInfo_AutoCreatedDemEvent_SPI_E_HARDWARE_ERROR: start-on-event=DemSatellite_OsApplication_Untrusted_Core0InternalBehavior/GetEventFailed, operation=EvtInfo_AutoCreatedDemEvent_SPI_E_HARDWARE_ERROR.GetEventFailed
        OpEventGetEventFailed_GetEventFailed_EvtInfo_AutoCreatedDemEvent_SpiDriver_SPI_E_HARDWARE_ERROR: start-on-event=DemSatellite_OsApplication_Untrusted_Core0InternalBehavior/GetEventFailed, operation=EvtInfo_AutoCreatedDemEvent_SpiDriver_SPI_E_HARDWARE_ERROR.GetEventFailed
        OpEventGetEventFailed_GetEventFailed_EvtInfo_AutoCreatedDemEvent_WDG_E_UNLOCKED: start-on-event=DemSatellite_OsApplication_Untrusted_Core0InternalBehavior/GetEventFailed, operation=EvtInfo_AutoCreatedDemEvent_WDG_E_UNLOCKED.GetEventFailed
        OpEventGetEventFailed_GetEventFailed_EvtInfo_AutoCreatedDemEvent_WDG_E_MODE_FAILED: start-on-event=DemSatellite_OsApplication_Untrusted_Core0InternalBehavior/GetEventFailed, operation=EvtInfo_AutoCreatedDemEvent_WDG_E_MODE_FAILED.GetEventFailed
        OpEventGetEventFailed_GetEventFailed_EvtInfo_AutoCreatedDemEvent_WDG_E_INVALID_PARAMETER: start-on-event=DemSatellite_OsApplication_Untrusted_Core0InternalBehavior/GetEventFailed, operation=EvtInfo_AutoCreatedDemEvent_WDG_E_INVALID_PARAMETER.GetEventFailed
        OpEventGetEventFailed_GetEventFailed_EvtInfo_AutoCreatedDemEvent_WDG_E_INVALID_CALL: start-on-event=DemSatellite_OsApplication_Untrusted_Core0InternalBehavior/GetEventFailed, operation=EvtInfo_AutoCreatedDemEvent_WDG_E_INVALID_CALL.GetEventFailed
        OpEventGetEventFailed_GetEventFailed_EvtInfo_AutoCreatedDemEvent_WDG_E_FORBIDDEN_INVOCATION: start-on-event=DemSatellite_OsApplication_Untrusted_Core0InternalBehavior/GetEventFailed, operation=EvtInfo_AutoCreatedDemEvent_WDG_E_FORBIDDEN_INVOCATION.GetEventFailed
        OpEventGetEventFailed_GetEventFailed_EvtInfo_AutoCreatedDemEvent_WDG_E_DISABLE_REJECTED: start-on-event=DemSatellite_OsApplication_Untrusted_Core0InternalBehavior/GetEventFailed, operation=EvtInfo_AutoCreatedDemEvent_WDG_E_DISABLE_REJECTED.GetEventFailed
        OpEventGetEventFailed_GetEventFailed_EvtInfo_AutoCreatedDemEvent_WDG_E_CORRUPT_CONFIG: start-on-event=DemSatellite_OsApplication_Untrusted_Core0InternalBehavior/GetEventFailed, operation=EvtInfo_AutoCreatedDemEvent_WDG_E_CORRUPT_CONFIG.GetEventFailed
        OpEventGetEventTested_GetEventTested_EvtInfo_AutoCreatedDemEvent_ADC_E_TIMEOUT: start-on-event=DemSatellite_OsApplication_Untrusted_Core0InternalBehavior/GetEventTested, operation=EvtInfo_AutoCreatedDemEvent_ADC_E_TIMEOUT.GetEventTested
        OpEventGetEventTested_GetEventTested_EvtInfo_AutoCreatedDemEvent_CC_DisableDM_CIOM_oCabSubnet_Rx_063a5fbc_BswMReportFailToDemRef: start-on-event=DemSatellite_OsApplication_Untrusted_Core0InternalBehavior/GetEventTested, operation=EvtInfo_AutoCreatedDemEvent_CC_DisableDM_CIOM_oCabSubnet_Rx_063a5fbc_BswMReportFailToDemRef.GetEventTested
        OpEventGetEventTested_GetEventTested_EvtInfo_AutoCreatedDemEvent_CC_J1939RmStateSwitch_CN_Backbone1J1939_0b1f4bae_CIOM_a65a12e6: start-on-event=DemSatellite_OsApplication_Untrusted_Core0InternalBehavior/GetEventTested, operation=EvtInfo_AutoCreatedDemEvent_CC_J1939RmStateSwitch_CN_Backbone1J1939_0b1f4bae_CIOM_4d5cd289_J1939RM_STATE_OFFLINE_BswMRe_5a5b15b8.GetEventTested
        OpEventGetEventTested_GetEventTested_EvtInfo_AutoCreatedDemEvent_CC_J1939RmStateSwitch_CN_Backbone1J1939_0b1f4bae_CIOM_db052275: start-on-event=DemSatellite_OsApplication_Untrusted_Core0InternalBehavior/GetEventTested, operation=EvtInfo_AutoCreatedDemEvent_CC_J1939RmStateSwitch_CN_Backbone1J1939_0b1f4bae_CIOM_4d5cd289_J1939RM_STATE_ONLINE_BswMRep_ec959aed.GetEventTested
        OpEventGetEventTested_GetEventTested_EvtInfo_AutoCreatedDemEvent_CC_DisablePDUGroup_CIOM_oLIN04_Tx_04202f7b_BswMReportF_1db406ef: start-on-event=DemSatellite_OsApplication_Untrusted_Core0InternalBehavior/GetEventTested, operation=EvtInfo_AutoCreatedDemEvent_CC_DisablePDUGroup_CIOM_oLIN04_Tx_04202f7b_BswMReportFailToDemRef.GetEventTested
        OpEventGetEventTested_GetEventTested_EvtInfo_AutoCreatedDemEvent_CC_DisablePDUGroup_CIOM_oLIN04_Rx_527a88fd_BswMReportF_d4166311: start-on-event=DemSatellite_OsApplication_Untrusted_Core0InternalBehavior/GetEventTested, operation=EvtInfo_AutoCreatedDemEvent_CC_DisablePDUGroup_CIOM_oLIN04_Rx_527a88fd_BswMReportFailToDemRef.GetEventTested
        OpEventGetEventTested_GetEventTested_EvtInfo_AutoCreatedDemEvent_CC_DisablePDUGroup_CIOM_oLIN01_Tx_33fedf49_BswMReportF_660caf96: start-on-event=DemSatellite_OsApplication_Untrusted_Core0InternalBehavior/GetEventTested, operation=EvtInfo_AutoCreatedDemEvent_CC_DisablePDUGroup_CIOM_oLIN01_Tx_33fedf49_BswMReportFailToDemRef.GetEventTested
        OpEventGetEventTested_GetEventTested_EvtInfo_AutoCreatedDemEvent_CC_DisablePDUGroup_CIOM_oLIN01_Rx_65a478cf_BswMReportF_583c051c: start-on-event=DemSatellite_OsApplication_Untrusted_Core0InternalBehavior/GetEventTested, operation=EvtInfo_AutoCreatedDemEvent_CC_DisablePDUGroup_CIOM_oLIN01_Rx_65a478cf_BswMReportFailToDemRef.GetEventTested
        OpEventGetEventTested_GetEventTested_EvtInfo_AutoCreatedDemEvent_CC_EnablePDUGroup_CIOM_oLIN04_Tx_04202f7b_BswMReportFa_b6785e04: start-on-event=DemSatellite_OsApplication_Untrusted_Core0InternalBehavior/GetEventTested, operation=EvtInfo_AutoCreatedDemEvent_CC_EnablePDUGroup_CIOM_oLIN04_Tx_04202f7b_BswMReportFailToDemRef.GetEventTested
        OpEventGetEventTested_GetEventTested_EvtInfo_AutoCreatedDemEvent_CC_EnablePDUGroup_CIOM_oLIN04_Rx_527a88fd_BswMReportFa_7fda3bfa: start-on-event=DemSatellite_OsApplication_Untrusted_Core0InternalBehavior/GetEventTested, operation=EvtInfo_AutoCreatedDemEvent_CC_EnablePDUGroup_CIOM_oLIN04_Rx_527a88fd_BswMReportFailToDemRef.GetEventTested
        OpEventGetEventTested_GetEventTested_EvtInfo_AutoCreatedDemEvent_CC_DisableDM_CIOM_oBackbone2_Rx_4e624434_BswMReportFailToDemRef: start-on-event=DemSatellite_OsApplication_Untrusted_Core0InternalBehavior/GetEventTested, operation=EvtInfo_AutoCreatedDemEvent_CC_DisableDM_CIOM_oBackbone2_Rx_4e624434_BswMReportFailToDemRef.GetEventTested
        OpEventGetEventTested_GetEventTested_EvtInfo_AutoCreatedDemEvent_CC_EnableDM_CIOM_oBackbone2_Rx_4e624434_BswMReportFailToDemRef: start-on-event=DemSatellite_OsApplication_Untrusted_Core0InternalBehavior/GetEventTested, operation=EvtInfo_AutoCreatedDemEvent_CC_EnableDM_CIOM_oBackbone2_Rx_4e624434_BswMReportFailToDemRef.GetEventTested
        OpEventGetEventTested_GetEventTested_EvtInfo_AutoCreatedDemEvent_CC_DisableDM_CIOM_oSecuritySubnet_Rx_3a3c1dbc_BswMRepo_56ce4825: start-on-event=DemSatellite_OsApplication_Untrusted_Core0InternalBehavior/GetEventTested, operation=EvtInfo_AutoCreatedDemEvent_CC_DisableDM_CIOM_oSecuritySubnet_Rx_3a3c1dbc_BswMReportFailToDemRef.GetEventTested
        OpEventGetEventTested_GetEventTested_EvtInfo_AutoCreatedDemEvent_CC_EnableDM_CIOM_oSecuritySubnet_Rx_3a3c1dbc_BswMRepor_13c92e08: start-on-event=DemSatellite_OsApplication_Untrusted_Core0InternalBehavior/GetEventTested, operation=EvtInfo_AutoCreatedDemEvent_CC_EnableDM_CIOM_oSecuritySubnet_Rx_3a3c1dbc_BswMReportFailToDemRef.GetEventTested
        OpEventGetEventTested_GetEventTested_EvtInfo_AutoCreatedDemEvent_CC_DisablePDUGroup_CIOM_oCabSubnet_Tx_5060f83a_BswMRep_6ee32d92: start-on-event=DemSatellite_OsApplication_Untrusted_Core0InternalBehavior/GetEventTested, operation=EvtInfo_AutoCreatedDemEvent_CC_DisablePDUGroup_CIOM_oCabSubnet_Tx_5060f83a_BswMReportFailToDemRef.GetEventTested
        OpEventGetEventTested_GetEventTested_EvtInfo_AutoCreatedDemEvent_CC_EnablePDUGroup_CIOM_oCabSubnet_Tx_5060f83a_BswMRepo_2b797681: start-on-event=DemSatellite_OsApplication_Untrusted_Core0InternalBehavior/GetEventTested, operation=EvtInfo_AutoCreatedDemEvent_CC_EnablePDUGroup_CIOM_oCabSubnet_Tx_5060f83a_BswMReportFailToDemRef.GetEventTested
        OpEventGetEventTested_GetEventTested_EvtInfo_AutoCreatedDemEvent_CC_EnableDM_CIOM_oCabSubnet_Rx_063a5fbc_BswMReportFailToDemRef: start-on-event=DemSatellite_OsApplication_Untrusted_Core0InternalBehavior/GetEventTested, operation=EvtInfo_AutoCreatedDemEvent_CC_EnableDM_CIOM_oCabSubnet_Rx_063a5fbc_BswMReportFailToDemRef.GetEventTested
        OpEventGetEventTested_GetEventTested_EvtInfo_AutoCreatedDemEvent_CC_DisablePDUGroup_CIOM_oBackbone2_Tx_1838e3b2_BswMRep_0cbeb0bc: start-on-event=DemSatellite_OsApplication_Untrusted_Core0InternalBehavior/GetEventTested, operation=EvtInfo_AutoCreatedDemEvent_CC_DisablePDUGroup_CIOM_oBackbone2_Tx_1838e3b2_BswMReportFailToDemRef.GetEventTested
        OpEventGetEventTested_GetEventTested_EvtInfo_AutoCreatedDemEvent_CC_EnablePDUGroup_CIOM_oBackbone2_Tx_1838e3b2_BswMRepo_4924ebaf: start-on-event=DemSatellite_OsApplication_Untrusted_Core0InternalBehavior/GetEventTested, operation=EvtInfo_AutoCreatedDemEvent_CC_EnablePDUGroup_CIOM_oBackbone2_Tx_1838e3b2_BswMReportFailToDemRef.GetEventTested
        OpEventGetEventTested_GetEventTested_EvtInfo_AutoCreatedDemEvent_CC_DisablePDUGroup_CIOM_oBackbone2_Rx_4e624434_BswMRep_f9ca1136: start-on-event=DemSatellite_OsApplication_Untrusted_Core0InternalBehavior/GetEventTested, operation=EvtInfo_AutoCreatedDemEvent_CC_DisablePDUGroup_CIOM_oBackbone2_Rx_4e624434_BswMReportFailToDemRef.GetEventTested
        OpEventGetEventTested_GetEventTested_EvtInfo_AutoCreatedDemEvent_CC_EnablePDUGroup_CIOM_oBackbone2_Rx_4e624434_BswMRepo_bc504a25: start-on-event=DemSatellite_OsApplication_Untrusted_Core0InternalBehavior/GetEventTested, operation=EvtInfo_AutoCreatedDemEvent_CC_EnablePDUGroup_CIOM_oBackbone2_Rx_4e624434_BswMReportFailToDemRef.GetEventTested
        OpEventGetEventTested_GetEventTested_EvtInfo_AutoCreatedDemEvent_CC_DisablePDUGroup_CIOM_oBackbone1J1939_Rx_BC_405bc776_c5f12ef7: start-on-event=DemSatellite_OsApplication_Untrusted_Core0InternalBehavior/GetEventTested, operation=EvtInfo_AutoCreatedDemEvent_CC_DisablePDUGroup_CIOM_oBackbone1J1939_Rx_BC_405bc776_BswMReportFailToDemRef.GetEventTested
        OpEventGetEventTested_GetEventTested_EvtInfo_AutoCreatedDemEvent_CC_EnablePDUGroup_CIOM_oBackbone1J1939_Rx_BC_405bc776_3af9476e: start-on-event=DemSatellite_OsApplication_Untrusted_Core0InternalBehavior/GetEventTested, operation=EvtInfo_AutoCreatedDemEvent_CC_EnablePDUGroup_CIOM_oBackbone1J1939_Rx_BC_405bc776_BswMReportFailToDemRef.GetEventTested
        OpEventGetEventTested_GetEventTested_EvtInfo_AutoCreatedDemEvent_CC_EnablePDUGroup_CIOM_oLIN02_Tx_214b70a7_BswMReportFa_2c50946e: start-on-event=DemSatellite_OsApplication_Untrusted_Core0InternalBehavior/GetEventTested, operation=EvtInfo_AutoCreatedDemEvent_CC_EnablePDUGroup_CIOM_oLIN02_Tx_214b70a7_BswMReportFailToDemRef.GetEventTested
        OpEventGetEventTested_GetEventTested_EvtInfo_AutoCreatedDemEvent_CC_EnablePDUGroup_CIOM_oLIN02_Rx_7711d721_BswMReportFa_fa9a570c: start-on-event=DemSatellite_OsApplication_Untrusted_Core0InternalBehavior/GetEventTested, operation=EvtInfo_AutoCreatedDemEvent_CC_EnablePDUGroup_CIOM_oLIN02_Rx_7711d721_BswMReportFailToDemRef.GetEventTested
        OpEventGetEventTested_GetEventTested_EvtInfo_AutoCreatedDemEvent_CC_EnablePDUGroup_CIOM_oLIN01_Tx_33fedf49_BswMReportFa_cdc0f77d: start-on-event=DemSatellite_OsApplication_Untrusted_Core0InternalBehavior/GetEventTested, operation=EvtInfo_AutoCreatedDemEvent_CC_EnablePDUGroup_CIOM_oLIN01_Tx_33fedf49_BswMReportFailToDemRef.GetEventTested
        OpEventGetEventTested_GetEventTested_EvtInfo_AutoCreatedDemEvent_CC_EnablePDUGroup_CIOM_oLIN01_Rx_65a478cf_BswMReportFa_f3f05df7: start-on-event=DemSatellite_OsApplication_Untrusted_Core0InternalBehavior/GetEventTested, operation=EvtInfo_AutoCreatedDemEvent_CC_EnablePDUGroup_CIOM_oLIN01_Rx_65a478cf_BswMReportFailToDemRef.GetEventTested
        OpEventGetEventTested_GetEventTested_EvtInfo_AutoCreatedDemEvent_CC_DisablePDUGroup_CIOM_oLIN03_Tx_99f717c2_BswMReportF_15661c4d: start-on-event=DemSatellite_OsApplication_Untrusted_Core0InternalBehavior/GetEventTested, operation=EvtInfo_AutoCreatedDemEvent_CC_DisablePDUGroup_CIOM_oLIN03_Tx_99f717c2_BswMReportFailToDemRef.GetEventTested
        OpEventGetEventTested_GetEventTested_EvtInfo_AutoCreatedDemEvent_CC_DisablePDUGroup_CIOM_oLIN03_Rx_cfadb044_BswMReportF_2ccb79b3: start-on-event=DemSatellite_OsApplication_Untrusted_Core0InternalBehavior/GetEventTested, operation=EvtInfo_AutoCreatedDemEvent_CC_DisablePDUGroup_CIOM_oLIN03_Rx_cfadb044_BswMReportFailToDemRef.GetEventTested
        OpEventGetEventTested_GetEventTested_EvtInfo_AutoCreatedDemEvent_CC_DisableDM_CIOM_oFMSNet_Rx_BC_dd2c1510_BswMReportFailToDemRef: start-on-event=DemSatellite_OsApplication_Untrusted_Core0InternalBehavior/GetEventTested, operation=EvtInfo_AutoCreatedDemEvent_CC_DisableDM_CIOM_oFMSNet_Rx_BC_dd2c1510_BswMReportFailToDemRef.GetEventTested
        OpEventGetEventTested_GetEventTested_EvtInfo_AutoCreatedDemEvent_CC_EnableDM_CIOM_oFMSNet_Rx_BC_dd2c1510_BswMReportFailToDemRef: start-on-event=DemSatellite_OsApplication_Untrusted_Core0InternalBehavior/GetEventTested, operation=EvtInfo_AutoCreatedDemEvent_CC_EnableDM_CIOM_oFMSNet_Rx_BC_dd2c1510_BswMReportFailToDemRef.GetEventTested
        OpEventGetEventTested_GetEventTested_EvtInfo_AutoCreatedDemEvent_CC_EnablePDUGroup_CIOM_oLIN03_Tx_99f717c2_BswMReportFa_beaa44a6: start-on-event=DemSatellite_OsApplication_Untrusted_Core0InternalBehavior/GetEventTested, operation=EvtInfo_AutoCreatedDemEvent_CC_EnablePDUGroup_CIOM_oLIN03_Tx_99f717c2_BswMReportFailToDemRef.GetEventTested
        OpEventGetEventTested_GetEventTested_EvtInfo_AutoCreatedDemEvent_CC_EnablePDUGroup_CIOM_oLIN03_Rx_cfadb044_BswMReportFa_87072158: start-on-event=DemSatellite_OsApplication_Untrusted_Core0InternalBehavior/GetEventTested, operation=EvtInfo_AutoCreatedDemEvent_CC_EnablePDUGroup_CIOM_oLIN03_Rx_cfadb044_BswMReportFailToDemRef.GetEventTested
        OpEventGetEventTested_GetEventTested_EvtInfo_AutoCreatedDemEvent_CC_DisablePDUGroup_CIOM_oLIN02_Tx_214b70a7_BswMReportF_879ccc85: start-on-event=DemSatellite_OsApplication_Untrusted_Core0InternalBehavior/GetEventTested, operation=EvtInfo_AutoCreatedDemEvent_CC_DisablePDUGroup_CIOM_oLIN02_Tx_214b70a7_BswMReportFailToDemRef.GetEventTested
        OpEventGetEventTested_GetEventTested_EvtInfo_AutoCreatedDemEvent_CC_DisablePDUGroup_CIOM_oLIN02_Rx_7711d721_BswMReportF_51560fe7: start-on-event=DemSatellite_OsApplication_Untrusted_Core0InternalBehavior/GetEventTested, operation=EvtInfo_AutoCreatedDemEvent_CC_DisablePDUGroup_CIOM_oLIN02_Rx_7711d721_BswMReportFailToDemRef.GetEventTested
        OpEventGetEventTested_GetEventTested_EvtInfo_AutoCreatedDemEvent_CC_DisablePDUGroup_CIOM_oCabSubnet_Rx_063a5fbc_BswMRep_9e9e1bb8: start-on-event=DemSatellite_OsApplication_Untrusted_Core0InternalBehavior/GetEventTested, operation=EvtInfo_AutoCreatedDemEvent_CC_DisablePDUGroup_CIOM_oCabSubnet_Rx_063a5fbc_BswMReportFailToDemRef.GetEventTested
        OpEventGetEventTested_GetEventTested_EvtInfo_AutoCreatedDemEvent_CC_EnablePDUGroup_CIOM_oCabSubnet_Rx_063a5fbc_BswMRepo_db0440ab: start-on-event=DemSatellite_OsApplication_Untrusted_Core0InternalBehavior/GetEventTested, operation=EvtInfo_AutoCreatedDemEvent_CC_EnablePDUGroup_CIOM_oCabSubnet_Rx_063a5fbc_BswMReportFailToDemRef.GetEventTested
        OpEventGetEventTested_GetEventTested_EvtInfo_AutoCreatedDemEvent_CC_DisablePDUGroup_CIOM_oFMSNet_Rx_BC_dd2c1510_BswMRep_d6698365: start-on-event=DemSatellite_OsApplication_Untrusted_Core0InternalBehavior/GetEventTested, operation=EvtInfo_AutoCreatedDemEvent_CC_DisablePDUGroup_CIOM_oFMSNet_Rx_BC_dd2c1510_BswMReportFailToDemRef.GetEventTested
        OpEventGetEventTested_GetEventTested_EvtInfo_AutoCreatedDemEvent_CC_EnablePDUGroup_CIOM_oFMSNet_Rx_BC_dd2c1510_BswMRepo_93f3d876: start-on-event=DemSatellite_OsApplication_Untrusted_Core0InternalBehavior/GetEventTested, operation=EvtInfo_AutoCreatedDemEvent_CC_EnablePDUGroup_CIOM_oFMSNet_Rx_BC_dd2c1510_BswMReportFailToDemRef.GetEventTested
        OpEventGetEventTested_GetEventTested_EvtInfo_AutoCreatedDemEvent_CC_DisablePDUGroup_CIOM_oSecuritySubnet_Rx_3a3c1dbc_Bs_2731dffb: start-on-event=DemSatellite_OsApplication_Untrusted_Core0InternalBehavior/GetEventTested, operation=EvtInfo_AutoCreatedDemEvent_CC_DisablePDUGroup_CIOM_oSecuritySubnet_Rx_3a3c1dbc_BswMReportFailToDemRef.GetEventTested
        OpEventGetEventTested_GetEventTested_EvtInfo_AutoCreatedDemEvent_CC_EnablePDUGroup_CIOM_oSecuritySubnet_Rx_3a3c1dbc_Bsw_61f73c6c: start-on-event=DemSatellite_OsApplication_Untrusted_Core0InternalBehavior/GetEventTested, operation=EvtInfo_AutoCreatedDemEvent_CC_EnablePDUGroup_CIOM_oSecuritySubnet_Rx_3a3c1dbc_BswMReportFailToDemRef.GetEventTested
        OpEventGetEventTested_GetEventTested_EvtInfo_AutoCreatedDemEvent_CC_DisablePDUGroup_CIOM_oFMSNet_Tx_0x31_BC_38fc8c7d_Bs_085372f6: start-on-event=DemSatellite_OsApplication_Untrusted_Core0InternalBehavior/GetEventTested, operation=EvtInfo_AutoCreatedDemEvent_CC_DisablePDUGroup_CIOM_oFMSNet_Tx_0x31_BC_38fc8c7d_BswMReportFailToDemRef.GetEventTested
        OpEventGetEventTested_GetEventTested_EvtInfo_AutoCreatedDemEvent_CC_EnablePDUGroup_CIOM_oFMSNet_Tx_0x31_BC_38fc8c7d_Bsw_4e959161: start-on-event=DemSatellite_OsApplication_Untrusted_Core0InternalBehavior/GetEventTested, operation=EvtInfo_AutoCreatedDemEvent_CC_EnablePDUGroup_CIOM_oFMSNet_Tx_0x31_BC_38fc8c7d_BswMReportFailToDemRef.GetEventTested
        OpEventGetEventTested_GetEventTested_EvtInfo_AutoCreatedDemEvent_CC_DisablePDUGroup_CIOM_oSecuritySubnet_Tx_6c66ba3a_Bs_e9ee6d9a: start-on-event=DemSatellite_OsApplication_Untrusted_Core0InternalBehavior/GetEventTested, operation=EvtInfo_AutoCreatedDemEvent_CC_DisablePDUGroup_CIOM_oSecuritySubnet_Tx_6c66ba3a_BswMReportFailToDemRef.GetEventTested
        OpEventGetEventTested_GetEventTested_EvtInfo_AutoCreatedDemEvent_CC_EnablePDUGroup_CIOM_oSecuritySubnet_Tx_6c66ba3a_Bsw_af288e0d: start-on-event=DemSatellite_OsApplication_Untrusted_Core0InternalBehavior/GetEventTested, operation=EvtInfo_AutoCreatedDemEvent_CC_EnablePDUGroup_CIOM_oSecuritySubnet_Tx_6c66ba3a_BswMReportFailToDemRef.GetEventTested
        OpEventGetEventTested_GetEventTested_EvtInfo_AutoCreatedDemEvent_CC_DisablePDUGroup_CIOM_oLIN00_Tx_8b42b82c_BswMReportF_0605c1ec: start-on-event=DemSatellite_OsApplication_Untrusted_Core0InternalBehavior/GetEventTested, operation=EvtInfo_AutoCreatedDemEvent_CC_DisablePDUGroup_CIOM_oLIN00_Tx_8b42b82c_BswMReportFailToDemRef.GetEventTested
        OpEventGetEventTested_GetEventTested_EvtInfo_AutoCreatedDemEvent_CC_EnablePDUGroup_CIOM_oLIN00_Rx_dd181faa_BswMReportFa_2c3deba4: start-on-event=DemSatellite_OsApplication_Untrusted_Core0InternalBehavior/GetEventTested, operation=EvtInfo_AutoCreatedDemEvent_CC_EnablePDUGroup_CIOM_oLIN00_Rx_dd181faa_BswMReportFailToDemRef.GetEventTested
        OpEventGetEventTested_GetEventTested_EvtInfo_AutoCreatedDemEvent_ESH_Action_ComMCheckPendingRequests_BswMReportFailToDemRef: start-on-event=DemSatellite_OsApplication_Untrusted_Core0InternalBehavior/GetEventTested, operation=EvtInfo_AutoCreatedDemEvent_ESH_Action_ComMCheckPendingRequests_BswMReportFailToDemRef.GetEventTested
        OpEventGetEventTested_GetEventTested_EvtInfo_AutoCreatedDemEvent_CC_DisableDM_CIOM_oBackbone1J1939_Rx_BC_405bc776_BswMR_51e4c5ec: start-on-event=DemSatellite_OsApplication_Untrusted_Core0InternalBehavior/GetEventTested, operation=EvtInfo_AutoCreatedDemEvent_CC_DisableDM_CIOM_oBackbone1J1939_Rx_BC_405bc776_BswMReportFailToDemRef.GetEventTested
        OpEventGetEventTested_GetEventTested_EvtInfo_AutoCreatedDemEvent_CC_DisablePDUGroup_CIOM_oLIN00_Rx_dd181faa_BswMReportF_87f1b34f: start-on-event=DemSatellite_OsApplication_Untrusted_Core0InternalBehavior/GetEventTested, operation=EvtInfo_AutoCreatedDemEvent_CC_DisablePDUGroup_CIOM_oLIN00_Rx_dd181faa_BswMReportFailToDemRef.GetEventTested
        OpEventGetEventTested_GetEventTested_EvtInfo_AutoCreatedDemEvent_CC_EnablePDUGroup_CIOM_oLIN00_Tx_8b42b82c_BswMReportFa_adc99907: start-on-event=DemSatellite_OsApplication_Untrusted_Core0InternalBehavior/GetEventTested, operation=EvtInfo_AutoCreatedDemEvent_CC_EnablePDUGroup_CIOM_oLIN00_Tx_8b42b82c_BswMReportFailToDemRef.GetEventTested
        OpEventGetEventTested_GetEventTested_EvtInfo_AutoCreatedDemEvent_ESH_Action_EnterExclusiveArea_BswMReportFailToDemRef: start-on-event=DemSatellite_OsApplication_Untrusted_Core0InternalBehavior/GetEventTested, operation=EvtInfo_AutoCreatedDemEvent_ESH_Action_EnterExclusiveArea_BswMReportFailToDemRef.GetEventTested
        OpEventGetEventTested_GetEventTested_EvtInfo_AutoCreatedDemEvent_ESH_RunToPostRunNested_BswMReportFailToDemRef: start-on-event=DemSatellite_OsApplication_Untrusted_Core0InternalBehavior/GetEventTested, operation=EvtInfo_AutoCreatedDemEvent_ESH_RunToPostRunNested_BswMReportFailToDemRef.GetEventTested
        OpEventGetEventTested_GetEventTested_EvtInfo_AutoCreatedDemEvent_CC_EnableDM_CIOM_oBackbone1J1939_Rx_BC_405bc776_BswMRe_ccb24998: start-on-event=DemSatellite_OsApplication_Untrusted_Core0InternalBehavior/GetEventTested, operation=EvtInfo_AutoCreatedDemEvent_CC_EnableDM_CIOM_oBackbone1J1939_Rx_BC_405bc776_BswMReportFailToDemRef.GetEventTested
        OpEventGetEventTested_GetEventTested_EvtInfo_AutoCreatedDemEvent_CC_DisablePDUGroup_CIOM_oBackbone1J1939_Tx_0x31_BC_378_fbf3cb49: start-on-event=DemSatellite_OsApplication_Untrusted_Core0InternalBehavior/GetEventTested, operation=EvtInfo_AutoCreatedDemEvent_CC_DisablePDUGroup_CIOM_oBackbone1J1939_Tx_0x31_BC_3782f500_BswMReportFailToDemRef.GetEventTested
        OpEventGetEventTested_GetEventTested_EvtInfo_AutoCreatedDemEvent_CC_J1939RmStateSwitch_CN_FMSNet_fce1aae5_CIOM_3a3d59b1_42fd165d: start-on-event=DemSatellite_OsApplication_Untrusted_Core0InternalBehavior/GetEventTested, operation=EvtInfo_AutoCreatedDemEvent_CC_J1939RmStateSwitch_CN_FMSNet_fce1aae5_CIOM_3a3d59b1_J1939RM_STATE_OFFLINE_BswMReportFailToDemRef.GetEventTested
        OpEventGetEventTested_GetEventTested_EvtInfo_AutoCreatedDemEvent_CC_EnablePDUGroup_CIOM_oBackbone1J1939_Tx_0x31_BC_3782_fcfc9a6b: start-on-event=DemSatellite_OsApplication_Untrusted_Core0InternalBehavior/GetEventTested, operation=EvtInfo_AutoCreatedDemEvent_CC_EnablePDUGroup_CIOM_oBackbone1J1939_Tx_0x31_BC_3782f500_BswMReportFailToDemRef.GetEventTested
        OpEventGetEventTested_GetEventTested_EvtInfo_AutoCreatedDemEvent_CC_J1939RmStateSwitch_CN_FMSNet_fce1aae5_CIOM_3a3d59b1_95c891f0: start-on-event=DemSatellite_OsApplication_Untrusted_Core0InternalBehavior/GetEventTested, operation=EvtInfo_AutoCreatedDemEvent_CC_J1939RmStateSwitch_CN_FMSNet_fce1aae5_CIOM_3a3d59b1_J1939RM_STATE_ONLINE_BswMReportFailToDemRef.GetEventTested
        OpEventGetEventTested_GetEventTested_EvtInfo_AutoCreatedDemEvent_ESH_Action_CancelNvMWriteAll_BswMReportFailToDemRef: start-on-event=DemSatellite_OsApplication_Untrusted_Core0InternalBehavior/GetEventTested, operation=EvtInfo_AutoCreatedDemEvent_ESH_Action_CancelNvMWriteAll_BswMReportFailToDemRef.GetEventTested
        OpEventGetEventTested_GetEventTested_EvtInfo_AutoCreatedDemEvent_ESH_Action_CancelWriteAllTimer_Start_BswMReportFailToDemRef: start-on-event=DemSatellite_OsApplication_Untrusted_Core0InternalBehavior/GetEventTested, operation=EvtInfo_AutoCreatedDemEvent_ESH_Action_CancelWriteAllTimer_Start_BswMReportFailToDemRef.GetEventTested
        OpEventGetEventTested_GetEventTested_EvtInfo_AutoCreatedDemEvent_ESH_Action_CancelWriteAllTimer_Stop_BswMReportFailToDemRef: start-on-event=DemSatellite_OsApplication_Untrusted_Core0InternalBehavior/GetEventTested, operation=EvtInfo_AutoCreatedDemEvent_ESH_Action_CancelWriteAllTimer_Stop_BswMReportFailToDemRef.GetEventTested
        OpEventGetEventTested_GetEventTested_EvtInfo_AutoCreatedDemEvent_ESH_Action_ComMAllow_CN_Backbone1J1939_0b1f4bae_BswMRe_5290728f: start-on-event=DemSatellite_OsApplication_Untrusted_Core0InternalBehavior/GetEventTested, operation=EvtInfo_AutoCreatedDemEvent_ESH_Action_ComMAllow_CN_Backbone1J1939_0b1f4bae_BswMReportFailToDemRef.GetEventTested
        OpEventGetEventTested_GetEventTested_EvtInfo_AutoCreatedDemEvent_ESH_Action_ComMAllow_CN_Backbone1J1939_0b1f4bae_BswMRe_2f34955a: start-on-event=DemSatellite_OsApplication_Untrusted_Core0InternalBehavior/GetEventTested, operation=EvtInfo_AutoCreatedDemEvent_ESH_Action_ComMAllow_CN_Backbone1J1939_0b1f4bae_BswMReportFailToDemRef_1.GetEventTested
        OpEventGetEventTested_GetEventTested_EvtInfo_AutoCreatedDemEvent_ESH_Action_ComMAllow_CN_Backbone2_78967e2c_BswMReportF_cd3dcc7b: start-on-event=DemSatellite_OsApplication_Untrusted_Core0InternalBehavior/GetEventTested, operation=EvtInfo_AutoCreatedDemEvent_ESH_Action_ComMAllow_CN_Backbone2_78967e2c_BswMReportFailToDemRef.GetEventTested
        OpEventGetEventTested_GetEventTested_EvtInfo_AutoCreatedDemEvent_ESH_Action_ComMAllow_CN_Backbone2_78967e2c_BswMReportF_733db0c5: start-on-event=DemSatellite_OsApplication_Untrusted_Core0InternalBehavior/GetEventTested, operation=EvtInfo_AutoCreatedDemEvent_ESH_Action_ComMAllow_CN_Backbone2_78967e2c_BswMReportFailToDemRef_1.GetEventTested
        OpEventGetEventTested_GetEventTested_EvtInfo_AutoCreatedDemEvent_ESH_Action_ComMAllow_CN_CabSubnet_9ea693f1_BswMReportF_10fffa0d: start-on-event=DemSatellite_OsApplication_Untrusted_Core0InternalBehavior/GetEventTested, operation=EvtInfo_AutoCreatedDemEvent_ESH_Action_ComMAllow_CN_CabSubnet_9ea693f1_BswMReportFailToDemRef.GetEventTested
        OpEventGetEventTested_GetEventTested_EvtInfo_AutoCreatedDemEvent_ESH_Action_ComMAllow_CN_CabSubnet_9ea693f1_BswMReportF_c5e226ee: start-on-event=DemSatellite_OsApplication_Untrusted_Core0InternalBehavior/GetEventTested, operation=EvtInfo_AutoCreatedDemEvent_ESH_Action_ComMAllow_CN_CabSubnet_9ea693f1_BswMReportFailToDemRef_1.GetEventTested
        OpEventGetEventTested_GetEventTested_EvtInfo_AutoCreatedDemEvent_ESH_Action_ComMAllow_CN_FMSNet_fce1aae5_BswMReportFailToDemRef: start-on-event=DemSatellite_OsApplication_Untrusted_Core0InternalBehavior/GetEventTested, operation=EvtInfo_AutoCreatedDemEvent_ESH_Action_ComMAllow_CN_FMSNet_fce1aae5_BswMReportFailToDemRef.GetEventTested
        OpEventGetEventTested_GetEventTested_EvtInfo_AutoCreatedDemEvent_ESH_Action_ComMAllow_CN_FMSNet_fce1aae5_BswMReportFail_d6449285: start-on-event=DemSatellite_OsApplication_Untrusted_Core0InternalBehavior/GetEventTested, operation=EvtInfo_AutoCreatedDemEvent_ESH_Action_ComMAllow_CN_FMSNet_fce1aae5_BswMReportFailToDemRef_1.GetEventTested
        OpEventGetEventTested_GetEventTested_EvtInfo_AutoCreatedDemEvent_ESH_Action_ComMAllow_CN_LIN00_2cd9a7df_BswMReportFailToDemRef: start-on-event=DemSatellite_OsApplication_Untrusted_Core0InternalBehavior/GetEventTested, operation=EvtInfo_AutoCreatedDemEvent_ESH_Action_ComMAllow_CN_LIN00_2cd9a7df_BswMReportFailToDemRef.GetEventTested
        OpEventGetEventTested_GetEventTested_EvtInfo_AutoCreatedDemEvent_ESH_Action_ComMAllow_CN_LIN00_2cd9a7df_BswMReportFailToDemRef_1: start-on-event=DemSatellite_OsApplication_Untrusted_Core0InternalBehavior/GetEventTested, operation=EvtInfo_AutoCreatedDemEvent_ESH_Action_ComMAllow_CN_LIN00_2cd9a7df_BswMReportFailToDemRef_1.GetEventTested
        OpEventGetEventTested_GetEventTested_EvtInfo_AutoCreatedDemEvent_ESH_Action_ComMAllow_CN_LIN01_5bde9749_BswMReportFailToDemRef: start-on-event=DemSatellite_OsApplication_Untrusted_Core0InternalBehavior/GetEventTested, operation=EvtInfo_AutoCreatedDemEvent_ESH_Action_ComMAllow_CN_LIN01_5bde9749_BswMReportFailToDemRef.GetEventTested
        OpEventGetEventTested_GetEventTested_EvtInfo_AutoCreatedDemEvent_ESH_Action_ComMAllow_CN_LIN01_5bde9749_BswMReportFailToDemRef_1: start-on-event=DemSatellite_OsApplication_Untrusted_Core0InternalBehavior/GetEventTested, operation=EvtInfo_AutoCreatedDemEvent_ESH_Action_ComMAllow_CN_LIN01_5bde9749_BswMReportFailToDemRef_1.GetEventTested
        OpEventGetEventTested_GetEventTested_EvtInfo_AutoCreatedDemEvent_ESH_Action_ComMAllow_CN_LIN02_c2d7c6f3_BswMReportFailToDemRef: start-on-event=DemSatellite_OsApplication_Untrusted_Core0InternalBehavior/GetEventTested, operation=EvtInfo_AutoCreatedDemEvent_ESH_Action_ComMAllow_CN_LIN02_c2d7c6f3_BswMReportFailToDemRef.GetEventTested
        OpEventGetEventTested_GetEventTested_EvtInfo_AutoCreatedDemEvent_ESH_Action_ComMAllow_CN_LIN02_c2d7c6f3_BswMReportFailToDemRef_1: start-on-event=DemSatellite_OsApplication_Untrusted_Core0InternalBehavior/GetEventTested, operation=EvtInfo_AutoCreatedDemEvent_ESH_Action_ComMAllow_CN_LIN02_c2d7c6f3_BswMReportFailToDemRef_1.GetEventTested
        OpEventGetEventTested_GetEventTested_EvtInfo_AutoCreatedDemEvent_ESH_Action_ComMAllow_CN_LIN03_b5d0f665_BswMReportFailToDemRef: start-on-event=DemSatellite_OsApplication_Untrusted_Core0InternalBehavior/GetEventTested, operation=EvtInfo_AutoCreatedDemEvent_ESH_Action_ComMAllow_CN_LIN03_b5d0f665_BswMReportFailToDemRef.GetEventTested
        OpEventGetEventTested_GetEventTested_EvtInfo_AutoCreatedDemEvent_ESH_Action_ComMAllow_CN_LIN03_b5d0f665_BswMReportFailToDemRef_1: start-on-event=DemSatellite_OsApplication_Untrusted_Core0InternalBehavior/GetEventTested, operation=EvtInfo_AutoCreatedDemEvent_ESH_Action_ComMAllow_CN_LIN03_b5d0f665_BswMReportFailToDemRef_1.GetEventTested
        OpEventGetEventTested_GetEventTested_EvtInfo_AutoCreatedDemEvent_ESH_Action_ComMAllow_CN_LIN04_2bb463c6_BswMReportFailToDemRef: start-on-event=DemSatellite_OsApplication_Untrusted_Core0InternalBehavior/GetEventTested, operation=EvtInfo_AutoCreatedDemEvent_ESH_Action_ComMAllow_CN_LIN04_2bb463c6_BswMReportFailToDemRef.GetEventTested
        OpEventGetEventTested_GetEventTested_EvtInfo_AutoCreatedDemEvent_ESH_Action_ComMAllow_CN_LIN04_2bb463c6_BswMReportFailToDemRef_1: start-on-event=DemSatellite_OsApplication_Untrusted_Core0InternalBehavior/GetEventTested, operation=EvtInfo_AutoCreatedDemEvent_ESH_Action_ComMAllow_CN_LIN04_2bb463c6_BswMReportFailToDemRef_1.GetEventTested
        OpEventGetEventTested_GetEventTested_EvtInfo_AutoCreatedDemEvent_ESH_Action_ComMAllow_CN_SecuritySubnet_e7a0ee54_BswMRe_fc1af349: start-on-event=DemSatellite_OsApplication_Untrusted_Core0InternalBehavior/GetEventTested, operation=EvtInfo_AutoCreatedDemEvent_ESH_Action_ComMAllow_CN_SecuritySubnet_e7a0ee54_BswMReportFailToDemRef.GetEventTested
        OpEventGetEventTested_GetEventTested_EvtInfo_AutoCreatedDemEvent_ESH_Action_ComMAllow_CN_SecuritySubnet_e7a0ee54_BswMRe_282bf8ae: start-on-event=DemSatellite_OsApplication_Untrusted_Core0InternalBehavior/GetEventTested, operation=EvtInfo_AutoCreatedDemEvent_ESH_Action_ComMAllow_CN_SecuritySubnet_e7a0ee54_BswMReportFailToDemRef_1.GetEventTested
        OpEventGetEventTested_GetEventTested_EvtInfo_AutoCreatedDemEvent_ESH_Action_ComMCheckPendingRequests_BswMReportFailToDemRef_1: start-on-event=DemSatellite_OsApplication_Untrusted_Core0InternalBehavior/GetEventTested, operation=EvtInfo_AutoCreatedDemEvent_ESH_Action_ComMCheckPendingRequests_BswMReportFailToDemRef_1.GetEventTested
        OpEventGetEventTested_GetEventTested_EvtInfo_AutoCreatedDemEvent_ESH_Action_ComMCheckPendingRequests_BswMReportFailToDemRef_2: start-on-event=DemSatellite_OsApplication_Untrusted_Core0InternalBehavior/GetEventTested, operation=EvtInfo_AutoCreatedDemEvent_ESH_Action_ComMCheckPendingRequests_BswMReportFailToDemRef_2.GetEventTested
        OpEventGetEventTested_GetEventTested_EvtInfo_AutoCreatedDemEvent_ESH_Action_ComMDisallow_CN_Backbone1J1939_0b1f4bae_Bsw_7d50e36b: start-on-event=DemSatellite_OsApplication_Untrusted_Core0InternalBehavior/GetEventTested, operation=EvtInfo_AutoCreatedDemEvent_ESH_Action_ComMDisallow_CN_Backbone1J1939_0b1f4bae_BswMReportFailToDemRef.GetEventTested
        OpEventGetEventTested_GetEventTested_EvtInfo_AutoCreatedDemEvent_ESH_Action_ComMDisallow_CN_Backbone2_78967e2c_BswMRepo_b7b3b475: start-on-event=DemSatellite_OsApplication_Untrusted_Core0InternalBehavior/GetEventTested, operation=EvtInfo_AutoCreatedDemEvent_ESH_Action_ComMDisallow_CN_Backbone2_78967e2c_BswMReportFailToDemRef.GetEventTested
        OpEventGetEventTested_GetEventTested_EvtInfo_AutoCreatedDemEvent_ESH_Action_ComMDisallow_CN_CabSubnet_9ea693f1_BswMRepo_6a718203: start-on-event=DemSatellite_OsApplication_Untrusted_Core0InternalBehavior/GetEventTested, operation=EvtInfo_AutoCreatedDemEvent_ESH_Action_ComMDisallow_CN_CabSubnet_9ea693f1_BswMReportFailToDemRef.GetEventTested
        OpEventGetEventTested_GetEventTested_EvtInfo_AutoCreatedDemEvent_ESH_Action_ComMDisallow_CN_FMSNet_fce1aae5_BswMReportF_361e6f42: start-on-event=DemSatellite_OsApplication_Untrusted_Core0InternalBehavior/GetEventTested, operation=EvtInfo_AutoCreatedDemEvent_ESH_Action_ComMDisallow_CN_FMSNet_fce1aae5_BswMReportFailToDemRef.GetEventTested
        OpEventGetEventTested_GetEventTested_EvtInfo_AutoCreatedDemEvent_ESH_Action_ComMDisallow_CN_LIN00_2cd9a7df_BswMReportFa_2c52eb30: start-on-event=DemSatellite_OsApplication_Untrusted_Core0InternalBehavior/GetEventTested, operation=EvtInfo_AutoCreatedDemEvent_ESH_Action_ComMDisallow_CN_LIN00_2cd9a7df_BswMReportFailToDemRef.GetEventTested
        OpEventGetEventTested_GetEventTested_EvtInfo_AutoCreatedDemEvent_ESH_Action_ComMDisallow_CN_LIN01_5bde9749_BswMReportFa_14e26cec: start-on-event=DemSatellite_OsApplication_Untrusted_Core0InternalBehavior/GetEventTested, operation=EvtInfo_AutoCreatedDemEvent_ESH_Action_ComMDisallow_CN_LIN01_5bde9749_BswMReportFailToDemRef.GetEventTested
        OpEventGetEventTested_GetEventTested_EvtInfo_AutoCreatedDemEvent_ESH_Action_ComMDisallow_CN_LIN02_c2d7c6f3_BswMReportFa_e99f9088: start-on-event=DemSatellite_OsApplication_Untrusted_Core0InternalBehavior/GetEventTested, operation=EvtInfo_AutoCreatedDemEvent_ESH_Action_ComMDisallow_CN_LIN02_c2d7c6f3_BswMReportFailToDemRef.GetEventTested
        OpEventGetEventTested_GetEventTested_EvtInfo_AutoCreatedDemEvent_ESH_Action_ComMDisallow_CN_LIN03_b5d0f665_BswMReportFa_3c6b2c02: start-on-event=DemSatellite_OsApplication_Untrusted_Core0InternalBehavior/GetEventTested, operation=EvtInfo_AutoCreatedDemEvent_ESH_Action_ComMDisallow_CN_LIN03_b5d0f665_BswMReportFailToDemRef.GetEventTested
        OpEventGetEventTested_GetEventTested_EvtInfo_AutoCreatedDemEvent_ESH_Action_ComMDisallow_CN_LIN04_2bb463c6_BswMReportFa_c325d3d4: start-on-event=DemSatellite_OsApplication_Untrusted_Core0InternalBehavior/GetEventTested, operation=EvtInfo_AutoCreatedDemEvent_ESH_Action_ComMDisallow_CN_LIN04_2bb463c6_BswMReportFailToDemRef.GetEventTested
        OpEventGetEventTested_GetEventTested_EvtInfo_AutoCreatedDemEvent_ESH_Action_ComMDisallow_CN_SecuritySubnet_e7a0ee54_Bsw_d3da62ad: start-on-event=DemSatellite_OsApplication_Untrusted_Core0InternalBehavior/GetEventTested, operation=EvtInfo_AutoCreatedDemEvent_ESH_Action_ComMDisallow_CN_SecuritySubnet_e7a0ee54_BswMReportFailToDemRef.GetEventTested
        OpEventGetEventTested_GetEventTested_EvtInfo_AutoCreatedDemEvent_ESH_Action_DemInit_BswMReportFailToDemRef: start-on-event=DemSatellite_OsApplication_Untrusted_Core0InternalBehavior/GetEventTested, operation=EvtInfo_AutoCreatedDemEvent_ESH_Action_DemInit_BswMReportFailToDemRef.GetEventTested
        OpEventGetEventTested_GetEventTested_EvtInfo_AutoCreatedDemEvent_ESH_Action_DemInitialized_BswMReportFailToDemRef: start-on-event=DemSatellite_OsApplication_Untrusted_Core0InternalBehavior/GetEventTested, operation=EvtInfo_AutoCreatedDemEvent_ESH_Action_DemInitialized_BswMReportFailToDemRef.GetEventTested
        OpEventGetEventTested_GetEventTested_EvtInfo_AutoCreatedDemEvent_ESH_Action_DemNotInitialized_BswMReportFailToDemRef: start-on-event=DemSatellite_OsApplication_Untrusted_Core0InternalBehavior/GetEventTested, operation=EvtInfo_AutoCreatedDemEvent_ESH_Action_DemNotInitialized_BswMReportFailToDemRef.GetEventTested
        OpEventGetEventTested_GetEventTested_EvtInfo_AutoCreatedDemEvent_ESH_Action_DemShutdown_BswMReportFailToDemRef: start-on-event=DemSatellite_OsApplication_Untrusted_Core0InternalBehavior/GetEventTested, operation=EvtInfo_AutoCreatedDemEvent_ESH_Action_DemShutdown_BswMReportFailToDemRef.GetEventTested
        OpEventGetEventTested_GetEventTested_EvtInfo_AutoCreatedDemEvent_ESH_Action_ESH_PostRun_BswMReportFailToDemRef: start-on-event=DemSatellite_OsApplication_Untrusted_Core0InternalBehavior/GetEventTested, operation=EvtInfo_AutoCreatedDemEvent_ESH_Action_ESH_PostRun_BswMReportFailToDemRef.GetEventTested
        OpEventGetEventTested_GetEventTested_EvtInfo_AutoCreatedDemEvent_ESH_Action_ESH_PrepShutdown_BswMReportFailToDemRef: start-on-event=DemSatellite_OsApplication_Untrusted_Core0InternalBehavior/GetEventTested, operation=EvtInfo_AutoCreatedDemEvent_ESH_Action_ESH_PrepShutdown_BswMReportFailToDemRef.GetEventTested
        OpEventGetEventTested_GetEventTested_EvtInfo_AutoCreatedDemEvent_ESH_Action_ESH_PrepShutdown_BswMReportFailToDemRef_1: start-on-event=DemSatellite_OsApplication_Untrusted_Core0InternalBehavior/GetEventTested, operation=EvtInfo_AutoCreatedDemEvent_ESH_Action_ESH_PrepShutdown_BswMReportFailToDemRef_1.GetEventTested
        OpEventGetEventTested_GetEventTested_EvtInfo_AutoCreatedDemEvent_ESH_Action_ESH_Run_BswMReportFailToDemRef: start-on-event=DemSatellite_OsApplication_Untrusted_Core0InternalBehavior/GetEventTested, operation=EvtInfo_AutoCreatedDemEvent_ESH_Action_ESH_Run_BswMReportFailToDemRef.GetEventTested
        OpEventGetEventTested_GetEventTested_EvtInfo_AutoCreatedDemEvent_ESH_Action_ESH_Run_BswMReportFailToDemRef_1: start-on-event=DemSatellite_OsApplication_Untrusted_Core0InternalBehavior/GetEventTested, operation=EvtInfo_AutoCreatedDemEvent_ESH_Action_ESH_Run_BswMReportFailToDemRef_1.GetEventTested
        OpEventGetEventTested_GetEventTested_EvtInfo_AutoCreatedDemEvent_ESH_Action_ESH_WaitForNvm_BswMReportFailToDemRef: start-on-event=DemSatellite_OsApplication_Untrusted_Core0InternalBehavior/GetEventTested, operation=EvtInfo_AutoCreatedDemEvent_ESH_Action_ESH_WaitForNvm_BswMReportFailToDemRef.GetEventTested
        OpEventGetEventTested_GetEventTested_EvtInfo_AutoCreatedDemEvent_ESH_Action_ESH_Wakeup_BswMReportFailToDemRef: start-on-event=DemSatellite_OsApplication_Untrusted_Core0InternalBehavior/GetEventTested, operation=EvtInfo_AutoCreatedDemEvent_ESH_Action_ESH_Wakeup_BswMReportFailToDemRef.GetEventTested
        OpEventGetEventTested_GetEventTested_EvtInfo_AutoCreatedDemEvent_ESH_Action_ESH_Wakeup_BswMReportFailToDemRef_1: start-on-event=DemSatellite_OsApplication_Untrusted_Core0InternalBehavior/GetEventTested, operation=EvtInfo_AutoCreatedDemEvent_ESH_Action_ESH_Wakeup_BswMReportFailToDemRef_1.GetEventTested
        OpEventGetEventTested_GetEventTested_EvtInfo_AutoCreatedDemEvent_ESH_Action_EcuMClearValidatedWakeupEvents_BswMReportFa_25759ea5: start-on-event=DemSatellite_OsApplication_Untrusted_Core0InternalBehavior/GetEventTested, operation=EvtInfo_AutoCreatedDemEvent_ESH_Action_EcuMClearValidatedWakeupEvents_BswMReportFailToDemRef.GetEventTested
        OpEventGetEventTested_GetEventTested_EvtInfo_AutoCreatedDemEvent_ESH_Action_EcuMGoToSelectedShutdownTarget_BswMReportFa_843f2e73: start-on-event=DemSatellite_OsApplication_Untrusted_Core0InternalBehavior/GetEventTested, operation=EvtInfo_AutoCreatedDemEvent_ESH_Action_EcuMGoToSelectedShutdownTarget_BswMReportFailToDemRef.GetEventTested
        OpEventGetEventTested_GetEventTested_EvtInfo_AutoCreatedDemEvent_ESH_Action_EnterExclusiveArea_BswMReportFailToDemRef_1: start-on-event=DemSatellite_OsApplication_Untrusted_Core0InternalBehavior/GetEventTested, operation=EvtInfo_AutoCreatedDemEvent_ESH_Action_EnterExclusiveArea_BswMReportFailToDemRef_1.GetEventTested
        OpEventGetEventTested_GetEventTested_EvtInfo_AutoCreatedDemEvent_ESH_Action_ExitExclusiveArea_BswMReportFailToDemRef: start-on-event=DemSatellite_OsApplication_Untrusted_Core0InternalBehavior/GetEventTested, operation=EvtInfo_AutoCreatedDemEvent_ESH_Action_ExitExclusiveArea_BswMReportFailToDemRef.GetEventTested
        OpEventGetEventTested_GetEventTested_EvtInfo_AutoCreatedDemEvent_ESH_Action_NvMWriteAll_BswMReportFailToDemRef: start-on-event=DemSatellite_OsApplication_Untrusted_Core0InternalBehavior/GetEventTested, operation=EvtInfo_AutoCreatedDemEvent_ESH_Action_NvMWriteAll_BswMReportFailToDemRef.GetEventTested
        OpEventGetEventTested_GetEventTested_EvtInfo_AutoCreatedDemEvent_ESH_Action_OnEnterPostRun_BswMReportFailToDemRef: start-on-event=DemSatellite_OsApplication_Untrusted_Core0InternalBehavior/GetEventTested, operation=EvtInfo_AutoCreatedDemEvent_ESH_Action_OnEnterPostRun_BswMReportFailToDemRef.GetEventTested
        OpEventGetEventTested_GetEventTested_EvtInfo_AutoCreatedDemEvent_ESH_Action_OnEnterPrepShutdown_BswMReportFailToDemRef: start-on-event=DemSatellite_OsApplication_Untrusted_Core0InternalBehavior/GetEventTested, operation=EvtInfo_AutoCreatedDemEvent_ESH_Action_OnEnterPrepShutdown_BswMReportFailToDemRef.GetEventTested
        OpEventGetEventTested_GetEventTested_EvtInfo_AutoCreatedDemEvent_ESH_Action_OnEnterPrepShutdown_BswMReportFailToDemRef_1: start-on-event=DemSatellite_OsApplication_Untrusted_Core0InternalBehavior/GetEventTested, operation=EvtInfo_AutoCreatedDemEvent_ESH_Action_OnEnterPrepShutdown_BswMReportFailToDemRef_1.GetEventTested
        OpEventGetEventTested_GetEventTested_EvtInfo_AutoCreatedDemEvent_ESH_Action_OnEnterRun_BswMReportFailToDemRef: start-on-event=DemSatellite_OsApplication_Untrusted_Core0InternalBehavior/GetEventTested, operation=EvtInfo_AutoCreatedDemEvent_ESH_Action_OnEnterRun_BswMReportFailToDemRef.GetEventTested
        OpEventGetEventTested_GetEventTested_EvtInfo_AutoCreatedDemEvent_ESH_Action_OnEnterRun_BswMReportFailToDemRef_1: start-on-event=DemSatellite_OsApplication_Untrusted_Core0InternalBehavior/GetEventTested, operation=EvtInfo_AutoCreatedDemEvent_ESH_Action_OnEnterRun_BswMReportFailToDemRef_1.GetEventTested
        OpEventGetEventTested_GetEventTested_EvtInfo_AutoCreatedDemEvent_ESH_Action_OnEnterShutdown_BswMReportFailToDemRef: start-on-event=DemSatellite_OsApplication_Untrusted_Core0InternalBehavior/GetEventTested, operation=EvtInfo_AutoCreatedDemEvent_ESH_Action_OnEnterShutdown_BswMReportFailToDemRef.GetEventTested
        OpEventGetEventTested_GetEventTested_EvtInfo_AutoCreatedDemEvent_ESH_Action_OnEnterWaitForNvm_BswMReportFailToDemRef: start-on-event=DemSatellite_OsApplication_Untrusted_Core0InternalBehavior/GetEventTested, operation=EvtInfo_AutoCreatedDemEvent_ESH_Action_OnEnterWaitForNvm_BswMReportFailToDemRef.GetEventTested
        OpEventGetEventTested_GetEventTested_EvtInfo_AutoCreatedDemEvent_ESH_Action_OnEnterWakeup_BswMReportFailToDemRef: start-on-event=DemSatellite_OsApplication_Untrusted_Core0InternalBehavior/GetEventTested, operation=EvtInfo_AutoCreatedDemEvent_ESH_Action_OnEnterWakeup_BswMReportFailToDemRef.GetEventTested
        OpEventGetEventTested_GetEventTested_EvtInfo_AutoCreatedDemEvent_ESH_Action_OnEnterWakeup_BswMReportFailToDemRef_1: start-on-event=DemSatellite_OsApplication_Untrusted_Core0InternalBehavior/GetEventTested, operation=EvtInfo_AutoCreatedDemEvent_ESH_Action_OnEnterWakeup_BswMReportFailToDemRef_1.GetEventTested
        OpEventGetEventTested_GetEventTested_EvtInfo_AutoCreatedDemEvent_ESH_Action_SelfRunRequestTimer_Start_BswMReportFailToDemRef: start-on-event=DemSatellite_OsApplication_Untrusted_Core0InternalBehavior/GetEventTested, operation=EvtInfo_AutoCreatedDemEvent_ESH_Action_SelfRunRequestTimer_Start_BswMReportFailToDemRef.GetEventTested
        OpEventGetEventTested_GetEventTested_EvtInfo_AutoCreatedDemEvent_ESH_Action_SelfRunRequestTimer_Start_BswMReportFailToDemRef_1: start-on-event=DemSatellite_OsApplication_Untrusted_Core0InternalBehavior/GetEventTested, operation=EvtInfo_AutoCreatedDemEvent_ESH_Action_SelfRunRequestTimer_Start_BswMReportFailToDemRef_1.GetEventTested
        OpEventGetEventTested_GetEventTested_EvtInfo_AutoCreatedDemEvent_ESH_Action_SwitchPostRun_BswMReportFailToDemRef: start-on-event=DemSatellite_OsApplication_Untrusted_Core0InternalBehavior/GetEventTested, operation=EvtInfo_AutoCreatedDemEvent_ESH_Action_SwitchPostRun_BswMReportFailToDemRef.GetEventTested
        OpEventGetEventTested_GetEventTested_EvtInfo_AutoCreatedDemEvent_ESH_Action_SwitchRun_BswMReportFailToDemRef: start-on-event=DemSatellite_OsApplication_Untrusted_Core0InternalBehavior/GetEventTested, operation=EvtInfo_AutoCreatedDemEvent_ESH_Action_SwitchRun_BswMReportFailToDemRef.GetEventTested
        OpEventGetEventTested_GetEventTested_EvtInfo_AutoCreatedDemEvent_ESH_Action_SwitchRun_BswMReportFailToDemRef_1: start-on-event=DemSatellite_OsApplication_Untrusted_Core0InternalBehavior/GetEventTested, operation=EvtInfo_AutoCreatedDemEvent_ESH_Action_SwitchRun_BswMReportFailToDemRef_1.GetEventTested
        OpEventGetEventTested_GetEventTested_EvtInfo_AutoCreatedDemEvent_ESH_Action_SwitchShutdown_BswMReportFailToDemRef: start-on-event=DemSatellite_OsApplication_Untrusted_Core0InternalBehavior/GetEventTested, operation=EvtInfo_AutoCreatedDemEvent_ESH_Action_SwitchShutdown_BswMReportFailToDemRef.GetEventTested
        OpEventGetEventTested_GetEventTested_EvtInfo_AutoCreatedDemEvent_ESH_Action_SwitchShutdown_BswMReportFailToDemRef_1: start-on-event=DemSatellite_OsApplication_Untrusted_Core0InternalBehavior/GetEventTested, operation=EvtInfo_AutoCreatedDemEvent_ESH_Action_SwitchShutdown_BswMReportFailToDemRef_1.GetEventTested
        OpEventGetEventTested_GetEventTested_EvtInfo_AutoCreatedDemEvent_ESH_Action_SwitchWakeup_BswMReportFailToDemRef: start-on-event=DemSatellite_OsApplication_Untrusted_Core0InternalBehavior/GetEventTested, operation=EvtInfo_AutoCreatedDemEvent_ESH_Action_SwitchWakeup_BswMReportFailToDemRef.GetEventTested
        OpEventGetEventTested_GetEventTested_EvtInfo_AutoCreatedDemEvent_ESH_Action_SwitchWakeup_BswMReportFailToDemRef_1: start-on-event=DemSatellite_OsApplication_Untrusted_Core0InternalBehavior/GetEventTested, operation=EvtInfo_AutoCreatedDemEvent_ESH_Action_SwitchWakeup_BswMReportFailToDemRef_1.GetEventTested
        OpEventGetEventTested_GetEventTested_EvtInfo_AutoCreatedDemEvent_ESH_Action_WriteAllTimer_Start_BswMReportFailToDemRef: start-on-event=DemSatellite_OsApplication_Untrusted_Core0InternalBehavior/GetEventTested, operation=EvtInfo_AutoCreatedDemEvent_ESH_Action_WriteAllTimer_Start_BswMReportFailToDemRef.GetEventTested
        OpEventGetEventTested_GetEventTested_EvtInfo_AutoCreatedDemEvent_ESH_Action_WriteAllTimer_Stop_BswMReportFailToDemRef: start-on-event=DemSatellite_OsApplication_Untrusted_Core0InternalBehavior/GetEventTested, operation=EvtInfo_AutoCreatedDemEvent_ESH_Action_WriteAllTimer_Stop_BswMReportFailToDemRef.GetEventTested
        OpEventGetEventTested_GetEventTested_EvtInfo_AutoCreatedDemEvent_ESH_Action_WriteAllTimer_Stop_BswMReportFailToDemRef_1: start-on-event=DemSatellite_OsApplication_Untrusted_Core0InternalBehavior/GetEventTested, operation=EvtInfo_AutoCreatedDemEvent_ESH_Action_WriteAllTimer_Stop_BswMReportFailToDemRef_1.GetEventTested
        OpEventGetEventTested_GetEventTested_EvtInfo_AutoCreatedDemEvent_ESH_DemInit_BswMReportFailToDemRef: start-on-event=DemSatellite_OsApplication_Untrusted_Core0InternalBehavior/GetEventTested, operation=EvtInfo_AutoCreatedDemEvent_ESH_DemInit_BswMReportFailToDemRef.GetEventTested
        OpEventGetEventTested_GetEventTested_EvtInfo_AutoCreatedDemEvent_ESH_PostRunNested_BswMReportFailToDemRef: start-on-event=DemSatellite_OsApplication_Untrusted_Core0InternalBehavior/GetEventTested, operation=EvtInfo_AutoCreatedDemEvent_ESH_PostRunNested_BswMReportFailToDemRef.GetEventTested
        OpEventGetEventTested_GetEventTested_EvtInfo_AutoCreatedDemEvent_ESH_PostRunToPrepNested_BswMReportFailToDemRef: start-on-event=DemSatellite_OsApplication_Untrusted_Core0InternalBehavior/GetEventTested, operation=EvtInfo_AutoCreatedDemEvent_ESH_PostRunToPrepNested_BswMReportFailToDemRef.GetEventTested
        OpEventGetEventTested_GetEventTested_EvtInfo_AutoCreatedDemEvent_ESH_Action_ExitExclusiveArea_BswMReportFailToDemRef_1: start-on-event=DemSatellite_OsApplication_Untrusted_Core0InternalBehavior/GetEventTested, operation=EvtInfo_AutoCreatedDemEvent_ESH_Action_ExitExclusiveArea_BswMReportFailToDemRef_1.GetEventTested
        OpEventGetEventTested_GetEventTested_EvtInfo_AutoCreatedDemEvent_INIT_Action_BrsHw_EnableHwAccess_BswMReportFailToDemRef: start-on-event=DemSatellite_OsApplication_Untrusted_Core0InternalBehavior/GetEventTested, operation=EvtInfo_AutoCreatedDemEvent_INIT_Action_BrsHw_EnableHwAccess_BswMReportFailToDemRef.GetEventTested
        OpEventGetEventTested_GetEventTested_EvtInfo_AutoCreatedDemEvent_INIT_Action_CanIf_Init_BswMReportFailToDemRef: start-on-event=DemSatellite_OsApplication_Untrusted_Core0InternalBehavior/GetEventTested, operation=EvtInfo_AutoCreatedDemEvent_INIT_Action_CanIf_Init_BswMReportFailToDemRef.GetEventTested
        OpEventGetEventTested_GetEventTested_EvtInfo_AutoCreatedDemEvent_INIT_Action_CanNm_Init_BswMReportFailToDemRef: start-on-event=DemSatellite_OsApplication_Untrusted_Core0InternalBehavior/GetEventTested, operation=EvtInfo_AutoCreatedDemEvent_INIT_Action_CanNm_Init_BswMReportFailToDemRef.GetEventTested
        OpEventGetEventTested_GetEventTested_EvtInfo_AutoCreatedDemEvent_INIT_Action_CanSM_Init_BswMReportFailToDemRef: start-on-event=DemSatellite_OsApplication_Untrusted_Core0InternalBehavior/GetEventTested, operation=EvtInfo_AutoCreatedDemEvent_INIT_Action_CanSM_Init_BswMReportFailToDemRef.GetEventTested
        OpEventGetEventTested_GetEventTested_EvtInfo_AutoCreatedDemEvent_INIT_Action_CanTp_Init_BswMReportFailToDemRef: start-on-event=DemSatellite_OsApplication_Untrusted_Core0InternalBehavior/GetEventTested, operation=EvtInfo_AutoCreatedDemEvent_INIT_Action_CanTp_Init_BswMReportFailToDemRef.GetEventTested
        OpEventGetEventTested_GetEventTested_EvtInfo_AutoCreatedDemEvent_INIT_Action_Can_Init_BswMReportFailToDemRef: start-on-event=DemSatellite_OsApplication_Untrusted_Core0InternalBehavior/GetEventTested, operation=EvtInfo_AutoCreatedDemEvent_INIT_Action_Can_Init_BswMReportFailToDemRef.GetEventTested
        OpEventGetEventTested_GetEventTested_EvtInfo_AutoCreatedDemEvent_INIT_Action_ComM_Init_BswMReportFailToDemRef: start-on-event=DemSatellite_OsApplication_Untrusted_Core0InternalBehavior/GetEventTested, operation=EvtInfo_AutoCreatedDemEvent_INIT_Action_ComM_Init_BswMReportFailToDemRef.GetEventTested
        OpEventGetEventTested_GetEventTested_EvtInfo_AutoCreatedDemEvent_INIT_Action_Com_Init_BswMReportFailToDemRef: start-on-event=DemSatellite_OsApplication_Untrusted_Core0InternalBehavior/GetEventTested, operation=EvtInfo_AutoCreatedDemEvent_INIT_Action_Com_Init_BswMReportFailToDemRef.GetEventTested
        OpEventGetEventTested_GetEventTested_EvtInfo_AutoCreatedDemEvent_INIT_Action_Dcm_Init_BswMReportFailToDemRef: start-on-event=DemSatellite_OsApplication_Untrusted_Core0InternalBehavior/GetEventTested, operation=EvtInfo_AutoCreatedDemEvent_INIT_Action_Dcm_Init_BswMReportFailToDemRef.GetEventTested
        OpEventGetEventTested_GetEventTested_EvtInfo_AutoCreatedDemEvent_INIT_Action_Dem_Init_BswMReportFailToDemRef: start-on-event=DemSatellite_OsApplication_Untrusted_Core0InternalBehavior/GetEventTested, operation=EvtInfo_AutoCreatedDemEvent_INIT_Action_Dem_Init_BswMReportFailToDemRef.GetEventTested
        OpEventGetEventTested_GetEventTested_EvtInfo_AutoCreatedDemEvent_INIT_Action_EnableInterrupts_BswMReportFailToDemRef: start-on-event=DemSatellite_OsApplication_Untrusted_Core0InternalBehavior/GetEventTested, operation=EvtInfo_AutoCreatedDemEvent_INIT_Action_EnableInterrupts_BswMReportFailToDemRef.GetEventTested
        OpEventGetEventTested_GetEventTested_EvtInfo_AutoCreatedDemEvent_INIT_Action_Fee_Init_BswMReportFailToDemRef: start-on-event=DemSatellite_OsApplication_Untrusted_Core0InternalBehavior/GetEventTested, operation=EvtInfo_AutoCreatedDemEvent_INIT_Action_Fee_Init_BswMReportFailToDemRef.GetEventTested
        OpEventGetEventTested_GetEventTested_EvtInfo_AutoCreatedDemEvent_INIT_Action_Issm_Init_BswMReportFailToDemRef: start-on-event=DemSatellite_OsApplication_Untrusted_Core0InternalBehavior/GetEventTested, operation=EvtInfo_AutoCreatedDemEvent_INIT_Action_Issm_Init_BswMReportFailToDemRef.GetEventTested
        OpEventGetEventTested_GetEventTested_EvtInfo_AutoCreatedDemEvent_INIT_Action_J1939Nm_Init_BswMReportFailToDemRef: start-on-event=DemSatellite_OsApplication_Untrusted_Core0InternalBehavior/GetEventTested, operation=EvtInfo_AutoCreatedDemEvent_INIT_Action_J1939Nm_Init_BswMReportFailToDemRef.GetEventTested
        OpEventGetEventTested_GetEventTested_EvtInfo_AutoCreatedDemEvent_INIT_Action_J1939Rm_Init_BswMReportFailToDemRef: start-on-event=DemSatellite_OsApplication_Untrusted_Core0InternalBehavior/GetEventTested, operation=EvtInfo_AutoCreatedDemEvent_INIT_Action_J1939Rm_Init_BswMReportFailToDemRef.GetEventTested
        OpEventGetEventTested_GetEventTested_EvtInfo_AutoCreatedDemEvent_INIT_Action_J1939Tp_Init_BswMReportFailToDemRef: start-on-event=DemSatellite_OsApplication_Untrusted_Core0InternalBehavior/GetEventTested, operation=EvtInfo_AutoCreatedDemEvent_INIT_Action_J1939Tp_Init_BswMReportFailToDemRef.GetEventTested
        OpEventGetEventTested_GetEventTested_EvtInfo_AutoCreatedDemEvent_INIT_Action_LinIf_Init_BswMReportFailToDemRef: start-on-event=DemSatellite_OsApplication_Untrusted_Core0InternalBehavior/GetEventTested, operation=EvtInfo_AutoCreatedDemEvent_INIT_Action_LinIf_Init_BswMReportFailToDemRef.GetEventTested
        OpEventGetEventTested_GetEventTested_EvtInfo_AutoCreatedDemEvent_INIT_Action_LinSM_Init_BswMReportFailToDemRef: start-on-event=DemSatellite_OsApplication_Untrusted_Core0InternalBehavior/GetEventTested, operation=EvtInfo_AutoCreatedDemEvent_INIT_Action_LinSM_Init_BswMReportFailToDemRef.GetEventTested
        OpEventGetEventTested_GetEventTested_EvtInfo_AutoCreatedDemEvent_INIT_Action_LinTp_Init_BswMReportFailToDemRef: start-on-event=DemSatellite_OsApplication_Untrusted_Core0InternalBehavior/GetEventTested, operation=EvtInfo_AutoCreatedDemEvent_INIT_Action_LinTp_Init_BswMReportFailToDemRef.GetEventTested
        OpEventGetEventTested_GetEventTested_EvtInfo_AutoCreatedDemEvent_INIT_Action_Lin_Init_BswMReportFailToDemRef: start-on-event=DemSatellite_OsApplication_Untrusted_Core0InternalBehavior/GetEventTested, operation=EvtInfo_AutoCreatedDemEvent_INIT_Action_Lin_Init_BswMReportFailToDemRef.GetEventTested
        OpEventGetEventTested_GetEventTested_EvtInfo_AutoCreatedDemEvent_INIT_Action_Nm_Init_BswMReportFailToDemRef: start-on-event=DemSatellite_OsApplication_Untrusted_Core0InternalBehavior/GetEventTested, operation=EvtInfo_AutoCreatedDemEvent_INIT_Action_Nm_Init_BswMReportFailToDemRef.GetEventTested
        OpEventGetEventTested_GetEventTested_EvtInfo_AutoCreatedDemEvent_INIT_Action_NvMReadAll_BswMReportFailToDemRef: start-on-event=DemSatellite_OsApplication_Untrusted_Core0InternalBehavior/GetEventTested, operation=EvtInfo_AutoCreatedDemEvent_INIT_Action_NvMReadAll_BswMReportFailToDemRef.GetEventTested
        OpEventGetEventTested_GetEventTested_EvtInfo_AutoCreatedDemEvent_INIT_Action_NvM_Init_BswMReportFailToDemRef: start-on-event=DemSatellite_OsApplication_Untrusted_Core0InternalBehavior/GetEventTested, operation=EvtInfo_AutoCreatedDemEvent_INIT_Action_NvM_Init_BswMReportFailToDemRef.GetEventTested
        OpEventGetEventTested_GetEventTested_EvtInfo_AutoCreatedDemEvent_INIT_Action_PduR_Init_BswMReportFailToDemRef: start-on-event=DemSatellite_OsApplication_Untrusted_Core0InternalBehavior/GetEventTested, operation=EvtInfo_AutoCreatedDemEvent_INIT_Action_PduR_Init_BswMReportFailToDemRef.GetEventTested
        OpEventGetEventTested_GetEventTested_EvtInfo_AutoCreatedDemEvent_INIT_Action_RteStart_BswMReportFailToDemRef: start-on-event=DemSatellite_OsApplication_Untrusted_Core0InternalBehavior/GetEventTested, operation=EvtInfo_AutoCreatedDemEvent_INIT_Action_RteStart_BswMReportFailToDemRef.GetEventTested
        OpEventGetEventTested_GetEventTested_EvtInfo_AutoCreatedDemEvent_CHNL_17344684_CANSM_E_MODE_REQUEST_TIMEOUT: start-on-event=DemSatellite_OsApplication_Untrusted_Core0InternalBehavior/GetEventTested, operation=EvtInfo_AutoCreatedDemEvent_CHNL_17344684_CANSM_E_MODE_REQUEST_TIMEOUT.GetEventTested
        OpEventGetEventTested_GetEventTested_EvtInfo_AutoCreatedDemEvent_CHNL_17344684_CANSM_E_BUS_OFF: start-on-event=DemSatellite_OsApplication_Untrusted_Core0InternalBehavior/GetEventTested, operation=EvtInfo_AutoCreatedDemEvent_CHNL_17344684_CANSM_E_BUS_OFF.GetEventTested
        OpEventGetEventTested_GetEventTested_EvtInfo_AutoCreatedDemEvent_CHNL_53cce282_CANSM_E_MODE_REQUEST_TIMEOUT: start-on-event=DemSatellite_OsApplication_Untrusted_Core0InternalBehavior/GetEventTested, operation=EvtInfo_AutoCreatedDemEvent_CHNL_53cce282_CANSM_E_MODE_REQUEST_TIMEOUT.GetEventTested
        OpEventGetEventTested_GetEventTested_EvtInfo_AutoCreatedDemEvent_CHNL_53cce282_CANSM_E_BUS_OFF: start-on-event=DemSatellite_OsApplication_Untrusted_Core0InternalBehavior/GetEventTested, operation=EvtInfo_AutoCreatedDemEvent_CHNL_53cce282_CANSM_E_BUS_OFF.GetEventTested
        OpEventGetEventTested_GetEventTested_EvtInfo_AutoCreatedDemEvent_CHNL_a6b6a922_CANSM_E_MODE_REQUEST_TIMEOUT: start-on-event=DemSatellite_OsApplication_Untrusted_Core0InternalBehavior/GetEventTested, operation=EvtInfo_AutoCreatedDemEvent_CHNL_a6b6a922_CANSM_E_MODE_REQUEST_TIMEOUT.GetEventTested
        OpEventGetEventTested_GetEventTested_EvtInfo_AutoCreatedDemEvent_CHNL_a6b6a922_CANSM_E_BUS_OFF: start-on-event=DemSatellite_OsApplication_Untrusted_Core0InternalBehavior/GetEventTested, operation=EvtInfo_AutoCreatedDemEvent_CHNL_a6b6a922_CANSM_E_BUS_OFF.GetEventTested
        OpEventGetEventTested_GetEventTested_EvtInfo_AutoCreatedDemEvent_CHNL_df893ad5_CANSM_E_MODE_REQUEST_TIMEOUT: start-on-event=DemSatellite_OsApplication_Untrusted_Core0InternalBehavior/GetEventTested, operation=EvtInfo_AutoCreatedDemEvent_CHNL_df893ad5_CANSM_E_MODE_REQUEST_TIMEOUT.GetEventTested
        OpEventGetEventTested_GetEventTested_EvtInfo_AutoCreatedDemEvent_CHNL_df893ad5_CANSM_E_BUS_OFF: start-on-event=DemSatellite_OsApplication_Untrusted_Core0InternalBehavior/GetEventTested, operation=EvtInfo_AutoCreatedDemEvent_CHNL_df893ad5_CANSM_E_BUS_OFF.GetEventTested
        OpEventGetEventTested_GetEventTested_EvtInfo_AutoCreatedDemEvent_CHNL_e058b4ae_CANSM_E_MODE_REQUEST_TIMEOUT: start-on-event=DemSatellite_OsApplication_Untrusted_Core0InternalBehavior/GetEventTested, operation=EvtInfo_AutoCreatedDemEvent_CHNL_e058b4ae_CANSM_E_MODE_REQUEST_TIMEOUT.GetEventTested
        OpEventGetEventTested_GetEventTested_EvtInfo_AutoCreatedDemEvent_CHNL_e058b4ae_CANSM_E_BUS_OFF: start-on-event=DemSatellite_OsApplication_Untrusted_Core0InternalBehavior/GetEventTested, operation=EvtInfo_AutoCreatedDemEvent_CHNL_e058b4ae_CANSM_E_BUS_OFF.GetEventTested
        OpEventGetEventTested_GetEventTested_EvtInfo_AutoCreatedDemEvent_ECUM_E_RAM_CHECK_FAILED: start-on-event=DemSatellite_OsApplication_Untrusted_Core0InternalBehavior/GetEventTested, operation=EvtInfo_AutoCreatedDemEvent_ECUM_E_RAM_CHECK_FAILED.GetEventTested
        OpEventGetEventTested_GetEventTested_EvtInfo_AutoCreatedDemEvent_ECUM_E_IMPROPER_CALLER: start-on-event=DemSatellite_OsApplication_Untrusted_Core0InternalBehavior/GetEventTested, operation=EvtInfo_AutoCreatedDemEvent_ECUM_E_IMPROPER_CALLER.GetEventTested
        OpEventGetEventTested_GetEventTested_EvtInfo_AutoCreatedDemEvent_ECUM_E_CONFIGURATION_DATA_INCONSISTENT: start-on-event=DemSatellite_OsApplication_Untrusted_Core0InternalBehavior/GetEventTested, operation=EvtInfo_AutoCreatedDemEvent_ECUM_E_CONFIGURATION_DATA_INCONSISTENT.GetEventTested
        OpEventGetEventTested_GetEventTested_EvtInfo_AutoCreatedDemEvent_ECUM_E_ALL_RUN_REQUESTS_KILLED: start-on-event=DemSatellite_OsApplication_Untrusted_Core0InternalBehavior/GetEventTested, operation=EvtInfo_AutoCreatedDemEvent_ECUM_E_ALL_RUN_REQUESTS_KILLED.GetEventTested
        OpEventGetEventTested_GetEventTested_EvtInfo_AutoCreatedDemEvent_FLS_E_WRITE_FAILED: start-on-event=DemSatellite_OsApplication_Untrusted_Core0InternalBehavior/GetEventTested, operation=EvtInfo_AutoCreatedDemEvent_FLS_E_WRITE_FAILED.GetEventTested
        OpEventGetEventTested_GetEventTested_EvtInfo_AutoCreatedDemEvent_FLS_E_UNEXPECTED_FLASH_ID: start-on-event=DemSatellite_OsApplication_Untrusted_Core0InternalBehavior/GetEventTested, operation=EvtInfo_AutoCreatedDemEvent_FLS_E_UNEXPECTED_FLASH_ID.GetEventTested
        OpEventGetEventTested_GetEventTested_EvtInfo_AutoCreatedDemEvent_FLS_E_READ_FAILED: start-on-event=DemSatellite_OsApplication_Untrusted_Core0InternalBehavior/GetEventTested, operation=EvtInfo_AutoCreatedDemEvent_FLS_E_READ_FAILED.GetEventTested
        OpEventGetEventTested_GetEventTested_EvtInfo_AutoCreatedDemEvent_FLS_E_ERASE_FAILED: start-on-event=DemSatellite_OsApplication_Untrusted_Core0InternalBehavior/GetEventTested, operation=EvtInfo_AutoCreatedDemEvent_FLS_E_ERASE_FAILED.GetEventTested
        OpEventGetEventTested_GetEventTested_EvtInfo_AutoCreatedDemEvent_FLS_E_COMPARE_FAILED: start-on-event=DemSatellite_OsApplication_Untrusted_Core0InternalBehavior/GetEventTested, operation=EvtInfo_AutoCreatedDemEvent_FLS_E_COMPARE_FAILED.GetEventTested
        OpEventGetEventTested_GetEventTested_EvtInfo_AutoCreatedDemEvent_GPT_E_TIMEOUT: start-on-event=DemSatellite_OsApplication_Untrusted_Core0InternalBehavior/GetEventTested, operation=EvtInfo_AutoCreatedDemEvent_GPT_E_TIMEOUT.GetEventTested
        OpEventGetEventTested_GetEventTested_EvtInfo_AutoCreatedDemEvent_J1939NM_E_ADDRESS_LOST: start-on-event=DemSatellite_OsApplication_Untrusted_Core0InternalBehavior/GetEventTested, operation=EvtInfo_AutoCreatedDemEvent_J1939NM_E_ADDRESS_LOST.GetEventTested
        OpEventGetEventTested_GetEventTested_EvtInfo_AutoCreatedDemEvent_J1939TpConfiguration_J1939TP_E_COMMUNICATION: start-on-event=DemSatellite_OsApplication_Untrusted_Core0InternalBehavior/GetEventTested, operation=EvtInfo_AutoCreatedDemEvent_J1939TpConfiguration_J1939TP_E_COMMUNICATION.GetEventTested
        OpEventGetEventTested_GetEventTested_EvtInfo_AutoCreatedDemEvent_LIN_E_TIMEOUT: start-on-event=DemSatellite_OsApplication_Untrusted_Core0InternalBehavior/GetEventTested, operation=EvtInfo_AutoCreatedDemEvent_LIN_E_TIMEOUT.GetEventTested
        OpEventGetEventTested_GetEventTested_EvtInfo_AutoCreatedDemEvent_MCL_E_DMA_UNRECOGNIZED: start-on-event=DemSatellite_OsApplication_Untrusted_Core0InternalBehavior/GetEventTested, operation=EvtInfo_AutoCreatedDemEvent_MCL_E_DMA_UNRECOGNIZED.GetEventTested
        OpEventGetEventTested_GetEventTested_EvtInfo_AutoCreatedDemEvent_MCL_E_DMA_PRIORITY: start-on-event=DemSatellite_OsApplication_Untrusted_Core0InternalBehavior/GetEventTested, operation=EvtInfo_AutoCreatedDemEvent_MCL_E_DMA_PRIORITY.GetEventTested
        OpEventGetEventTested_GetEventTested_EvtInfo_AutoCreatedDemEvent_MCL_E_DMA_INCONSISTENCY: start-on-event=DemSatellite_OsApplication_Untrusted_Core0InternalBehavior/GetEventTested, operation=EvtInfo_AutoCreatedDemEvent_MCL_E_DMA_INCONSISTENCY.GetEventTested
        OpEventGetEventTested_GetEventTested_EvtInfo_AutoCreatedDemEvent_MCL_E_DMA_ECC: start-on-event=DemSatellite_OsApplication_Untrusted_Core0InternalBehavior/GetEventTested, operation=EvtInfo_AutoCreatedDemEvent_MCL_E_DMA_ECC.GetEventTested
        OpEventGetEventTested_GetEventTested_EvtInfo_AutoCreatedDemEvent_MCL_E_DMA_DESCRIPTOR: start-on-event=DemSatellite_OsApplication_Untrusted_Core0InternalBehavior/GetEventTested, operation=EvtInfo_AutoCreatedDemEvent_MCL_E_DMA_DESCRIPTOR.GetEventTested
        OpEventGetEventTested_GetEventTested_EvtInfo_AutoCreatedDemEvent_MCL_E_DMA_BUS: start-on-event=DemSatellite_OsApplication_Untrusted_Core0InternalBehavior/GetEventTested, operation=EvtInfo_AutoCreatedDemEvent_MCL_E_DMA_BUS.GetEventTested
        OpEventGetEventTested_GetEventTested_EvtInfo_AutoCreatedDemEvent_MCU_E_TIMEOUT_FAILURE: start-on-event=DemSatellite_OsApplication_Untrusted_Core0InternalBehavior/GetEventTested, operation=EvtInfo_AutoCreatedDemEvent_MCU_E_TIMEOUT_FAILURE.GetEventTested
        OpEventGetEventTested_GetEventTested_EvtInfo_AutoCreatedDemEvent_MCU_E_SSCM_CER_FAILURE: start-on-event=DemSatellite_OsApplication_Untrusted_Core0InternalBehavior/GetEventTested, operation=EvtInfo_AutoCreatedDemEvent_MCU_E_SSCM_CER_FAILURE.GetEventTested
        OpEventGetEventTested_GetEventTested_EvtInfo_AutoCreatedDemEvent_MCU_E_INVALIDMODE_CONFIG: start-on-event=DemSatellite_OsApplication_Untrusted_Core0InternalBehavior/GetEventTested, operation=EvtInfo_AutoCreatedDemEvent_MCU_E_INVALIDMODE_CONFIG.GetEventTested
        OpEventGetEventTested_GetEventTested_EvtInfo_AutoCreatedDemEvent_MCU_E_CLOCK_FAILURE: start-on-event=DemSatellite_OsApplication_Untrusted_Core0InternalBehavior/GetEventTested, operation=EvtInfo_AutoCreatedDemEvent_MCU_E_CLOCK_FAILURE.GetEventTested
        OpEventGetEventTested_GetEventTested_EvtInfo_AutoCreatedDemEvent_NVM_E_WRONG_BLOCK_ID: start-on-event=DemSatellite_OsApplication_Untrusted_Core0InternalBehavior/GetEventTested, operation=EvtInfo_AutoCreatedDemEvent_NVM_E_WRONG_BLOCK_ID.GetEventTested
        OpEventGetEventTested_GetEventTested_EvtInfo_AutoCreatedDemEvent_NVM_E_WRITE_PROTECTED: start-on-event=DemSatellite_OsApplication_Untrusted_Core0InternalBehavior/GetEventTested, operation=EvtInfo_AutoCreatedDemEvent_NVM_E_WRITE_PROTECTED.GetEventTested
        OpEventGetEventTested_GetEventTested_EvtInfo_AutoCreatedDemEvent_NVM_E_VERIFY_FAILED: start-on-event=DemSatellite_OsApplication_Untrusted_Core0InternalBehavior/GetEventTested, operation=EvtInfo_AutoCreatedDemEvent_NVM_E_VERIFY_FAILED.GetEventTested
        OpEventGetEventTested_GetEventTested_EvtInfo_AutoCreatedDemEvent_NVM_E_REQ_FAILED: start-on-event=DemSatellite_OsApplication_Untrusted_Core0InternalBehavior/GetEventTested, operation=EvtInfo_AutoCreatedDemEvent_NVM_E_REQ_FAILED.GetEventTested
        OpEventGetEventTested_GetEventTested_EvtInfo_AutoCreatedDemEvent_NVM_E_QUEUE_OVERFLOW: start-on-event=DemSatellite_OsApplication_Untrusted_Core0InternalBehavior/GetEventTested, operation=EvtInfo_AutoCreatedDemEvent_NVM_E_QUEUE_OVERFLOW.GetEventTested
        OpEventGetEventTested_GetEventTested_EvtInfo_AutoCreatedDemEvent_NVM_E_LOSS_OF_REDUNDANCY: start-on-event=DemSatellite_OsApplication_Untrusted_Core0InternalBehavior/GetEventTested, operation=EvtInfo_AutoCreatedDemEvent_NVM_E_LOSS_OF_REDUNDANCY.GetEventTested
        OpEventGetEventTested_GetEventTested_EvtInfo_AutoCreatedDemEvent_NVM_E_INTEGRITY_FAILED: start-on-event=DemSatellite_OsApplication_Untrusted_Core0InternalBehavior/GetEventTested, operation=EvtInfo_AutoCreatedDemEvent_NVM_E_INTEGRITY_FAILED.GetEventTested
        OpEventGetEventTested_GetEventTested_EvtInfo_AutoCreatedDemEvent_SPI_E_HARDWARE_ERROR: start-on-event=DemSatellite_OsApplication_Untrusted_Core0InternalBehavior/GetEventTested, operation=EvtInfo_AutoCreatedDemEvent_SPI_E_HARDWARE_ERROR.GetEventTested
        OpEventGetEventTested_GetEventTested_EvtInfo_AutoCreatedDemEvent_SpiDriver_SPI_E_HARDWARE_ERROR: start-on-event=DemSatellite_OsApplication_Untrusted_Core0InternalBehavior/GetEventTested, operation=EvtInfo_AutoCreatedDemEvent_SpiDriver_SPI_E_HARDWARE_ERROR.GetEventTested
        OpEventGetEventTested_GetEventTested_EvtInfo_AutoCreatedDemEvent_WDG_E_UNLOCKED: start-on-event=DemSatellite_OsApplication_Untrusted_Core0InternalBehavior/GetEventTested, operation=EvtInfo_AutoCreatedDemEvent_WDG_E_UNLOCKED.GetEventTested
        OpEventGetEventTested_GetEventTested_EvtInfo_AutoCreatedDemEvent_WDG_E_MODE_FAILED: start-on-event=DemSatellite_OsApplication_Untrusted_Core0InternalBehavior/GetEventTested, operation=EvtInfo_AutoCreatedDemEvent_WDG_E_MODE_FAILED.GetEventTested
        OpEventGetEventTested_GetEventTested_EvtInfo_AutoCreatedDemEvent_WDG_E_INVALID_PARAMETER: start-on-event=DemSatellite_OsApplication_Untrusted_Core0InternalBehavior/GetEventTested, operation=EvtInfo_AutoCreatedDemEvent_WDG_E_INVALID_PARAMETER.GetEventTested
        OpEventGetEventTested_GetEventTested_EvtInfo_AutoCreatedDemEvent_WDG_E_INVALID_CALL: start-on-event=DemSatellite_OsApplication_Untrusted_Core0InternalBehavior/GetEventTested, operation=EvtInfo_AutoCreatedDemEvent_WDG_E_INVALID_CALL.GetEventTested
        OpEventGetEventTested_GetEventTested_EvtInfo_AutoCreatedDemEvent_WDG_E_FORBIDDEN_INVOCATION: start-on-event=DemSatellite_OsApplication_Untrusted_Core0InternalBehavior/GetEventTested, operation=EvtInfo_AutoCreatedDemEvent_WDG_E_FORBIDDEN_INVOCATION.GetEventTested
        OpEventGetEventTested_GetEventTested_EvtInfo_AutoCreatedDemEvent_WDG_E_DISABLE_REJECTED: start-on-event=DemSatellite_OsApplication_Untrusted_Core0InternalBehavior/GetEventTested, operation=EvtInfo_AutoCreatedDemEvent_WDG_E_DISABLE_REJECTED.GetEventTested
        OpEventGetEventTested_GetEventTested_EvtInfo_AutoCreatedDemEvent_WDG_E_CORRUPT_CONFIG: start-on-event=DemSatellite_OsApplication_Untrusted_Core0InternalBehavior/GetEventTested, operation=EvtInfo_AutoCreatedDemEvent_WDG_E_CORRUPT_CONFIG.GetEventTested
        OpEventGetDTCOfEvent_GetDTCOfEvent_EvtInfo_AutoCreatedDemEvent_ADC_E_TIMEOUT: start-on-event=DemSatellite_OsApplication_Untrusted_Core0InternalBehavior/GetDTCOfEvent, operation=EvtInfo_AutoCreatedDemEvent_ADC_E_TIMEOUT.GetDTCOfEvent
        OpEventGetDTCOfEvent_GetDTCOfEvent_EvtInfo_AutoCreatedDemEvent_CC_DisableDM_CIOM_oCabSubnet_Rx_063a5fbc_BswMReportFailToDemRef: start-on-event=DemSatellite_OsApplication_Untrusted_Core0InternalBehavior/GetDTCOfEvent, operation=EvtInfo_AutoCreatedDemEvent_CC_DisableDM_CIOM_oCabSubnet_Rx_063a5fbc_BswMReportFailToDemRef.GetDTCOfEvent
        OpEventGetDTCOfEvent_GetDTCOfEvent_EvtInfo_AutoCreatedDemEvent_CC_J1939RmStateSwitch_CN_Backbone1J1939_0b1f4bae_CIOM_4d_fedce947: start-on-event=DemSatellite_OsApplication_Untrusted_Core0InternalBehavior/GetDTCOfEvent, operation=EvtInfo_AutoCreatedDemEvent_CC_J1939RmStateSwitch_CN_Backbone1J1939_0b1f4bae_CIOM_4d5cd289_J1939RM_STATE_OFFLINE_BswMRe_5a5b15b8.GetDTCOfEvent
        OpEventGetDTCOfEvent_GetDTCOfEvent_EvtInfo_AutoCreatedDemEvent_CC_J1939RmStateSwitch_CN_Backbone1J1939_0b1f4bae_CIOM_4d_8383d9d4: start-on-event=DemSatellite_OsApplication_Untrusted_Core0InternalBehavior/GetDTCOfEvent, operation=EvtInfo_AutoCreatedDemEvent_CC_J1939RmStateSwitch_CN_Backbone1J1939_0b1f4bae_CIOM_4d5cd289_J1939RM_STATE_ONLINE_BswMRep_ec959aed.GetDTCOfEvent
        OpEventGetDTCOfEvent_GetDTCOfEvent_EvtInfo_AutoCreatedDemEvent_CC_DisablePDUGroup_CIOM_oLIN04_Tx_04202f7b_BswMReportFailToDemRef: start-on-event=DemSatellite_OsApplication_Untrusted_Core0InternalBehavior/GetDTCOfEvent, operation=EvtInfo_AutoCreatedDemEvent_CC_DisablePDUGroup_CIOM_oLIN04_Tx_04202f7b_BswMReportFailToDemRef.GetDTCOfEvent
        OpEventGetDTCOfEvent_GetDTCOfEvent_EvtInfo_AutoCreatedDemEvent_CC_DisablePDUGroup_CIOM_oLIN04_Rx_527a88fd_BswMReportFailToDemRef: start-on-event=DemSatellite_OsApplication_Untrusted_Core0InternalBehavior/GetDTCOfEvent, operation=EvtInfo_AutoCreatedDemEvent_CC_DisablePDUGroup_CIOM_oLIN04_Rx_527a88fd_BswMReportFailToDemRef.GetDTCOfEvent
        OpEventGetDTCOfEvent_GetDTCOfEvent_EvtInfo_AutoCreatedDemEvent_CC_DisablePDUGroup_CIOM_oLIN01_Tx_33fedf49_BswMReportFailToDemRef: start-on-event=DemSatellite_OsApplication_Untrusted_Core0InternalBehavior/GetDTCOfEvent, operation=EvtInfo_AutoCreatedDemEvent_CC_DisablePDUGroup_CIOM_oLIN01_Tx_33fedf49_BswMReportFailToDemRef.GetDTCOfEvent
        OpEventGetDTCOfEvent_GetDTCOfEvent_EvtInfo_AutoCreatedDemEvent_CC_DisablePDUGroup_CIOM_oLIN01_Rx_65a478cf_BswMReportFailToDemRef: start-on-event=DemSatellite_OsApplication_Untrusted_Core0InternalBehavior/GetDTCOfEvent, operation=EvtInfo_AutoCreatedDemEvent_CC_DisablePDUGroup_CIOM_oLIN01_Rx_65a478cf_BswMReportFailToDemRef.GetDTCOfEvent
        OpEventGetDTCOfEvent_GetDTCOfEvent_EvtInfo_AutoCreatedDemEvent_CC_EnablePDUGroup_CIOM_oLIN04_Tx_04202f7b_BswMReportFailToDemRef: start-on-event=DemSatellite_OsApplication_Untrusted_Core0InternalBehavior/GetDTCOfEvent, operation=EvtInfo_AutoCreatedDemEvent_CC_EnablePDUGroup_CIOM_oLIN04_Tx_04202f7b_BswMReportFailToDemRef.GetDTCOfEvent
        OpEventGetDTCOfEvent_GetDTCOfEvent_EvtInfo_AutoCreatedDemEvent_CC_EnablePDUGroup_CIOM_oLIN04_Rx_527a88fd_BswMReportFailToDemRef: start-on-event=DemSatellite_OsApplication_Untrusted_Core0InternalBehavior/GetDTCOfEvent, operation=EvtInfo_AutoCreatedDemEvent_CC_EnablePDUGroup_CIOM_oLIN04_Rx_527a88fd_BswMReportFailToDemRef.GetDTCOfEvent
        OpEventGetDTCOfEvent_GetDTCOfEvent_EvtInfo_AutoCreatedDemEvent_CC_DisableDM_CIOM_oBackbone2_Rx_4e624434_BswMReportFailToDemRef: start-on-event=DemSatellite_OsApplication_Untrusted_Core0InternalBehavior/GetDTCOfEvent, operation=EvtInfo_AutoCreatedDemEvent_CC_DisableDM_CIOM_oBackbone2_Rx_4e624434_BswMReportFailToDemRef.GetDTCOfEvent
        OpEventGetDTCOfEvent_GetDTCOfEvent_EvtInfo_AutoCreatedDemEvent_CC_EnableDM_CIOM_oBackbone2_Rx_4e624434_BswMReportFailToDemRef: start-on-event=DemSatellite_OsApplication_Untrusted_Core0InternalBehavior/GetDTCOfEvent, operation=EvtInfo_AutoCreatedDemEvent_CC_EnableDM_CIOM_oBackbone2_Rx_4e624434_BswMReportFailToDemRef.GetDTCOfEvent
        OpEventGetDTCOfEvent_GetDTCOfEvent_EvtInfo_AutoCreatedDemEvent_CC_DisableDM_CIOM_oSecuritySubnet_Rx_3a3c1dbc_BswMReport_738f9f23: start-on-event=DemSatellite_OsApplication_Untrusted_Core0InternalBehavior/GetDTCOfEvent, operation=EvtInfo_AutoCreatedDemEvent_CC_DisableDM_CIOM_oSecuritySubnet_Rx_3a3c1dbc_BswMReportFailToDemRef.GetDTCOfEvent
        OpEventGetDTCOfEvent_GetDTCOfEvent_EvtInfo_AutoCreatedDemEvent_CC_EnableDM_CIOM_oSecuritySubnet_Rx_3a3c1dbc_BswMReportF_3dcc88ba: start-on-event=DemSatellite_OsApplication_Untrusted_Core0InternalBehavior/GetDTCOfEvent, operation=EvtInfo_AutoCreatedDemEvent_CC_EnableDM_CIOM_oSecuritySubnet_Rx_3a3c1dbc_BswMReportFailToDemRef.GetDTCOfEvent
        OpEventGetDTCOfEvent_GetDTCOfEvent_EvtInfo_AutoCreatedDemEvent_CC_DisablePDUGroup_CIOM_oCabSubnet_Tx_5060f83a_BswMRepor_87a5c970: start-on-event=DemSatellite_OsApplication_Untrusted_Core0InternalBehavior/GetDTCOfEvent, operation=EvtInfo_AutoCreatedDemEvent_CC_DisablePDUGroup_CIOM_oCabSubnet_Tx_5060f83a_BswMReportFailToDemRef.GetDTCOfEvent
        OpEventGetDTCOfEvent_GetDTCOfEvent_EvtInfo_AutoCreatedDemEvent_CC_EnablePDUGroup_CIOM_oCabSubnet_Tx_5060f83a_BswMReport_0e38a187: start-on-event=DemSatellite_OsApplication_Untrusted_Core0InternalBehavior/GetDTCOfEvent, operation=EvtInfo_AutoCreatedDemEvent_CC_EnablePDUGroup_CIOM_oCabSubnet_Tx_5060f83a_BswMReportFailToDemRef.GetDTCOfEvent
        OpEventGetDTCOfEvent_GetDTCOfEvent_EvtInfo_AutoCreatedDemEvent_CC_EnableDM_CIOM_oCabSubnet_Rx_063a5fbc_BswMReportFailToDemRef: start-on-event=DemSatellite_OsApplication_Untrusted_Core0InternalBehavior/GetDTCOfEvent, operation=EvtInfo_AutoCreatedDemEvent_CC_EnableDM_CIOM_oCabSubnet_Rx_063a5fbc_BswMReportFailToDemRef.GetDTCOfEvent
        OpEventGetDTCOfEvent_GetDTCOfEvent_EvtInfo_AutoCreatedDemEvent_CC_DisablePDUGroup_CIOM_oBackbone2_Tx_1838e3b2_BswMRepor_e5f8545e: start-on-event=DemSatellite_OsApplication_Untrusted_Core0InternalBehavior/GetDTCOfEvent, operation=EvtInfo_AutoCreatedDemEvent_CC_DisablePDUGroup_CIOM_oBackbone2_Tx_1838e3b2_BswMReportFailToDemRef.GetDTCOfEvent
        OpEventGetDTCOfEvent_GetDTCOfEvent_EvtInfo_AutoCreatedDemEvent_CC_EnablePDUGroup_CIOM_oBackbone2_Tx_1838e3b2_BswMReport_6c653ca9: start-on-event=DemSatellite_OsApplication_Untrusted_Core0InternalBehavior/GetDTCOfEvent, operation=EvtInfo_AutoCreatedDemEvent_CC_EnablePDUGroup_CIOM_oBackbone2_Tx_1838e3b2_BswMReportFailToDemRef.GetDTCOfEvent
        OpEventGetDTCOfEvent_GetDTCOfEvent_EvtInfo_AutoCreatedDemEvent_CC_DisablePDUGroup_CIOM_oBackbone2_Rx_4e624434_BswMRepor_108cf5d4: start-on-event=DemSatellite_OsApplication_Untrusted_Core0InternalBehavior/GetDTCOfEvent, operation=EvtInfo_AutoCreatedDemEvent_CC_DisablePDUGroup_CIOM_oBackbone2_Rx_4e624434_BswMReportFailToDemRef.GetDTCOfEvent
        OpEventGetDTCOfEvent_GetDTCOfEvent_EvtInfo_AutoCreatedDemEvent_CC_EnablePDUGroup_CIOM_oBackbone2_Rx_4e624434_BswMReport_99119d23: start-on-event=DemSatellite_OsApplication_Untrusted_Core0InternalBehavior/GetDTCOfEvent, operation=EvtInfo_AutoCreatedDemEvent_CC_EnablePDUGroup_CIOM_oBackbone2_Rx_4e624434_BswMReportFailToDemRef.GetDTCOfEvent
        OpEventGetDTCOfEvent_GetDTCOfEvent_EvtInfo_AutoCreatedDemEvent_CC_DisablePDUGroup_CIOM_oBackbone1J1939_Rx_BC_405bc776_B_0f2ec230: start-on-event=DemSatellite_OsApplication_Untrusted_Core0InternalBehavior/GetDTCOfEvent, operation=EvtInfo_AutoCreatedDemEvent_CC_DisablePDUGroup_CIOM_oBackbone1J1939_Rx_BC_405bc776_BswMReportFailToDemRef.GetDTCOfEvent
        OpEventGetDTCOfEvent_GetDTCOfEvent_EvtInfo_AutoCreatedDemEvent_CC_EnablePDUGroup_CIOM_oBackbone1J1939_Rx_BC_405bc776_Bs_5fd70a9f: start-on-event=DemSatellite_OsApplication_Untrusted_Core0InternalBehavior/GetDTCOfEvent, operation=EvtInfo_AutoCreatedDemEvent_CC_EnablePDUGroup_CIOM_oBackbone1J1939_Rx_BC_405bc776_BswMReportFailToDemRef.GetDTCOfEvent
        OpEventGetDTCOfEvent_GetDTCOfEvent_EvtInfo_AutoCreatedDemEvent_CC_EnablePDUGroup_CIOM_oLIN02_Tx_214b70a7_BswMReportFailToDemRef: start-on-event=DemSatellite_OsApplication_Untrusted_Core0InternalBehavior/GetDTCOfEvent, operation=EvtInfo_AutoCreatedDemEvent_CC_EnablePDUGroup_CIOM_oLIN02_Tx_214b70a7_BswMReportFailToDemRef.GetDTCOfEvent
        OpEventGetDTCOfEvent_GetDTCOfEvent_EvtInfo_AutoCreatedDemEvent_CC_EnablePDUGroup_CIOM_oLIN02_Rx_7711d721_BswMReportFailToDemRef: start-on-event=DemSatellite_OsApplication_Untrusted_Core0InternalBehavior/GetDTCOfEvent, operation=EvtInfo_AutoCreatedDemEvent_CC_EnablePDUGroup_CIOM_oLIN02_Rx_7711d721_BswMReportFailToDemRef.GetDTCOfEvent
        OpEventGetDTCOfEvent_GetDTCOfEvent_EvtInfo_AutoCreatedDemEvent_CC_EnablePDUGroup_CIOM_oLIN01_Tx_33fedf49_BswMReportFailToDemRef: start-on-event=DemSatellite_OsApplication_Untrusted_Core0InternalBehavior/GetDTCOfEvent, operation=EvtInfo_AutoCreatedDemEvent_CC_EnablePDUGroup_CIOM_oLIN01_Tx_33fedf49_BswMReportFailToDemRef.GetDTCOfEvent
        OpEventGetDTCOfEvent_GetDTCOfEvent_EvtInfo_AutoCreatedDemEvent_CC_EnablePDUGroup_CIOM_oLIN01_Rx_65a478cf_BswMReportFailToDemRef: start-on-event=DemSatellite_OsApplication_Untrusted_Core0InternalBehavior/GetDTCOfEvent, operation=EvtInfo_AutoCreatedDemEvent_CC_EnablePDUGroup_CIOM_oLIN01_Rx_65a478cf_BswMReportFailToDemRef.GetDTCOfEvent
        OpEventGetDTCOfEvent_GetDTCOfEvent_EvtInfo_AutoCreatedDemEvent_CC_DisablePDUGroup_CIOM_oLIN03_Tx_99f717c2_BswMReportFailToDemRef: start-on-event=DemSatellite_OsApplication_Untrusted_Core0InternalBehavior/GetDTCOfEvent, operation=EvtInfo_AutoCreatedDemEvent_CC_DisablePDUGroup_CIOM_oLIN03_Tx_99f717c2_BswMReportFailToDemRef.GetDTCOfEvent
        OpEventGetDTCOfEvent_GetDTCOfEvent_EvtInfo_AutoCreatedDemEvent_CC_DisablePDUGroup_CIOM_oLIN03_Rx_cfadb044_BswMReportFailToDemRef: start-on-event=DemSatellite_OsApplication_Untrusted_Core0InternalBehavior/GetDTCOfEvent, operation=EvtInfo_AutoCreatedDemEvent_CC_DisablePDUGroup_CIOM_oLIN03_Rx_cfadb044_BswMReportFailToDemRef.GetDTCOfEvent
        OpEventGetDTCOfEvent_GetDTCOfEvent_EvtInfo_AutoCreatedDemEvent_CC_DisableDM_CIOM_oFMSNet_Rx_BC_dd2c1510_BswMReportFailToDemRef: start-on-event=DemSatellite_OsApplication_Untrusted_Core0InternalBehavior/GetDTCOfEvent, operation=EvtInfo_AutoCreatedDemEvent_CC_DisableDM_CIOM_oFMSNet_Rx_BC_dd2c1510_BswMReportFailToDemRef.GetDTCOfEvent
        OpEventGetDTCOfEvent_GetDTCOfEvent_EvtInfo_AutoCreatedDemEvent_CC_EnableDM_CIOM_oFMSNet_Rx_BC_dd2c1510_BswMReportFailToDemRef: start-on-event=DemSatellite_OsApplication_Untrusted_Core0InternalBehavior/GetDTCOfEvent, operation=EvtInfo_AutoCreatedDemEvent_CC_EnableDM_CIOM_oFMSNet_Rx_BC_dd2c1510_BswMReportFailToDemRef.GetDTCOfEvent
        OpEventGetDTCOfEvent_GetDTCOfEvent_EvtInfo_AutoCreatedDemEvent_CC_EnablePDUGroup_CIOM_oLIN03_Tx_99f717c2_BswMReportFailToDemRef: start-on-event=DemSatellite_OsApplication_Untrusted_Core0InternalBehavior/GetDTCOfEvent, operation=EvtInfo_AutoCreatedDemEvent_CC_EnablePDUGroup_CIOM_oLIN03_Tx_99f717c2_BswMReportFailToDemRef.GetDTCOfEvent
        OpEventGetDTCOfEvent_GetDTCOfEvent_EvtInfo_AutoCreatedDemEvent_CC_EnablePDUGroup_CIOM_oLIN03_Rx_cfadb044_BswMReportFailToDemRef: start-on-event=DemSatellite_OsApplication_Untrusted_Core0InternalBehavior/GetDTCOfEvent, operation=EvtInfo_AutoCreatedDemEvent_CC_EnablePDUGroup_CIOM_oLIN03_Rx_cfadb044_BswMReportFailToDemRef.GetDTCOfEvent
        OpEventGetDTCOfEvent_GetDTCOfEvent_EvtInfo_AutoCreatedDemEvent_CC_DisablePDUGroup_CIOM_oLIN02_Tx_214b70a7_BswMReportFailToDemRef: start-on-event=DemSatellite_OsApplication_Untrusted_Core0InternalBehavior/GetDTCOfEvent, operation=EvtInfo_AutoCreatedDemEvent_CC_DisablePDUGroup_CIOM_oLIN02_Tx_214b70a7_BswMReportFailToDemRef.GetDTCOfEvent
        OpEventGetDTCOfEvent_GetDTCOfEvent_EvtInfo_AutoCreatedDemEvent_CC_DisablePDUGroup_CIOM_oLIN02_Rx_7711d721_BswMReportFailToDemRef: start-on-event=DemSatellite_OsApplication_Untrusted_Core0InternalBehavior/GetDTCOfEvent, operation=EvtInfo_AutoCreatedDemEvent_CC_DisablePDUGroup_CIOM_oLIN02_Rx_7711d721_BswMReportFailToDemRef.GetDTCOfEvent
        OpEventGetDTCOfEvent_GetDTCOfEvent_EvtInfo_AutoCreatedDemEvent_CC_DisablePDUGroup_CIOM_oCabSubnet_Rx_063a5fbc_BswMRepor_77d8ff5a: start-on-event=DemSatellite_OsApplication_Untrusted_Core0InternalBehavior/GetDTCOfEvent, operation=EvtInfo_AutoCreatedDemEvent_CC_DisablePDUGroup_CIOM_oCabSubnet_Rx_063a5fbc_BswMReportFailToDemRef.GetDTCOfEvent
        OpEventGetDTCOfEvent_GetDTCOfEvent_EvtInfo_AutoCreatedDemEvent_CC_EnablePDUGroup_CIOM_oCabSubnet_Rx_063a5fbc_BswMReport_fe4597ad: start-on-event=DemSatellite_OsApplication_Untrusted_Core0InternalBehavior/GetDTCOfEvent, operation=EvtInfo_AutoCreatedDemEvent_CC_EnablePDUGroup_CIOM_oCabSubnet_Rx_063a5fbc_BswMReportFailToDemRef.GetDTCOfEvent
        OpEventGetDTCOfEvent_GetDTCOfEvent_EvtInfo_AutoCreatedDemEvent_CC_DisablePDUGroup_CIOM_oFMSNet_Rx_BC_dd2c1510_BswMRepor_3f2f6787: start-on-event=DemSatellite_OsApplication_Untrusted_Core0InternalBehavior/GetDTCOfEvent, operation=EvtInfo_AutoCreatedDemEvent_CC_DisablePDUGroup_CIOM_oFMSNet_Rx_BC_dd2c1510_BswMReportFailToDemRef.GetDTCOfEvent
        OpEventGetDTCOfEvent_GetDTCOfEvent_EvtInfo_AutoCreatedDemEvent_CC_EnablePDUGroup_CIOM_oFMSNet_Rx_BC_dd2c1510_BswMReport_b6b20f70: start-on-event=DemSatellite_OsApplication_Untrusted_Core0InternalBehavior/GetDTCOfEvent, operation=EvtInfo_AutoCreatedDemEvent_CC_EnablePDUGroup_CIOM_oFMSNet_Rx_BC_dd2c1510_BswMReportFailToDemRef.GetDTCOfEvent
        OpEventGetDTCOfEvent_GetDTCOfEvent_EvtInfo_AutoCreatedDemEvent_CC_DisablePDUGroup_CIOM_oSecuritySubnet_Rx_3a3c1dbc_BswM_d79324fc: start-on-event=DemSatellite_OsApplication_Untrusted_Core0InternalBehavior/GetDTCOfEvent, operation=EvtInfo_AutoCreatedDemEvent_CC_DisablePDUGroup_CIOM_oSecuritySubnet_Rx_3a3c1dbc_BswMReportFailToDemRef.GetDTCOfEvent
        OpEventGetDTCOfEvent_GetDTCOfEvent_EvtInfo_AutoCreatedDemEvent_CC_EnablePDUGroup_CIOM_oSecuritySubnet_Rx_3a3c1dbc_BswMR_cc9f7ffc: start-on-event=DemSatellite_OsApplication_Untrusted_Core0InternalBehavior/GetDTCOfEvent, operation=EvtInfo_AutoCreatedDemEvent_CC_EnablePDUGroup_CIOM_oSecuritySubnet_Rx_3a3c1dbc_BswMReportFailToDemRef.GetDTCOfEvent
        OpEventGetDTCOfEvent_GetDTCOfEvent_EvtInfo_AutoCreatedDemEvent_CC_DisablePDUGroup_CIOM_oFMSNet_Tx_0x31_BC_38fc8c7d_BswM_f8f189f1: start-on-event=DemSatellite_OsApplication_Untrusted_Core0InternalBehavior/GetDTCOfEvent, operation=EvtInfo_AutoCreatedDemEvent_CC_DisablePDUGroup_CIOM_oFMSNet_Tx_0x31_BC_38fc8c7d_BswMReportFailToDemRef.GetDTCOfEvent
        OpEventGetDTCOfEvent_GetDTCOfEvent_EvtInfo_AutoCreatedDemEvent_CC_EnablePDUGroup_CIOM_oFMSNet_Tx_0x31_BC_38fc8c7d_BswMR_e3fdd2f1: start-on-event=DemSatellite_OsApplication_Untrusted_Core0InternalBehavior/GetDTCOfEvent, operation=EvtInfo_AutoCreatedDemEvent_CC_EnablePDUGroup_CIOM_oFMSNet_Tx_0x31_BC_38fc8c7d_BswMReportFailToDemRef.GetDTCOfEvent
        OpEventGetDTCOfEvent_GetDTCOfEvent_EvtInfo_AutoCreatedDemEvent_CC_DisablePDUGroup_CIOM_oSecuritySubnet_Tx_6c66ba3a_BswM_194c969d: start-on-event=DemSatellite_OsApplication_Untrusted_Core0InternalBehavior/GetDTCOfEvent, operation=EvtInfo_AutoCreatedDemEvent_CC_DisablePDUGroup_CIOM_oSecuritySubnet_Tx_6c66ba3a_BswMReportFailToDemRef.GetDTCOfEvent
        OpEventGetDTCOfEvent_GetDTCOfEvent_EvtInfo_AutoCreatedDemEvent_CC_EnablePDUGroup_CIOM_oSecuritySubnet_Tx_6c66ba3a_BswMR_0240cd9d: start-on-event=DemSatellite_OsApplication_Untrusted_Core0InternalBehavior/GetDTCOfEvent, operation=EvtInfo_AutoCreatedDemEvent_CC_EnablePDUGroup_CIOM_oSecuritySubnet_Tx_6c66ba3a_BswMReportFailToDemRef.GetDTCOfEvent
        OpEventGetDTCOfEvent_GetDTCOfEvent_EvtInfo_AutoCreatedDemEvent_CC_DisablePDUGroup_CIOM_oLIN00_Tx_8b42b82c_BswMReportFailToDemRef: start-on-event=DemSatellite_OsApplication_Untrusted_Core0InternalBehavior/GetDTCOfEvent, operation=EvtInfo_AutoCreatedDemEvent_CC_DisablePDUGroup_CIOM_oLIN00_Tx_8b42b82c_BswMReportFailToDemRef.GetDTCOfEvent
        OpEventGetDTCOfEvent_GetDTCOfEvent_EvtInfo_AutoCreatedDemEvent_CC_EnablePDUGroup_CIOM_oLIN00_Rx_dd181faa_BswMReportFailToDemRef: start-on-event=DemSatellite_OsApplication_Untrusted_Core0InternalBehavior/GetDTCOfEvent, operation=EvtInfo_AutoCreatedDemEvent_CC_EnablePDUGroup_CIOM_oLIN00_Rx_dd181faa_BswMReportFailToDemRef.GetDTCOfEvent
        OpEventGetDTCOfEvent_GetDTCOfEvent_EvtInfo_AutoCreatedDemEvent_ESH_Action_ComMCheckPendingRequests_BswMReportFailToDemRef: start-on-event=DemSatellite_OsApplication_Untrusted_Core0InternalBehavior/GetDTCOfEvent, operation=EvtInfo_AutoCreatedDemEvent_ESH_Action_ComMCheckPendingRequests_BswMReportFailToDemRef.GetDTCOfEvent
        OpEventGetDTCOfEvent_GetDTCOfEvent_EvtInfo_AutoCreatedDemEvent_CC_DisableDM_CIOM_oBackbone1J1939_Rx_BC_405bc776_BswMRep_9acb9ba5: start-on-event=DemSatellite_OsApplication_Untrusted_Core0InternalBehavior/GetDTCOfEvent, operation=EvtInfo_AutoCreatedDemEvent_CC_DisableDM_CIOM_oBackbone1J1939_Rx_BC_405bc776_BswMReportFailToDemRef.GetDTCOfEvent
        OpEventGetDTCOfEvent_GetDTCOfEvent_EvtInfo_AutoCreatedDemEvent_CC_DisablePDUGroup_CIOM_oLIN00_Rx_dd181faa_BswMReportFailToDemRef: start-on-event=DemSatellite_OsApplication_Untrusted_Core0InternalBehavior/GetDTCOfEvent, operation=EvtInfo_AutoCreatedDemEvent_CC_DisablePDUGroup_CIOM_oLIN00_Rx_dd181faa_BswMReportFailToDemRef.GetDTCOfEvent
        OpEventGetDTCOfEvent_GetDTCOfEvent_EvtInfo_AutoCreatedDemEvent_CC_EnablePDUGroup_CIOM_oLIN00_Tx_8b42b82c_BswMReportFailToDemRef: start-on-event=DemSatellite_OsApplication_Untrusted_Core0InternalBehavior/GetDTCOfEvent, operation=EvtInfo_AutoCreatedDemEvent_CC_EnablePDUGroup_CIOM_oLIN00_Tx_8b42b82c_BswMReportFailToDemRef.GetDTCOfEvent
        OpEventGetDTCOfEvent_GetDTCOfEvent_EvtInfo_AutoCreatedDemEvent_ESH_Action_EnterExclusiveArea_BswMReportFailToDemRef: start-on-event=DemSatellite_OsApplication_Untrusted_Core0InternalBehavior/GetDTCOfEvent, operation=EvtInfo_AutoCreatedDemEvent_ESH_Action_EnterExclusiveArea_BswMReportFailToDemRef.GetDTCOfEvent
        OpEventGetDTCOfEvent_GetDTCOfEvent_EvtInfo_AutoCreatedDemEvent_ESH_RunToPostRunNested_BswMReportFailToDemRef: start-on-event=DemSatellite_OsApplication_Untrusted_Core0InternalBehavior/GetDTCOfEvent, operation=EvtInfo_AutoCreatedDemEvent_ESH_RunToPostRunNested_BswMReportFailToDemRef.GetDTCOfEvent
        OpEventGetDTCOfEvent_GetDTCOfEvent_EvtInfo_AutoCreatedDemEvent_CC_EnableDM_CIOM_oBackbone1J1939_Rx_BC_405bc776_BswMRepo_825f8c28: start-on-event=DemSatellite_OsApplication_Untrusted_Core0InternalBehavior/GetDTCOfEvent, operation=EvtInfo_AutoCreatedDemEvent_CC_EnableDM_CIOM_oBackbone1J1939_Rx_BC_405bc776_BswMReportFailToDemRef.GetDTCOfEvent
        OpEventGetDTCOfEvent_GetDTCOfEvent_EvtInfo_AutoCreatedDemEvent_CC_DisablePDUGroup_CIOM_oBackbone1J1939_Tx_0x31_BC_3782f_8baf4ccb: start-on-event=DemSatellite_OsApplication_Untrusted_Core0InternalBehavior/GetDTCOfEvent, operation=EvtInfo_AutoCreatedDemEvent_CC_DisablePDUGroup_CIOM_oBackbone1J1939_Tx_0x31_BC_3782f500_BswMReportFailToDemRef.GetDTCOfEvent
        OpEventGetDTCOfEvent_GetDTCOfEvent_EvtInfo_AutoCreatedDemEvent_CC_J1939RmStateSwitch_CN_FMSNet_fce1aae5_CIOM_3a3d59b1_J_ac4aa660: start-on-event=DemSatellite_OsApplication_Untrusted_Core0InternalBehavior/GetDTCOfEvent, operation=EvtInfo_AutoCreatedDemEvent_CC_J1939RmStateSwitch_CN_FMSNet_fce1aae5_CIOM_3a3d59b1_J1939RM_STATE_OFFLINE_BswMReportFailToDemRef.GetDTCOfEvent
        OpEventGetDTCOfEvent_GetDTCOfEvent_EvtInfo_AutoCreatedDemEvent_CC_EnablePDUGroup_CIOM_oBackbone1J1939_Tx_0x31_BC_3782f5_ca8f976e: start-on-event=DemSatellite_OsApplication_Untrusted_Core0InternalBehavior/GetDTCOfEvent, operation=EvtInfo_AutoCreatedDemEvent_CC_EnablePDUGroup_CIOM_oBackbone1J1939_Tx_0x31_BC_3782f500_BswMReportFailToDemRef.GetDTCOfEvent
        OpEventGetDTCOfEvent_GetDTCOfEvent_EvtInfo_AutoCreatedDemEvent_CC_J1939RmStateSwitch_CN_FMSNet_fce1aae5_CIOM_3a3d59b1_J_2c1980f2: start-on-event=DemSatellite_OsApplication_Untrusted_Core0InternalBehavior/GetDTCOfEvent, operation=EvtInfo_AutoCreatedDemEvent_CC_J1939RmStateSwitch_CN_FMSNet_fce1aae5_CIOM_3a3d59b1_J1939RM_STATE_ONLINE_BswMReportFailToDemRef.GetDTCOfEvent
        OpEventGetDTCOfEvent_GetDTCOfEvent_EvtInfo_AutoCreatedDemEvent_ESH_Action_CancelNvMWriteAll_BswMReportFailToDemRef: start-on-event=DemSatellite_OsApplication_Untrusted_Core0InternalBehavior/GetDTCOfEvent, operation=EvtInfo_AutoCreatedDemEvent_ESH_Action_CancelNvMWriteAll_BswMReportFailToDemRef.GetDTCOfEvent
        OpEventGetDTCOfEvent_GetDTCOfEvent_EvtInfo_AutoCreatedDemEvent_ESH_Action_CancelWriteAllTimer_Start_BswMReportFailToDemRef: start-on-event=DemSatellite_OsApplication_Untrusted_Core0InternalBehavior/GetDTCOfEvent, operation=EvtInfo_AutoCreatedDemEvent_ESH_Action_CancelWriteAllTimer_Start_BswMReportFailToDemRef.GetDTCOfEvent
        OpEventGetDTCOfEvent_GetDTCOfEvent_EvtInfo_AutoCreatedDemEvent_ESH_Action_CancelWriteAllTimer_Stop_BswMReportFailToDemRef: start-on-event=DemSatellite_OsApplication_Untrusted_Core0InternalBehavior/GetDTCOfEvent, operation=EvtInfo_AutoCreatedDemEvent_ESH_Action_CancelWriteAllTimer_Stop_BswMReportFailToDemRef.GetDTCOfEvent
        OpEventGetDTCOfEvent_GetDTCOfEvent_EvtInfo_AutoCreatedDemEvent_ESH_Action_ComMAllow_CN_Backbone1J1939_0b1f4bae_BswMRepo_1c7db73f: start-on-event=DemSatellite_OsApplication_Untrusted_Core0InternalBehavior/GetDTCOfEvent, operation=EvtInfo_AutoCreatedDemEvent_ESH_Action_ComMAllow_CN_Backbone1J1939_0b1f4bae_BswMReportFailToDemRef.GetDTCOfEvent
        OpEventGetDTCOfEvent_GetDTCOfEvent_EvtInfo_AutoCreatedDemEvent_ESH_Action_ComMAllow_CN_Backbone1J1939_0b1f4bae_BswMRepo_20ff4330: start-on-event=DemSatellite_OsApplication_Untrusted_Core0InternalBehavior/GetDTCOfEvent, operation=EvtInfo_AutoCreatedDemEvent_ESH_Action_ComMAllow_CN_Backbone1J1939_0b1f4bae_BswMReportFailToDemRef_1.GetDTCOfEvent
        OpEventGetDTCOfEvent_GetDTCOfEvent_EvtInfo_AutoCreatedDemEvent_ESH_Action_ComMAllow_CN_Backbone2_78967e2c_BswMReportFailToDemRef: start-on-event=DemSatellite_OsApplication_Untrusted_Core0InternalBehavior/GetDTCOfEvent, operation=EvtInfo_AutoCreatedDemEvent_ESH_Action_ComMAllow_CN_Backbone2_78967e2c_BswMReportFailToDemRef.GetDTCOfEvent
        OpEventGetDTCOfEvent_GetDTCOfEvent_EvtInfo_AutoCreatedDemEvent_ESH_Action_ComMAllow_CN_Backbone2_78967e2c_BswMReportFai_5d381677: start-on-event=DemSatellite_OsApplication_Untrusted_Core0InternalBehavior/GetDTCOfEvent, operation=EvtInfo_AutoCreatedDemEvent_ESH_Action_ComMAllow_CN_Backbone2_78967e2c_BswMReportFailToDemRef_1.GetDTCOfEvent
        OpEventGetDTCOfEvent_GetDTCOfEvent_EvtInfo_AutoCreatedDemEvent_ESH_Action_ComMAllow_CN_CabSubnet_9ea693f1_BswMReportFailToDemRef: start-on-event=DemSatellite_OsApplication_Untrusted_Core0InternalBehavior/GetDTCOfEvent, operation=EvtInfo_AutoCreatedDemEvent_ESH_Action_ComMAllow_CN_CabSubnet_9ea693f1_BswMReportFailToDemRef.GetDTCOfEvent
        OpEventGetDTCOfEvent_GetDTCOfEvent_EvtInfo_AutoCreatedDemEvent_ESH_Action_ComMAllow_CN_CabSubnet_9ea693f1_BswMReportFai_ebe7805c: start-on-event=DemSatellite_OsApplication_Untrusted_Core0InternalBehavior/GetDTCOfEvent, operation=EvtInfo_AutoCreatedDemEvent_ESH_Action_ComMAllow_CN_CabSubnet_9ea693f1_BswMReportFailToDemRef_1.GetDTCOfEvent
        OpEventGetDTCOfEvent_GetDTCOfEvent_EvtInfo_AutoCreatedDemEvent_ESH_Action_ComMAllow_CN_FMSNet_fce1aae5_BswMReportFailToDemRef: start-on-event=DemSatellite_OsApplication_Untrusted_Core0InternalBehavior/GetDTCOfEvent, operation=EvtInfo_AutoCreatedDemEvent_ESH_Action_ComMAllow_CN_FMSNet_fce1aae5_BswMReportFailToDemRef.GetDTCOfEvent
        OpEventGetDTCOfEvent_GetDTCOfEvent_EvtInfo_AutoCreatedDemEvent_ESH_Action_ComMAllow_CN_FMSNet_fce1aae5_BswMReportFailToDemRef_1: start-on-event=DemSatellite_OsApplication_Untrusted_Core0InternalBehavior/GetDTCOfEvent, operation=EvtInfo_AutoCreatedDemEvent_ESH_Action_ComMAllow_CN_FMSNet_fce1aae5_BswMReportFailToDemRef_1.GetDTCOfEvent
        OpEventGetDTCOfEvent_GetDTCOfEvent_EvtInfo_AutoCreatedDemEvent_ESH_Action_ComMAllow_CN_LIN00_2cd9a7df_BswMReportFailToDemRef: start-on-event=DemSatellite_OsApplication_Untrusted_Core0InternalBehavior/GetDTCOfEvent, operation=EvtInfo_AutoCreatedDemEvent_ESH_Action_ComMAllow_CN_LIN00_2cd9a7df_BswMReportFailToDemRef.GetDTCOfEvent
        OpEventGetDTCOfEvent_GetDTCOfEvent_EvtInfo_AutoCreatedDemEvent_ESH_Action_ComMAllow_CN_LIN00_2cd9a7df_BswMReportFailToDemRef_1: start-on-event=DemSatellite_OsApplication_Untrusted_Core0InternalBehavior/GetDTCOfEvent, operation=EvtInfo_AutoCreatedDemEvent_ESH_Action_ComMAllow_CN_LIN00_2cd9a7df_BswMReportFailToDemRef_1.GetDTCOfEvent
        OpEventGetDTCOfEvent_GetDTCOfEvent_EvtInfo_AutoCreatedDemEvent_ESH_Action_ComMAllow_CN_LIN01_5bde9749_BswMReportFailToDemRef: start-on-event=DemSatellite_OsApplication_Untrusted_Core0InternalBehavior/GetDTCOfEvent, operation=EvtInfo_AutoCreatedDemEvent_ESH_Action_ComMAllow_CN_LIN01_5bde9749_BswMReportFailToDemRef.GetDTCOfEvent
        OpEventGetDTCOfEvent_GetDTCOfEvent_EvtInfo_AutoCreatedDemEvent_ESH_Action_ComMAllow_CN_LIN01_5bde9749_BswMReportFailToDemRef_1: start-on-event=DemSatellite_OsApplication_Untrusted_Core0InternalBehavior/GetDTCOfEvent, operation=EvtInfo_AutoCreatedDemEvent_ESH_Action_ComMAllow_CN_LIN01_5bde9749_BswMReportFailToDemRef_1.GetDTCOfEvent
        OpEventGetDTCOfEvent_GetDTCOfEvent_EvtInfo_AutoCreatedDemEvent_ESH_Action_ComMAllow_CN_LIN02_c2d7c6f3_BswMReportFailToDemRef: start-on-event=DemSatellite_OsApplication_Untrusted_Core0InternalBehavior/GetDTCOfEvent, operation=EvtInfo_AutoCreatedDemEvent_ESH_Action_ComMAllow_CN_LIN02_c2d7c6f3_BswMReportFailToDemRef.GetDTCOfEvent
        OpEventGetDTCOfEvent_GetDTCOfEvent_EvtInfo_AutoCreatedDemEvent_ESH_Action_ComMAllow_CN_LIN02_c2d7c6f3_BswMReportFailToDemRef_1: start-on-event=DemSatellite_OsApplication_Untrusted_Core0InternalBehavior/GetDTCOfEvent, operation=EvtInfo_AutoCreatedDemEvent_ESH_Action_ComMAllow_CN_LIN02_c2d7c6f3_BswMReportFailToDemRef_1.GetDTCOfEvent
        OpEventGetDTCOfEvent_GetDTCOfEvent_EvtInfo_AutoCreatedDemEvent_ESH_Action_ComMAllow_CN_LIN03_b5d0f665_BswMReportFailToDemRef: start-on-event=DemSatellite_OsApplication_Untrusted_Core0InternalBehavior/GetDTCOfEvent, operation=EvtInfo_AutoCreatedDemEvent_ESH_Action_ComMAllow_CN_LIN03_b5d0f665_BswMReportFailToDemRef.GetDTCOfEvent
        OpEventGetDTCOfEvent_GetDTCOfEvent_EvtInfo_AutoCreatedDemEvent_ESH_Action_ComMAllow_CN_LIN03_b5d0f665_BswMReportFailToDemRef_1: start-on-event=DemSatellite_OsApplication_Untrusted_Core0InternalBehavior/GetDTCOfEvent, operation=EvtInfo_AutoCreatedDemEvent_ESH_Action_ComMAllow_CN_LIN03_b5d0f665_BswMReportFailToDemRef_1.GetDTCOfEvent
        OpEventGetDTCOfEvent_GetDTCOfEvent_EvtInfo_AutoCreatedDemEvent_ESH_Action_ComMAllow_CN_LIN04_2bb463c6_BswMReportFailToDemRef: start-on-event=DemSatellite_OsApplication_Untrusted_Core0InternalBehavior/GetDTCOfEvent, operation=EvtInfo_AutoCreatedDemEvent_ESH_Action_ComMAllow_CN_LIN04_2bb463c6_BswMReportFailToDemRef.GetDTCOfEvent
        OpEventGetDTCOfEvent_GetDTCOfEvent_EvtInfo_AutoCreatedDemEvent_ESH_Action_ComMAllow_CN_LIN04_2bb463c6_BswMReportFailToDemRef_1: start-on-event=DemSatellite_OsApplication_Untrusted_Core0InternalBehavior/GetDTCOfEvent, operation=EvtInfo_AutoCreatedDemEvent_ESH_Action_ComMAllow_CN_LIN04_2bb463c6_BswMReportFailToDemRef_1.GetDTCOfEvent
        OpEventGetDTCOfEvent_GetDTCOfEvent_EvtInfo_AutoCreatedDemEvent_ESH_Action_ComMAllow_CN_SecuritySubnet_e7a0ee54_BswMRepo_b2f736f9: start-on-event=DemSatellite_OsApplication_Untrusted_Core0InternalBehavior/GetDTCOfEvent, operation=EvtInfo_AutoCreatedDemEvent_ESH_Action_ComMAllow_CN_SecuritySubnet_e7a0ee54_BswMReportFailToDemRef.GetDTCOfEvent
        OpEventGetDTCOfEvent_GetDTCOfEvent_EvtInfo_AutoCreatedDemEvent_ESH_Action_ComMAllow_CN_SecuritySubnet_e7a0ee54_BswMRepo_27e02ec4: start-on-event=DemSatellite_OsApplication_Untrusted_Core0InternalBehavior/GetDTCOfEvent, operation=EvtInfo_AutoCreatedDemEvent_ESH_Action_ComMAllow_CN_SecuritySubnet_e7a0ee54_BswMReportFailToDemRef_1.GetDTCOfEvent
        OpEventGetDTCOfEvent_GetDTCOfEvent_EvtInfo_AutoCreatedDemEvent_ESH_Action_ComMCheckPendingRequests_BswMReportFailToDemRef_1: start-on-event=DemSatellite_OsApplication_Untrusted_Core0InternalBehavior/GetDTCOfEvent, operation=EvtInfo_AutoCreatedDemEvent_ESH_Action_ComMCheckPendingRequests_BswMReportFailToDemRef_1.GetDTCOfEvent
        OpEventGetDTCOfEvent_GetDTCOfEvent_EvtInfo_AutoCreatedDemEvent_ESH_Action_ComMCheckPendingRequests_BswMReportFailToDemRef_2: start-on-event=DemSatellite_OsApplication_Untrusted_Core0InternalBehavior/GetDTCOfEvent, operation=EvtInfo_AutoCreatedDemEvent_ESH_Action_ComMCheckPendingRequests_BswMReportFailToDemRef_2.GetDTCOfEvent
        OpEventGetDTCOfEvent_GetDTCOfEvent_EvtInfo_AutoCreatedDemEvent_ESH_Action_ComMDisallow_CN_Backbone1J1939_0b1f4bae_BswMR_d038a0fb: start-on-event=DemSatellite_OsApplication_Untrusted_Core0InternalBehavior/GetDTCOfEvent, operation=EvtInfo_AutoCreatedDemEvent_ESH_Action_ComMDisallow_CN_Backbone1J1939_0b1f4bae_BswMReportFailToDemRef.GetDTCOfEvent
        OpEventGetDTCOfEvent_GetDTCOfEvent_EvtInfo_AutoCreatedDemEvent_ESH_Action_ComMDisallow_CN_Backbone2_78967e2c_BswMReport_92f26373: start-on-event=DemSatellite_OsApplication_Untrusted_Core0InternalBehavior/GetDTCOfEvent, operation=EvtInfo_AutoCreatedDemEvent_ESH_Action_ComMDisallow_CN_Backbone2_78967e2c_BswMReportFailToDemRef.GetDTCOfEvent
        OpEventGetDTCOfEvent_GetDTCOfEvent_EvtInfo_AutoCreatedDemEvent_ESH_Action_ComMDisallow_CN_CabSubnet_9ea693f1_BswMReport_4f305505: start-on-event=DemSatellite_OsApplication_Untrusted_Core0InternalBehavior/GetDTCOfEvent, operation=EvtInfo_AutoCreatedDemEvent_ESH_Action_ComMDisallow_CN_CabSubnet_9ea693f1_BswMReportFailToDemRef.GetDTCOfEvent
        OpEventGetDTCOfEvent_GetDTCOfEvent_EvtInfo_AutoCreatedDemEvent_ESH_Action_ComMDisallow_CN_FMSNet_fce1aae5_BswMReportFailToDemRef: start-on-event=DemSatellite_OsApplication_Untrusted_Core0InternalBehavior/GetDTCOfEvent, operation=EvtInfo_AutoCreatedDemEvent_ESH_Action_ComMDisallow_CN_FMSNet_fce1aae5_BswMReportFailToDemRef.GetDTCOfEvent
        OpEventGetDTCOfEvent_GetDTCOfEvent_EvtInfo_AutoCreatedDemEvent_ESH_Action_ComMDisallow_CN_LIN00_2cd9a7df_BswMReportFailToDemRef: start-on-event=DemSatellite_OsApplication_Untrusted_Core0InternalBehavior/GetDTCOfEvent, operation=EvtInfo_AutoCreatedDemEvent_ESH_Action_ComMDisallow_CN_LIN00_2cd9a7df_BswMReportFailToDemRef.GetDTCOfEvent
