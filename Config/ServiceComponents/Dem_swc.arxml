[part 3 of 5: package /MICROSAR/Dem_swc/ComponentTypes]
AUTOSAR XML (schema 4-2-1)
package /MICROSAR/Dem_swc/ComponentTypes  (continued)
  service sw component type DemSatellite_OsApplication_Untrusted_Core0: category=SERVICE_COMPONENT  (continued)
    behavior DemSatellite_OsApplication_Untrusted_Core0InternalBehavior: handle-termination-and-restart=NO-SUPPORT, included-data-type-set=data-type=[Dem_EventIdType, Dem_RatioIdType, Dem_EventStatusType, Dem_UdsStatusByteType, Dem_DTCFormatType, Dem_InitMonitorReasonType, Dem_OperationCycleStateType, Dem_DTCStatusMaskType, Dem_IndicatorStatusType, Dem_MaxDataValueType, Dem_DTCKindType, Dem_DTCGroupType, Dem_IumprDenomCondIdType, Dem_IumprDenomCondStatusType, Dem_DebounceResetStatusType, Dem_DebouncingStateType, Dem_IumprReadinessGroupType, Dem_DTRControlType, Dem_DTCSeverityType, Dem_MonitorStatusType]  (continued)
      2354 x operation invoked event:  (continued)
        OpEventGetDTCOfEvent_GetDTCOfEvent_EvtInfo_AutoCreatedDemEvent_ESH_Action_ComMDisallow_CN_LIN01_5bde9749_BswMReportFailToDemRef: start-on-event=DemSatellite_OsApplication_Untrusted_Core0InternalBehavior/GetDTCOfEvent, operation=EvtInfo_AutoCreatedDemEvent_ESH_Action_ComMDisallow_CN_LIN01_5bde9749_BswMReportFailToDemRef.GetDTCOfEvent
        OpEventGetDTCOfEvent_GetDTCOfEvent_EvtInfo_AutoCreatedDemEvent_ESH_Action_ComMDisallow_CN_LIN02_c2d7c6f3_BswMReportFailToDemRef: start-on-event=DemSatellite_OsApplication_Untrusted_Core0InternalBehavior/GetDTCOfEvent, operation=EvtInfo_AutoCreatedDemEvent_ESH_Action_ComMDisallow_CN_LIN02_c2d7c6f3_BswMReportFailToDemRef.GetDTCOfEvent
        OpEventGetDTCOfEvent_GetDTCOfEvent_EvtInfo_AutoCreatedDemEvent_ESH_Action_ComMDisallow_CN_LIN03_b5d0f665_BswMReportFailToDemRef: start-on-event=DemSatellite_OsApplication_Untrusted_Core0InternalBehavior/GetDTCOfEvent, operation=EvtInfo_AutoCreatedDemEvent_ESH_Action_ComMDisallow_CN_LIN03_b5d0f665_BswMReportFailToDemRef.GetDTCOfEvent
        OpEventGetDTCOfEvent_GetDTCOfEvent_EvtInfo_AutoCreatedDemEvent_ESH_Action_ComMDisallow_CN_LIN04_2bb463c6_BswMReportFailToDemRef: start-on-event=DemSatellite_OsApplication_Untrusted_Core0InternalBehavior/GetDTCOfEvent, operation=EvtInfo_AutoCreatedDemEvent_ESH_Action_ComMDisallow_CN_LIN04_2bb463c6_BswMReportFailToDemRef.GetDTCOfEvent
        OpEventGetDTCOfEvent_GetDTCOfEvent_EvtInfo_AutoCreatedDemEvent_ESH_Action_ComMDisallow_CN_SecuritySubnet_e7a0ee54_BswMR_7eb2213d: start-on-event=DemSatellite_OsApplication_Untrusted_Core0InternalBehavior/GetDTCOfEvent, operation=EvtInfo_AutoCreatedDemEvent_ESH_Action_ComMDisallow_CN_SecuritySubnet_e7a0ee54_BswMReportFailToDemRef.GetDTCOfEvent
        OpEventGetDTCOfEvent_GetDTCOfEvent_EvtInfo_AutoCreatedDemEvent_ESH_Action_DemInit_BswMReportFailToDemRef: start-on-event=DemSatellite_OsApplication_Untrusted_Core0InternalBehavior/GetDTCOfEvent, operation=EvtInfo_AutoCreatedDemEvent_ESH_Action_DemInit_BswMReportFailToDemRef.GetDTCOfEvent
        OpEventGetDTCOfEvent_GetDTCOfEvent_EvtInfo_AutoCreatedDemEvent_ESH_Action_DemInitialized_BswMReportFailToDemRef: start-on-event=DemSatellite_OsApplication_Untrusted_Core0InternalBehavior/GetDTCOfEvent, operation=EvtInfo_AutoCreatedDemEvent_ESH_Action_DemInitialized_BswMReportFailToDemRef.GetDTCOfEvent
        OpEventGetDTCOfEvent_GetDTCOfEvent_EvtInfo_AutoCreatedDemEvent_ESH_Action_DemNotInitialized_BswMReportFailToDemRef: start-on-event=DemSatellite_OsApplication_Untrusted_Core0InternalBehavior/GetDTCOfEvent, operation=EvtInfo_AutoCreatedDemEvent_ESH_Action_DemNotInitialized_BswMReportFailToDemRef.GetDTCOfEvent
        OpEventGetDTCOfEvent_GetDTCOfEvent_EvtInfo_AutoCreatedDemEvent_ESH_Action_DemShutdown_BswMReportFailToDemRef: start-on-event=DemSatellite_OsApplication_Untrusted_Core0InternalBehavior/GetDTCOfEvent, operation=EvtInfo_AutoCreatedDemEvent_ESH_Action_DemShutdown_BswMReportFailToDemRef.GetDTCOfEvent
        OpEventGetDTCOfEvent_GetDTCOfEvent_EvtInfo_AutoCreatedDemEvent_ESH_Action_ESH_PostRun_BswMReportFailToDemRef: start-on-event=DemSatellite_OsApplication_Untrusted_Core0InternalBehavior/GetDTCOfEvent, operation=EvtInfo_AutoCreatedDemEvent_ESH_Action_ESH_PostRun_BswMReportFailToDemRef.GetDTCOfEvent
        OpEventGetDTCOfEvent_GetDTCOfEvent_EvtInfo_AutoCreatedDemEvent_ESH_Action_ESH_PrepShutdown_BswMReportFailToDemRef: start-on-event=DemSatellite_OsApplication_Untrusted_Core0InternalBehavior/GetDTCOfEvent, operation=EvtInfo_AutoCreatedDemEvent_ESH_Action_ESH_PrepShutdown_BswMReportFailToDemRef.GetDTCOfEvent
        OpEventGetDTCOfEvent_GetDTCOfEvent_EvtInfo_AutoCreatedDemEvent_ESH_Action_ESH_PrepShutdown_BswMReportFailToDemRef_1: start-on-event=DemSatellite_OsApplication_Untrusted_Core0InternalBehavior/GetDTCOfEvent, operation=EvtInfo_AutoCreatedDemEvent_ESH_Action_ESH_PrepShutdown_BswMReportFailToDemRef_1.GetDTCOfEvent
        OpEventGetDTCOfEvent_GetDTCOfEvent_EvtInfo_AutoCreatedDemEvent_ESH_Action_ESH_Run_BswMReportFailToDemRef: start-on-event=DemSatellite_OsApplication_Untrusted_Core0InternalBehavior/GetDTCOfEvent, operation=EvtInfo_AutoCreatedDemEvent_ESH_Action_ESH_Run_BswMReportFailToDemRef.GetDTCOfEvent
        OpEventGetDTCOfEvent_GetDTCOfEvent_EvtInfo_AutoCreatedDemEvent_ESH_Action_ESH_Run_BswMReportFailToDemRef_1: start-on-event=DemSatellite_OsApplication_Untrusted_Core0InternalBehavior/GetDTCOfEvent, operation=EvtInfo_AutoCreatedDemEvent_ESH_Action_ESH_Run_BswMReportFailToDemRef_1.GetDTCOfEvent
        OpEventGetDTCOfEvent_GetDTCOfEvent_EvtInfo_AutoCreatedDemEvent_ESH_Action_ESH_WaitForNvm_BswMReportFailToDemRef: start-on-event=DemSatellite_OsApplication_Untrusted_Core0InternalBehavior/GetDTCOfEvent, operation=EvtInfo_AutoCreatedDemEvent_ESH_Action_ESH_WaitForNvm_BswMReportFailToDemRef.GetDTCOfEvent
        OpEventGetDTCOfEvent_GetDTCOfEvent_EvtInfo_AutoCreatedDemEvent_ESH_Action_ESH_Wakeup_BswMReportFailToDemRef: start-on-event=DemSatellite_OsApplication_Untrusted_Core0InternalBehavior/GetDTCOfEvent, operation=EvtInfo_AutoCreatedDemEvent_ESH_Action_ESH_Wakeup_BswMReportFailToDemRef.GetDTCOfEvent
        OpEventGetDTCOfEvent_GetDTCOfEvent_EvtInfo_AutoCreatedDemEvent_ESH_Action_ESH_Wakeup_BswMReportFailToDemRef_1: start-on-event=DemSatellite_OsApplication_Untrusted_Core0InternalBehavior/GetDTCOfEvent, operation=EvtInfo_AutoCreatedDemEvent_ESH_Action_ESH_Wakeup_BswMReportFailToDemRef_1.GetDTCOfEvent
        OpEventGetDTCOfEvent_GetDTCOfEvent_EvtInfo_AutoCreatedDemEvent_ESH_Action_EcuMClearValidatedWakeupEvents_BswMReportFailToDemRef: start-on-event=DemSatellite_OsApplication_Untrusted_Core0InternalBehavior/GetDTCOfEvent, operation=EvtInfo_AutoCreatedDemEvent_ESH_Action_EcuMClearValidatedWakeupEvents_BswMReportFailToDemRef.GetDTCOfEvent
        OpEventGetDTCOfEvent_GetDTCOfEvent_EvtInfo_AutoCreatedDemEvent_ESH_Action_EcuMGoToSelectedShutdownTarget_BswMReportFailToDemRef: start-on-event=DemSatellite_OsApplication_Untrusted_Core0InternalBehavior/GetDTCOfEvent, operation=EvtInfo_AutoCreatedDemEvent_ESH_Action_EcuMGoToSelectedShutdownTarget_BswMReportFailToDemRef.GetDTCOfEvent
        OpEventGetDTCOfEvent_GetDTCOfEvent_EvtInfo_AutoCreatedDemEvent_ESH_Action_EnterExclusiveArea_BswMReportFailToDemRef_1: start-on-event=DemSatellite_OsApplication_Untrusted_Core0InternalBehavior/GetDTCOfEvent, operation=EvtInfo_AutoCreatedDemEvent_ESH_Action_EnterExclusiveArea_BswMReportFailToDemRef_1.GetDTCOfEvent
        OpEventGetDTCOfEvent_GetDTCOfEvent_EvtInfo_AutoCreatedDemEvent_ESH_Action_ExitExclusiveArea_BswMReportFailToDemRef: start-on-event=DemSatellite_OsApplication_Untrusted_Core0InternalBehavior/GetDTCOfEvent, operation=EvtInfo_AutoCreatedDemEvent_ESH_Action_ExitExclusiveArea_BswMReportFailToDemRef.GetDTCOfEvent
        OpEventGetDTCOfEvent_GetDTCOfEvent_EvtInfo_AutoCreatedDemEvent_ESH_Action_NvMWriteAll_BswMReportFailToDemRef: start-on-event=DemSatellite_OsApplication_Untrusted_Core0InternalBehavior/GetDTCOfEvent, operation=EvtInfo_AutoCreatedDemEvent_ESH_Action_NvMWriteAll_BswMReportFailToDemRef.GetDTCOfEvent
        OpEventGetDTCOfEvent_GetDTCOfEvent_EvtInfo_AutoCreatedDemEvent_ESH_Action_OnEnterPostRun_BswMReportFailToDemRef: start-on-event=DemSatellite_OsApplication_Untrusted_Core0InternalBehavior/GetDTCOfEvent, operation=EvtInfo_AutoCreatedDemEvent_ESH_Action_OnEnterPostRun_BswMReportFailToDemRef.GetDTCOfEvent
        OpEventGetDTCOfEvent_GetDTCOfEvent_EvtInfo_AutoCreatedDemEvent_ESH_Action_OnEnterPrepShutdown_BswMReportFailToDemRef: start-on-event=DemSatellite_OsApplication_Untrusted_Core0InternalBehavior/GetDTCOfEvent, operation=EvtInfo_AutoCreatedDemEvent_ESH_Action_OnEnterPrepShutdown_BswMReportFailToDemRef.GetDTCOfEvent
        OpEventGetDTCOfEvent_GetDTCOfEvent_EvtInfo_AutoCreatedDemEvent_ESH_Action_OnEnterPrepShutdown_BswMReportFailToDemRef_1: start-on-event=DemSatellite_OsApplication_Untrusted_Core0InternalBehavior/GetDTCOfEvent, operation=EvtInfo_AutoCreatedDemEvent_ESH_Action_OnEnterPrepShutdown_BswMReportFailToDemRef_1.GetDTCOfEvent
        OpEventGetDTCOfEvent_GetDTCOfEvent_EvtInfo_AutoCreatedDemEvent_ESH_Action_OnEnterRun_BswMReportFailToDemRef: start-on-event=DemSatellite_OsApplication_Untrusted_Core0InternalBehavior/GetDTCOfEvent, operation=EvtInfo_AutoCreatedDemEvent_ESH_Action_OnEnterRun_BswMReportFailToDemRef.GetDTCOfEvent
        OpEventGetDTCOfEvent_GetDTCOfEvent_EvtInfo_AutoCreatedDemEvent_ESH_Action_OnEnterRun_BswMReportFailToDemRef_1: start-on-event=DemSatellite_OsApplication_Untrusted_Core0InternalBehavior/GetDTCOfEvent, operation=EvtInfo_AutoCreatedDemEvent_ESH_Action_OnEnterRun_BswMReportFailToDemRef_1.GetDTCOfEvent
        OpEventGetDTCOfEvent_GetDTCOfEvent_EvtInfo_AutoCreatedDemEvent_ESH_Action_OnEnterShutdown_BswMReportFailToDemRef: start-on-event=DemSatellite_OsApplication_Untrusted_Core0InternalBehavior/GetDTCOfEvent, operation=EvtInfo_AutoCreatedDemEvent_ESH_Action_OnEnterShutdown_BswMReportFailToDemRef.GetDTCOfEvent
        OpEventGetDTCOfEvent_GetDTCOfEvent_EvtInfo_AutoCreatedDemEvent_ESH_Action_OnEnterWaitForNvm_BswMReportFailToDemRef: start-on-event=DemSatellite_OsApplication_Untrusted_Core0InternalBehavior/GetDTCOfEvent, operation=EvtInfo_AutoCreatedDemEvent_ESH_Action_OnEnterWaitForNvm_BswMReportFailToDemRef.GetDTCOfEvent
        OpEventGetDTCOfEvent_GetDTCOfEvent_EvtInfo_AutoCreatedDemEvent_ESH_Action_OnEnterWakeup_BswMReportFailToDemRef: start-on-event=DemSatellite_OsApplication_Untrusted_Core0InternalBehavior/GetDTCOfEvent, operation=EvtInfo_AutoCreatedDemEvent_ESH_Action_OnEnterWakeup_BswMReportFailToDemRef.GetDTCOfEvent
        OpEventGetDTCOfEvent_GetDTCOfEvent_EvtInfo_AutoCreatedDemEvent_ESH_Action_OnEnterWakeup_BswMReportFailToDemRef_1: start-on-event=DemSatellite_OsApplication_Untrusted_Core0InternalBehavior/GetDTCOfEvent, operation=EvtInfo_AutoCreatedDemEvent_ESH_Action_OnEnterWakeup_BswMReportFailToDemRef_1.GetDTCOfEvent
        OpEventGetDTCOfEvent_GetDTCOfEvent_EvtInfo_AutoCreatedDemEvent_ESH_Action_SelfRunRequestTimer_Start_BswMReportFailToDemRef: start-on-event=DemSatellite_OsApplication_Untrusted_Core0InternalBehavior/GetDTCOfEvent, operation=EvtInfo_AutoCreatedDemEvent_ESH_Action_SelfRunRequestTimer_Start_BswMReportFailToDemRef.GetDTCOfEvent
        OpEventGetDTCOfEvent_GetDTCOfEvent_EvtInfo_AutoCreatedDemEvent_ESH_Action_SelfRunRequestTimer_Start_BswMReportFailToDemRef_1: start-on-event=DemSatellite_OsApplication_Untrusted_Core0InternalBehavior/GetDTCOfEvent, operation=EvtInfo_AutoCreatedDemEvent_ESH_Action_SelfRunRequestTimer_Start_BswMReportFailToDemRef_1.GetDTCOfEvent
        OpEventGetDTCOfEvent_GetDTCOfEvent_EvtInfo_AutoCreatedDemEvent_ESH_Action_SwitchPostRun_BswMReportFailToDemRef: start-on-event=DemSatellite_OsApplication_Untrusted_Core0InternalBehavior/GetDTCOfEvent, operation=EvtInfo_AutoCreatedDemEvent_ESH_Action_SwitchPostRun_BswMReportFailToDemRef.GetDTCOfEvent
        OpEventGetDTCOfEvent_GetDTCOfEvent_EvtInfo_AutoCreatedDemEvent_ESH_Action_SwitchRun_BswMReportFailToDemRef: start-on-event=DemSatellite_OsApplication_Untrusted_Core0InternalBehavior/GetDTCOfEvent, operation=EvtInfo_AutoCreatedDemEvent_ESH_Action_SwitchRun_BswMReportFailToDemRef.GetDTCOfEvent
        OpEventGetDTCOfEvent_GetDTCOfEvent_EvtInfo_AutoCreatedDemEvent_ESH_Action_SwitchRun_BswMReportFailToDemRef_1: start-on-event=DemSatellite_OsApplication_Untrusted_Core0InternalBehavior/GetDTCOfEvent, operation=EvtInfo_AutoCreatedDemEvent_ESH_Action_SwitchRun_BswMReportFailToDemRef_1.GetDTCOfEvent
        OpEventGetDTCOfEvent_GetDTCOfEvent_EvtInfo_AutoCreatedDemEvent_ESH_Action_SwitchShutdown_BswMReportFailToDemRef: start-on-event=DemSatellite_OsApplication_Untrusted_Core0InternalBehavior/GetDTCOfEvent, operation=EvtInfo_AutoCreatedDemEvent_ESH_Action_SwitchShutdown_BswMReportFailToDemRef.GetDTCOfEvent
        OpEventGetDTCOfEvent_GetDTCOfEvent_EvtInfo_AutoCreatedDemEvent_ESH_Action_SwitchShutdown_BswMReportFailToDemRef_1: start-on-event=DemSatellite_OsApplication_Untrusted_Core0InternalBehavior/GetDTCOfEvent, operation=EvtInfo_AutoCreatedDemEvent_ESH_Action_SwitchShutdown_BswMReportFailToDemRef_1.GetDTCOfEvent
        OpEventGetDTCOfEvent_GetDTCOfEvent_EvtInfo_AutoCreatedDemEvent_ESH_Action_SwitchWakeup_BswMReportFailToDemRef: start-on-event=DemSatellite_OsApplication_Untrusted_Core0InternalBehavior/GetDTCOfEvent, operation=EvtInfo_AutoCreatedDemEvent_ESH_Action_SwitchWakeup_BswMReportFailToDemRef.GetDTCOfEvent
        OpEventGetDTCOfEvent_GetDTCOfEvent_EvtInfo_AutoCreatedDemEvent_ESH_Action_SwitchWakeup_BswMReportFailToDemRef_1: start-on-event=DemSatellite_OsApplication_Untrusted_Core0InternalBehavior/GetDTCOfEvent, operation=EvtInfo_AutoCreatedDemEvent_ESH_Action_SwitchWakeup_BswMReportFailToDemRef_1.GetDTCOfEvent
        OpEventGetDTCOfEvent_GetDTCOfEvent_EvtInfo_AutoCreatedDemEvent_ESH_Action_WriteAllTimer_Start_BswMReportFailToDemRef: start-on-event=DemSatellite_OsApplication_Untrusted_Core0InternalBehavior/GetDTCOfEvent, operation=EvtInfo_AutoCreatedDemEvent_ESH_Action_WriteAllTimer_Start_BswMReportFailToDemRef.GetDTCOfEvent
        OpEventGetDTCOfEvent_GetDTCOfEvent_EvtInfo_AutoCreatedDemEvent_ESH_Action_WriteAllTimer_Stop_BswMReportFailToDemRef: start-on-event=DemSatellite_OsApplication_Untrusted_Core0InternalBehavior/GetDTCOfEvent, operation=EvtInfo_AutoCreatedDemEvent_ESH_Action_WriteAllTimer_Stop_BswMReportFailToDemRef.GetDTCOfEvent
        OpEventGetDTCOfEvent_GetDTCOfEvent_EvtInfo_AutoCreatedDemEvent_ESH_Action_WriteAllTimer_Stop_BswMReportFailToDemRef_1: start-on-event=DemSatellite_OsApplication_Untrusted_Core0InternalBehavior/GetDTCOfEvent, operation=EvtInfo_AutoCreatedDemEvent_ESH_Action_WriteAllTimer_Stop_BswMReportFailToDemRef_1.GetDTCOfEvent
        OpEventGetDTCOfEvent_GetDTCOfEvent_EvtInfo_AutoCreatedDemEvent_ESH_DemInit_BswMReportFailToDemRef: start-on-event=DemSatellite_OsApplication_Untrusted_Core0InternalBehavior/GetDTCOfEvent, operation=EvtInfo_AutoCreatedDemEvent_ESH_DemInit_BswMReportFailToDemRef.GetDTCOfEvent
        OpEventGetDTCOfEvent_GetDTCOfEvent_EvtInfo_AutoCreatedDemEvent_ESH_PostRunNested_BswMReportFailToDemRef: start-on-event=DemSatellite_OsApplication_Untrusted_Core0InternalBehavior/GetDTCOfEvent, operation=EvtInfo_AutoCreatedDemEvent_ESH_PostRunNested_BswMReportFailToDemRef.GetDTCOfEvent
        OpEventGetDTCOfEvent_GetDTCOfEvent_EvtInfo_AutoCreatedDemEvent_ESH_PostRunToPrepNested_BswMReportFailToDemRef: start-on-event=DemSatellite_OsApplication_Untrusted_Core0InternalBehavior/GetDTCOfEvent, operation=EvtInfo_AutoCreatedDemEvent_ESH_PostRunToPrepNested_BswMReportFailToDemRef.GetDTCOfEvent
        OpEventGetDTCOfEvent_GetDTCOfEvent_EvtInfo_AutoCreatedDemEvent_ESH_Action_ExitExclusiveArea_BswMReportFailToDemRef_1: start-on-event=DemSatellite_OsApplication_Untrusted_Core0InternalBehavior/GetDTCOfEvent, operation=EvtInfo_AutoCreatedDemEvent_ESH_Action_ExitExclusiveArea_BswMReportFailToDemRef_1.GetDTCOfEvent
        OpEventGetDTCOfEvent_GetDTCOfEvent_EvtInfo_AutoCreatedDemEvent_INIT_Action_BrsHw_EnableHwAccess_BswMReportFailToDemRef: start-on-event=DemSatellite_OsApplication_Untrusted_Core0InternalBehavior/GetDTCOfEvent, operation=EvtInfo_AutoCreatedDemEvent_INIT_Action_BrsHw_EnableHwAccess_BswMReportFailToDemRef.GetDTCOfEvent
        OpEventGetDTCOfEvent_GetDTCOfEvent_EvtInfo_AutoCreatedDemEvent_INIT_Action_CanIf_Init_BswMReportFailToDemRef: start-on-event=DemSatellite_OsApplication_Untrusted_Core0InternalBehavior/GetDTCOfEvent, operation=EvtInfo_AutoCreatedDemEvent_INIT_Action_CanIf_Init_BswMReportFailToDemRef.GetDTCOfEvent
        OpEventGetDTCOfEvent_GetDTCOfEvent_EvtInfo_AutoCreatedDemEvent_INIT_Action_CanNm_Init_BswMReportFailToDemRef: start-on-event=DemSatellite_OsApplication_Untrusted_Core0InternalBehavior/GetDTCOfEvent, operation=EvtInfo_AutoCreatedDemEvent_INIT_Action_CanNm_Init_BswMReportFailToDemRef.GetDTCOfEvent
        OpEventGetDTCOfEvent_GetDTCOfEvent_EvtInfo_AutoCreatedDemEvent_INIT_Action_CanSM_Init_BswMReportFailToDemRef: start-on-event=DemSatellite_OsApplication_Untrusted_Core0InternalBehavior/GetDTCOfEvent, operation=EvtInfo_AutoCreatedDemEvent_INIT_Action_CanSM_Init_BswMReportFailToDemRef.GetDTCOfEvent
        OpEventGetDTCOfEvent_GetDTCOfEvent_EvtInfo_AutoCreatedDemEvent_INIT_Action_CanTp_Init_BswMReportFailToDemRef: start-on-event=DemSatellite_OsApplication_Untrusted_Core0InternalBehavior/GetDTCOfEvent, operation=EvtInfo_AutoCreatedDemEvent_INIT_Action_CanTp_Init_BswMReportFailToDemRef.GetDTCOfEvent
        OpEventGetDTCOfEvent_GetDTCOfEvent_EvtInfo_AutoCreatedDemEvent_INIT_Action_Can_Init_BswMReportFailToDemRef: start-on-event=DemSatellite_OsApplication_Untrusted_Core0InternalBehavior/GetDTCOfEvent, operation=EvtInfo_AutoCreatedDemEvent_INIT_Action_Can_Init_BswMReportFailToDemRef.GetDTCOfEvent
        OpEventGetDTCOfEvent_GetDTCOfEvent_EvtInfo_AutoCreatedDemEvent_INIT_Action_ComM_Init_BswMReportFailToDemRef: start-on-event=DemSatellite_OsApplication_Untrusted_Core0InternalBehavior/GetDTCOfEvent, operation=EvtInfo_AutoCreatedDemEvent_INIT_Action_ComM_Init_BswMReportFailToDemRef.GetDTCOfEvent
        OpEventGetDTCOfEvent_GetDTCOfEvent_EvtInfo_AutoCreatedDemEvent_INIT_Action_Com_Init_BswMReportFailToDemRef: start-on-event=DemSatellite_OsApplication_Untrusted_Core0InternalBehavior/GetDTCOfEvent, operation=EvtInfo_AutoCreatedDemEvent_INIT_Action_Com_Init_BswMReportFailToDemRef.GetDTCOfEvent
        OpEventGetDTCOfEvent_GetDTCOfEvent_EvtInfo_AutoCreatedDemEvent_INIT_Action_Dcm_Init_BswMReportFailToDemRef: start-on-event=DemSatellite_OsApplication_Untrusted_Core0InternalBehavior/GetDTCOfEvent, operation=EvtInfo_AutoCreatedDemEvent_INIT_Action_Dcm_Init_BswMReportFailToDemRef.GetDTCOfEvent
        OpEventGetDTCOfEvent_GetDTCOfEvent_EvtInfo_AutoCreatedDemEvent_INIT_Action_Dem_Init_BswMReportFailToDemRef: start-on-event=DemSatellite_OsApplication_Untrusted_Core0InternalBehavior/GetDTCOfEvent, operation=EvtInfo_AutoCreatedDemEvent_INIT_Action_Dem_Init_BswMReportFailToDemRef.GetDTCOfEvent
        OpEventGetDTCOfEvent_GetDTCOfEvent_EvtInfo_AutoCreatedDemEvent_INIT_Action_EnableInterrupts_BswMReportFailToDemRef: start-on-event=DemSatellite_OsApplication_Untrusted_Core0InternalBehavior/GetDTCOfEvent, operation=EvtInfo_AutoCreatedDemEvent_INIT_Action_EnableInterrupts_BswMReportFailToDemRef.GetDTCOfEvent
        OpEventGetDTCOfEvent_GetDTCOfEvent_EvtInfo_AutoCreatedDemEvent_INIT_Action_Fee_Init_BswMReportFailToDemRef: start-on-event=DemSatellite_OsApplication_Untrusted_Core0InternalBehavior/GetDTCOfEvent, operation=EvtInfo_AutoCreatedDemEvent_INIT_Action_Fee_Init_BswMReportFailToDemRef.GetDTCOfEvent
        OpEventGetDTCOfEvent_GetDTCOfEvent_EvtInfo_AutoCreatedDemEvent_INIT_Action_Issm_Init_BswMReportFailToDemRef: start-on-event=DemSatellite_OsApplication_Untrusted_Core0InternalBehavior/GetDTCOfEvent, operation=EvtInfo_AutoCreatedDemEvent_INIT_Action_Issm_Init_BswMReportFailToDemRef.GetDTCOfEvent
        OpEventGetDTCOfEvent_GetDTCOfEvent_EvtInfo_AutoCreatedDemEvent_INIT_Action_J1939Nm_Init_BswMReportFailToDemRef: start-on-event=DemSatellite_OsApplication_Untrusted_Core0InternalBehavior/GetDTCOfEvent, operation=EvtInfo_AutoCreatedDemEvent_INIT_Action_J1939Nm_Init_BswMReportFailToDemRef.GetDTCOfEvent
        OpEventGetDTCOfEvent_GetDTCOfEvent_EvtInfo_AutoCreatedDemEvent_INIT_Action_J1939Rm_Init_BswMReportFailToDemRef: start-on-event=DemSatellite_OsApplication_Untrusted_Core0InternalBehavior/GetDTCOfEvent, operation=EvtInfo_AutoCreatedDemEvent_INIT_Action_J1939Rm_Init_BswMReportFailToDemRef.GetDTCOfEvent
        OpEventGetDTCOfEvent_GetDTCOfEvent_EvtInfo_AutoCreatedDemEvent_INIT_Action_J1939Tp_Init_BswMReportFailToDemRef: start-on-event=DemSatellite_OsApplication_Untrusted_Core0InternalBehavior/GetDTCOfEvent, operation=EvtInfo_AutoCreatedDemEvent_INIT_Action_J1939Tp_Init_BswMReportFailToDemRef.GetDTCOfEvent
        OpEventGetDTCOfEvent_GetDTCOfEvent_EvtInfo_AutoCreatedDemEvent_INIT_Action_LinIf_Init_BswMReportFailToDemRef: start-on-event=DemSatellite_OsApplication_Untrusted_Core0InternalBehavior/GetDTCOfEvent, operation=EvtInfo_AutoCreatedDemEvent_INIT_Action_LinIf_Init_BswMReportFailToDemRef.GetDTCOfEvent
        OpEventGetDTCOfEvent_GetDTCOfEvent_EvtInfo_AutoCreatedDemEvent_INIT_Action_LinSM_Init_BswMReportFailToDemRef: start-on-event=DemSatellite_OsApplication_Untrusted_Core0InternalBehavior/GetDTCOfEvent, operation=EvtInfo_AutoCreatedDemEvent_INIT_Action_LinSM_Init_BswMReportFailToDemRef.GetDTCOfEvent
        OpEventGetDTCOfEvent_GetDTCOfEvent_EvtInfo_AutoCreatedDemEvent_INIT_Action_LinTp_Init_BswMReportFailToDemRef: start-on-event=DemSatellite_OsApplication_Untrusted_Core0InternalBehavior/GetDTCOfEvent, operation=EvtInfo_AutoCreatedDemEvent_INIT_Action_LinTp_Init_BswMReportFailToDemRef.GetDTCOfEvent
        OpEventGetDTCOfEvent_GetDTCOfEvent_EvtInfo_AutoCreatedDemEvent_INIT_Action_Lin_Init_BswMReportFailToDemRef: start-on-event=DemSatellite_OsApplication_Untrusted_Core0InternalBehavior/GetDTCOfEvent, operation=EvtInfo_AutoCreatedDemEvent_INIT_Action_Lin_Init_BswMReportFailToDemRef.GetDTCOfEvent
        OpEventGetDTCOfEvent_GetDTCOfEvent_EvtInfo_AutoCreatedDemEvent_INIT_Action_Nm_Init_BswMReportFailToDemRef: start-on-event=DemSatellite_OsApplication_Untrusted_Core0InternalBehavior/GetDTCOfEvent, operation=EvtInfo_AutoCreatedDemEvent_INIT_Action_Nm_Init_BswMReportFailToDemRef.GetDTCOfEvent
        OpEventGetDTCOfEvent_GetDTCOfEvent_EvtInfo_AutoCreatedDemEvent_INIT_Action_NvMReadAll_BswMReportFailToDemRef: start-on-event=DemSatellite_OsApplication_Untrusted_Core0InternalBehavior/GetDTCOfEvent, operation=EvtInfo_AutoCreatedDemEvent_INIT_Action_NvMReadAll_BswMReportFailToDemRef.GetDTCOfEvent
        OpEventGetDTCOfEvent_GetDTCOfEvent_EvtInfo_AutoCreatedDemEvent_INIT_Action_NvM_Init_BswMReportFailToDemRef: start-on-event=DemSatellite_OsApplication_Untrusted_Core0InternalBehavior/GetDTCOfEvent, operation=EvtInfo_AutoCreatedDemEvent_INIT_Action_NvM_Init_BswMReportFailToDemRef.GetDTCOfEvent
        OpEventGetDTCOfEvent_GetDTCOfEvent_EvtInfo_AutoCreatedDemEvent_INIT_Action_PduR_Init_BswMReportFailToDemRef: start-on-event=DemSatellite_OsApplication_Untrusted_Core0InternalBehavior/GetDTCOfEvent, operation=EvtInfo_AutoCreatedDemEvent_INIT_Action_PduR_Init_BswMReportFailToDemRef.GetDTCOfEvent
        OpEventGetDTCOfEvent_GetDTCOfEvent_EvtInfo_AutoCreatedDemEvent_INIT_Action_RteStart_BswMReportFailToDemRef: start-on-event=DemSatellite_OsApplication_Untrusted_Core0InternalBehavior/GetDTCOfEvent, operation=EvtInfo_AutoCreatedDemEvent_INIT_Action_RteStart_BswMReportFailToDemRef.GetDTCOfEvent
        OpEventGetDTCOfEvent_GetDTCOfEvent_EvtInfo_AutoCreatedDemEvent_CHNL_17344684_CANSM_E_MODE_REQUEST_TIMEOUT: start-on-event=DemSatellite_OsApplication_Untrusted_Core0InternalBehavior/GetDTCOfEvent, operation=EvtInfo_AutoCreatedDemEvent_CHNL_17344684_CANSM_E_MODE_REQUEST_TIMEOUT.GetDTCOfEvent
        OpEventGetDTCOfEvent_GetDTCOfEvent_EvtInfo_AutoCreatedDemEvent_CHNL_17344684_CANSM_E_BUS_OFF: start-on-event=DemSatellite_OsApplication_Untrusted_Core0InternalBehavior/GetDTCOfEvent, operation=EvtInfo_AutoCreatedDemEvent_CHNL_17344684_CANSM_E_BUS_OFF.GetDTCOfEvent
        OpEventGetDTCOfEvent_GetDTCOfEvent_EvtInfo_AutoCreatedDemEvent_CHNL_53cce282_CANSM_E_MODE_REQUEST_TIMEOUT: start-on-event=DemSatellite_OsApplication_Untrusted_Core0InternalBehavior/GetDTCOfEvent, operation=EvtInfo_AutoCreatedDemEvent_CHNL_53cce282_CANSM_E_MODE_REQUEST_TIMEOUT.GetDTCOfEvent
        OpEventGetDTCOfEvent_GetDTCOfEvent_EvtInfo_AutoCreatedDemEvent_CHNL_53cce282_CANSM_E_BUS_OFF: start-on-event=DemSatellite_OsApplication_Untrusted_Core0InternalBehavior/GetDTCOfEvent, operation=EvtInfo_AutoCreatedDemEvent_CHNL_53cce282_CANSM_E_BUS_OFF.GetDTCOfEvent
        OpEventGetDTCOfEvent_GetDTCOfEvent_EvtInfo_AutoCreatedDemEvent_CHNL_a6b6a922_CANSM_E_MODE_REQUEST_TIMEOUT: start-on-event=DemSatellite_OsApplication_Untrusted_Core0InternalBehavior/GetDTCOfEvent, operation=EvtInfo_AutoCreatedDemEvent_CHNL_a6b6a922_CANSM_E_MODE_REQUEST_TIMEOUT.GetDTCOfEvent
        OpEventGetDTCOfEvent_GetDTCOfEvent_EvtInfo_AutoCreatedDemEvent_CHNL_a6b6a922_CANSM_E_BUS_OFF: start-on-event=DemSatellite_OsApplication_Untrusted_Core0InternalBehavior/GetDTCOfEvent, operation=EvtInfo_AutoCreatedDemEvent_CHNL_a6b6a922_CANSM_E_BUS_OFF.GetDTCOfEvent
        OpEventGetDTCOfEvent_GetDTCOfEvent_EvtInfo_AutoCreatedDemEvent_CHNL_df893ad5_CANSM_E_MODE_REQUEST_TIMEOUT: start-on-event=DemSatellite_OsApplication_Untrusted_Core0InternalBehavior/GetDTCOfEvent, operation=EvtInfo_AutoCreatedDemEvent_CHNL_df893ad5_CANSM_E_MODE_REQUEST_TIMEOUT.GetDTCOfEvent
        OpEventGetDTCOfEvent_GetDTCOfEvent_EvtInfo_AutoCreatedDemEvent_CHNL_df893ad5_CANSM_E_BUS_OFF: start-on-event=DemSatellite_OsApplication_Untrusted_Core0InternalBehavior/GetDTCOfEvent, operation=EvtInfo_AutoCreatedDemEvent_CHNL_df893ad5_CANSM_E_BUS_OFF.GetDTCOfEvent
        OpEventGetDTCOfEvent_GetDTCOfEvent_EvtInfo_AutoCreatedDemEvent_CHNL_e058b4ae_CANSM_E_MODE_REQUEST_TIMEOUT: start-on-event=DemSatellite_OsApplication_Untrusted_Core0InternalBehavior/GetDTCOfEvent, operation=EvtInfo_AutoCreatedDemEvent_CHNL_e058b4ae_CANSM_E_MODE_REQUEST_TIMEOUT.GetDTCOfEvent
        OpEventGetDTCOfEvent_GetDTCOfEvent_EvtInfo_AutoCreatedDemEvent_CHNL_e058b4ae_CANSM_E_BUS_OFF: start-on-event=DemSatellite_OsApplication_Untrusted_Core0InternalBehavior/GetDTCOfEvent, operation=EvtInfo_AutoCreatedDemEvent_CHNL_e058b4ae_CANSM_E_BUS_OFF.GetDTCOfEvent
        OpEventGetDTCOfEvent_GetDTCOfEvent_EvtInfo_AutoCreatedDemEvent_ECUM_E_RAM_CHECK_FAILED: start-on-event=DemSatellite_OsApplication_Untrusted_Core0InternalBehavior/GetDTCOfEvent, operation=EvtInfo_AutoCreatedDemEvent_ECUM_E_RAM_CHECK_FAILED.GetDTCOfEvent
        OpEventGetDTCOfEvent_GetDTCOfEvent_EvtInfo_AutoCreatedDemEvent_ECUM_E_IMPROPER_CALLER: start-on-event=DemSatellite_OsApplication_Untrusted_Core0InternalBehavior/GetDTCOfEvent, operation=EvtInfo_AutoCreatedDemEvent_ECUM_E_IMPROPER_CALLER.GetDTCOfEvent
        OpEventGetDTCOfEvent_GetDTCOfEvent_EvtInfo_AutoCreatedDemEvent_ECUM_E_CONFIGURATION_DATA_INCONSISTENT: start-on-event=DemSatellite_OsApplication_Untrusted_Core0InternalBehavior/GetDTCOfEvent, operation=EvtInfo_AutoCreatedDemEvent_ECUM_E_CONFIGURATION_DATA_INCONSISTENT.GetDTCOfEvent
        OpEventGetDTCOfEvent_GetDTCOfEvent_EvtInfo_AutoCreatedDemEvent_ECUM_E_ALL_RUN_REQUESTS_KILLED: start-on-event=DemSatellite_OsApplication_Untrusted_Core0InternalBehavior/GetDTCOfEvent, operation=EvtInfo_AutoCreatedDemEvent_ECUM_E_ALL_RUN_REQUESTS_KILLED.GetDTCOfEvent
        OpEventGetDTCOfEvent_GetDTCOfEvent_EvtInfo_AutoCreatedDemEvent_FLS_E_WRITE_FAILED: start-on-event=DemSatellite_OsApplication_Untrusted_Core0InternalBehavior/GetDTCOfEvent, operation=EvtInfo_AutoCreatedDemEvent_FLS_E_WRITE_FAILED.GetDTCOfEvent
        OpEventGetDTCOfEvent_GetDTCOfEvent_EvtInfo_AutoCreatedDemEvent_FLS_E_UNEXPECTED_FLASH_ID: start-on-event=DemSatellite_OsApplication_Untrusted_Core0InternalBehavior/GetDTCOfEvent, operation=EvtInfo_AutoCreatedDemEvent_FLS_E_UNEXPECTED_FLASH_ID.GetDTCOfEvent
        OpEventGetDTCOfEvent_GetDTCOfEvent_EvtInfo_AutoCreatedDemEvent_FLS_E_READ_FAILED: start-on-event=DemSatellite_OsApplication_Untrusted_Core0InternalBehavior/GetDTCOfEvent, operation=EvtInfo_AutoCreatedDemEvent_FLS_E_READ_FAILED.GetDTCOfEvent
        OpEventGetDTCOfEvent_GetDTCOfEvent_EvtInfo_AutoCreatedDemEvent_FLS_E_ERASE_FAILED: start-on-event=DemSatellite_OsApplication_Untrusted_Core0InternalBehavior/GetDTCOfEvent, operation=EvtInfo_AutoCreatedDemEvent_FLS_E_ERASE_FAILED.GetDTCOfEvent
        OpEventGetDTCOfEvent_GetDTCOfEvent_EvtInfo_AutoCreatedDemEvent_FLS_E_COMPARE_FAILED: start-on-event=DemSatellite_OsApplication_Untrusted_Core0InternalBehavior/GetDTCOfEvent, operation=EvtInfo_AutoCreatedDemEvent_FLS_E_COMPARE_FAILED.GetDTCOfEvent
        OpEventGetDTCOfEvent_GetDTCOfEvent_EvtInfo_AutoCreatedDemEvent_GPT_E_TIMEOUT: start-on-event=DemSatellite_OsApplication_Untrusted_Core0InternalBehavior/GetDTCOfEvent, operation=EvtInfo_AutoCreatedDemEvent_GPT_E_TIMEOUT.GetDTCOfEvent
        OpEventGetDTCOfEvent_GetDTCOfEvent_EvtInfo_AutoCreatedDemEvent_J1939NM_E_ADDRESS_LOST: start-on-event=DemSatellite_OsApplication_Untrusted_Core0InternalBehavior/GetDTCOfEvent, operation=EvtInfo_AutoCreatedDemEvent_J1939NM_E_ADDRESS_LOST.GetDTCOfEvent
        OpEventGetDTCOfEvent_GetDTCOfEvent_EvtInfo_AutoCreatedDemEvent_J1939TpConfiguration_J1939TP_E_COMMUNICATION: start-on-event=DemSatellite_OsApplication_Untrusted_Core0InternalBehavior/GetDTCOfEvent, operation=EvtInfo_AutoCreatedDemEvent_J1939TpConfiguration_J1939TP_E_COMMUNICATION.GetDTCOfEvent
        OpEventGetDTCOfEvent_GetDTCOfEvent_EvtInfo_AutoCreatedDemEvent_LIN_E_TIMEOUT: start-on-event=DemSatellite_OsApplication_Untrusted_Core0InternalBehavior/GetDTCOfEvent, operation=EvtInfo_AutoCreatedDemEvent_LIN_E_TIMEOUT.GetDTCOfEvent
        OpEventGetDTCOfEvent_GetDTCOfEvent_EvtInfo_AutoCreatedDemEvent_MCL_E_DMA_UNRECOGNIZED: start-on-event=DemSatellite_OsApplication_Untrusted_Core0InternalBehavior/GetDTCOfEvent, operation=EvtInfo_AutoCreatedDemEvent_MCL_E_DMA_UNRECOGNIZED.GetDTCOfEvent
        OpEventGetDTCOfEvent_GetDTCOfEvent_EvtInfo_AutoCreatedDemEvent_MCL_E_DMA_PRIORITY: start-on-event=DemSatellite_OsApplication_Untrusted_Core0InternalBehavior/GetDTCOfEvent, operation=EvtInfo_AutoCreatedDemEvent_MCL_E_DMA_PRIORITY.GetDTCOfEvent
        OpEventGetDTCOfEvent_GetDTCOfEvent_EvtInfo_AutoCreatedDemEvent_MCL_E_DMA_INCONSISTENCY: start-on-event=DemSatellite_OsApplication_Untrusted_Core0InternalBehavior/GetDTCOfEvent, operation=EvtInfo_AutoCreatedDemEvent_MCL_E_DMA_INCONSISTENCY.GetDTCOfEvent
        OpEventGetDTCOfEvent_GetDTCOfEvent_EvtInfo_AutoCreatedDemEvent_MCL_E_DMA_ECC: start-on-event=DemSatellite_OsApplication_Untrusted_Core0InternalBehavior/GetDTCOfEvent, operation=EvtInfo_AutoCreatedDemEvent_MCL_E_DMA_ECC.GetDTCOfEvent
        OpEventGetDTCOfEvent_GetDTCOfEvent_EvtInfo_AutoCreatedDemEvent_MCL_E_DMA_DESCRIPTOR: start-on-event=DemSatellite_OsApplication_Untrusted_Core0InternalBehavior/GetDTCOfEvent, operation=EvtInfo_AutoCreatedDemEvent_MCL_E_DMA_DESCRIPTOR.GetDTCOfEvent
        OpEventGetDTCOfEvent_GetDTCOfEvent_EvtInfo_AutoCreatedDemEvent_MCL_E_DMA_BUS: start-on-event=DemSatellite_OsApplication_Untrusted_Core0InternalBehavior/GetDTCOfEvent, operation=EvtInfo_AutoCreatedDemEvent_MCL_E_DMA_BUS.GetDTCOfEvent
        OpEventGetDTCOfEvent_GetDTCOfEvent_EvtInfo_AutoCreatedDemEvent_MCU_E_TIMEOUT_FAILURE: start-on-event=DemSatellite_OsApplication_Untrusted_Core0InternalBehavior/GetDTCOfEvent, operation=EvtInfo_AutoCreatedDemEvent_MCU_E_TIMEOUT_FAILURE.GetDTCOfEvent
        OpEventGetDTCOfEvent_GetDTCOfEvent_EvtInfo_AutoCreatedDemEvent_MCU_E_SSCM_CER_FAILURE: start-on-event=DemSatellite_OsApplication_Untrusted_Core0InternalBehavior/GetDTCOfEvent, operation=EvtInfo_AutoCreatedDemEvent_MCU_E_SSCM_CER_FAILURE.GetDTCOfEvent
        OpEventGetDTCOfEvent_GetDTCOfEvent_EvtInfo_AutoCreatedDemEvent_MCU_E_INVALIDMODE_CONFIG: start-on-event=DemSatellite_OsApplication_Untrusted_Core0InternalBehavior/GetDTCOfEvent, operation=EvtInfo_AutoCreatedDemEvent_MCU_E_INVALIDMODE_CONFIG.GetDTCOfEvent
        OpEventGetDTCOfEvent_GetDTCOfEvent_EvtInfo_AutoCreatedDemEvent_MCU_E_CLOCK_FAILURE: start-on-event=DemSatellite_OsApplication_Untrusted_Core0InternalBehavior/GetDTCOfEvent, operation=EvtInfo_AutoCreatedDemEvent_MCU_E_CLOCK_FAILURE.GetDTCOfEvent
        OpEventGetDTCOfEvent_GetDTCOfEvent_EvtInfo_AutoCreatedDemEvent_NVM_E_WRONG_BLOCK_ID: start-on-event=DemSatellite_OsApplication_Untrusted_Core0InternalBehavior/GetDTCOfEvent, operation=EvtInfo_AutoCreatedDemEvent_NVM_E_WRONG_BLOCK_ID.GetDTCOfEvent
        OpEventGetDTCOfEvent_GetDTCOfEvent_EvtInfo_AutoCreatedDemEvent_NVM_E_WRITE_PROTECTED: start-on-event=DemSatellite_OsApplication_Untrusted_Core0InternalBehavior/GetDTCOfEvent, operation=EvtInfo_AutoCreatedDemEvent_NVM_E_WRITE_PROTECTED.GetDTCOfEvent
        OpEventGetDTCOfEvent_GetDTCOfEvent_EvtInfo_AutoCreatedDemEvent_NVM_E_VERIFY_FAILED: start-on-event=DemSatellite_OsApplication_Untrusted_Core0InternalBehavior/GetDTCOfEvent, operation=EvtInfo_AutoCreatedDemEvent_NVM_E_VERIFY_FAILED.GetDTCOfEvent
        OpEventGetDTCOfEvent_GetDTCOfEvent_EvtInfo_AutoCreatedDemEvent_NVM_E_REQ_FAILED: start-on-event=DemSatellite_OsApplication_Untrusted_Core0InternalBehavior/GetDTCOfEvent, operation=EvtInfo_AutoCreatedDemEvent_NVM_E_REQ_FAILED.GetDTCOfEvent
        OpEventGetDTCOfEvent_GetDTCOfEvent_EvtInfo_AutoCreatedDemEvent_NVM_E_QUEUE_OVERFLOW: start-on-event=DemSatellite_OsApplication_Untrusted_Core0InternalBehavior/GetDTCOfEvent, operation=EvtInfo_AutoCreatedDemEvent_NVM_E_QUEUE_OVERFLOW.GetDTCOfEvent
        OpEventGetDTCOfEvent_GetDTCOfEvent_EvtInfo_AutoCreatedDemEvent_NVM_E_LOSS_OF_REDUNDANCY: start-on-event=DemSatellite_OsApplication_Untrusted_Core0InternalBehavior/GetDTCOfEvent, operation=EvtInfo_AutoCreatedDemEvent_NVM_E_LOSS_OF_REDUNDANCY.GetDTCOfEvent
        OpEventGetDTCOfEvent_GetDTCOfEvent_EvtInfo_AutoCreatedDemEvent_NVM_E_INTEGRITY_FAILED: start-on-event=DemSatellite_OsApplication_Untrusted_Core0InternalBehavior/GetDTCOfEvent, operation=EvtInfo_AutoCreatedDemEvent_NVM_E_INTEGRITY_FAILED.GetDTCOfEvent
        OpEventGetDTCOfEvent_GetDTCOfEvent_EvtInfo_AutoCreatedDemEvent_SPI_E_HARDWARE_ERROR: start-on-event=DemSatellite_OsApplication_Untrusted_Core0InternalBehavior/GetDTCOfEvent, operation=EvtInfo_AutoCreatedDemEvent_SPI_E_HARDWARE_ERROR.GetDTCOfEvent
        OpEventGetDTCOfEvent_GetDTCOfEvent_EvtInfo_AutoCreatedDemEvent_SpiDriver_SPI_E_HARDWARE_ERROR: start-on-event=DemSatellite_OsApplication_Untrusted_Core0InternalBehavior/GetDTCOfEvent, operation=EvtInfo_AutoCreatedDemEvent_SpiDriver_SPI_E_HARDWARE_ERROR.GetDTCOfEvent
        OpEventGetDTCOfEvent_GetDTCOfEvent_EvtInfo_AutoCreatedDemEvent_WDG_E_UNLOCKED: start-on-event=DemSatellite_OsApplication_Untrusted_Core0InternalBehavior/GetDTCOfEvent, operation=EvtInfo_AutoCreatedDemEvent_WDG_E_UNLOCKED.GetDTCOfEvent
        OpEventGetDTCOfEvent_GetDTCOfEvent_EvtInfo_AutoCreatedDemEvent_WDG_E_MODE_FAILED: start-on-event=DemSatellite_OsApplication_Untrusted_Core0InternalBehavior/GetDTCOfEvent, operation=EvtInfo_AutoCreatedDemEvent_WDG_E_MODE_FAILED.GetDTCOfEvent
        OpEventGetDTCOfEvent_GetDTCOfEvent_EvtInfo_AutoCreatedDemEvent_WDG_E_INVALID_PARAMETER: start-on-event=DemSatellite_OsApplication_Untrusted_Core0InternalBehavior/GetDTCOfEvent, operation=EvtInfo_AutoCreatedDemEvent_WDG_E_INVALID_PARAMETER.GetDTCOfEvent
        OpEventGetDTCOfEvent_GetDTCOfEvent_EvtInfo_AutoCreatedDemEvent_WDG_E_INVALID_CALL: start-on-event=DemSatellite_OsApplication_Untrusted_Core0InternalBehavior/GetDTCOfEvent, operation=EvtInfo_AutoCreatedDemEvent_WDG_E_INVALID_CALL.GetDTCOfEvent
        OpEventGetDTCOfEvent_GetDTCOfEvent_EvtInfo_AutoCreatedDemEvent_WDG_E_FORBIDDEN_INVOCATION: start-on-event=DemSatellite_OsApplication_Untrusted_Core0InternalBehavior/GetDTCOfEvent, operation=EvtInfo_AutoCreatedDemEvent_WDG_E_FORBIDDEN_INVOCATION.GetDTCOfEvent
        OpEventGetDTCOfEvent_GetDTCOfEvent_EvtInfo_AutoCreatedDemEvent_WDG_E_DISABLE_REJECTED: start-on-event=DemSatellite_OsApplication_Untrusted_Core0InternalBehavior/GetDTCOfEvent, operation=EvtInfo_AutoCreatedDemEvent_WDG_E_DISABLE_REJECTED.GetDTCOfEvent
        OpEventGetDTCOfEvent_GetDTCOfEvent_EvtInfo_AutoCreatedDemEvent_WDG_E_CORRUPT_CONFIG: start-on-event=DemSatellite_OsApplication_Untrusted_Core0InternalBehavior/GetDTCOfEvent, operation=EvtInfo_AutoCreatedDemEvent_WDG_E_CORRUPT_CONFIG.GetDTCOfEvent
        OpEventGetFaultDetectionCounter_GetFaultDetectionCounter_EvtInfo_AutoCreatedDemEvent_ADC_E_TIMEOUT: start-on-event=DemSatellite_OsApplication_Untrusted_Core0InternalBehavior/GetFaultDetectionCounter, operation=EvtInfo_AutoCreatedDemEvent_ADC_E_TIMEOUT.GetFaultDetectionCounter
        OpEventGetFaultDetectionCounter_GetFaultDetectionCounter_EvtInfo_AutoCreatedDemEvent_CC_DisableDM_CIOM_oCabSubnet_Rx_06_97a3cc9d: start-on-event=DemSatellite_OsApplication_Untrusted_Core0InternalBehavior/GetFaultDetectionCounter, operation=EvtInfo_AutoCreatedDemEvent_CC_DisableDM_CIOM_oCabSubnet_Rx_063a5fbc_BswMReportFailToDemRef.GetFaultDetectionCounter
        OpEventGetFaultDetectionCounter_GetFaultDetectionCounter_EvtInfo_AutoCreatedDemEvent_CC_J1939RmStateSwitch_CN_Backbone1_631faafe: start-on-event=DemSatellite_OsApplication_Untrusted_Core0InternalBehavior/GetFaultDetectionCounter, operation=EvtInfo_AutoCreatedDemEvent_CC_J1939RmStateSwitch_CN_Backbone1J1939_0b1f4bae_CIOM_4d5cd289_J1939RM_STATE_OFFLINE_BswMRe_5a5b15b8.GetFaultDetectionCounter
        OpEventGetFaultDetectionCounter_GetFaultDetectionCounter_EvtInfo_AutoCreatedDemEvent_CC_J1939RmStateSwitch_CN_Backbone1_1e409a6d: start-on-event=DemSatellite_OsApplication_Untrusted_Core0InternalBehavior/GetFaultDetectionCounter, operation=EvtInfo_AutoCreatedDemEvent_CC_J1939RmStateSwitch_CN_Backbone1J1939_0b1f4bae_CIOM_4d5cd289_J1939RM_STATE_ONLINE_BswMRep_ec959aed.GetFaultDetectionCounter
        OpEventGetFaultDetectionCounter_GetFaultDetectionCounter_EvtInfo_AutoCreatedDemEvent_CC_DisablePDUGroup_CIOM_oLIN04_Tx_552f3f9d: start-on-event=DemSatellite_OsApplication_Untrusted_Core0InternalBehavior/GetFaultDetectionCounter, operation=EvtInfo_AutoCreatedDemEvent_CC_DisablePDUGroup_CIOM_oLIN04_Tx_04202f7b_BswMReportFailToDemRef.GetFaultDetectionCounter
        OpEventGetFaultDetectionCounter_GetFaultDetectionCounter_EvtInfo_AutoCreatedDemEvent_CC_DisablePDUGroup_CIOM_oLIN04_Rx_9c8d5a63: start-on-event=DemSatellite_OsApplication_Untrusted_Core0InternalBehavior/GetFaultDetectionCounter, operation=EvtInfo_AutoCreatedDemEvent_CC_DisablePDUGroup_CIOM_oLIN04_Rx_527a88fd_BswMReportFailToDemRef.GetFaultDetectionCounter
        OpEventGetFaultDetectionCounter_GetFaultDetectionCounter_EvtInfo_AutoCreatedDemEvent_CC_DisablePDUGroup_CIOM_oLIN01_Tx_2e9796e4: start-on-event=DemSatellite_OsApplication_Untrusted_Core0InternalBehavior/GetFaultDetectionCounter, operation=EvtInfo_AutoCreatedDemEvent_CC_DisablePDUGroup_CIOM_oLIN01_Tx_33fedf49_BswMReportFailToDemRef.GetFaultDetectionCounter
        OpEventGetFaultDetectionCounter_GetFaultDetectionCounter_EvtInfo_AutoCreatedDemEvent_CC_DisablePDUGroup_CIOM_oLIN01_Rx_10a73c6e: start-on-event=DemSatellite_OsApplication_Untrusted_Core0InternalBehavior/GetFaultDetectionCounter, operation=EvtInfo_AutoCreatedDemEvent_CC_DisablePDUGroup_CIOM_oLIN01_Rx_65a478cf_BswMReportFailToDemRef.GetFaultDetectionCounter
        OpEventGetFaultDetectionCounter_GetFaultDetectionCounter_EvtInfo_AutoCreatedDemEvent_CC_EnablePDUGroup_CIOM_oLIN04_Tx_0_9f7767a3: start-on-event=DemSatellite_OsApplication_Untrusted_Core0InternalBehavior/GetFaultDetectionCounter, operation=EvtInfo_AutoCreatedDemEvent_CC_EnablePDUGroup_CIOM_oLIN04_Tx_04202f7b_BswMReportFailToDemRef.GetFaultDetectionCounter
        OpEventGetFaultDetectionCounter_GetFaultDetectionCounter_EvtInfo_AutoCreatedDemEvent_CC_EnablePDUGroup_CIOM_oLIN04_Rx_5_56d5025d: start-on-event=DemSatellite_OsApplication_Untrusted_Core0InternalBehavior/GetFaultDetectionCounter, operation=EvtInfo_AutoCreatedDemEvent_CC_EnablePDUGroup_CIOM_oLIN04_Rx_527a88fd_BswMReportFailToDemRef.GetFaultDetectionCounter
        OpEventGetFaultDetectionCounter_GetFaultDetectionCounter_EvtInfo_AutoCreatedDemEvent_CC_DisableDM_CIOM_oBackbone2_Rx_4e_f0f7c613: start-on-event=DemSatellite_OsApplication_Untrusted_Core0InternalBehavior/GetFaultDetectionCounter, operation=EvtInfo_AutoCreatedDemEvent_CC_DisableDM_CIOM_oBackbone2_Rx_4e624434_BswMReportFailToDemRef.GetFaultDetectionCounter
        OpEventGetFaultDetectionCounter_GetFaultDetectionCounter_EvtInfo_AutoCreatedDemEvent_CC_EnableDM_CIOM_oBackbone2_Rx_4e6_d23923da: start-on-event=DemSatellite_OsApplication_Untrusted_Core0InternalBehavior/GetFaultDetectionCounter, operation=EvtInfo_AutoCreatedDemEvent_CC_EnableDM_CIOM_oBackbone2_Rx_4e624434_BswMReportFailToDemRef.GetFaultDetectionCounter
        OpEventGetFaultDetectionCounter_GetFaultDetectionCounter_EvtInfo_AutoCreatedDemEvent_CC_DisableDM_CIOM_oSecuritySubnet_68e23325: start-on-event=DemSatellite_OsApplication_Untrusted_Core0InternalBehavior/GetFaultDetectionCounter, operation=EvtInfo_AutoCreatedDemEvent_CC_DisableDM_CIOM_oSecuritySubnet_Rx_3a3c1dbc_BswMReportFailToDemRef.GetFaultDetectionCounter
        OpEventGetFaultDetectionCounter_GetFaultDetectionCounter_EvtInfo_AutoCreatedDemEvent_CC_EnableDM_CIOM_oSecuritySubnet_R_51c5f5ef: start-on-event=DemSatellite_OsApplication_Untrusted_Core0InternalBehavior/GetFaultDetectionCounter, operation=EvtInfo_AutoCreatedDemEvent_CC_EnableDM_CIOM_oSecuritySubnet_Rx_3a3c1dbc_BswMReportFailToDemRef.GetFaultDetectionCounter
        OpEventGetFaultDetectionCounter_GetFaultDetectionCounter_EvtInfo_AutoCreatedDemEvent_CC_DisablePDUGroup_CIOM_oCabSubnet_6edd01e9: start-on-event=DemSatellite_OsApplication_Untrusted_Core0InternalBehavior/GetFaultDetectionCounter, operation=EvtInfo_AutoCreatedDemEvent_CC_DisablePDUGroup_CIOM_oCabSubnet_Tx_5060f83a_BswMReportFailToDemRef.GetFaultDetectionCounter
        OpEventGetFaultDetectionCounter_GetFaultDetectionCounter_EvtInfo_AutoCreatedDemEvent_CC_EnablePDUGroup_CIOM_oCabSubnet_15550d81: start-on-event=DemSatellite_OsApplication_Untrusted_Core0InternalBehavior/GetFaultDetectionCounter, operation=EvtInfo_AutoCreatedDemEvent_CC_EnablePDUGroup_CIOM_oCabSubnet_Tx_5060f83a_BswMReportFailToDemRef.GetFaultDetectionCounter
        OpEventGetFaultDetectionCounter_GetFaultDetectionCounter_EvtInfo_AutoCreatedDemEvent_CC_EnableDM_CIOM_oCabSubnet_Rx_063_b56d2954: start-on-event=DemSatellite_OsApplication_Untrusted_Core0InternalBehavior/GetFaultDetectionCounter, operation=EvtInfo_AutoCreatedDemEvent_CC_EnableDM_CIOM_oCabSubnet_Rx_063a5fbc_BswMReportFailToDemRef.GetFaultDetectionCounter
        OpEventGetFaultDetectionCounter_GetFaultDetectionCounter_EvtInfo_AutoCreatedDemEvent_CC_DisablePDUGroup_CIOM_oBackbone2_0c809cc7: start-on-event=DemSatellite_OsApplication_Untrusted_Core0InternalBehavior/GetFaultDetectionCounter, operation=EvtInfo_AutoCreatedDemEvent_CC_DisablePDUGroup_CIOM_oBackbone2_Tx_1838e3b2_BswMReportFailToDemRef.GetFaultDetectionCounter
        OpEventGetFaultDetectionCounter_GetFaultDetectionCounter_EvtInfo_AutoCreatedDemEvent_CC_EnablePDUGroup_CIOM_oBackbone2_770890af: start-on-event=DemSatellite_OsApplication_Untrusted_Core0InternalBehavior/GetFaultDetectionCounter, operation=EvtInfo_AutoCreatedDemEvent_CC_EnablePDUGroup_CIOM_oBackbone2_Tx_1838e3b2_BswMReportFailToDemRef.GetFaultDetectionCounter
        OpEventGetFaultDetectionCounter_GetFaultDetectionCounter_EvtInfo_AutoCreatedDemEvent_CC_DisablePDUGroup_CIOM_oBackbone2_f9f43d4d: start-on-event=DemSatellite_OsApplication_Untrusted_Core0InternalBehavior/GetFaultDetectionCounter, operation=EvtInfo_AutoCreatedDemEvent_CC_DisablePDUGroup_CIOM_oBackbone2_Rx_4e624434_BswMReportFailToDemRef.GetFaultDetectionCounter
        OpEventGetFaultDetectionCounter_GetFaultDetectionCounter_EvtInfo_AutoCreatedDemEvent_CC_EnablePDUGroup_CIOM_oBackbone2_827c3125: start-on-event=DemSatellite_OsApplication_Untrusted_Core0InternalBehavior/GetFaultDetectionCounter, operation=EvtInfo_AutoCreatedDemEvent_CC_EnablePDUGroup_CIOM_oBackbone2_Rx_4e624434_BswMReportFailToDemRef.GetFaultDetectionCounter
        OpEventGetFaultDetectionCounter_GetFaultDetectionCounter_EvtInfo_AutoCreatedDemEvent_CC_DisablePDUGroup_CIOM_oBackbone1_02a69604: start-on-event=DemSatellite_OsApplication_Untrusted_Core0InternalBehavior/GetFaultDetectionCounter, operation=EvtInfo_AutoCreatedDemEvent_CC_DisablePDUGroup_CIOM_oBackbone1J1939_Rx_BC_405bc776_BswMReportFailToDemRef.GetFaultDetectionCounter
        OpEventGetFaultDetectionCounter_GetFaultDetectionCounter_EvtInfo_AutoCreatedDemEvent_CC_EnablePDUGroup_CIOM_oBackbone1J_bae90015: start-on-event=DemSatellite_OsApplication_Untrusted_Core0InternalBehavior/GetFaultDetectionCounter, operation=EvtInfo_AutoCreatedDemEvent_CC_EnablePDUGroup_CIOM_oBackbone1J1939_Rx_BC_405bc776_BswMReportFailToDemRef.GetFaultDetectionCounter
        OpEventGetFaultDetectionCounter_GetFaultDetectionCounter_EvtInfo_AutoCreatedDemEvent_CC_EnablePDUGroup_CIOM_oLIN02_Tx_2_055fadc9: start-on-event=DemSatellite_OsApplication_Untrusted_Core0InternalBehavior/GetFaultDetectionCounter, operation=EvtInfo_AutoCreatedDemEvent_CC_EnablePDUGroup_CIOM_oLIN02_Tx_214b70a7_BswMReportFailToDemRef.GetFaultDetectionCounter
        OpEventGetFaultDetectionCounter_GetFaultDetectionCounter_EvtInfo_AutoCreatedDemEvent_CC_EnablePDUGroup_CIOM_oLIN02_Rx_7_d3956eab: start-on-event=DemSatellite_OsApplication_Untrusted_Core0InternalBehavior/GetFaultDetectionCounter, operation=EvtInfo_AutoCreatedDemEvent_CC_EnablePDUGroup_CIOM_oLIN02_Rx_7711d721_BswMReportFailToDemRef.GetFaultDetectionCounter
        OpEventGetFaultDetectionCounter_GetFaultDetectionCounter_EvtInfo_AutoCreatedDemEvent_CC_EnablePDUGroup_CIOM_oLIN01_Tx_3_e4cfceda: start-on-event=DemSatellite_OsApplication_Untrusted_Core0InternalBehavior/GetFaultDetectionCounter, operation=EvtInfo_AutoCreatedDemEvent_CC_EnablePDUGroup_CIOM_oLIN01_Tx_33fedf49_BswMReportFailToDemRef.GetFaultDetectionCounter
        OpEventGetFaultDetectionCounter_GetFaultDetectionCounter_EvtInfo_AutoCreatedDemEvent_CC_EnablePDUGroup_CIOM_oLIN01_Rx_6_daff6450: start-on-event=DemSatellite_OsApplication_Untrusted_Core0InternalBehavior/GetFaultDetectionCounter, operation=EvtInfo_AutoCreatedDemEvent_CC_EnablePDUGroup_CIOM_oLIN01_Rx_65a478cf_BswMReportFailToDemRef.GetFaultDetectionCounter
        OpEventGetFaultDetectionCounter_GetFaultDetectionCounter_EvtInfo_AutoCreatedDemEvent_CC_DisablePDUGroup_CIOM_oLIN03_Tx_5dfd253f: start-on-event=DemSatellite_OsApplication_Untrusted_Core0InternalBehavior/GetFaultDetectionCounter, operation=EvtInfo_AutoCreatedDemEvent_CC_DisablePDUGroup_CIOM_oLIN03_Tx_99f717c2_BswMReportFailToDemRef.GetFaultDetectionCounter
        OpEventGetFaultDetectionCounter_GetFaultDetectionCounter_EvtInfo_AutoCreatedDemEvent_CC_DisablePDUGroup_CIOM_oLIN03_Rx_645040c1: start-on-event=DemSatellite_OsApplication_Untrusted_Core0InternalBehavior/GetFaultDetectionCounter, operation=EvtInfo_AutoCreatedDemEvent_CC_DisablePDUGroup_CIOM_oLIN03_Rx_cfadb044_BswMReportFailToDemRef.GetFaultDetectionCounter
        OpEventGetFaultDetectionCounter_GetFaultDetectionCounter_EvtInfo_AutoCreatedDemEvent_CC_DisableDM_CIOM_oFMSNet_Rx_BC_dd_df545440: start-on-event=DemSatellite_OsApplication_Untrusted_Core0InternalBehavior/GetFaultDetectionCounter, operation=EvtInfo_AutoCreatedDemEvent_CC_DisableDM_CIOM_oFMSNet_Rx_BC_dd2c1510_BswMReportFailToDemRef.GetFaultDetectionCounter
        OpEventGetFaultDetectionCounter_GetFaultDetectionCounter_EvtInfo_AutoCreatedDemEvent_CC_EnableDM_CIOM_oFMSNet_Rx_BC_dd2_fd9ab189: start-on-event=DemSatellite_OsApplication_Untrusted_Core0InternalBehavior/GetFaultDetectionCounter, operation=EvtInfo_AutoCreatedDemEvent_CC_EnableDM_CIOM_oFMSNet_Rx_BC_dd2c1510_BswMReportFailToDemRef.GetFaultDetectionCounter
        OpEventGetFaultDetectionCounter_GetFaultDetectionCounter_EvtInfo_AutoCreatedDemEvent_CC_EnablePDUGroup_CIOM_oLIN03_Tx_9_97a57d01: start-on-event=DemSatellite_OsApplication_Untrusted_Core0InternalBehavior/GetFaultDetectionCounter, operation=EvtInfo_AutoCreatedDemEvent_CC_EnablePDUGroup_CIOM_oLIN03_Tx_99f717c2_BswMReportFailToDemRef.GetFaultDetectionCounter
        OpEventGetFaultDetectionCounter_GetFaultDetectionCounter_EvtInfo_AutoCreatedDemEvent_CC_EnablePDUGroup_CIOM_oLIN03_Rx_c_ae0818ff: start-on-event=DemSatellite_OsApplication_Untrusted_Core0InternalBehavior/GetFaultDetectionCounter, operation=EvtInfo_AutoCreatedDemEvent_CC_EnablePDUGroup_CIOM_oLIN03_Rx_cfadb044_BswMReportFailToDemRef.GetFaultDetectionCounter
        OpEventGetFaultDetectionCounter_GetFaultDetectionCounter_EvtInfo_AutoCreatedDemEvent_CC_DisablePDUGroup_CIOM_oLIN02_Tx_cf07f5f7: start-on-event=DemSatellite_OsApplication_Untrusted_Core0InternalBehavior/GetFaultDetectionCounter, operation=EvtInfo_AutoCreatedDemEvent_CC_DisablePDUGroup_CIOM_oLIN02_Tx_214b70a7_BswMReportFailToDemRef.GetFaultDetectionCounter
        OpEventGetFaultDetectionCounter_GetFaultDetectionCounter_EvtInfo_AutoCreatedDemEvent_CC_DisablePDUGroup_CIOM_oLIN02_Rx_19cd3695: start-on-event=DemSatellite_OsApplication_Untrusted_Core0InternalBehavior/GetFaultDetectionCounter, operation=EvtInfo_AutoCreatedDemEvent_CC_DisablePDUGroup_CIOM_oLIN02_Rx_7711d721_BswMReportFailToDemRef.GetFaultDetectionCounter
        OpEventGetFaultDetectionCounter_GetFaultDetectionCounter_EvtInfo_AutoCreatedDemEvent_CC_DisablePDUGroup_CIOM_oCabSubnet_9ea037c3: start-on-event=DemSatellite_OsApplication_Untrusted_Core0InternalBehavior/GetFaultDetectionCounter, operation=EvtInfo_AutoCreatedDemEvent_CC_DisablePDUGroup_CIOM_oCabSubnet_Rx_063a5fbc_BswMReportFailToDemRef.GetFaultDetectionCounter
        OpEventGetFaultDetectionCounter_GetFaultDetectionCounter_EvtInfo_AutoCreatedDemEvent_CC_EnablePDUGroup_CIOM_oCabSubnet_e5283bab: start-on-event=DemSatellite_OsApplication_Untrusted_Core0InternalBehavior/GetFaultDetectionCounter, operation=EvtInfo_AutoCreatedDemEvent_CC_EnablePDUGroup_CIOM_oCabSubnet_Rx_063a5fbc_BswMReportFailToDemRef.GetFaultDetectionCounter
        OpEventGetFaultDetectionCounter_GetFaultDetectionCounter_EvtInfo_AutoCreatedDemEvent_CC_DisablePDUGroup_CIOM_oFMSNet_Rx_d657af1e: start-on-event=DemSatellite_OsApplication_Untrusted_Core0InternalBehavior/GetFaultDetectionCounter, operation=EvtInfo_AutoCreatedDemEvent_CC_DisablePDUGroup_CIOM_oFMSNet_Rx_BC_dd2c1510_BswMReportFailToDemRef.GetFaultDetectionCounter
        OpEventGetFaultDetectionCounter_GetFaultDetectionCounter_EvtInfo_AutoCreatedDemEvent_CC_EnablePDUGroup_CIOM_oFMSNet_Rx_addfa376: start-on-event=DemSatellite_OsApplication_Untrusted_Core0InternalBehavior/GetFaultDetectionCounter, operation=EvtInfo_AutoCreatedDemEvent_CC_EnablePDUGroup_CIOM_oFMSNet_Rx_BC_dd2c1510_BswMReportFailToDemRef.GetFaultDetectionCounter
        OpEventGetFaultDetectionCounter_GetFaultDetectionCounter_EvtInfo_AutoCreatedDemEvent_CC_DisablePDUGroup_CIOM_oSecurityS_6d22d639: start-on-event=DemSatellite_OsApplication_Untrusted_Core0InternalBehavior/GetFaultDetectionCounter, operation=EvtInfo_AutoCreatedDemEvent_CC_DisablePDUGroup_CIOM_oSecuritySubnet_Rx_3a3c1dbc_BswMReportFailToDemRef.GetFaultDetectionCounter
        OpEventGetFaultDetectionCounter_GetFaultDetectionCounter_EvtInfo_AutoCreatedDemEvent_CC_EnablePDUGroup_CIOM_oSecuritySu_ad5bbf08: start-on-event=DemSatellite_OsApplication_Untrusted_Core0InternalBehavior/GetFaultDetectionCounter, operation=EvtInfo_AutoCreatedDemEvent_CC_EnablePDUGroup_CIOM_oSecuritySubnet_Rx_3a3c1dbc_BswMReportFailToDemRef.GetFaultDetectionCounter
        OpEventGetFaultDetectionCounter_GetFaultDetectionCounter_EvtInfo_AutoCreatedDemEvent_CC_DisablePDUGroup_CIOM_oFMSNet_Tx_42407b34: start-on-event=DemSatellite_OsApplication_Untrusted_Core0InternalBehavior/GetFaultDetectionCounter, operation=EvtInfo_AutoCreatedDemEvent_CC_DisablePDUGroup_CIOM_oFMSNet_Tx_0x31_BC_38fc8c7d_BswMReportFailToDemRef.GetFaultDetectionCounter
        OpEventGetFaultDetectionCounter_GetFaultDetectionCounter_EvtInfo_AutoCreatedDemEvent_CC_EnablePDUGroup_CIOM_oFMSNet_Tx_82391205: start-on-event=DemSatellite_OsApplication_Untrusted_Core0InternalBehavior/GetFaultDetectionCounter, operation=EvtInfo_AutoCreatedDemEvent_CC_EnablePDUGroup_CIOM_oFMSNet_Tx_0x31_BC_38fc8c7d_BswMReportFailToDemRef.GetFaultDetectionCounter
        OpEventGetFaultDetectionCounter_GetFaultDetectionCounter_EvtInfo_AutoCreatedDemEvent_CC_DisablePDUGroup_CIOM_oSecurityS_a3fd6458: start-on-event=DemSatellite_OsApplication_Untrusted_Core0InternalBehavior/GetFaultDetectionCounter, operation=EvtInfo_AutoCreatedDemEvent_CC_DisablePDUGroup_CIOM_oSecuritySubnet_Tx_6c66ba3a_BswMReportFailToDemRef.GetFaultDetectionCounter
        OpEventGetFaultDetectionCounter_GetFaultDetectionCounter_EvtInfo_AutoCreatedDemEvent_CC_EnablePDUGroup_CIOM_oSecuritySu_63840d69: start-on-event=DemSatellite_OsApplication_Untrusted_Core0InternalBehavior/GetFaultDetectionCounter, operation=EvtInfo_AutoCreatedDemEvent_CC_EnablePDUGroup_CIOM_oSecuritySubnet_Tx_6c66ba3a_BswMReportFailToDemRef.GetFaultDetectionCounter
        OpEventGetFaultDetectionCounter_GetFaultDetectionCounter_EvtInfo_AutoCreatedDemEvent_CC_DisablePDUGroup_CIOM_oLIN00_Tx_4e9ef89e: start-on-event=DemSatellite_OsApplication_Untrusted_Core0InternalBehavior/GetFaultDetectionCounter, operation=EvtInfo_AutoCreatedDemEvent_CC_DisablePDUGroup_CIOM_oLIN00_Tx_8b42b82c_BswMReportFailToDemRef.GetFaultDetectionCounter
        OpEventGetFaultDetectionCounter_GetFaultDetectionCounter_EvtInfo_AutoCreatedDemEvent_CC_EnablePDUGroup_CIOM_oLIN00_Rx_d_0532d203: start-on-event=DemSatellite_OsApplication_Untrusted_Core0InternalBehavior/GetFaultDetectionCounter, operation=EvtInfo_AutoCreatedDemEvent_CC_EnablePDUGroup_CIOM_oLIN00_Rx_dd181faa_BswMReportFailToDemRef.GetFaultDetectionCounter
        OpEventGetFaultDetectionCounter_GetFaultDetectionCounter_EvtInfo_AutoCreatedDemEvent_ESH_Action_ComMCheckPendingRequest_73db11d9: start-on-event=DemSatellite_OsApplication_Untrusted_Core0InternalBehavior/GetFaultDetectionCounter, operation=EvtInfo_AutoCreatedDemEvent_ESH_Action_ComMCheckPendingRequests_BswMReportFailToDemRef.GetFaultDetectionCounter
        OpEventGetFaultDetectionCounter_GetFaultDetectionCounter_EvtInfo_AutoCreatedDemEvent_CC_DisableDM_CIOM_oBackbone1J1939_aff7090c: start-on-event=DemSatellite_OsApplication_Untrusted_Core0InternalBehavior/GetFaultDetectionCounter, operation=EvtInfo_AutoCreatedDemEvent_CC_DisableDM_CIOM_oBackbone1J1939_Rx_BC_405bc776_BswMReportFailToDemRef.GetFaultDetectionCounter
        OpEventGetFaultDetectionCounter_GetFaultDetectionCounter_EvtInfo_AutoCreatedDemEvent_CC_DisablePDUGroup_CIOM_oLIN00_Rx_cf6a8a3d: start-on-event=DemSatellite_OsApplication_Untrusted_Core0InternalBehavior/GetFaultDetectionCounter, operation=EvtInfo_AutoCreatedDemEvent_CC_DisablePDUGroup_CIOM_oLIN00_Rx_dd181faa_BswMReportFailToDemRef.GetFaultDetectionCounter
        OpEventGetFaultDetectionCounter_GetFaultDetectionCounter_EvtInfo_AutoCreatedDemEvent_CC_EnablePDUGroup_CIOM_oLIN00_Tx_8_84c6a0a0: start-on-event=DemSatellite_OsApplication_Untrusted_Core0InternalBehavior/GetFaultDetectionCounter, operation=EvtInfo_AutoCreatedDemEvent_CC_EnablePDUGroup_CIOM_oLIN00_Tx_8b42b82c_BswMReportFailToDemRef.GetFaultDetectionCounter
        OpEventGetFaultDetectionCounter_GetFaultDetectionCounter_EvtInfo_AutoCreatedDemEvent_ESH_Action_EnterExclusiveArea_BswM_74f097d0: start-on-event=DemSatellite_OsApplication_Untrusted_Core0InternalBehavior/GetFaultDetectionCounter, operation=EvtInfo_AutoCreatedDemEvent_ESH_Action_EnterExclusiveArea_BswMReportFailToDemRef.GetFaultDetectionCounter
        OpEventGetFaultDetectionCounter_GetFaultDetectionCounter_EvtInfo_AutoCreatedDemEvent_ESH_RunToPostRunNested_BswMReportF_b10deb49: start-on-event=DemSatellite_OsApplication_Untrusted_Core0InternalBehavior/GetFaultDetectionCounter, operation=EvtInfo_AutoCreatedDemEvent_ESH_RunToPostRunNested_BswMReportFailToDemRef.GetFaultDetectionCounter
        OpEventGetFaultDetectionCounter_GetFaultDetectionCounter_EvtInfo_AutoCreatedDemEvent_CC_EnableDM_CIOM_oBackbone1J1939_R_0b65df00: start-on-event=DemSatellite_OsApplication_Untrusted_Core0InternalBehavior/GetFaultDetectionCounter, operation=EvtInfo_AutoCreatedDemEvent_CC_EnableDM_CIOM_oBackbone1J1939_Rx_BC_405bc776_BswMReportFailToDemRef.GetFaultDetectionCounter
        OpEventGetFaultDetectionCounter_GetFaultDetectionCounter_EvtInfo_AutoCreatedDemEvent_CC_DisablePDUGroup_CIOM_oBackbone1_c1e9fe0d: start-on-event=DemSatellite_OsApplication_Untrusted_Core0InternalBehavior/GetFaultDetectionCounter, operation=EvtInfo_AutoCreatedDemEvent_CC_DisablePDUGroup_CIOM_oBackbone1J1939_Tx_0x31_BC_3782f500_BswMReportFailToDemRef.GetFaultDetectionCounter
        OpEventGetFaultDetectionCounter_GetFaultDetectionCounter_EvtInfo_AutoCreatedDemEvent_CC_J1939RmStateSwitch_CN_FMSNet_fc_bd7eb0e5: start-on-event=DemSatellite_OsApplication_Untrusted_Core0InternalBehavior/GetFaultDetectionCounter, operation=EvtInfo_AutoCreatedDemEvent_CC_J1939RmStateSwitch_CN_FMSNet_fce1aae5_CIOM_3a3d59b1_J1939RM_STATE_OFFLINE_BswMReportFailToDemRef.GetFaultDetectionCounter
        OpEventGetFaultDetectionCounter_GetFaultDetectionCounter_EvtInfo_AutoCreatedDemEvent_CC_EnablePDUGroup_CIOM_oBackbone1J_5398100a: start-on-event=DemSatellite_OsApplication_Untrusted_Core0InternalBehavior/GetFaultDetectionCounter, operation=EvtInfo_AutoCreatedDemEvent_CC_EnablePDUGroup_CIOM_oBackbone1J1939_Tx_0x31_BC_3782f500_BswMReportFailToDemRef.GetFaultDetectionCounter
        OpEventGetFaultDetectionCounter_GetFaultDetectionCounter_EvtInfo_AutoCreatedDemEvent_CC_J1939RmStateSwitch_CN_FMSNet_fc_19045929: start-on-event=DemSatellite_OsApplication_Untrusted_Core0InternalBehavior/GetFaultDetectionCounter, operation=EvtInfo_AutoCreatedDemEvent_CC_J1939RmStateSwitch_CN_FMSNet_fce1aae5_CIOM_3a3d59b1_J1939RM_STATE_ONLINE_BswMReportFailToDemRef.GetFaultDetectionCounter
        OpEventGetFaultDetectionCounter_GetFaultDetectionCounter_EvtInfo_AutoCreatedDemEvent_ESH_Action_CancelNvMWriteAll_BswMR_0e6d7020: start-on-event=DemSatellite_OsApplication_Untrusted_Core0InternalBehavior/GetFaultDetectionCounter, operation=EvtInfo_AutoCreatedDemEvent_ESH_Action_CancelNvMWriteAll_BswMReportFailToDemRef.GetFaultDetectionCounter
        OpEventGetFaultDetectionCounter_GetFaultDetectionCounter_EvtInfo_AutoCreatedDemEvent_ESH_Action_CancelWriteAllTimer_Sta_6bc1c150: start-on-event=DemSatellite_OsApplication_Untrusted_Core0InternalBehavior/GetFaultDetectionCounter, operation=EvtInfo_AutoCreatedDemEvent_ESH_Action_CancelWriteAllTimer_Start_BswMReportFailToDemRef.GetFaultDetectionCounter
        OpEventGetFaultDetectionCounter_GetFaultDetectionCounter_EvtInfo_AutoCreatedDemEvent_ESH_Action_CancelWriteAllTimer_Sto_ed260600: start-on-event=DemSatellite_OsApplication_Untrusted_Core0InternalBehavior/GetFaultDetectionCounter, operation=EvtInfo_AutoCreatedDemEvent_ESH_Action_CancelWriteAllTimer_Stop_BswMReportFailToDemRef.GetFaultDetectionCounter
        OpEventGetFaultDetectionCounter_GetFaultDetectionCounter_EvtInfo_AutoCreatedDemEvent_ESH_Action_ComMAllow_CN_Backbone1J_9547e417: start-on-event=DemSatellite_OsApplication_Untrusted_Core0InternalBehavior/GetFaultDetectionCounter, operation=EvtInfo_AutoCreatedDemEvent_ESH_Action_ComMAllow_CN_Backbone1J1939_0b1f4bae_BswMReportFailToDemRef.GetFaultDetectionCounter
        OpEventGetFaultDetectionCounter_GetFaultDetectionCounter_EvtInfo_AutoCreatedDemEvent_ESH_Action_ComMAllow_CN_Backbone1J_8fc064ee: start-on-event=DemSatellite_OsApplication_Untrusted_Core0InternalBehavior/GetFaultDetectionCounter, operation=EvtInfo_AutoCreatedDemEvent_ESH_Action_ComMAllow_CN_Backbone1J1939_0b1f4bae_BswMReportFailToDemRef_1.GetFaultDetectionCounter
        OpEventGetFaultDetectionCounter_GetFaultDetectionCounter_EvtInfo_AutoCreatedDemEvent_ESH_Action_ComMAllow_CN_Backbone2_85a6f509: start-on-event=DemSatellite_OsApplication_Untrusted_Core0InternalBehavior/GetFaultDetectionCounter, operation=EvtInfo_AutoCreatedDemEvent_ESH_Action_ComMAllow_CN_Backbone2_78967e2c_BswMReportFailToDemRef.GetFaultDetectionCounter
        OpEventGetFaultDetectionCounter_GetFaultDetectionCounter_EvtInfo_AutoCreatedDemEvent_ESH_Action_ComMAllow_CN_Backbone2_31316b22: start-on-event=DemSatellite_OsApplication_Untrusted_Core0InternalBehavior/GetFaultDetectionCounter, operation=EvtInfo_AutoCreatedDemEvent_ESH_Action_ComMAllow_CN_Backbone2_78967e2c_BswMReportFailToDemRef_1.GetFaultDetectionCounter
        OpEventGetFaultDetectionCounter_GetFaultDetectionCounter_EvtInfo_AutoCreatedDemEvent_ESH_Action_ComMAllow_CN_CabSubnet_5864c37f: start-on-event=DemSatellite_OsApplication_Untrusted_Core0InternalBehavior/GetFaultDetectionCounter, operation=EvtInfo_AutoCreatedDemEvent_ESH_Action_ComMAllow_CN_CabSubnet_9ea693f1_BswMReportFailToDemRef.GetFaultDetectionCounter
        OpEventGetFaultDetectionCounter_GetFaultDetectionCounter_EvtInfo_AutoCreatedDemEvent_ESH_Action_ComMAllow_CN_CabSubnet_87eefd09: start-on-event=DemSatellite_OsApplication_Untrusted_Core0InternalBehavior/GetFaultDetectionCounter, operation=EvtInfo_AutoCreatedDemEvent_ESH_Action_ComMAllow_CN_CabSubnet_9ea693f1_BswMReportFailToDemRef_1.GetFaultDetectionCounter
        OpEventGetFaultDetectionCounter_GetFaultDetectionCounter_EvtInfo_AutoCreatedDemEvent_ESH_Action_ComMAllow_CN_FMSNet_fce_a09cf95c: start-on-event=DemSatellite_OsApplication_Untrusted_Core0InternalBehavior/GetFaultDetectionCounter, operation=EvtInfo_AutoCreatedDemEvent_ESH_Action_ComMAllow_CN_FMSNet_fce1aae5_BswMReportFailToDemRef.GetFaultDetectionCounter
        OpEventGetFaultDetectionCounter_GetFaultDetectionCounter_EvtInfo_AutoCreatedDemEvent_ESH_Action_ComMAllow_CN_FMSNet_fce_ff4bab22: start-on-event=DemSatellite_OsApplication_Untrusted_Core0InternalBehavior/GetFaultDetectionCounter, operation=EvtInfo_AutoCreatedDemEvent_ESH_Action_ComMAllow_CN_FMSNet_fce1aae5_BswMReportFailToDemRef_1.GetFaultDetectionCounter
        OpEventGetFaultDetectionCounter_GetFaultDetectionCounter_EvtInfo_AutoCreatedDemEvent_ESH_Action_ComMAllow_CN_LIN00_2cd9_a76c7b7a: start-on-event=DemSatellite_OsApplication_Untrusted_Core0InternalBehavior/GetFaultDetectionCounter, operation=EvtInfo_AutoCreatedDemEvent_ESH_Action_ComMAllow_CN_LIN00_2cd9a7df_BswMReportFailToDemRef.GetFaultDetectionCounter
        OpEventGetFaultDetectionCounter_GetFaultDetectionCounter_EvtInfo_AutoCreatedDemEvent_ESH_Action_ComMAllow_CN_LIN00_2cd9_3f23cdfa: start-on-event=DemSatellite_OsApplication_Untrusted_Core0InternalBehavior/GetFaultDetectionCounter, operation=EvtInfo_AutoCreatedDemEvent_ESH_Action_ComMAllow_CN_LIN00_2cd9a7df_BswMReportFailToDemRef_1.GetFaultDetectionCounter
        OpEventGetFaultDetectionCounter_GetFaultDetectionCounter_EvtInfo_AutoCreatedDemEvent_ESH_Action_ComMAllow_CN_LIN01_5bde_9fdcfca6: start-on-event=DemSatellite_OsApplication_Untrusted_Core0InternalBehavior/GetFaultDetectionCounter, operation=EvtInfo_AutoCreatedDemEvent_ESH_Action_ComMAllow_CN_LIN01_5bde9749_BswMReportFailToDemRef.GetFaultDetectionCounter
        OpEventGetFaultDetectionCounter_GetFaultDetectionCounter_EvtInfo_AutoCreatedDemEvent_ESH_Action_ComMAllow_CN_LIN01_5bde_617269da: start-on-event=DemSatellite_OsApplication_Untrusted_Core0InternalBehavior/GetFaultDetectionCounter, operation=EvtInfo_AutoCreatedDemEvent_ESH_Action_ComMAllow_CN_LIN01_5bde9749_BswMReportFailToDemRef_1.GetFaultDetectionCounter
        OpEventGetFaultDetectionCounter_GetFaultDetectionCounter_EvtInfo_AutoCreatedDemEvent_ESH_Action_ComMAllow_CN_LIN02_c2d7_62a100c2: start-on-event=DemSatellite_OsApplication_Untrusted_Core0InternalBehavior/GetFaultDetectionCounter, operation=EvtInfo_AutoCreatedDemEvent_ESH_Action_ComMAllow_CN_LIN02_c2d7c6f3_BswMReportFailToDemRef.GetFaultDetectionCounter
        OpEventGetFaultDetectionCounter_GetFaultDetectionCounter_EvtInfo_AutoCreatedDemEvent_ESH_Action_ComMAllow_CN_LIN02_c2d7_d4e88433: start-on-event=DemSatellite_OsApplication_Untrusted_Core0InternalBehavior/GetFaultDetectionCounter, operation=EvtInfo_AutoCreatedDemEvent_ESH_Action_ComMAllow_CN_LIN02_c2d7c6f3_BswMReportFailToDemRef_1.GetFaultDetectionCounter
        OpEventGetFaultDetectionCounter_GetFaultDetectionCounter_EvtInfo_AutoCreatedDemEvent_ESH_Action_ComMAllow_CN_LIN03_b5d0_b755bc48: start-on-event=DemSatellite_OsApplication_Untrusted_Core0InternalBehavior/GetFaultDetectionCounter, operation=EvtInfo_AutoCreatedDemEvent_ESH_Action_ComMAllow_CN_LIN03_b5d0f665_BswMReportFailToDemRef.GetFaultDetectionCounter
        OpEventGetFaultDetectionCounter_GetFaultDetectionCounter_EvtInfo_AutoCreatedDemEvent_ESH_Action_ComMAllow_CN_LIN03_b5d0_d753dea1: start-on-event=DemSatellite_OsApplication_Untrusted_Core0InternalBehavior/GetFaultDetectionCounter, operation=EvtInfo_AutoCreatedDemEvent_ESH_Action_ComMAllow_CN_LIN03_b5d0f665_BswMReportFailToDemRef_1.GetFaultDetectionCounter
        OpEventGetFaultDetectionCounter_GetFaultDetectionCounter_EvtInfo_AutoCreatedDemEvent_ESH_Action_ComMAllow_CN_LIN04_2bb4_481b439e: start-on-event=DemSatellite_OsApplication_Untrusted_Core0InternalBehavior/GetFaultDetectionCounter, operation=EvtInfo_AutoCreatedDemEvent_ESH_Action_ComMAllow_CN_LIN04_2bb463c6_BswMReportFailToDemRef.GetFaultDetectionCounter
        OpEventGetFaultDetectionCounter_GetFaultDetectionCounter_EvtInfo_AutoCreatedDemEvent_ESH_Action_ComMAllow_CN_LIN04_2bb4_2d33acfb: start-on-event=DemSatellite_OsApplication_Untrusted_Core0InternalBehavior/GetFaultDetectionCounter, operation=EvtInfo_AutoCreatedDemEvent_ESH_Action_ComMAllow_CN_LIN04_2bb463c6_BswMReportFailToDemRef_1.GetFaultDetectionCounter
        OpEventGetFaultDetectionCounter_GetFaultDetectionCounter_EvtInfo_AutoCreatedDemEvent_ESH_Action_ComMAllow_CN_SecuritySu_3bcd65d1: start-on-event=DemSatellite_OsApplication_Untrusted_Core0InternalBehavior/GetFaultDetectionCounter, operation=EvtInfo_AutoCreatedDemEvent_ESH_Action_ComMAllow_CN_SecuritySubnet_e7a0ee54_BswMReportFailToDemRef.GetFaultDetectionCounter
        OpEventGetFaultDetectionCounter_GetFaultDetectionCounter_EvtInfo_AutoCreatedDemEvent_ESH_Action_ComMAllow_CN_SecuritySu_88df091a: start-on-event=DemSatellite_OsApplication_Untrusted_Core0InternalBehavior/GetFaultDetectionCounter, operation=EvtInfo_AutoCreatedDemEvent_ESH_Action_ComMAllow_CN_SecuritySubnet_e7a0ee54_BswMReportFailToDemRef_1.GetFaultDetectionCounter
        OpEventGetFaultDetectionCounter_GetFaultDetectionCounter_EvtInfo_AutoCreatedDemEvent_ESH_Action_ComMCheckPendingRequest_176e7e21: start-on-event=DemSatellite_OsApplication_Untrusted_Core0InternalBehavior/GetFaultDetectionCounter, operation=EvtInfo_AutoCreatedDemEvent_ESH_Action_ComMCheckPendingRequests_BswMReportFailToDemRef_1.GetFaultDetectionCounter
        OpEventGetFaultDetectionCounter_GetFaultDetectionCounter_EvtInfo_AutoCreatedDemEvent_ESH_Action_ComMCheckPendingRequest_8e672f9b: start-on-event=DemSatellite_OsApplication_Untrusted_Core0InternalBehavior/GetFaultDetectionCounter, operation=EvtInfo_AutoCreatedDemEvent_ESH_Action_ComMCheckPendingRequests_BswMReportFailToDemRef_2.GetFaultDetectionCounter
        OpEventGetFaultDetectionCounter_GetFaultDetectionCounter_EvtInfo_AutoCreatedDemEvent_ESH_Action_ComMDisallow_CN_Backbon_b1fc600f: start-on-event=DemSatellite_OsApplication_Untrusted_Core0InternalBehavior/GetFaultDetectionCounter, operation=EvtInfo_AutoCreatedDemEvent_ESH_Action_ComMDisallow_CN_Backbone1J1939_0b1f4bae_BswMReportFailToDemRef.GetFaultDetectionCounter
        OpEventGetFaultDetectionCounter_GetFaultDetectionCounter_EvtInfo_AutoCreatedDemEvent_ESH_Action_ComMDisallow_CN_Backbon_899fcf75: start-on-event=DemSatellite_OsApplication_Untrusted_Core0InternalBehavior/GetFaultDetectionCounter, operation=EvtInfo_AutoCreatedDemEvent_ESH_Action_ComMDisallow_CN_Backbone2_78967e2c_BswMReportFailToDemRef.GetFaultDetectionCounter
        OpEventGetFaultDetectionCounter_GetFaultDetectionCounter_EvtInfo_AutoCreatedDemEvent_ESH_Action_ComMDisallow_CN_CabSubn_545df903: start-on-event=DemSatellite_OsApplication_Untrusted_Core0InternalBehavior/GetFaultDetectionCounter, operation=EvtInfo_AutoCreatedDemEvent_ESH_Action_ComMDisallow_CN_CabSubnet_9ea693f1_BswMReportFailToDemRef.GetFaultDetectionCounter
        OpEventGetFaultDetectionCounter_GetFaultDetectionCounter_EvtInfo_AutoCreatedDemEvent_ESH_Action_ComMDisallow_CN_FMSNet_7e855630: start-on-event=DemSatellite_OsApplication_Untrusted_Core0InternalBehavior/GetFaultDetectionCounter, operation=EvtInfo_AutoCreatedDemEvent_ESH_Action_ComMDisallow_CN_FMSNet_fce1aae5_BswMReportFailToDemRef.GetFaultDetectionCounter
        OpEventGetFaultDetectionCounter_GetFaultDetectionCounter_EvtInfo_AutoCreatedDemEvent_ESH_Action_ComMDisallow_CN_LIN00_2_055dd297: start-on-event=DemSatellite_OsApplication_Untrusted_Core0InternalBehavior/GetFaultDetectionCounter, operation=EvtInfo_AutoCreatedDemEvent_ESH_Action_ComMDisallow_CN_LIN00_2cd9a7df_BswMReportFailToDemRef.GetFaultDetectionCounter
        OpEventGetFaultDetectionCounter_GetFaultDetectionCounter_EvtInfo_AutoCreatedDemEvent_ESH_Action_ComMDisallow_CN_LIN01_5_3ded554b: start-on-event=DemSatellite_OsApplication_Untrusted_Core0InternalBehavior/GetFaultDetectionCounter, operation=EvtInfo_AutoCreatedDemEvent_ESH_Action_ComMDisallow_CN_LIN01_5bde9749_BswMReportFailToDemRef.GetFaultDetectionCounter
        OpEventGetFaultDetectionCounter_GetFaultDetectionCounter_EvtInfo_AutoCreatedDemEvent_ESH_Action_ComMDisallow_CN_LIN02_c_c090a92f: start-on-event=DemSatellite_OsApplication_Untrusted_Core0InternalBehavior/GetFaultDetectionCounter, operation=EvtInfo_AutoCreatedDemEvent_ESH_Action_ComMDisallow_CN_LIN02_c2d7c6f3_BswMReportFailToDemRef.GetFaultDetectionCounter
        OpEventGetFaultDetectionCounter_GetFaultDetectionCounter_EvtInfo_AutoCreatedDemEvent_ESH_Action_ComMDisallow_CN_LIN03_b_156415a5: start-on-event=DemSatellite_OsApplication_Untrusted_Core0InternalBehavior/GetFaultDetectionCounter, operation=EvtInfo_AutoCreatedDemEvent_ESH_Action_ComMDisallow_CN_LIN03_b5d0f665_BswMReportFailToDemRef.GetFaultDetectionCounter
        OpEventGetFaultDetectionCounter_GetFaultDetectionCounter_EvtInfo_AutoCreatedDemEvent_ESH_Action_ComMDisallow_CN_LIN04_2_ea2aea73: start-on-event=DemSatellite_OsApplication_Untrusted_Core0InternalBehavior/GetFaultDetectionCounter, operation=EvtInfo_AutoCreatedDemEvent_ESH_Action_ComMDisallow_CN_LIN04_2bb463c6_BswMReportFailToDemRef.GetFaultDetectionCounter
        OpEventGetFaultDetectionCounter_GetFaultDetectionCounter_EvtInfo_AutoCreatedDemEvent_ESH_Action_ComMDisallow_CN_Securit_1f76e1c9: start-on-event=DemSatellite_OsApplication_Untrusted_Core0InternalBehavior/GetFaultDetectionCounter, operation=EvtInfo_AutoCreatedDemEvent_ESH_Action_ComMDisallow_CN_SecuritySubnet_e7a0ee54_BswMReportFailToDemRef.GetFaultDetectionCounter
        OpEventGetFaultDetectionCounter_GetFaultDetectionCounter_EvtInfo_AutoCreatedDemEvent_ESH_Action_DemInit_BswMReportFailToDemRef: start-on-event=DemSatellite_OsApplication_Untrusted_Core0InternalBehavior/GetFaultDetectionCounter, operation=EvtInfo_AutoCreatedDemEvent_ESH_Action_DemInit_BswMReportFailToDemRef.GetFaultDetectionCounter
        OpEventGetFaultDetectionCounter_GetFaultDetectionCounter_EvtInfo_AutoCreatedDemEvent_ESH_Action_DemInitialized_BswMRepo_2fb98b48: start-on-event=DemSatellite_OsApplication_Untrusted_Core0InternalBehavior/GetFaultDetectionCounter, operation=EvtInfo_AutoCreatedDemEvent_ESH_Action_DemInitialized_BswMReportFailToDemRef.GetFaultDetectionCounter
        OpEventGetFaultDetectionCounter_GetFaultDetectionCounter_EvtInfo_AutoCreatedDemEvent_ESH_Action_DemNotInitialized_BswMR_7182809d: start-on-event=DemSatellite_OsApplication_Untrusted_Core0InternalBehavior/GetFaultDetectionCounter, operation=EvtInfo_AutoCreatedDemEvent_ESH_Action_DemNotInitialized_BswMReportFailToDemRef.GetFaultDetectionCounter
        OpEventGetFaultDetectionCounter_GetFaultDetectionCounter_EvtInfo_AutoCreatedDemEvent_ESH_Action_DemShutdown_BswMReportF_423301fa: start-on-event=DemSatellite_OsApplication_Untrusted_Core0InternalBehavior/GetFaultDetectionCounter, operation=EvtInfo_AutoCreatedDemEvent_ESH_Action_DemShutdown_BswMReportFailToDemRef.GetFaultDetectionCounter
        OpEventGetFaultDetectionCounter_GetFaultDetectionCounter_EvtInfo_AutoCreatedDemEvent_ESH_Action_ESH_PostRun_BswMReportF_a7953f60: start-on-event=DemSatellite_OsApplication_Untrusted_Core0InternalBehavior/GetFaultDetectionCounter, operation=EvtInfo_AutoCreatedDemEvent_ESH_Action_ESH_PostRun_BswMReportFailToDemRef.GetFaultDetectionCounter
        OpEventGetFaultDetectionCounter_GetFaultDetectionCounter_EvtInfo_AutoCreatedDemEvent_ESH_Action_ESH_PrepShutdown_BswMRe_93d4b0f9: start-on-event=DemSatellite_OsApplication_Untrusted_Core0InternalBehavior/GetFaultDetectionCounter, operation=EvtInfo_AutoCreatedDemEvent_ESH_Action_ESH_PrepShutdown_BswMReportFailToDemRef.GetFaultDetectionCounter
        OpEventGetFaultDetectionCounter_GetFaultDetectionCounter_EvtInfo_AutoCreatedDemEvent_ESH_Action_ESH_PrepShutdown_BswMRe_233b29f2: start-on-event=DemSatellite_OsApplication_Untrusted_Core0InternalBehavior/GetFaultDetectionCounter, operation=EvtInfo_AutoCreatedDemEvent_ESH_Action_ESH_PrepShutdown_BswMReportFailToDemRef_1.GetFaultDetectionCounter
        OpEventGetFaultDetectionCounter_GetFaultDetectionCounter_EvtInfo_AutoCreatedDemEvent_ESH_Action_ESH_Run_BswMReportFailToDemRef: start-on-event=DemSatellite_OsApplication_Untrusted_Core0InternalBehavior/GetFaultDetectionCounter, operation=EvtInfo_AutoCreatedDemEvent_ESH_Action_ESH_Run_BswMReportFailToDemRef.GetFaultDetectionCounter
        OpEventGetFaultDetectionCounter_GetFaultDetectionCounter_EvtInfo_AutoCreatedDemEvent_ESH_Action_ESH_Run_BswMReportFailToDemRef_1: start-on-event=DemSatellite_OsApplication_Untrusted_Core0InternalBehavior/GetFaultDetectionCounter, operation=EvtInfo_AutoCreatedDemEvent_ESH_Action_ESH_Run_BswMReportFailToDemRef_1.GetFaultDetectionCounter
        OpEventGetFaultDetectionCounter_GetFaultDetectionCounter_EvtInfo_AutoCreatedDemEvent_ESH_Action_ESH_WaitForNvm_BswMRepo_a1e4e554: start-on-event=DemSatellite_OsApplication_Untrusted_Core0InternalBehavior/GetFaultDetectionCounter, operation=EvtInfo_AutoCreatedDemEvent_ESH_Action_ESH_WaitForNvm_BswMReportFailToDemRef.GetFaultDetectionCounter
        OpEventGetFaultDetectionCounter_GetFaultDetectionCounter_EvtInfo_AutoCreatedDemEvent_ESH_Action_ESH_Wakeup_BswMReportFa_7a88a00e: start-on-event=DemSatellite_OsApplication_Untrusted_Core0InternalBehavior/GetFaultDetectionCounter, operation=EvtInfo_AutoCreatedDemEvent_ESH_Action_ESH_Wakeup_BswMReportFailToDemRef.GetFaultDetectionCounter
        OpEventGetFaultDetectionCounter_GetFaultDetectionCounter_EvtInfo_AutoCreatedDemEvent_ESH_Action_ESH_Wakeup_BswMReportFa_6571a7b0: start-on-event=DemSatellite_OsApplication_Untrusted_Core0InternalBehavior/GetFaultDetectionCounter, operation=EvtInfo_AutoCreatedDemEvent_ESH_Action_ESH_Wakeup_BswMReportFailToDemRef_1.GetFaultDetectionCounter
        OpEventGetFaultDetectionCounter_GetFaultDetectionCounter_EvtInfo_AutoCreatedDemEvent_ESH_Action_EcuMClearValidatedWakeu_0c7aa702: start-on-event=DemSatellite_OsApplication_Untrusted_Core0InternalBehavior/GetFaultDetectionCounter, operation=EvtInfo_AutoCreatedDemEvent_ESH_Action_EcuMClearValidatedWakeupEvents_BswMReportFailToDemRef.GetFaultDetectionCounter
        OpEventGetFaultDetectionCounter_GetFaultDetectionCounter_EvtInfo_AutoCreatedDemEvent_ESH_Action_EcuMGoToSelectedShutdow_ad3017d4: start-on-event=DemSatellite_OsApplication_Untrusted_Core0InternalBehavior/GetFaultDetectionCounter, operation=EvtInfo_AutoCreatedDemEvent_ESH_Action_EcuMGoToSelectedShutdownTarget_BswMReportFailToDemRef.GetFaultDetectionCounter
        OpEventGetFaultDetectionCounter_GetFaultDetectionCounter_EvtInfo_AutoCreatedDemEvent_ESH_Action_EnterExclusiveArea_BswM_c277e456: start-on-event=DemSatellite_OsApplication_Untrusted_Core0InternalBehavior/GetFaultDetectionCounter, operation=EvtInfo_AutoCreatedDemEvent_ESH_Action_EnterExclusiveArea_BswMReportFailToDemRef_1.GetFaultDetectionCounter
        OpEventGetFaultDetectionCounter_GetFaultDetectionCounter_EvtInfo_AutoCreatedDemEvent_ESH_Action_ExitExclusiveArea_BswMR_f6e358a9: start-on-event=DemSatellite_OsApplication_Untrusted_Core0InternalBehavior/GetFaultDetectionCounter, operation=EvtInfo_AutoCreatedDemEvent_ESH_Action_ExitExclusiveArea_BswMReportFailToDemRef.GetFaultDetectionCounter
        OpEventGetFaultDetectionCounter_GetFaultDetectionCounter_EvtInfo_AutoCreatedDemEvent_ESH_Action_NvMWriteAll_BswMReportF_2be0bb4b: start-on-event=DemSatellite_OsApplication_Untrusted_Core0InternalBehavior/GetFaultDetectionCounter, operation=EvtInfo_AutoCreatedDemEvent_ESH_Action_NvMWriteAll_BswMReportFailToDemRef.GetFaultDetectionCounter
        OpEventGetFaultDetectionCounter_GetFaultDetectionCounter_EvtInfo_AutoCreatedDemEvent_ESH_Action_OnEnterPostRun_BswMRepo_92e9a092: start-on-event=DemSatellite_OsApplication_Untrusted_Core0InternalBehavior/GetFaultDetectionCounter, operation=EvtInfo_AutoCreatedDemEvent_ESH_Action_OnEnterPostRun_BswMReportFailToDemRef.GetFaultDetectionCounter
        OpEventGetFaultDetectionCounter_GetFaultDetectionCounter_EvtInfo_AutoCreatedDemEvent_ESH_Action_OnEnterPrepShutdown_Bsw_bbd911b4: start-on-event=DemSatellite_OsApplication_Untrusted_Core0InternalBehavior/GetFaultDetectionCounter, operation=EvtInfo_AutoCreatedDemEvent_ESH_Action_OnEnterPrepShutdown_BswMReportFailToDemRef.GetFaultDetectionCounter
        OpEventGetFaultDetectionCounter_GetFaultDetectionCounter_EvtInfo_AutoCreatedDemEvent_ESH_Action_OnEnterPrepShutdown_Bsw_c73da3c9: start-on-event=DemSatellite_OsApplication_Untrusted_Core0InternalBehavior/GetFaultDetectionCounter, operation=EvtInfo_AutoCreatedDemEvent_ESH_Action_OnEnterPrepShutdown_BswMReportFailToDemRef_1.GetFaultDetectionCounter
        OpEventGetFaultDetectionCounter_GetFaultDetectionCounter_EvtInfo_AutoCreatedDemEvent_ESH_Action_OnEnterRun_BswMReportFa_b76e563c: start-on-event=DemSatellite_OsApplication_Untrusted_Core0InternalBehavior/GetFaultDetectionCounter, operation=EvtInfo_AutoCreatedDemEvent_ESH_Action_OnEnterRun_BswMReportFailToDemRef.GetFaultDetectionCounter
        OpEventGetFaultDetectionCounter_GetFaultDetectionCounter_EvtInfo_AutoCreatedDemEvent_ESH_Action_OnEnterRun_BswMReportFa_dcdf690e: start-on-event=DemSatellite_OsApplication_Untrusted_Core0InternalBehavior/GetFaultDetectionCounter, operation=EvtInfo_AutoCreatedDemEvent_ESH_Action_OnEnterRun_BswMReportFailToDemRef_1.GetFaultDetectionCounter
        OpEventGetFaultDetectionCounter_GetFaultDetectionCounter_EvtInfo_AutoCreatedDemEvent_ESH_Action_OnEnterShutdown_BswMRep_a97a5cd4: start-on-event=DemSatellite_OsApplication_Untrusted_Core0InternalBehavior/GetFaultDetectionCounter, operation=EvtInfo_AutoCreatedDemEvent_ESH_Action_OnEnterShutdown_BswMReportFailToDemRef.GetFaultDetectionCounter
        OpEventGetFaultDetectionCounter_GetFaultDetectionCounter_EvtInfo_AutoCreatedDemEvent_ESH_Action_OnEnterWaitForNvm_BswMR_b8cee91d: start-on-event=DemSatellite_OsApplication_Untrusted_Core0InternalBehavior/GetFaultDetectionCounter, operation=EvtInfo_AutoCreatedDemEvent_ESH_Action_OnEnterWaitForNvm_BswMReportFailToDemRef.GetFaultDetectionCounter
        OpEventGetFaultDetectionCounter_GetFaultDetectionCounter_EvtInfo_AutoCreatedDemEvent_ESH_Action_OnEnterWakeup_BswMRepor_b3bfa826: start-on-event=DemSatellite_OsApplication_Untrusted_Core0InternalBehavior/GetFaultDetectionCounter, operation=EvtInfo_AutoCreatedDemEvent_ESH_Action_OnEnterWakeup_BswMReportFailToDemRef.GetFaultDetectionCounter
        OpEventGetFaultDetectionCounter_GetFaultDetectionCounter_EvtInfo_AutoCreatedDemEvent_ESH_Action_OnEnterWakeup_BswMRepor_36f7481f: start-on-event=DemSatellite_OsApplication_Untrusted_Core0InternalBehavior/GetFaultDetectionCounter, operation=EvtInfo_AutoCreatedDemEvent_ESH_Action_OnEnterWakeup_BswMReportFailToDemRef_1.GetFaultDetectionCounter
        OpEventGetFaultDetectionCounter_GetFaultDetectionCounter_EvtInfo_AutoCreatedDemEvent_ESH_Action_SelfRunRequestTimer_Sta_59bb0788: start-on-event=DemSatellite_OsApplication_Untrusted_Core0InternalBehavior/GetFaultDetectionCounter, operation=EvtInfo_AutoCreatedDemEvent_ESH_Action_SelfRunRequestTimer_Start_BswMReportFailToDemRef.GetFaultDetectionCounter
        OpEventGetFaultDetectionCounter_GetFaultDetectionCounter_EvtInfo_AutoCreatedDemEvent_ESH_Action_SelfRunRequestTimer_Sta_401a8d05: start-on-event=DemSatellite_OsApplication_Untrusted_Core0InternalBehavior/GetFaultDetectionCounter, operation=EvtInfo_AutoCreatedDemEvent_ESH_Action_SelfRunRequestTimer_Start_BswMReportFailToDemRef_1.GetFaultDetectionCounter
        OpEventGetFaultDetectionCounter_GetFaultDetectionCounter_EvtInfo_AutoCreatedDemEvent_ESH_Action_SwitchPostRun_BswMRepor_988c80b1: start-on-event=DemSatellite_OsApplication_Untrusted_Core0InternalBehavior/GetFaultDetectionCounter, operation=EvtInfo_AutoCreatedDemEvent_ESH_Action_SwitchPostRun_BswMReportFailToDemRef.GetFaultDetectionCounter
        OpEventGetFaultDetectionCounter_GetFaultDetectionCounter_EvtInfo_AutoCreatedDemEvent_ESH_Action_SwitchRun_BswMReportFailToDemRef: start-on-event=DemSatellite_OsApplication_Untrusted_Core0InternalBehavior/GetFaultDetectionCounter, operation=EvtInfo_AutoCreatedDemEvent_ESH_Action_SwitchRun_BswMReportFailToDemRef.GetFaultDetectionCounter
        OpEventGetFaultDetectionCounter_GetFaultDetectionCounter_EvtInfo_AutoCreatedDemEvent_ESH_Action_SwitchRun_BswMReportFai_e2022156: start-on-event=DemSatellite_OsApplication_Untrusted_Core0InternalBehavior/GetFaultDetectionCounter, operation=EvtInfo_AutoCreatedDemEvent_ESH_Action_SwitchRun_BswMReportFailToDemRef_1.GetFaultDetectionCounter
        OpEventGetFaultDetectionCounter_GetFaultDetectionCounter_EvtInfo_AutoCreatedDemEvent_ESH_Action_SwitchShutdown_BswMRepo_0b174886: start-on-event=DemSatellite_OsApplication_Untrusted_Core0InternalBehavior/GetFaultDetectionCounter, operation=EvtInfo_AutoCreatedDemEvent_ESH_Action_SwitchShutdown_BswMReportFailToDemRef.GetFaultDetectionCounter
        OpEventGetFaultDetectionCounter_GetFaultDetectionCounter_EvtInfo_AutoCreatedDemEvent_ESH_Action_SwitchShutdown_BswMRepo_38faae26: start-on-event=DemSatellite_OsApplication_Untrusted_Core0InternalBehavior/GetFaultDetectionCounter, operation=EvtInfo_AutoCreatedDemEvent_ESH_Action_SwitchShutdown_BswMReportFailToDemRef_1.GetFaultDetectionCounter
        OpEventGetFaultDetectionCounter_GetFaultDetectionCounter_EvtInfo_AutoCreatedDemEvent_ESH_Action_SwitchWakeup_BswMReport_d631aca8: start-on-event=DemSatellite_OsApplication_Untrusted_Core0InternalBehavior/GetFaultDetectionCounter, operation=EvtInfo_AutoCreatedDemEvent_ESH_Action_SwitchWakeup_BswMReportFailToDemRef.GetFaultDetectionCounter
        OpEventGetFaultDetectionCounter_GetFaultDetectionCounter_EvtInfo_AutoCreatedDemEvent_ESH_Action_SwitchWakeup_BswMReport_949a5c4d: start-on-event=DemSatellite_OsApplication_Untrusted_Core0InternalBehavior/GetFaultDetectionCounter, operation=EvtInfo_AutoCreatedDemEvent_ESH_Action_SwitchWakeup_BswMReportFailToDemRef_1.GetFaultDetectionCounter
        OpEventGetFaultDetectionCounter_GetFaultDetectionCounter_EvtInfo_AutoCreatedDemEvent_ESH_Action_WriteAllTimer_Start_Bsw_835511be: start-on-event=DemSatellite_OsApplication_Untrusted_Core0InternalBehavior/GetFaultDetectionCounter, operation=EvtInfo_AutoCreatedDemEvent_ESH_Action_WriteAllTimer_Start_BswMReportFailToDemRef.GetFaultDetectionCounter
        OpEventGetFaultDetectionCounter_GetFaultDetectionCounter_EvtInfo_AutoCreatedDemEvent_ESH_Action_WriteAllTimer_Stop_BswM_c122db47: start-on-event=DemSatellite_OsApplication_Untrusted_Core0InternalBehavior/GetFaultDetectionCounter, operation=EvtInfo_AutoCreatedDemEvent_ESH_Action_WriteAllTimer_Stop_BswMReportFailToDemRef.GetFaultDetectionCounter
        OpEventGetFaultDetectionCounter_GetFaultDetectionCounter_EvtInfo_AutoCreatedDemEvent_ESH_Action_WriteAllTimer_Stop_BswM_831d40e2: start-on-event=DemSatellite_OsApplication_Untrusted_Core0InternalBehavior/GetFaultDetectionCounter, operation=EvtInfo_AutoCreatedDemEvent_ESH_Action_WriteAllTimer_Stop_BswMReportFailToDemRef_1.GetFaultDetectionCounter
        OpEventGetFaultDetectionCounter_GetFaultDetectionCounter_EvtInfo_AutoCreatedDemEvent_ESH_DemInit_BswMReportFailToDemRef: start-on-event=DemSatellite_OsApplication_Untrusted_Core0InternalBehavior/GetFaultDetectionCounter, operation=EvtInfo_AutoCreatedDemEvent_ESH_DemInit_BswMReportFailToDemRef.GetFaultDetectionCounter
        OpEventGetFaultDetectionCounter_GetFaultDetectionCounter_EvtInfo_AutoCreatedDemEvent_ESH_PostRunNested_BswMReportFailToDemRef: start-on-event=DemSatellite_OsApplication_Untrusted_Core0InternalBehavior/GetFaultDetectionCounter, operation=EvtInfo_AutoCreatedDemEvent_ESH_PostRunNested_BswMReportFailToDemRef.GetFaultDetectionCounter
        OpEventGetFaultDetectionCounter_GetFaultDetectionCounter_EvtInfo_AutoCreatedDemEvent_ESH_PostRunToPrepNested_BswMReport_0a9564bb: start-on-event=DemSatellite_OsApplication_Untrusted_Core0InternalBehavior/GetFaultDetectionCounter, operation=EvtInfo_AutoCreatedDemEvent_ESH_PostRunToPrepNested_BswMReportFailToDemRef.GetFaultDetectionCounter
        OpEventGetFaultDetectionCounter_GetFaultDetectionCounter_EvtInfo_AutoCreatedDemEvent_ESH_Action_ExitExclusiveArea_BswMR_37517bdb: start-on-event=DemSatellite_OsApplication_Untrusted_Core0InternalBehavior/GetFaultDetectionCounter, operation=EvtInfo_AutoCreatedDemEvent_ESH_Action_ExitExclusiveArea_BswMReportFailToDemRef_1.GetFaultDetectionCounter
        OpEventGetFaultDetectionCounter_GetFaultDetectionCounter_EvtInfo_AutoCreatedDemEvent_INIT_Action_BrsHw_EnableHwAccess_B_4bf9b0a2: start-on-event=DemSatellite_OsApplication_Untrusted_Core0InternalBehavior/GetFaultDetectionCounter, operation=EvtInfo_AutoCreatedDemEvent_INIT_Action_BrsHw_EnableHwAccess_BswMReportFailToDemRef.GetFaultDetectionCounter
        OpEventGetFaultDetectionCounter_GetFaultDetectionCounter_EvtInfo_AutoCreatedDemEvent_INIT_Action_CanIf_Init_BswMReportF_50bfabef: start-on-event=DemSatellite_OsApplication_Untrusted_Core0InternalBehavior/GetFaultDetectionCounter, operation=EvtInfo_AutoCreatedDemEvent_INIT_Action_CanIf_Init_BswMReportFailToDemRef.GetFaultDetectionCounter
        OpEventGetFaultDetectionCounter_GetFaultDetectionCounter_EvtInfo_AutoCreatedDemEvent_INIT_Action_CanNm_Init_BswMReportF_ee49ac19: start-on-event=DemSatellite_OsApplication_Untrusted_Core0InternalBehavior/GetFaultDetectionCounter, operation=EvtInfo_AutoCreatedDemEvent_INIT_Action_CanNm_Init_BswMReportFailToDemRef.GetFaultDetectionCounter
        OpEventGetFaultDetectionCounter_GetFaultDetectionCounter_EvtInfo_AutoCreatedDemEvent_INIT_Action_CanSM_Init_BswMReportF_bdd0fd79: start-on-event=DemSatellite_OsApplication_Untrusted_Core0InternalBehavior/GetFaultDetectionCounter, operation=EvtInfo_AutoCreatedDemEvent_INIT_Action_CanSM_Init_BswMReportFailToDemRef.GetFaultDetectionCounter
        OpEventGetFaultDetectionCounter_GetFaultDetectionCounter_EvtInfo_AutoCreatedDemEvent_INIT_Action_CanTp_Init_BswMReportF_c26fbb58: start-on-event=DemSatellite_OsApplication_Untrusted_Core0InternalBehavior/GetFaultDetectionCounter, operation=EvtInfo_AutoCreatedDemEvent_INIT_Action_CanTp_Init_BswMReportFailToDemRef.GetFaultDetectionCounter
        OpEventGetFaultDetectionCounter_GetFaultDetectionCounter_EvtInfo_AutoCreatedDemEvent_INIT_Action_Can_Init_BswMReportFailToDemRef: start-on-event=DemSatellite_OsApplication_Untrusted_Core0InternalBehavior/GetFaultDetectionCounter, operation=EvtInfo_AutoCreatedDemEvent_INIT_Action_Can_Init_BswMReportFailToDemRef.GetFaultDetectionCounter
        OpEventGetFaultDetectionCounter_GetFaultDetectionCounter_EvtInfo_AutoCreatedDemEvent_INIT_Action_ComM_Init_BswMReportFa_3ef32f4a: start-on-event=DemSatellite_OsApplication_Untrusted_Core0InternalBehavior/GetFaultDetectionCounter, operation=EvtInfo_AutoCreatedDemEvent_INIT_Action_ComM_Init_BswMReportFailToDemRef.GetFaultDetectionCounter
        OpEventGetFaultDetectionCounter_GetFaultDetectionCounter_EvtInfo_AutoCreatedDemEvent_INIT_Action_Com_Init_BswMReportFailToDemRef: start-on-event=DemSatellite_OsApplication_Untrusted_Core0InternalBehavior/GetFaultDetectionCounter, operation=EvtInfo_AutoCreatedDemEvent_INIT_Action_Com_Init_BswMReportFailToDemRef.GetFaultDetectionCounter
        OpEventGetFaultDetectionCounter_GetFaultDetectionCounter_EvtInfo_AutoCreatedDemEvent_INIT_Action_Dcm_Init_BswMReportFailToDemRef: start-on-event=DemSatellite_OsApplication_Untrusted_Core0InternalBehavior/GetFaultDetectionCounter, operation=EvtInfo_AutoCreatedDemEvent_INIT_Action_Dcm_Init_BswMReportFailToDemRef.GetFaultDetectionCounter
        OpEventGetFaultDetectionCounter_GetFaultDetectionCounter_EvtInfo_AutoCreatedDemEvent_INIT_Action_Dem_Init_BswMReportFailToDemRef: start-on-event=DemSatellite_OsApplication_Untrusted_Core0InternalBehavior/GetFaultDetectionCounter, operation=EvtInfo_AutoCreatedDemEvent_INIT_Action_Dem_Init_BswMReportFailToDemRef.GetFaultDetectionCounter
        OpEventGetFaultDetectionCounter_GetFaultDetectionCounter_EvtInfo_AutoCreatedDemEvent_INIT_Action_EnableInterrupts_BswMR_1aad833e: start-on-event=DemSatellite_OsApplication_Untrusted_Core0InternalBehavior/GetFaultDetectionCounter, operation=EvtInfo_AutoCreatedDemEvent_INIT_Action_EnableInterrupts_BswMReportFailToDemRef.GetFaultDetectionCounter
        OpEventGetFaultDetectionCounter_GetFaultDetectionCounter_EvtInfo_AutoCreatedDemEvent_INIT_Action_Fee_Init_BswMReportFailToDemRef: start-on-event=DemSatellite_OsApplication_Untrusted_Core0InternalBehavior/GetFaultDetectionCounter, operation=EvtInfo_AutoCreatedDemEvent_INIT_Action_Fee_Init_BswMReportFailToDemRef.GetFaultDetectionCounter
        OpEventGetFaultDetectionCounter_GetFaultDetectionCounter_EvtInfo_AutoCreatedDemEvent_INIT_Action_Issm_Init_BswMReportFa_50c40aaf: start-on-event=DemSatellite_OsApplication_Untrusted_Core0InternalBehavior/GetFaultDetectionCounter, operation=EvtInfo_AutoCreatedDemEvent_INIT_Action_Issm_Init_BswMReportFailToDemRef.GetFaultDetectionCounter
        OpEventGetFaultDetectionCounter_GetFaultDetectionCounter_EvtInfo_AutoCreatedDemEvent_INIT_Action_J1939Nm_Init_BswMRepor_74d4a55e: start-on-event=DemSatellite_OsApplication_Untrusted_Core0InternalBehavior/GetFaultDetectionCounter, operation=EvtInfo_AutoCreatedDemEvent_INIT_Action_J1939Nm_Init_BswMReportFailToDemRef.GetFaultDetectionCounter
        OpEventGetFaultDetectionCounter_GetFaultDetectionCounter_EvtInfo_AutoCreatedDemEvent_INIT_Action_J1939Rm_Init_BswMRepor_cdcd0b7d: start-on-event=DemSatellite_OsApplication_Untrusted_Core0InternalBehavior/GetFaultDetectionCounter, operation=EvtInfo_AutoCreatedDemEvent_INIT_Action_J1939Rm_Init_BswMReportFailToDemRef.GetFaultDetectionCounter
        OpEventGetFaultDetectionCounter_GetFaultDetectionCounter_EvtInfo_AutoCreatedDemEvent_INIT_Action_J1939Tp_Init_BswMRepor_58f2b21f: start-on-event=DemSatellite_OsApplication_Untrusted_Core0InternalBehavior/GetFaultDetectionCounter, operation=EvtInfo_AutoCreatedDemEvent_INIT_Action_J1939Tp_Init_BswMReportFailToDemRef.GetFaultDetectionCounter
        OpEventGetFaultDetectionCounter_GetFaultDetectionCounter_EvtInfo_AutoCreatedDemEvent_INIT_Action_LinIf_Init_BswMReportF_5f93ecbb: start-on-event=DemSatellite_OsApplication_Untrusted_Core0InternalBehavior/GetFaultDetectionCounter, operation=EvtInfo_AutoCreatedDemEvent_INIT_Action_LinIf_Init_BswMReportFailToDemRef.GetFaultDetectionCounter
        OpEventGetFaultDetectionCounter_GetFaultDetectionCounter_EvtInfo_AutoCreatedDemEvent_INIT_Action_LinSM_Init_BswMReportF_b2fcba2d: start-on-event=DemSatellite_OsApplication_Untrusted_Core0InternalBehavior/GetFaultDetectionCounter, operation=EvtInfo_AutoCreatedDemEvent_INIT_Action_LinSM_Init_BswMReportFailToDemRef.GetFaultDetectionCounter
        OpEventGetFaultDetectionCounter_GetFaultDetectionCounter_EvtInfo_AutoCreatedDemEvent_INIT_Action_LinTp_Init_BswMReportF_cd43fc0c: start-on-event=DemSatellite_OsApplication_Untrusted_Core0InternalBehavior/GetFaultDetectionCounter, operation=EvtInfo_AutoCreatedDemEvent_INIT_Action_LinTp_Init_BswMReportFailToDemRef.GetFaultDetectionCounter
        OpEventGetFaultDetectionCounter_GetFaultDetectionCounter_EvtInfo_AutoCreatedDemEvent_INIT_Action_Lin_Init_BswMReportFailToDemRef: start-on-event=DemSatellite_OsApplication_Untrusted_Core0InternalBehavior/GetFaultDetectionCounter, operation=EvtInfo_AutoCreatedDemEvent_INIT_Action_Lin_Init_BswMReportFailToDemRef.GetFaultDetectionCounter
        OpEventGetFaultDetectionCounter_GetFaultDetectionCounter_EvtInfo_AutoCreatedDemEvent_INIT_Action_Nm_Init_BswMReportFailToDemRef: start-on-event=DemSatellite_OsApplication_Untrusted_Core0InternalBehavior/GetFaultDetectionCounter, operation=EvtInfo_AutoCreatedDemEvent_INIT_Action_Nm_Init_BswMReportFailToDemRef.GetFaultDetectionCounter
        OpEventGetFaultDetectionCounter_GetFaultDetectionCounter_EvtInfo_AutoCreatedDemEvent_INIT_Action_NvMReadAll_BswMReportF_6c03d7bf: start-on-event=DemSatellite_OsApplication_Untrusted_Core0InternalBehavior/GetFaultDetectionCounter, operation=EvtInfo_AutoCreatedDemEvent_INIT_Action_NvMReadAll_BswMReportFailToDemRef.GetFaultDetectionCounter
        OpEventGetFaultDetectionCounter_GetFaultDetectionCounter_EvtInfo_AutoCreatedDemEvent_INIT_Action_NvM_Init_BswMReportFailToDemRef: start-on-event=DemSatellite_OsApplication_Untrusted_Core0InternalBehavior/GetFaultDetectionCounter, operation=EvtInfo_AutoCreatedDemEvent_INIT_Action_NvM_Init_BswMReportFailToDemRef.GetFaultDetectionCounter
        OpEventGetFaultDetectionCounter_GetFaultDetectionCounter_EvtInfo_AutoCreatedDemEvent_INIT_Action_PduR_Init_BswMReportFa_1c4a55fe: start-on-event=DemSatellite_OsApplication_Untrusted_Core0InternalBehavior/GetFaultDetectionCounter, operation=EvtInfo_AutoCreatedDemEvent_INIT_Action_PduR_Init_BswMReportFailToDemRef.GetFaultDetectionCounter
        OpEventGetFaultDetectionCounter_GetFaultDetectionCounter_EvtInfo_AutoCreatedDemEvent_INIT_Action_RteStart_BswMReportFailToDemRef: start-on-event=DemSatellite_OsApplication_Untrusted_Core0InternalBehavior/GetFaultDetectionCounter, operation=EvtInfo_AutoCreatedDemEvent_INIT_Action_RteStart_BswMReportFailToDemRef.GetFaultDetectionCounter
        OpEventGetFaultDetectionCounter_GetFaultDetectionCounter_EvtInfo_AutoCreatedDemEvent_CHNL_17344684_CANSM_E_MODE_REQUEST_TIMEOUT: start-on-event=DemSatellite_OsApplication_Untrusted_Core0InternalBehavior/GetFaultDetectionCounter, operation=EvtInfo_AutoCreatedDemEvent_CHNL_17344684_CANSM_E_MODE_REQUEST_TIMEOUT.GetFaultDetectionCounter
        OpEventGetFaultDetectionCounter_GetFaultDetectionCounter_EvtInfo_AutoCreatedDemEvent_CHNL_17344684_CANSM_E_BUS_OFF: start-on-event=DemSatellite_OsApplication_Untrusted_Core0InternalBehavior/GetFaultDetectionCounter, operation=EvtInfo_AutoCreatedDemEvent_CHNL_17344684_CANSM_E_BUS_OFF.GetFaultDetectionCounter
        OpEventGetFaultDetectionCounter_GetFaultDetectionCounter_EvtInfo_AutoCreatedDemEvent_CHNL_53cce282_CANSM_E_MODE_REQUEST_TIMEOUT: start-on-event=DemSatellite_OsApplication_Untrusted_Core0InternalBehavior/GetFaultDetectionCounter, operation=EvtInfo_AutoCreatedDemEvent_CHNL_53cce282_CANSM_E_MODE_REQUEST_TIMEOUT.GetFaultDetectionCounter
        OpEventGetFaultDetectionCounter_GetFaultDetectionCounter_EvtInfo_AutoCreatedDemEvent_CHNL_53cce282_CANSM_E_BUS_OFF: start-on-event=DemSatellite_OsApplication_Untrusted_Core0InternalBehavior/GetFaultDetectionCounter, operation=EvtInfo_AutoCreatedDemEvent_CHNL_53cce282_CANSM_E_BUS_OFF.GetFaultDetectionCounter
        OpEventGetFaultDetectionCounter_GetFaultDetectionCounter_EvtInfo_AutoCreatedDemEvent_CHNL_a6b6a922_CANSM_E_MODE_REQUEST_TIMEOUT: start-on-event=DemSatellite_OsApplication_Untrusted_Core0InternalBehavior/GetFaultDetectionCounter, operation=EvtInfo_AutoCreatedDemEvent_CHNL_a6b6a922_CANSM_E_MODE_REQUEST_TIMEOUT.GetFaultDetectionCounter
        OpEventGetFaultDetectionCounter_GetFaultDetectionCounter_EvtInfo_AutoCreatedDemEvent_CHNL_a6b6a922_CANSM_E_BUS_OFF: start-on-event=DemSatellite_OsApplication_Untrusted_Core0InternalBehavior/GetFaultDetectionCounter, operation=EvtInfo_AutoCreatedDemEvent_CHNL_a6b6a922_CANSM_E_BUS_OFF.GetFaultDetectionCounter
        OpEventGetFaultDetectionCounter_GetFaultDetectionCounter_EvtInfo_AutoCreatedDemEvent_CHNL_df893ad5_CANSM_E_MODE_REQUEST_TIMEOUT: start-on-event=DemSatellite_OsApplication_Untrusted_Core0InternalBehavior/GetFaultDetectionCounter, operation=EvtInfo_AutoCreatedDemEvent_CHNL_df893ad5_CANSM_E_MODE_REQUEST_TIMEOUT.GetFaultDetectionCounter
        OpEventGetFaultDetectionCounter_GetFaultDetectionCounter_EvtInfo_AutoCreatedDemEvent_CHNL_df893ad5_CANSM_E_BUS_OFF: start-on-event=DemSatellite_OsApplication_Untrusted_Core0InternalBehavior/GetFaultDetectionCounter, operation=EvtInfo_AutoCreatedDemEvent_CHNL_df893ad5_CANSM_E_BUS_OFF.GetFaultDetectionCounter
        OpEventGetFaultDetectionCounter_GetFaultDetectionCounter_EvtInfo_AutoCreatedDemEvent_CHNL_e058b4ae_CANSM_E_MODE_REQUEST_TIMEOUT: start-on-event=DemSatellite_OsApplication_Untrusted_Core0InternalBehavior/GetFaultDetectionCounter, operation=EvtInfo_AutoCreatedDemEvent_CHNL_e058b4ae_CANSM_E_MODE_REQUEST_TIMEOUT.GetFaultDetectionCounter
        OpEventGetFaultDetectionCounter_GetFaultDetectionCounter_EvtInfo_AutoCreatedDemEvent_CHNL_e058b4ae_CANSM_E_BUS_OFF: start-on-event=DemSatellite_OsApplication_Untrusted_Core0InternalBehavior/GetFaultDetectionCounter, operation=EvtInfo_AutoCreatedDemEvent_CHNL_e058b4ae_CANSM_E_BUS_OFF.GetFaultDetectionCounter
        OpEventGetFaultDetectionCounter_GetFaultDetectionCounter_EvtInfo_AutoCreatedDemEvent_ECUM_E_RAM_CHECK_FAILED: start-on-event=DemSatellite_OsApplication_Untrusted_Core0InternalBehavior/GetFaultDetectionCounter, operation=EvtInfo_AutoCreatedDemEvent_ECUM_E_RAM_CHECK_FAILED.GetFaultDetectionCounter
        OpEventGetFaultDetectionCounter_GetFaultDetectionCounter_EvtInfo_AutoCreatedDemEvent_ECUM_E_IMPROPER_CALLER: start-on-event=DemSatellite_OsApplication_Untrusted_Core0InternalBehavior/GetFaultDetectionCounter, operation=EvtInfo_AutoCreatedDemEvent_ECUM_E_IMPROPER_CALLER.GetFaultDetectionCounter
        OpEventGetFaultDetectionCounter_GetFaultDetectionCounter_EvtInfo_AutoCreatedDemEvent_ECUM_E_CONFIGURATION_DATA_INCONSISTENT: start-on-event=DemSatellite_OsApplication_Untrusted_Core0InternalBehavior/GetFaultDetectionCounter, operation=EvtInfo_AutoCreatedDemEvent_ECUM_E_CONFIGURATION_DATA_INCONSISTENT.GetFaultDetectionCounter
        OpEventGetFaultDetectionCounter_GetFaultDetectionCounter_EvtInfo_AutoCreatedDemEvent_ECUM_E_ALL_RUN_REQUESTS_KILLED: start-on-event=DemSatellite_OsApplication_Untrusted_Core0InternalBehavior/GetFaultDetectionCounter, operation=EvtInfo_AutoCreatedDemEvent_ECUM_E_ALL_RUN_REQUESTS_KILLED.GetFaultDetectionCounter
        OpEventGetFaultDetectionCounter_GetFaultDetectionCounter_EvtInfo_AutoCreatedDemEvent_FLS_E_WRITE_FAILED: start-on-event=DemSatellite_OsApplication_Untrusted_Core0InternalBehavior/GetFaultDetectionCounter, operation=EvtInfo_AutoCreatedDemEvent_FLS_E_WRITE_FAILED.GetFaultDetectionCounter
        OpEventGetFaultDetectionCounter_GetFaultDetectionCounter_EvtInfo_AutoCreatedDemEvent_FLS_E_UNEXPECTED_FLASH_ID: start-on-event=DemSatellite_OsApplication_Untrusted_Core0InternalBehavior/GetFaultDetectionCounter, operation=EvtInfo_AutoCreatedDemEvent_FLS_E_UNEXPECTED_FLASH_ID.GetFaultDetectionCounter
        OpEventGetFaultDetectionCounter_GetFaultDetectionCounter_EvtInfo_AutoCreatedDemEvent_FLS_E_READ_FAILED: start-on-event=DemSatellite_OsApplication_Untrusted_Core0InternalBehavior/GetFaultDetectionCounter, operation=EvtInfo_AutoCreatedDemEvent_FLS_E_READ_FAILED.GetFaultDetectionCounter
        OpEventGetFaultDetectionCounter_GetFaultDetectionCounter_EvtInfo_AutoCreatedDemEvent_FLS_E_ERASE_FAILED: start-on-event=DemSatellite_OsApplication_Untrusted_Core0InternalBehavior/GetFaultDetectionCounter, operation=EvtInfo_AutoCreatedDemEvent_FLS_E_ERASE_FAILED.GetFaultDetectionCounter
        OpEventGetFaultDetectionCounter_GetFaultDetectionCounter_EvtInfo_AutoCreatedDemEvent_FLS_E_COMPARE_FAILED: start-on-event=DemSatellite_OsApplication_Untrusted_Core0InternalBehavior/GetFaultDetectionCounter, operation=EvtInfo_AutoCreatedDemEvent_FLS_E_COMPARE_FAILED.GetFaultDetectionCounter
        OpEventGetFaultDetectionCounter_GetFaultDetectionCounter_EvtInfo_AutoCreatedDemEvent_GPT_E_TIMEOUT: start-on-event=DemSatellite_OsApplication_Untrusted_Core0InternalBehavior/GetFaultDetectionCounter, operation=EvtInfo_AutoCreatedDemEvent_GPT_E_TIMEOUT.GetFaultDetectionCounter
        OpEventGetFaultDetectionCounter_GetFaultDetectionCounter_EvtInfo_AutoCreatedDemEvent_J1939NM_E_ADDRESS_LOST: start-on-event=DemSatellite_OsApplication_Untrusted_Core0InternalBehavior/GetFaultDetectionCounter, operation=EvtInfo_AutoCreatedDemEvent_J1939NM_E_ADDRESS_LOST.GetFaultDetectionCounter
        OpEventGetFaultDetectionCounter_GetFaultDetectionCounter_EvtInfo_AutoCreatedDemEvent_J1939TpConfiguration_J1939TP_E_COM_e528d5f1: start-on-event=DemSatellite_OsApplication_Untrusted_Core0InternalBehavior/GetFaultDetectionCounter, operation=EvtInfo_AutoCreatedDemEvent_J1939TpConfiguration_J1939TP_E_COMMUNICATION.GetFaultDetectionCounter
        OpEventGetFaultDetectionCounter_GetFaultDetectionCounter_EvtInfo_AutoCreatedDemEvent_LIN_E_TIMEOUT: start-on-event=DemSatellite_OsApplication_Untrusted_Core0InternalBehavior/GetFaultDetectionCounter, operation=EvtInfo_AutoCreatedDemEvent_LIN_E_TIMEOUT.GetFaultDetectionCounter
        OpEventGetFaultDetectionCounter_GetFaultDetectionCounter_EvtInfo_AutoCreatedDemEvent_MCL_E_DMA_UNRECOGNIZED: start-on-event=DemSatellite_OsApplication_Untrusted_Core0InternalBehavior/GetFaultDetectionCounter, operation=EvtInfo_AutoCreatedDemEvent_MCL_E_DMA_UNRECOGNIZED.GetFaultDetectionCounter
        OpEventGetFaultDetectionCounter_GetFaultDetectionCounter_EvtInfo_AutoCreatedDemEvent_MCL_E_DMA_PRIORITY: start-on-event=DemSatellite_OsApplication_Untrusted_Core0InternalBehavior/GetFaultDetectionCounter, operation=EvtInfo_AutoCreatedDemEvent_MCL_E_DMA_PRIORITY.GetFaultDetectionCounter
        OpEventGetFaultDetectionCounter_GetFaultDetectionCounter_EvtInfo_AutoCreatedDemEvent_MCL_E_DMA_INCONSISTENCY: start-on-event=DemSatellite_OsApplication_Untrusted_Core0InternalBehavior/GetFaultDetectionCounter, operation=EvtInfo_AutoCreatedDemEvent_MCL_E_DMA_INCONSISTENCY.GetFaultDetectionCounter
        OpEventGetFaultDetectionCounter_GetFaultDetectionCounter_EvtInfo_AutoCreatedDemEvent_MCL_E_DMA_ECC: start-on-event=DemSatellite_OsApplication_Untrusted_Core0InternalBehavior/GetFaultDetectionCounter, operation=EvtInfo_AutoCreatedDemEvent_MCL_E_DMA_ECC.GetFaultDetectionCounter
        OpEventGetFaultDetectionCounter_GetFaultDetectionCounter_EvtInfo_AutoCreatedDemEvent_MCL_E_DMA_DESCRIPTOR: start-on-event=DemSatellite_OsApplication_Untrusted_Core0InternalBehavior/GetFaultDetectionCounter, operation=EvtInfo_AutoCreatedDemEvent_MCL_E_DMA_DESCRIPTOR.GetFaultDetectionCounter
        OpEventGetFaultDetectionCounter_GetFaultDetectionCounter_EvtInfo_AutoCreatedDemEvent_MCL_E_DMA_BUS: start-on-event=DemSatellite_OsApplication_Untrusted_Core0InternalBehavior/GetFaultDetectionCounter, operation=EvtInfo_AutoCreatedDemEvent_MCL_E_DMA_BUS.GetFaultDetectionCounter
        OpEventGetFaultDetectionCounter_GetFaultDetectionCounter_EvtInfo_AutoCreatedDemEvent_MCU_E_TIMEOUT_FAILURE: start-on-event=DemSatellite_OsApplication_Untrusted_Core0InternalBehavior/GetFaultDetectionCounter, operation=EvtInfo_AutoCreatedDemEvent_MCU_E_TIMEOUT_FAILURE.GetFaultDetectionCounter
        OpEventGetFaultDetectionCounter_GetFaultDetectionCounter_EvtInfo_AutoCreatedDemEvent_MCU_E_SSCM_CER_FAILURE: start-on-event=DemSatellite_OsApplication_Untrusted_Core0InternalBehavior/GetFaultDetectionCounter, operation=EvtInfo_AutoCreatedDemEvent_MCU_E_SSCM_CER_FAILURE.GetFaultDetectionCounter
        OpEventGetFaultDetectionCounter_GetFaultDetectionCounter_EvtInfo_AutoCreatedDemEvent_MCU_E_INVALIDMODE_CONFIG: start-on-event=DemSatellite_OsApplication_Untrusted_Core0InternalBehavior/GetFaultDetectionCounter, operation=EvtInfo_AutoCreatedDemEvent_MCU_E_INVALIDMODE_CONFIG.GetFaultDetectionCounter
        OpEventGetFaultDetectionCounter_GetFaultDetectionCounter_EvtInfo_AutoCreatedDemEvent_MCU_E_CLOCK_FAILURE: start-on-event=DemSatellite_OsApplication_Untrusted_Core0InternalBehavior/GetFaultDetectionCounter, operation=EvtInfo_AutoCreatedDemEvent_MCU_E_CLOCK_FAILURE.GetFaultDetectionCounter
        OpEventGetFaultDetectionCounter_GetFaultDetectionCounter_EvtInfo_AutoCreatedDemEvent_NVM_E_WRONG_BLOCK_ID: start-on-event=DemSatellite_OsApplication_Untrusted_Core0InternalBehavior/GetFaultDetectionCounter, operation=EvtInfo_AutoCreatedDemEvent_NVM_E_WRONG_BLOCK_ID.GetFaultDetectionCounter
        OpEventGetFaultDetectionCounter_GetFaultDetectionCounter_EvtInfo_AutoCreatedDemEvent_NVM_E_WRITE_PROTECTED: start-on-event=DemSatellite_OsApplication_Untrusted_Core0InternalBehavior/GetFaultDetectionCounter, operation=EvtInfo_AutoCreatedDemEvent_NVM_E_WRITE_PROTECTED.GetFaultDetectionCounter
        OpEventGetFaultDetectionCounter_GetFaultDetectionCounter_EvtInfo_AutoCreatedDemEvent_NVM_E_VERIFY_FAILED: start-on-event=DemSatellite_OsApplication_Untrusted_Core0InternalBehavior/GetFaultDetectionCounter, operation=EvtInfo_AutoCreatedDemEvent_NVM_E_VERIFY_FAILED.GetFaultDetectionCounter
        OpEventGetFaultDetectionCounter_GetFaultDetectionCounter_EvtInfo_AutoCreatedDemEvent_NVM_E_REQ_FAILED: start-on-event=DemSatellite_OsApplication_Untrusted_Core0InternalBehavior/GetFaultDetectionCounter, operation=EvtInfo_AutoCreatedDemEvent_NVM_E_REQ_FAILED.GetFaultDetectionCounter
        OpEventGetFaultDetectionCounter_GetFaultDetectionCounter_EvtInfo_AutoCreatedDemEvent_NVM_E_QUEUE_OVERFLOW: start-on-event=DemSatellite_OsApplication_Untrusted_Core0InternalBehavior/GetFaultDetectionCounter, operation=EvtInfo_AutoCreatedDemEvent_NVM_E_QUEUE_OVERFLOW.GetFaultDetectionCounter
        OpEventGetFaultDetectionCounter_GetFaultDetectionCounter_EvtInfo_AutoCreatedDemEvent_NVM_E_LOSS_OF_REDUNDANCY: start-on-event=DemSatellite_OsApplication_Untrusted_Core0InternalBehavior/GetFaultDetectionCounter, operation=EvtInfo_AutoCreatedDemEvent_NVM_E_LOSS_OF_REDUNDANCY.GetFaultDetectionCounter
        OpEventGetFaultDetectionCounter_GetFaultDetectionCounter_EvtInfo_AutoCreatedDemEvent_NVM_E_INTEGRITY_FAILED: start-on-event=DemSatellite_OsApplication_Untrusted_Core0InternalBehavior/GetFaultDetectionCounter, operation=EvtInfo_AutoCreatedDemEvent_NVM_E_INTEGRITY_FAILED.GetFaultDetectionCounter
        OpEventGetFaultDetectionCounter_GetFaultDetectionCounter_EvtInfo_AutoCreatedDemEvent_SPI_E_HARDWARE_ERROR: start-on-event=DemSatellite_OsApplication_Untrusted_Core0InternalBehavior/GetFaultDetectionCounter, operation=EvtInfo_AutoCreatedDemEvent_SPI_E_HARDWARE_ERROR.GetFaultDetectionCounter
        OpEventGetFaultDetectionCounter_GetFaultDetectionCounter_EvtInfo_AutoCreatedDemEvent_SpiDriver_SPI_E_HARDWARE_ERROR: start-on-event=DemSatellite_OsApplication_Untrusted_Core0InternalBehavior/GetFaultDetectionCounter, operation=EvtInfo_AutoCreatedDemEvent_SpiDriver_SPI_E_HARDWARE_ERROR.GetFaultDetectionCounter
        OpEventGetFaultDetectionCounter_GetFaultDetectionCounter_EvtInfo_AutoCreatedDemEvent_WDG_E_UNLOCKED: start-on-event=DemSatellite_OsApplication_Untrusted_Core0InternalBehavior/GetFaultDetectionCounter, operation=EvtInfo_AutoCreatedDemEvent_WDG_E_UNLOCKED.GetFaultDetectionCounter
        OpEventGetFaultDetectionCounter_GetFaultDetectionCounter_EvtInfo_AutoCreatedDemEvent_WDG_E_MODE_FAILED: start-on-event=DemSatellite_OsApplication_Untrusted_Core0InternalBehavior/GetFaultDetectionCounter, operation=EvtInfo_AutoCreatedDemEvent_WDG_E_MODE_FAILED.GetFaultDetectionCounter
        OpEventGetFaultDetectionCounter_GetFaultDetectionCounter_EvtInfo_AutoCreatedDemEvent_WDG_E_INVALID_PARAMETER: start-on-event=DemSatellite_OsApplication_Untrusted_Core0InternalBehavior/GetFaultDetectionCounter, operation=EvtInfo_AutoCreatedDemEvent_WDG_E_INVALID_PARAMETER.GetFaultDetectionCounter
        OpEventGetFaultDetectionCounter_GetFaultDetectionCounter_EvtInfo_AutoCreatedDemEvent_WDG_E_INVALID_CALL: start-on-event=DemSatellite_OsApplication_Untrusted_Core0InternalBehavior/GetFaultDetectionCounter, operation=EvtInfo_AutoCreatedDemEvent_WDG_E_INVALID_CALL.GetFaultDetectionCounter
        OpEventGetFaultDetectionCounter_GetFaultDetectionCounter_EvtInfo_AutoCreatedDemEvent_WDG_E_FORBIDDEN_INVOCATION: start-on-event=DemSatellite_OsApplication_Untrusted_Core0InternalBehavior/GetFaultDetectionCounter, operation=EvtInfo_AutoCreatedDemEvent_WDG_E_FORBIDDEN_INVOCATION.GetFaultDetectionCounter
        OpEventGetFaultDetectionCounter_GetFaultDetectionCounter_EvtInfo_AutoCreatedDemEvent_WDG_E_DISABLE_REJECTED: start-on-event=DemSatellite_OsApplication_Untrusted_Core0InternalBehavior/GetFaultDetectionCounter, operation=EvtInfo_AutoCreatedDemEvent_WDG_E_DISABLE_REJECTED.GetFaultDetectionCounter
        OpEventGetFaultDetectionCounter_GetFaultDetectionCounter_EvtInfo_AutoCreatedDemEvent_WDG_E_CORRUPT_CONFIG: start-on-event=DemSatellite_OsApplication_Untrusted_Core0InternalBehavior/GetFaultDetectionCounter, operation=EvtInfo_AutoCreatedDemEvent_WDG_E_CORRUPT_CONFIG.GetFaultDetectionCounter
        OpEventGetEventFreezeFrameDataEx_GetEventFreezeFrameDataEx_EvtInfo_AutoCreatedDemEvent_ADC_E_TIMEOUT: start-on-event=DemSatellite_OsApplication_Untrusted_Core0InternalBehavior/GetEventFreezeFrameDataEx, operation=EvtInfo_AutoCreatedDemEvent_ADC_E_TIMEOUT.GetEventFreezeFrameDataEx
        OpEventGetEventFreezeFrameDataEx_GetEventFreezeFrameDataEx_EvtInfo_AutoCreatedDemEvent_CC_DisableDM_CIOM_oCabSubnet_Rx_2c5d5dad: start-on-event=DemSatellite_OsApplication_Untrusted_Core0InternalBehavior/GetEventFreezeFrameDataEx, operation=EvtInfo_AutoCreatedDemEvent_CC_DisableDM_CIOM_oCabSubnet_Rx_063a5fbc_BswMReportFailToDemRef.GetEventFreezeFrameDataEx
        OpEventGetEventFreezeFrameDataEx_GetEventFreezeFrameDataEx_EvtInfo_AutoCreatedDemEvent_CC_J1939RmStateSwitch_CN_Backbon_fc1e475e: start-on-event=DemSatellite_OsApplication_Untrusted_Core0InternalBehavior/GetEventFreezeFrameDataEx, operation=EvtInfo_AutoCreatedDemEvent_CC_J1939RmStateSwitch_CN_Backbone1J1939_0b1f4bae_CIOM_4d5cd289_J1939RM_STATE_OFFLINE_BswMRe_5a5b15b8.GetEventFreezeFrameDataEx
        OpEventGetEventFreezeFrameDataEx_GetEventFreezeFrameDataEx_EvtInfo_AutoCreatedDemEvent_CC_J1939RmStateSwitch_CN_Backbon_814177cd: start-on-event=DemSatellite_OsApplication_Untrusted_Core0InternalBehavior/GetEventFreezeFrameDataEx, operation=EvtInfo_AutoCreatedDemEvent_CC_J1939RmStateSwitch_CN_Backbone1J1939_0b1f4bae_CIOM_4d5cd289_J1939RM_STATE_ONLINE_BswMRep_ec959aed.GetEventFreezeFrameDataEx
        OpEventGetEventFreezeFrameDataEx_GetEventFreezeFrameDataEx_EvtInfo_AutoCreatedDemEvent_CC_DisablePDUGroup_CIOM_oLIN04_T_0d611142: start-on-event=DemSatellite_OsApplication_Untrusted_Core0InternalBehavior/GetEventFreezeFrameDataEx, operation=EvtInfo_AutoCreatedDemEvent_CC_DisablePDUGroup_CIOM_oLIN04_Tx_04202f7b_BswMReportFailToDemRef.GetEventFreezeFrameDataEx
        OpEventGetEventFreezeFrameDataEx_GetEventFreezeFrameDataEx_EvtInfo_AutoCreatedDemEvent_CC_DisablePDUGroup_CIOM_oLIN04_R_c4c374bc: start-on-event=DemSatellite_OsApplication_Untrusted_Core0InternalBehavior/GetEventFreezeFrameDataEx, operation=EvtInfo_AutoCreatedDemEvent_CC_DisablePDUGroup_CIOM_oLIN04_Rx_527a88fd_BswMReportFailToDemRef.GetEventFreezeFrameDataEx
        OpEventGetEventFreezeFrameDataEx_GetEventFreezeFrameDataEx_EvtInfo_AutoCreatedDemEvent_CC_DisablePDUGroup_CIOM_oLIN01_T_76d9b83b: start-on-event=DemSatellite_OsApplication_Untrusted_Core0InternalBehavior/GetEventFreezeFrameDataEx, operation=EvtInfo_AutoCreatedDemEvent_CC_DisablePDUGroup_CIOM_oLIN01_Tx_33fedf49_BswMReportFailToDemRef.GetEventFreezeFrameDataEx
        OpEventGetEventFreezeFrameDataEx_GetEventFreezeFrameDataEx_EvtInfo_AutoCreatedDemEvent_CC_DisablePDUGroup_CIOM_oLIN01_R_48e912b1: start-on-event=DemSatellite_OsApplication_Untrusted_Core0InternalBehavior/GetEventFreezeFrameDataEx, operation=EvtInfo_AutoCreatedDemEvent_CC_DisablePDUGroup_CIOM_oLIN01_Rx_65a478cf_BswMReportFailToDemRef.GetEventFreezeFrameDataEx
        OpEventGetEventFreezeFrameDataEx_GetEventFreezeFrameDataEx_EvtInfo_AutoCreatedDemEvent_CC_EnablePDUGroup_CIOM_oLIN04_Tx_b915a99e: start-on-event=DemSatellite_OsApplication_Untrusted_Core0InternalBehavior/GetEventFreezeFrameDataEx, operation=EvtInfo_AutoCreatedDemEvent_CC_EnablePDUGroup_CIOM_oLIN04_Tx_04202f7b_BswMReportFailToDemRef.GetEventFreezeFrameDataEx
        OpEventGetEventFreezeFrameDataEx_GetEventFreezeFrameDataEx_EvtInfo_AutoCreatedDemEvent_CC_EnablePDUGroup_CIOM_oLIN04_Rx_70b7cc60: start-on-event=DemSatellite_OsApplication_Untrusted_Core0InternalBehavior/GetEventFreezeFrameDataEx, operation=EvtInfo_AutoCreatedDemEvent_CC_EnablePDUGroup_CIOM_oLIN04_Rx_527a88fd_BswMReportFailToDemRef.GetEventFreezeFrameDataEx
        OpEventGetEventFreezeFrameDataEx_GetEventFreezeFrameDataEx_EvtInfo_AutoCreatedDemEvent_CC_DisableDM_CIOM_oBackbone2_Rx_4b095723: start-on-event=DemSatellite_OsApplication_Untrusted_Core0InternalBehavior/GetEventFreezeFrameDataEx, operation=EvtInfo_AutoCreatedDemEvent_CC_DisableDM_CIOM_oBackbone2_Rx_4e624434_BswMReportFailToDemRef.GetEventFreezeFrameDataEx
        OpEventGetEventFreezeFrameDataEx_GetEventFreezeFrameDataEx_EvtInfo_AutoCreatedDemEvent_CC_EnableDM_CIOM_oBackbone2_Rx_4_27ef106f: start-on-event=DemSatellite_OsApplication_Untrusted_Core0InternalBehavior/GetEventFreezeFrameDataEx, operation=EvtInfo_AutoCreatedDemEvent_CC_EnableDM_CIOM_oBackbone2_Rx_4e624434_BswMReportFailToDemRef.GetEventFreezeFrameDataEx
        OpEventGetEventFreezeFrameDataEx_GetEventFreezeFrameDataEx_EvtInfo_AutoCreatedDemEvent_CC_DisableDM_CIOM_oSecuritySubne_745424cb: start-on-event=DemSatellite_OsApplication_Untrusted_Core0InternalBehavior/GetEventFreezeFrameDataEx, operation=EvtInfo_AutoCreatedDemEvent_CC_DisableDM_CIOM_oSecuritySubnet_Rx_3a3c1dbc_BswMReportFailToDemRef.GetEventFreezeFrameDataEx
        OpEventGetEventFreezeFrameDataEx_GetEventFreezeFrameDataEx_EvtInfo_AutoCreatedDemEvent_CC_EnableDM_CIOM_oSecuritySubnet_8bb379be: start-on-event=DemSatellite_OsApplication_Untrusted_Core0InternalBehavior/GetEventFreezeFrameDataEx, operation=EvtInfo_AutoCreatedDemEvent_CC_EnableDM_CIOM_oSecuritySubnet_Rx_3a3c1dbc_BswMReportFailToDemRef.GetEventFreezeFrameDataEx
        OpEventGetEventFreezeFrameDataEx_GetEventFreezeFrameDataEx_EvtInfo_AutoCreatedDemEvent_CC_DisablePDUGroup_CIOM_oCabSubn_29737881: start-on-event=DemSatellite_OsApplication_Untrusted_Core0InternalBehavior/GetEventFreezeFrameDataEx, operation=EvtInfo_AutoCreatedDemEvent_CC_DisablePDUGroup_CIOM_oCabSubnet_Tx_5060f83a_BswMReportFailToDemRef.GetEventFreezeFrameDataEx
        OpEventGetEventFreezeFrameDataEx_GetEventFreezeFrameDataEx_EvtInfo_AutoCreatedDemEvent_CC_EnablePDUGroup_CIOM_oCabSubne_09e31a6f: start-on-event=DemSatellite_OsApplication_Untrusted_Core0InternalBehavior/GetEventFreezeFrameDataEx, operation=EvtInfo_AutoCreatedDemEvent_CC_EnablePDUGroup_CIOM_oCabSubnet_Tx_5060f83a_BswMReportFailToDemRef.GetEventFreezeFrameDataEx
        OpEventGetEventFreezeFrameDataEx_GetEventFreezeFrameDataEx_EvtInfo_AutoCreatedDemEvent_CC_EnableDM_CIOM_oCabSubnet_Rx_0_40bb1ae1: start-on-event=DemSatellite_OsApplication_Untrusted_Core0InternalBehavior/GetEventFreezeFrameDataEx, operation=EvtInfo_AutoCreatedDemEvent_CC_EnableDM_CIOM_oCabSubnet_Rx_063a5fbc_BswMReportFailToDemRef.GetEventFreezeFrameDataEx
        OpEventGetEventFreezeFrameDataEx_GetEventFreezeFrameDataEx_EvtInfo_AutoCreatedDemEvent_CC_DisablePDUGroup_CIOM_oBackbon_4b2ee5af: start-on-event=DemSatellite_OsApplication_Untrusted_Core0InternalBehavior/GetEventFreezeFrameDataEx, operation=EvtInfo_AutoCreatedDemEvent_CC_DisablePDUGroup_CIOM_oBackbone2_Tx_1838e3b2_BswMReportFailToDemRef.GetEventFreezeFrameDataEx
        OpEventGetEventFreezeFrameDataEx_GetEventFreezeFrameDataEx_EvtInfo_AutoCreatedDemEvent_CC_EnablePDUGroup_CIOM_oBackbone_6bbe8741: start-on-event=DemSatellite_OsApplication_Untrusted_Core0InternalBehavior/GetEventFreezeFrameDataEx, operation=EvtInfo_AutoCreatedDemEvent_CC_EnablePDUGroup_CIOM_oBackbone2_Tx_1838e3b2_BswMReportFailToDemRef.GetEventFreezeFrameDataEx
        OpEventGetEventFreezeFrameDataEx_GetEventFreezeFrameDataEx_EvtInfo_AutoCreatedDemEvent_CC_DisablePDUGroup_CIOM_oBackbon_be5a4425: start-on-event=DemSatellite_OsApplication_Untrusted_Core0InternalBehavior/GetEventFreezeFrameDataEx, operation=EvtInfo_AutoCreatedDemEvent_CC_DisablePDUGroup_CIOM_oBackbone2_Rx_4e624434_BswMReportFailToDemRef.GetEventFreezeFrameDataEx
        OpEventGetEventFreezeFrameDataEx_GetEventFreezeFrameDataEx_EvtInfo_AutoCreatedDemEvent_CC_EnablePDUGroup_CIOM_oBackbone_9eca26cb: start-on-event=DemSatellite_OsApplication_Untrusted_Core0InternalBehavior/GetEventFreezeFrameDataEx, operation=EvtInfo_AutoCreatedDemEvent_CC_EnablePDUGroup_CIOM_oBackbone2_Rx_4e624434_BswMReportFailToDemRef.GetEventFreezeFrameDataEx
        OpEventGetEventFreezeFrameDataEx_GetEventFreezeFrameDataEx_EvtInfo_AutoCreatedDemEvent_CC_DisablePDUGroup_CIOM_oBackbon_b19d4c35: start-on-event=DemSatellite_OsApplication_Untrusted_Core0InternalBehavior/GetEventFreezeFrameDataEx, operation=EvtInfo_AutoCreatedDemEvent_CC_DisablePDUGroup_CIOM_oBackbone1J1939_Rx_BC_405bc776_BswMReportFailToDemRef.GetEventFreezeFrameDataEx
        OpEventGetEventFreezeFrameDataEx_GetEventFreezeFrameDataEx_EvtInfo_AutoCreatedDemEvent_CC_EnablePDUGroup_CIOM_oBackbone_e7491fed: start-on-event=DemSatellite_OsApplication_Untrusted_Core0InternalBehavior/GetEventFreezeFrameDataEx, operation=EvtInfo_AutoCreatedDemEvent_CC_EnablePDUGroup_CIOM_oBackbone1J1939_Rx_BC_405bc776_BswMReportFailToDemRef.GetEventFreezeFrameDataEx
        OpEventGetEventFreezeFrameDataEx_GetEventFreezeFrameDataEx_EvtInfo_AutoCreatedDemEvent_CC_EnablePDUGroup_CIOM_oLIN02_Tx_233d63f4: start-on-event=DemSatellite_OsApplication_Untrusted_Core0InternalBehavior/GetEventFreezeFrameDataEx, operation=EvtInfo_AutoCreatedDemEvent_CC_EnablePDUGroup_CIOM_oLIN02_Tx_214b70a7_BswMReportFailToDemRef.GetEventFreezeFrameDataEx
        OpEventGetEventFreezeFrameDataEx_GetEventFreezeFrameDataEx_EvtInfo_AutoCreatedDemEvent_CC_EnablePDUGroup_CIOM_oLIN02_Rx_f5f7a096: start-on-event=DemSatellite_OsApplication_Untrusted_Core0InternalBehavior/GetEventFreezeFrameDataEx, operation=EvtInfo_AutoCreatedDemEvent_CC_EnablePDUGroup_CIOM_oLIN02_Rx_7711d721_BswMReportFailToDemRef.GetEventFreezeFrameDataEx
        OpEventGetEventFreezeFrameDataEx_GetEventFreezeFrameDataEx_EvtInfo_AutoCreatedDemEvent_CC_EnablePDUGroup_CIOM_oLIN01_Tx_c2ad00e7: start-on-event=DemSatellite_OsApplication_Untrusted_Core0InternalBehavior/GetEventFreezeFrameDataEx, operation=EvtInfo_AutoCreatedDemEvent_CC_EnablePDUGroup_CIOM_oLIN01_Tx_33fedf49_BswMReportFailToDemRef.GetEventFreezeFrameDataEx
        OpEventGetEventFreezeFrameDataEx_GetEventFreezeFrameDataEx_EvtInfo_AutoCreatedDemEvent_CC_EnablePDUGroup_CIOM_oLIN01_Rx_fc9daa6d: start-on-event=DemSatellite_OsApplication_Untrusted_Core0InternalBehavior/GetEventFreezeFrameDataEx, operation=EvtInfo_AutoCreatedDemEvent_CC_EnablePDUGroup_CIOM_oLIN01_Rx_65a478cf_BswMReportFailToDemRef.GetEventFreezeFrameDataEx
        OpEventGetEventFreezeFrameDataEx_GetEventFreezeFrameDataEx_EvtInfo_AutoCreatedDemEvent_CC_DisablePDUGroup_CIOM_oLIN03_T_05b30be0: start-on-event=DemSatellite_OsApplication_Untrusted_Core0InternalBehavior/GetEventFreezeFrameDataEx, operation=EvtInfo_AutoCreatedDemEvent_CC_DisablePDUGroup_CIOM_oLIN03_Tx_99f717c2_BswMReportFailToDemRef.GetEventFreezeFrameDataEx
        OpEventGetEventFreezeFrameDataEx_GetEventFreezeFrameDataEx_EvtInfo_AutoCreatedDemEvent_CC_DisablePDUGroup_CIOM_oLIN03_R_3c1e6e1e: start-on-event=DemSatellite_OsApplication_Untrusted_Core0InternalBehavior/GetEventFreezeFrameDataEx, operation=EvtInfo_AutoCreatedDemEvent_CC_DisablePDUGroup_CIOM_oLIN03_Rx_cfadb044_BswMReportFailToDemRef.GetEventFreezeFrameDataEx
        OpEventGetEventFreezeFrameDataEx_GetEventFreezeFrameDataEx_EvtInfo_AutoCreatedDemEvent_CC_DisableDM_CIOM_oFMSNet_Rx_BC_64aac570: start-on-event=DemSatellite_OsApplication_Untrusted_Core0InternalBehavior/GetEventFreezeFrameDataEx, operation=EvtInfo_AutoCreatedDemEvent_CC_DisableDM_CIOM_oFMSNet_Rx_BC_dd2c1510_BswMReportFailToDemRef.GetEventFreezeFrameDataEx
        OpEventGetEventFreezeFrameDataEx_GetEventFreezeFrameDataEx_EvtInfo_AutoCreatedDemEvent_CC_EnableDM_CIOM_oFMSNet_Rx_BC_d_084c823c: start-on-event=DemSatellite_OsApplication_Untrusted_Core0InternalBehavior/GetEventFreezeFrameDataEx, operation=EvtInfo_AutoCreatedDemEvent_CC_EnableDM_CIOM_oFMSNet_Rx_BC_dd2c1510_BswMReportFailToDemRef.GetEventFreezeFrameDataEx
        OpEventGetEventFreezeFrameDataEx_GetEventFreezeFrameDataEx_EvtInfo_AutoCreatedDemEvent_CC_EnablePDUGroup_CIOM_oLIN03_Tx_b1c7b33c: start-on-event=DemSatellite_OsApplication_Untrusted_Core0InternalBehavior/GetEventFreezeFrameDataEx, operation=EvtInfo_AutoCreatedDemEvent_CC_EnablePDUGroup_CIOM_oLIN03_Tx_99f717c2_BswMReportFailToDemRef.GetEventFreezeFrameDataEx
        OpEventGetEventFreezeFrameDataEx_GetEventFreezeFrameDataEx_EvtInfo_AutoCreatedDemEvent_CC_EnablePDUGroup_CIOM_oLIN03_Rx_886ad6c2: start-on-event=DemSatellite_OsApplication_Untrusted_Core0InternalBehavior/GetEventFreezeFrameDataEx, operation=EvtInfo_AutoCreatedDemEvent_CC_EnablePDUGroup_CIOM_oLIN03_Rx_cfadb044_BswMReportFailToDemRef.GetEventFreezeFrameDataEx
        OpEventGetEventFreezeFrameDataEx_GetEventFreezeFrameDataEx_EvtInfo_AutoCreatedDemEvent_CC_DisablePDUGroup_CIOM_oLIN02_T_9749db28: start-on-event=DemSatellite_OsApplication_Untrusted_Core0InternalBehavior/GetEventFreezeFrameDataEx, operation=EvtInfo_AutoCreatedDemEvent_CC_DisablePDUGroup_CIOM_oLIN02_Tx_214b70a7_BswMReportFailToDemRef.GetEventFreezeFrameDataEx
        OpEventGetEventFreezeFrameDataEx_GetEventFreezeFrameDataEx_EvtInfo_AutoCreatedDemEvent_CC_DisablePDUGroup_CIOM_oLIN02_R_4183184a: start-on-event=DemSatellite_OsApplication_Untrusted_Core0InternalBehavior/GetEventFreezeFrameDataEx, operation=EvtInfo_AutoCreatedDemEvent_CC_DisablePDUGroup_CIOM_oLIN02_Rx_7711d721_BswMReportFailToDemRef.GetEventFreezeFrameDataEx
        OpEventGetEventFreezeFrameDataEx_GetEventFreezeFrameDataEx_EvtInfo_AutoCreatedDemEvent_CC_DisablePDUGroup_CIOM_oCabSubn_d90e4eab: start-on-event=DemSatellite_OsApplication_Untrusted_Core0InternalBehavior/GetEventFreezeFrameDataEx, operation=EvtInfo_AutoCreatedDemEvent_CC_DisablePDUGroup_CIOM_oCabSubnet_Rx_063a5fbc_BswMReportFailToDemRef.GetEventFreezeFrameDataEx
        OpEventGetEventFreezeFrameDataEx_GetEventFreezeFrameDataEx_EvtInfo_AutoCreatedDemEvent_CC_EnablePDUGroup_CIOM_oCabSubne_f99e2c45: start-on-event=DemSatellite_OsApplication_Untrusted_Core0InternalBehavior/GetEventFreezeFrameDataEx, operation=EvtInfo_AutoCreatedDemEvent_CC_EnablePDUGroup_CIOM_oCabSubnet_Rx_063a5fbc_BswMReportFailToDemRef.GetEventFreezeFrameDataEx
        OpEventGetEventFreezeFrameDataEx_GetEventFreezeFrameDataEx_EvtInfo_AutoCreatedDemEvent_CC_DisablePDUGroup_CIOM_oFMSNet_91f9d676: start-on-event=DemSatellite_OsApplication_Untrusted_Core0InternalBehavior/GetEventFreezeFrameDataEx, operation=EvtInfo_AutoCreatedDemEvent_CC_DisablePDUGroup_CIOM_oFMSNet_Rx_BC_dd2c1510_BswMReportFailToDemRef.GetEventFreezeFrameDataEx
        OpEventGetEventFreezeFrameDataEx_GetEventFreezeFrameDataEx_EvtInfo_AutoCreatedDemEvent_CC_EnablePDUGroup_CIOM_oFMSNet_R_b169b498: start-on-event=DemSatellite_OsApplication_Untrusted_Core0InternalBehavior/GetEventFreezeFrameDataEx, operation=EvtInfo_AutoCreatedDemEvent_CC_EnablePDUGroup_CIOM_oFMSNet_Rx_BC_dd2c1510_BswMReportFailToDemRef.GetEventFreezeFrameDataEx
        OpEventGetEventFreezeFrameDataEx_GetEventFreezeFrameDataEx_EvtInfo_AutoCreatedDemEvent_CC_DisablePDUGroup_CIOM_oSecurit_be89ac0b: start-on-event=DemSatellite_OsApplication_Untrusted_Core0InternalBehavior/GetEventFreezeFrameDataEx, operation=EvtInfo_AutoCreatedDemEvent_CC_DisablePDUGroup_CIOM_oSecuritySubnet_Rx_3a3c1dbc_BswMReportFailToDemRef.GetEventFreezeFrameDataEx
        OpEventGetEventFreezeFrameDataEx_GetEventFreezeFrameDataEx_EvtInfo_AutoCreatedDemEvent_CC_EnablePDUGroup_CIOM_oSecurity_d0d5766f: start-on-event=DemSatellite_OsApplication_Untrusted_Core0InternalBehavior/GetEventFreezeFrameDataEx, operation=EvtInfo_AutoCreatedDemEvent_CC_EnablePDUGroup_CIOM_oSecuritySubnet_Rx_3a3c1dbc_BswMReportFailToDemRef.GetEventFreezeFrameDataEx
        OpEventGetEventFreezeFrameDataEx_GetEventFreezeFrameDataEx_EvtInfo_AutoCreatedDemEvent_CC_DisablePDUGroup_CIOM_oFMSNet_91eb0106: start-on-event=DemSatellite_OsApplication_Untrusted_Core0InternalBehavior/GetEventFreezeFrameDataEx, operation=EvtInfo_AutoCreatedDemEvent_CC_DisablePDUGroup_CIOM_oFMSNet_Tx_0x31_BC_38fc8c7d_BswMReportFailToDemRef.GetEventFreezeFrameDataEx
        OpEventGetEventFreezeFrameDataEx_GetEventFreezeFrameDataEx_EvtInfo_AutoCreatedDemEvent_CC_EnablePDUGroup_CIOM_oFMSNet_T_ffb7db62: start-on-event=DemSatellite_OsApplication_Untrusted_Core0InternalBehavior/GetEventFreezeFrameDataEx, operation=EvtInfo_AutoCreatedDemEvent_CC_EnablePDUGroup_CIOM_oFMSNet_Tx_0x31_BC_38fc8c7d_BswMReportFailToDemRef.GetEventFreezeFrameDataEx
        OpEventGetEventFreezeFrameDataEx_GetEventFreezeFrameDataEx_EvtInfo_AutoCreatedDemEvent_CC_DisablePDUGroup_CIOM_oSecurit_70561e6a: start-on-event=DemSatellite_OsApplication_Untrusted_Core0InternalBehavior/GetEventFreezeFrameDataEx, operation=EvtInfo_AutoCreatedDemEvent_CC_DisablePDUGroup_CIOM_oSecuritySubnet_Tx_6c66ba3a_BswMReportFailToDemRef.GetEventFreezeFrameDataEx
        OpEventGetEventFreezeFrameDataEx_GetEventFreezeFrameDataEx_EvtInfo_AutoCreatedDemEvent_CC_EnablePDUGroup_CIOM_oSecurity_1e0ac40e: start-on-event=DemSatellite_OsApplication_Untrusted_Core0InternalBehavior/GetEventFreezeFrameDataEx, operation=EvtInfo_AutoCreatedDemEvent_CC_EnablePDUGroup_CIOM_oSecuritySubnet_Tx_6c66ba3a_BswMReportFailToDemRef.GetEventFreezeFrameDataEx
        OpEventGetEventFreezeFrameDataEx_GetEventFreezeFrameDataEx_EvtInfo_AutoCreatedDemEvent_CC_DisablePDUGroup_CIOM_oLIN00_T_16d0d641: start-on-event=DemSatellite_OsApplication_Untrusted_Core0InternalBehavior/GetEventFreezeFrameDataEx, operation=EvtInfo_AutoCreatedDemEvent_CC_DisablePDUGroup_CIOM_oLIN00_Tx_8b42b82c_BswMReportFailToDemRef.GetEventFreezeFrameDataEx
        OpEventGetEventFreezeFrameDataEx_GetEventFreezeFrameDataEx_EvtInfo_AutoCreatedDemEvent_CC_EnablePDUGroup_CIOM_oLIN00_Rx_23501c3e: start-on-event=DemSatellite_OsApplication_Untrusted_Core0InternalBehavior/GetEventFreezeFrameDataEx, operation=EvtInfo_AutoCreatedDemEvent_CC_EnablePDUGroup_CIOM_oLIN00_Rx_dd181faa_BswMReportFailToDemRef.GetEventFreezeFrameDataEx
        OpEventGetEventFreezeFrameDataEx_GetEventFreezeFrameDataEx_EvtInfo_AutoCreatedDemEvent_ESH_Action_ComMCheckPendingReque_ba9c1d12: start-on-event=DemSatellite_OsApplication_Untrusted_Core0InternalBehavior/GetEventFreezeFrameDataEx, operation=EvtInfo_AutoCreatedDemEvent_ESH_Action_ComMCheckPendingRequests_BswMReportFailToDemRef.GetEventFreezeFrameDataEx
        OpEventGetEventFreezeFrameDataEx_GetEventFreezeFrameDataEx_EvtInfo_AutoCreatedDemEvent_CC_DisableDM_CIOM_oBackbone1J193_2b0a6695: start-on-event=DemSatellite_OsApplication_Untrusted_Core0InternalBehavior/GetEventFreezeFrameDataEx, operation=EvtInfo_AutoCreatedDemEvent_CC_DisableDM_CIOM_oBackbone1J1939_Rx_BC_405bc776_BswMReportFailToDemRef.GetEventFreezeFrameDataEx
        OpEventGetEventFreezeFrameDataEx_GetEventFreezeFrameDataEx_EvtInfo_AutoCreatedDemEvent_CC_DisablePDUGroup_CIOM_oLIN00_R_9724a4e2: start-on-event=DemSatellite_OsApplication_Untrusted_Core0InternalBehavior/GetEventFreezeFrameDataEx, operation=EvtInfo_AutoCreatedDemEvent_CC_DisablePDUGroup_CIOM_oLIN00_Rx_dd181faa_BswMReportFailToDemRef.GetEventFreezeFrameDataEx
        OpEventGetEventFreezeFrameDataEx_GetEventFreezeFrameDataEx_EvtInfo_AutoCreatedDemEvent_CC_EnablePDUGroup_CIOM_oLIN00_Tx_a2a46e9d: start-on-event=DemSatellite_OsApplication_Untrusted_Core0InternalBehavior/GetEventFreezeFrameDataEx, operation=EvtInfo_AutoCreatedDemEvent_CC_EnablePDUGroup_CIOM_oLIN00_Tx_8b42b82c_BswMReportFailToDemRef.GetEventFreezeFrameDataEx
        OpEventGetEventFreezeFrameDataEx_GetEventFreezeFrameDataEx_EvtInfo_AutoCreatedDemEvent_ESH_Action_EnterExclusiveArea_Bs_491e7bee: start-on-event=DemSatellite_OsApplication_Untrusted_Core0InternalBehavior/GetEventFreezeFrameDataEx, operation=EvtInfo_AutoCreatedDemEvent_ESH_Action_EnterExclusiveArea_BswMReportFailToDemRef.GetEventFreezeFrameDataEx
        OpEventGetEventFreezeFrameDataEx_GetEventFreezeFrameDataEx_EvtInfo_AutoCreatedDemEvent_ESH_RunToPostRunNested_BswMRepor_52c6a2c5: start-on-event=DemSatellite_OsApplication_Untrusted_Core0InternalBehavior/GetEventFreezeFrameDataEx, operation=EvtInfo_AutoCreatedDemEvent_ESH_RunToPostRunNested_BswMReportFailToDemRef.GetEventFreezeFrameDataEx
        OpEventGetEventFreezeFrameDataEx_GetEventFreezeFrameDataEx_EvtInfo_AutoCreatedDemEvent_CC_EnableDM_CIOM_oBackbone1J1939_484b9813: start-on-event=DemSatellite_OsApplication_Untrusted_Core0InternalBehavior/GetEventFreezeFrameDataEx, operation=EvtInfo_AutoCreatedDemEvent_CC_EnableDM_CIOM_oBackbone1J1939_Rx_BC_405bc776_BswMReportFailToDemRef.GetEventFreezeFrameDataEx
        OpEventGetEventFreezeFrameDataEx_GetEventFreezeFrameDataEx_EvtInfo_AutoCreatedDemEvent_CC_DisablePDUGroup_CIOM_oBackbon_f397c1cc: start-on-event=DemSatellite_OsApplication_Untrusted_Core0InternalBehavior/GetEventFreezeFrameDataEx, operation=EvtInfo_AutoCreatedDemEvent_CC_DisablePDUGroup_CIOM_oBackbone1J1939_Tx_0x31_BC_3782f500_BswMReportFailToDemRef.GetEventFreezeFrameDataEx
        OpEventGetEventFreezeFrameDataEx_GetEventFreezeFrameDataEx_EvtInfo_AutoCreatedDemEvent_CC_J1939RmStateSwitch_CN_FMSNet_0377b5a3: start-on-event=DemSatellite_OsApplication_Untrusted_Core0InternalBehavior/GetEventFreezeFrameDataEx, operation=EvtInfo_AutoCreatedDemEvent_CC_J1939RmStateSwitch_CN_FMSNet_fce1aae5_CIOM_3a3d59b1_J1939RM_STATE_OFFLINE_BswMReportFailToDemRef.GetEventFreezeFrameDataEx
        OpEventGetEventFreezeFrameDataEx_GetEventFreezeFrameDataEx_EvtInfo_AutoCreatedDemEvent_CC_EnablePDUGroup_CIOM_oBackbone_f5cb3226: start-on-event=DemSatellite_OsApplication_Untrusted_Core0InternalBehavior/GetEventFreezeFrameDataEx, operation=EvtInfo_AutoCreatedDemEvent_CC_EnablePDUGroup_CIOM_oBackbone1J1939_Tx_0x31_BC_3782f500_BswMReportFailToDemRef.GetEventFreezeFrameDataEx
        OpEventGetEventFreezeFrameDataEx_GetEventFreezeFrameDataEx_EvtInfo_AutoCreatedDemEvent_CC_J1939RmStateSwitch_CN_FMSNet_1b110f5b: start-on-event=DemSatellite_OsApplication_Untrusted_Core0InternalBehavior/GetEventFreezeFrameDataEx, operation=EvtInfo_AutoCreatedDemEvent_CC_J1939RmStateSwitch_CN_FMSNet_fce1aae5_CIOM_3a3d59b1_J1939RM_STATE_ONLINE_BswMReportFailToDemRef.GetEventFreezeFrameDataEx
        OpEventGetEventFreezeFrameDataEx_GetEventFreezeFrameDataEx_EvtInfo_AutoCreatedDemEvent_ESH_Action_CancelNvMWriteAll_Bsw_38149945: start-on-event=DemSatellite_OsApplication_Untrusted_Core0InternalBehavior/GetEventFreezeFrameDataEx, operation=EvtInfo_AutoCreatedDemEvent_ESH_Action_CancelNvMWriteAll_BswMReportFailToDemRef.GetEventFreezeFrameDataEx
        OpEventGetEventFreezeFrameDataEx_GetEventFreezeFrameDataEx_EvtInfo_AutoCreatedDemEvent_ESH_Action_CancelWriteAllTimer_S_67be9d64: start-on-event=DemSatellite_OsApplication_Untrusted_Core0InternalBehavior/GetEventFreezeFrameDataEx, operation=EvtInfo_AutoCreatedDemEvent_ESH_Action_CancelWriteAllTimer_Start_BswMReportFailToDemRef.GetEventFreezeFrameDataEx
        OpEventGetEventFreezeFrameDataEx_GetEventFreezeFrameDataEx_EvtInfo_AutoCreatedDemEvent_ESH_Action_CancelWriteAllTimer_S_24610acb: start-on-event=DemSatellite_OsApplication_Untrusted_Core0InternalBehavior/GetEventFreezeFrameDataEx, operation=EvtInfo_AutoCreatedDemEvent_ESH_Action_CancelWriteAllTimer_Stop_BswMReportFailToDemRef.GetEventFreezeFrameDataEx
        OpEventGetEventFreezeFrameDataEx_GetEventFreezeFrameDataEx_EvtInfo_AutoCreatedDemEvent_ESH_Action_ComMAllow_CN_Backbone_d669a304: start-on-event=DemSatellite_OsApplication_Untrusted_Core0InternalBehavior/GetEventFreezeFrameDataEx, operation=EvtInfo_AutoCreatedDemEvent_ESH_Action_ComMAllow_CN_Backbone1J1939_0b1f4bae_BswMReportFailToDemRef.GetEventFreezeFrameDataEx
        OpEventGetEventFreezeFrameDataEx_GetEventFreezeFrameDataEx_EvtInfo_AutoCreatedDemEvent_ESH_Action_ComMAllow_CN_Backbone_0697b261: start-on-event=DemSatellite_OsApplication_Untrusted_Core0InternalBehavior/GetEventFreezeFrameDataEx, operation=EvtInfo_AutoCreatedDemEvent_ESH_Action_ComMAllow_CN_Backbone1J1939_0b1f4bae_BswMReportFailToDemRef_1.GetEventFreezeFrameDataEx
        OpEventGetEventFreezeFrameDataEx_GetEventFreezeFrameDataEx_EvtInfo_AutoCreatedDemEvent_ESH_Action_ComMAllow_CN_Backbone_dde8dbd6: start-on-event=DemSatellite_OsApplication_Untrusted_Core0InternalBehavior/GetEventFreezeFrameDataEx, operation=EvtInfo_AutoCreatedDemEvent_ESH_Action_ComMAllow_CN_Backbone2_78967e2c_BswMReportFailToDemRef.GetEventFreezeFrameDataEx
        OpEventGetEventFreezeFrameDataEx_GetEventFreezeFrameDataEx_EvtInfo_AutoCreatedDemEvent_ESH_Action_ComMAllow_CN_Backbone_eb47e773: start-on-event=DemSatellite_OsApplication_Untrusted_Core0InternalBehavior/GetEventFreezeFrameDataEx, operation=EvtInfo_AutoCreatedDemEvent_ESH_Action_ComMAllow_CN_Backbone2_78967e2c_BswMReportFailToDemRef_1.GetEventFreezeFrameDataEx
        OpEventGetEventFreezeFrameDataEx_GetEventFreezeFrameDataEx_EvtInfo_AutoCreatedDemEvent_ESH_Action_ComMAllow_CN_CabSubne_002aeda0: start-on-event=DemSatellite_OsApplication_Untrusted_Core0InternalBehavior/GetEventFreezeFrameDataEx, operation=EvtInfo_AutoCreatedDemEvent_ESH_Action_ComMAllow_CN_CabSubnet_9ea693f1_BswMReportFailToDemRef.GetEventFreezeFrameDataEx
        OpEventGetEventFreezeFrameDataEx_GetEventFreezeFrameDataEx_EvtInfo_AutoCreatedDemEvent_ESH_Action_ComMAllow_CN_CabSubne_5d987158: start-on-event=DemSatellite_OsApplication_Untrusted_Core0InternalBehavior/GetEventFreezeFrameDataEx, operation=EvtInfo_AutoCreatedDemEvent_ESH_Action_ComMAllow_CN_CabSubnet_9ea693f1_BswMReportFailToDemRef_1.GetEventFreezeFrameDataEx
        OpEventGetEventFreezeFrameDataEx_GetEventFreezeFrameDataEx_EvtInfo_AutoCreatedDemEvent_ESH_Action_ComMAllow_CN_FMSNet_f_554acae9: start-on-event=DemSatellite_OsApplication_Untrusted_Core0InternalBehavior/GetEventFreezeFrameDataEx, operation=EvtInfo_AutoCreatedDemEvent_ESH_Action_ComMAllow_CN_FMSNet_fce1aae5_BswMReportFailToDemRef.GetEventFreezeFrameDataEx
        OpEventGetEventFreezeFrameDataEx_GetEventFreezeFrameDataEx_EvtInfo_AutoCreatedDemEvent_ESH_Action_ComMAllow_CN_FMSNet_f_d929651f: start-on-event=DemSatellite_OsApplication_Untrusted_Core0InternalBehavior/GetEventFreezeFrameDataEx, operation=EvtInfo_AutoCreatedDemEvent_ESH_Action_ComMAllow_CN_FMSNet_fce1aae5_BswMReportFailToDemRef_1.GetEventFreezeFrameDataEx
        OpEventGetEventFreezeFrameDataEx_GetEventFreezeFrameDataEx_EvtInfo_AutoCreatedDemEvent_ESH_Action_ComMAllow_CN_LIN00_2c_7e9b992d: start-on-event=DemSatellite_OsApplication_Untrusted_Core0InternalBehavior/GetEventFreezeFrameDataEx, operation=EvtInfo_AutoCreatedDemEvent_ESH_Action_ComMAllow_CN_LIN00_2cd9a7df_BswMReportFailToDemRef.GetEventFreezeFrameDataEx
        OpEventGetEventFreezeFrameDataEx_GetEventFreezeFrameDataEx_EvtInfo_AutoCreatedDemEvent_ESH_Action_ComMAllow_CN_LIN00_2c_84dd5cca: start-on-event=DemSatellite_OsApplication_Untrusted_Core0InternalBehavior/GetEventFreezeFrameDataEx, operation=EvtInfo_AutoCreatedDemEvent_ESH_Action_ComMAllow_CN_LIN00_2cd9a7df_BswMReportFailToDemRef_1.GetEventFreezeFrameDataEx
        OpEventGetEventFreezeFrameDataEx_GetEventFreezeFrameDataEx_EvtInfo_AutoCreatedDemEvent_ESH_Action_ComMAllow_CN_LIN01_5b_462b1ef1: start-on-event=DemSatellite_OsApplication_Untrusted_Core0InternalBehavior/GetEventFreezeFrameDataEx, operation=EvtInfo_AutoCreatedDemEvent_ESH_Action_ComMAllow_CN_LIN01_5bde9749_BswMReportFailToDemRef.GetEventFreezeFrameDataEx
        OpEventGetEventFreezeFrameDataEx_GetEventFreezeFrameDataEx_EvtInfo_AutoCreatedDemEvent_ESH_Action_ComMAllow_CN_LIN01_5b_da8cf8ea: start-on-event=DemSatellite_OsApplication_Untrusted_Core0InternalBehavior/GetEventFreezeFrameDataEx, operation=EvtInfo_AutoCreatedDemEvent_ESH_Action_ComMAllow_CN_LIN01_5bde9749_BswMReportFailToDemRef_1.GetEventFreezeFrameDataEx
        OpEventGetEventFreezeFrameDataEx_GetEventFreezeFrameDataEx_EvtInfo_AutoCreatedDemEvent_ESH_Action_ComMAllow_CN_LIN02_c2_bb56e295: start-on-event=DemSatellite_OsApplication_Untrusted_Core0InternalBehavior/GetEventFreezeFrameDataEx, operation=EvtInfo_AutoCreatedDemEvent_ESH_Action_ComMAllow_CN_LIN02_c2d7c6f3_BswMReportFailToDemRef.GetEventFreezeFrameDataEx
        OpEventGetEventFreezeFrameDataEx_GetEventFreezeFrameDataEx_EvtInfo_AutoCreatedDemEvent_ESH_Action_ComMAllow_CN_LIN02_c2_6f161503: start-on-event=DemSatellite_OsApplication_Untrusted_Core0InternalBehavior/GetEventFreezeFrameDataEx, operation=EvtInfo_AutoCreatedDemEvent_ESH_Action_ComMAllow_CN_LIN02_c2d7c6f3_BswMReportFailToDemRef_1.GetEventFreezeFrameDataEx
        OpEventGetEventFreezeFrameDataEx_GetEventFreezeFrameDataEx_EvtInfo_AutoCreatedDemEvent_ESH_Action_ComMAllow_CN_LIN03_b5_6ea25e1f: start-on-event=DemSatellite_OsApplication_Untrusted_Core0InternalBehavior/GetEventFreezeFrameDataEx, operation=EvtInfo_AutoCreatedDemEvent_ESH_Action_ComMAllow_CN_LIN03_b5d0f665_BswMReportFailToDemRef.GetEventFreezeFrameDataEx
        OpEventGetEventFreezeFrameDataEx_GetEventFreezeFrameDataEx_EvtInfo_AutoCreatedDemEvent_ESH_Action_ComMAllow_CN_LIN03_b5_6cad4f91: start-on-event=DemSatellite_OsApplication_Untrusted_Core0InternalBehavior/GetEventFreezeFrameDataEx, operation=EvtInfo_AutoCreatedDemEvent_ESH_Action_ComMAllow_CN_LIN03_b5d0f665_BswMReportFailToDemRef_1.GetEventFreezeFrameDataEx
        OpEventGetEventFreezeFrameDataEx_GetEventFreezeFrameDataEx_EvtInfo_AutoCreatedDemEvent_ESH_Action_ComMAllow_CN_LIN04_2b_91eca1c9: start-on-event=DemSatellite_OsApplication_Untrusted_Core0InternalBehavior/GetEventFreezeFrameDataEx, operation=EvtInfo_AutoCreatedDemEvent_ESH_Action_ComMAllow_CN_LIN04_2bb463c6_BswMReportFailToDemRef.GetEventFreezeFrameDataEx
        OpEventGetEventFreezeFrameDataEx_GetEventFreezeFrameDataEx_EvtInfo_AutoCreatedDemEvent_ESH_Action_ComMAllow_CN_LIN04_2b_96cd3dcb: start-on-event=DemSatellite_OsApplication_Untrusted_Core0InternalBehavior/GetEventFreezeFrameDataEx, operation=EvtInfo_AutoCreatedDemEvent_ESH_Action_ComMAllow_CN_LIN04_2bb463c6_BswMReportFailToDemRef_1.GetEventFreezeFrameDataEx
        OpEventGetEventFreezeFrameDataEx_GetEventFreezeFrameDataEx_EvtInfo_AutoCreatedDemEvent_ESH_Action_ComMAllow_CN_Security_78e322c2: start-on-event=DemSatellite_OsApplication_Untrusted_Core0InternalBehavior/GetEventFreezeFrameDataEx, operation=EvtInfo_AutoCreatedDemEvent_ESH_Action_ComMAllow_CN_SecuritySubnet_e7a0ee54_BswMReportFailToDemRef.GetEventFreezeFrameDataEx
        OpEventGetEventFreezeFrameDataEx_GetEventFreezeFrameDataEx_EvtInfo_AutoCreatedDemEvent_ESH_Action_ComMAllow_CN_Security_0188df95: start-on-event=DemSatellite_OsApplication_Untrusted_Core0InternalBehavior/GetEventFreezeFrameDataEx, operation=EvtInfo_AutoCreatedDemEvent_ESH_Action_ComMAllow_CN_SecuritySubnet_e7a0ee54_BswMReportFailToDemRef_1.GetEventFreezeFrameDataEx
        OpEventGetEventFreezeFrameDataEx_GetEventFreezeFrameDataEx_EvtInfo_AutoCreatedDemEvent_ESH_Action_ComMCheckPendingReque_36d6f5c8: start-on-event=DemSatellite_OsApplication_Untrusted_Core0InternalBehavior/GetEventFreezeFrameDataEx, operation=EvtInfo_AutoCreatedDemEvent_ESH_Action_ComMCheckPendingRequests_BswMReportFailToDemRef_1.GetEventFreezeFrameDataEx
        OpEventGetEventFreezeFrameDataEx_GetEventFreezeFrameDataEx_EvtInfo_AutoCreatedDemEvent_ESH_Action_ComMCheckPendingReque_afdfa472: start-on-event=DemSatellite_OsApplication_Untrusted_Core0InternalBehavior/GetEventFreezeFrameDataEx, operation=EvtInfo_AutoCreatedDemEvent_ESH_Action_ComMCheckPendingRequests_BswMReportFailToDemRef_2.GetEventFreezeFrameDataEx
        OpEventGetEventFreezeFrameDataEx_GetEventFreezeFrameDataEx_EvtInfo_AutoCreatedDemEvent_ESH_Action_ComMDisallow_CN_Backb_cc72a968: start-on-event=DemSatellite_OsApplication_Untrusted_Core0InternalBehavior/GetEventFreezeFrameDataEx, operation=EvtInfo_AutoCreatedDemEvent_ESH_Action_ComMDisallow_CN_Backbone1J1939_0b1f4bae_BswMReportFailToDemRef.GetEventFreezeFrameDataEx
        OpEventGetEventFreezeFrameDataEx_GetEventFreezeFrameDataEx_EvtInfo_AutoCreatedDemEvent_ESH_Action_ComMDisallow_CN_Backb_9529d89b: start-on-event=DemSatellite_OsApplication_Untrusted_Core0InternalBehavior/GetEventFreezeFrameDataEx, operation=EvtInfo_AutoCreatedDemEvent_ESH_Action_ComMDisallow_CN_Backbone2_78967e2c_BswMReportFailToDemRef.GetEventFreezeFrameDataEx
        OpEventGetEventFreezeFrameDataEx_GetEventFreezeFrameDataEx_EvtInfo_AutoCreatedDemEvent_ESH_Action_ComMDisallow_CN_CabSu_48ebeeed: start-on-event=DemSatellite_OsApplication_Untrusted_Core0InternalBehavior/GetEventFreezeFrameDataEx, operation=EvtInfo_AutoCreatedDemEvent_ESH_Action_ComMDisallow_CN_CabSubnet_9ea693f1_BswMReportFailToDemRef.GetEventFreezeFrameDataEx
        OpEventGetEventFreezeFrameDataEx_GetEventFreezeFrameDataEx_EvtInfo_AutoCreatedDemEvent_ESH_Action_ComMDisallow_CN_FMSNe_26cb78ef: start-on-event=DemSatellite_OsApplication_Untrusted_Core0InternalBehavior/GetEventFreezeFrameDataEx, operation=EvtInfo_AutoCreatedDemEvent_ESH_Action_ComMDisallow_CN_FMSNet_fce1aae5_BswMReportFailToDemRef.GetEventFreezeFrameDataEx
        OpEventGetEventFreezeFrameDataEx_GetEventFreezeFrameDataEx_EvtInfo_AutoCreatedDemEvent_ESH_Action_ComMDisallow_CN_LIN00_233f1caa: start-on-event=DemSatellite_OsApplication_Untrusted_Core0InternalBehavior/GetEventFreezeFrameDataEx, operation=EvtInfo_AutoCreatedDemEvent_ESH_Action_ComMDisallow_CN_LIN00_2cd9a7df_BswMReportFailToDemRef.GetEventFreezeFrameDataEx
        OpEventGetEventFreezeFrameDataEx_GetEventFreezeFrameDataEx_EvtInfo_AutoCreatedDemEvent_ESH_Action_ComMDisallow_CN_LIN01_1b8f9b76: start-on-event=DemSatellite_OsApplication_Untrusted_Core0InternalBehavior/GetEventFreezeFrameDataEx, operation=EvtInfo_AutoCreatedDemEvent_ESH_Action_ComMDisallow_CN_LIN01_5bde9749_BswMReportFailToDemRef.GetEventFreezeFrameDataEx
        OpEventGetEventFreezeFrameDataEx_GetEventFreezeFrameDataEx_EvtInfo_AutoCreatedDemEvent_ESH_Action_ComMDisallow_CN_LIN02_e6f26712: start-on-event=DemSatellite_OsApplication_Untrusted_Core0InternalBehavior/GetEventFreezeFrameDataEx, operation=EvtInfo_AutoCreatedDemEvent_ESH_Action_ComMDisallow_CN_LIN02_c2d7c6f3_BswMReportFailToDemRef.GetEventFreezeFrameDataEx
        OpEventGetEventFreezeFrameDataEx_GetEventFreezeFrameDataEx_EvtInfo_AutoCreatedDemEvent_ESH_Action_ComMDisallow_CN_LIN03_3306db98: start-on-event=DemSatellite_OsApplication_Untrusted_Core0InternalBehavior/GetEventFreezeFrameDataEx, operation=EvtInfo_AutoCreatedDemEvent_ESH_Action_ComMDisallow_CN_LIN03_b5d0f665_BswMReportFailToDemRef.GetEventFreezeFrameDataEx
        OpEventGetEventFreezeFrameDataEx_GetEventFreezeFrameDataEx_EvtInfo_AutoCreatedDemEvent_ESH_Action_ComMDisallow_CN_LIN04_cc48244e: start-on-event=DemSatellite_OsApplication_Untrusted_Core0InternalBehavior/GetEventFreezeFrameDataEx, operation=EvtInfo_AutoCreatedDemEvent_ESH_Action_ComMDisallow_CN_LIN04_2bb463c6_BswMReportFailToDemRef.GetEventFreezeFrameDataEx
        OpEventGetEventFreezeFrameDataEx_GetEventFreezeFrameDataEx_EvtInfo_AutoCreatedDemEvent_ESH_Action_ComMDisallow_CN_Secur_62f828ae: start-on-event=DemSatellite_OsApplication_Untrusted_Core0InternalBehavior/GetEventFreezeFrameDataEx, operation=EvtInfo_AutoCreatedDemEvent_ESH_Action_ComMDisallow_CN_SecuritySubnet_e7a0ee54_BswMReportFailToDemRef.GetEventFreezeFrameDataEx
        OpEventGetEventFreezeFrameDataEx_GetEventFreezeFrameDataEx_EvtInfo_AutoCreatedDemEvent_ESH_Action_DemInit_BswMReportFailToDemRef: start-on-event=DemSatellite_OsApplication_Untrusted_Core0InternalBehavior/GetEventFreezeFrameDataEx, operation=EvtInfo_AutoCreatedDemEvent_ESH_Action_DemInit_BswMReportFailToDemRef.GetEventFreezeFrameDataEx
        OpEventGetEventFreezeFrameDataEx_GetEventFreezeFrameDataEx_EvtInfo_AutoCreatedDemEvent_ESH_Action_DemInitialized_BswMRe_ea9b863b: start-on-event=DemSatellite_OsApplication_Untrusted_Core0InternalBehavior/GetEventFreezeFrameDataEx, operation=EvtInfo_AutoCreatedDemEvent_ESH_Action_DemInitialized_BswMReportFailToDemRef.GetEventFreezeFrameDataEx
        OpEventGetEventFreezeFrameDataEx_GetEventFreezeFrameDataEx_EvtInfo_AutoCreatedDemEvent_ESH_Action_DemNotInitialized_Bsw_47fb69f8: start-on-event=DemSatellite_OsApplication_Untrusted_Core0InternalBehavior/GetEventFreezeFrameDataEx, operation=EvtInfo_AutoCreatedDemEvent_ESH_Action_DemNotInitialized_BswMReportFailToDemRef.GetEventFreezeFrameDataEx
        OpEventGetEventFreezeFrameDataEx_GetEventFreezeFrameDataEx_EvtInfo_AutoCreatedDemEvent_ESH_Action_DemShutdown_BswMRepor_a1f84876: start-on-event=DemSatellite_OsApplication_Untrusted_Core0InternalBehavior/GetEventFreezeFrameDataEx, operation=EvtInfo_AutoCreatedDemEvent_ESH_Action_DemShutdown_BswMReportFailToDemRef.GetEventFreezeFrameDataEx
        OpEventGetEventFreezeFrameDataEx_GetEventFreezeFrameDataEx_EvtInfo_AutoCreatedDemEvent_ESH_Action_ESH_PostRun_BswMRepor_445e76ec: start-on-event=DemSatellite_OsApplication_Untrusted_Core0InternalBehavior/GetEventFreezeFrameDataEx, operation=EvtInfo_AutoCreatedDemEvent_ESH_Action_ESH_PostRun_BswMReportFailToDemRef.GetEventFreezeFrameDataEx
        OpEventGetEventFreezeFrameDataEx_GetEventFreezeFrameDataEx_EvtInfo_AutoCreatedDemEvent_ESH_Action_ESH_PrepShutdown_BswM_e9772353: start-on-event=DemSatellite_OsApplication_Untrusted_Core0InternalBehavior/GetEventFreezeFrameDataEx, operation=EvtInfo_AutoCreatedDemEvent_ESH_Action_ESH_PrepShutdown_BswMReportFailToDemRef.GetEventFreezeFrameDataEx
        OpEventGetEventFreezeFrameDataEx_GetEventFreezeFrameDataEx_EvtInfo_AutoCreatedDemEvent_ESH_Action_ESH_PrepShutdown_BswM_1ed5c5cc: start-on-event=DemSatellite_OsApplication_Untrusted_Core0InternalBehavior/GetEventFreezeFrameDataEx, operation=EvtInfo_AutoCreatedDemEvent_ESH_Action_ESH_PrepShutdown_BswMReportFailToDemRef_1.GetEventFreezeFrameDataEx
        OpEventGetEventFreezeFrameDataEx_GetEventFreezeFrameDataEx_EvtInfo_AutoCreatedDemEvent_ESH_Action_ESH_Run_BswMReportFailToDemRef: start-on-event=DemSatellite_OsApplication_Untrusted_Core0InternalBehavior/GetEventFreezeFrameDataEx, operation=EvtInfo_AutoCreatedDemEvent_ESH_Action_ESH_Run_BswMReportFailToDemRef.GetEventFreezeFrameDataEx
        OpEventGetEventFreezeFrameDataEx_GetEventFreezeFrameDataEx_EvtInfo_AutoCreatedDemEvent_ESH_Action_ESH_Run_BswMReportFai_c2b61ad0: start-on-event=DemSatellite_OsApplication_Untrusted_Core0InternalBehavior/GetEventFreezeFrameDataEx, operation=EvtInfo_AutoCreatedDemEvent_ESH_Action_ESH_Run_BswMReportFailToDemRef_1.GetEventFreezeFrameDataEx
        OpEventGetEventFreezeFrameDataEx_GetEventFreezeFrameDataEx_EvtInfo_AutoCreatedDemEvent_ESH_Action_ESH_WaitForNvm_BswMRe_64c6e827: start-on-event=DemSatellite_OsApplication_Untrusted_Core0InternalBehavior/GetEventFreezeFrameDataEx, operation=EvtInfo_AutoCreatedDemEvent_ESH_Action_ESH_WaitForNvm_BswMReportFailToDemRef.GetEventFreezeFrameDataEx
        OpEventGetEventFreezeFrameDataEx_GetEventFreezeFrameDataEx_EvtInfo_AutoCreatedDemEvent_ESH_Action_ESH_Wakeup_BswMReport_d2ca3e86: start-on-event=DemSatellite_OsApplication_Untrusted_Core0InternalBehavior/GetEventFreezeFrameDataEx, operation=EvtInfo_AutoCreatedDemEvent_ESH_Action_ESH_Wakeup_BswMReportFailToDemRef.GetEventFreezeFrameDataEx
        OpEventGetEventFreezeFrameDataEx_GetEventFreezeFrameDataEx_EvtInfo_AutoCreatedDemEvent_ESH_Action_ESH_Wakeup_BswMReport_819ca3f2: start-on-event=DemSatellite_OsApplication_Untrusted_Core0InternalBehavior/GetEventFreezeFrameDataEx, operation=EvtInfo_AutoCreatedDemEvent_ESH_Action_ESH_Wakeup_BswMReportFailToDemRef_1.GetEventFreezeFrameDataEx
        OpEventGetEventFreezeFrameDataEx_GetEventFreezeFrameDataEx_EvtInfo_AutoCreatedDemEvent_ESH_Action_EcuMClearValidatedWak_2a18693f: start-on-event=DemSatellite_OsApplication_Untrusted_Core0InternalBehavior/GetEventFreezeFrameDataEx, operation=EvtInfo_AutoCreatedDemEvent_ESH_Action_EcuMClearValidatedWakeupEvents_BswMReportFailToDemRef.GetEventFreezeFrameDataEx
        OpEventGetEventFreezeFrameDataEx_GetEventFreezeFrameDataEx_EvtInfo_AutoCreatedDemEvent_ESH_Action_EcuMGoToSelectedShutd_8b52d9e9: start-on-event=DemSatellite_OsApplication_Untrusted_Core0InternalBehavior/GetEventFreezeFrameDataEx, operation=EvtInfo_AutoCreatedDemEvent_ESH_Action_EcuMGoToSelectedShutdownTarget_BswMReportFailToDemRef.GetEventFreezeFrameDataEx
        OpEventGetEventFreezeFrameDataEx_GetEventFreezeFrameDataEx_EvtInfo_AutoCreatedDemEvent_ESH_Action_EnterExclusiveArea_Bs_2a0e6c96: start-on-event=DemSatellite_OsApplication_Untrusted_Core0InternalBehavior/GetEventFreezeFrameDataEx, operation=EvtInfo_AutoCreatedDemEvent_ESH_Action_EnterExclusiveArea_BswMReportFailToDemRef_1.GetEventFreezeFrameDataEx
        OpEventGetEventFreezeFrameDataEx_GetEventFreezeFrameDataEx_EvtInfo_AutoCreatedDemEvent_ESH_Action_ExitExclusiveArea_Bsw_c09ab1cc: start-on-event=DemSatellite_OsApplication_Untrusted_Core0InternalBehavior/GetEventFreezeFrameDataEx, operation=EvtInfo_AutoCreatedDemEvent_ESH_Action_ExitExclusiveArea_BswMReportFailToDemRef.GetEventFreezeFrameDataEx
        OpEventGetEventFreezeFrameDataEx_GetEventFreezeFrameDataEx_EvtInfo_AutoCreatedDemEvent_ESH_Action_NvMWriteAll_BswMRepor_c82bf2c7: start-on-event=DemSatellite_OsApplication_Untrusted_Core0InternalBehavior/GetEventFreezeFrameDataEx, operation=EvtInfo_AutoCreatedDemEvent_ESH_Action_NvMWriteAll_BswMReportFailToDemRef.GetEventFreezeFrameDataEx
        OpEventGetEventFreezeFrameDataEx_GetEventFreezeFrameDataEx_EvtInfo_AutoCreatedDemEvent_ESH_Action_OnEnterPostRun_BswMRe_57cbade1: start-on-event=DemSatellite_OsApplication_Untrusted_Core0InternalBehavior/GetEventFreezeFrameDataEx, operation=EvtInfo_AutoCreatedDemEvent_ESH_Action_OnEnterPostRun_BswMReportFailToDemRef.GetEventFreezeFrameDataEx
        OpEventGetEventFreezeFrameDataEx_GetEventFreezeFrameDataEx_EvtInfo_AutoCreatedDemEvent_ESH_Action_OnEnterPrepShutdown_B_7a85e2f3: start-on-event=DemSatellite_OsApplication_Untrusted_Core0InternalBehavior/GetEventFreezeFrameDataEx, operation=EvtInfo_AutoCreatedDemEvent_ESH_Action_OnEnterPrepShutdown_BswMReportFailToDemRef.GetEventFreezeFrameDataEx
        OpEventGetEventFreezeFrameDataEx_GetEventFreezeFrameDataEx_EvtInfo_AutoCreatedDemEvent_ESH_Action_OnEnterPrepShutdown_B_5cb118f1: start-on-event=DemSatellite_OsApplication_Untrusted_Core0InternalBehavior/GetEventFreezeFrameDataEx, operation=EvtInfo_AutoCreatedDemEvent_ESH_Action_OnEnterPrepShutdown_BswMReportFailToDemRef_1.GetEventFreezeFrameDataEx
        OpEventGetEventFreezeFrameDataEx_GetEventFreezeFrameDataEx_EvtInfo_AutoCreatedDemEvent_ESH_Action_OnEnterRun_BswMReport_1f2cc8b4: start-on-event=DemSatellite_OsApplication_Untrusted_Core0InternalBehavior/GetEventFreezeFrameDataEx, operation=EvtInfo_AutoCreatedDemEvent_ESH_Action_OnEnterRun_BswMReportFailToDemRef.GetEventFreezeFrameDataEx
        OpEventGetEventFreezeFrameDataEx_GetEventFreezeFrameDataEx_EvtInfo_AutoCreatedDemEvent_ESH_Action_OnEnterRun_BswMReport_38326d4c: start-on-event=DemSatellite_OsApplication_Untrusted_Core0InternalBehavior/GetEventFreezeFrameDataEx, operation=EvtInfo_AutoCreatedDemEvent_ESH_Action_OnEnterRun_BswMReportFailToDemRef_1.GetEventFreezeFrameDataEx
        OpEventGetEventFreezeFrameDataEx_GetEventFreezeFrameDataEx_EvtInfo_AutoCreatedDemEvent_ESH_Action_OnEnterShutdown_BswMR_60b35e5f: start-on-event=DemSatellite_OsApplication_Untrusted_Core0InternalBehavior/GetEventFreezeFrameDataEx, operation=EvtInfo_AutoCreatedDemEvent_ESH_Action_OnEnterShutdown_BswMReportFailToDemRef.GetEventFreezeFrameDataEx
        OpEventGetEventFreezeFrameDataEx_GetEventFreezeFrameDataEx_EvtInfo_AutoCreatedDemEvent_ESH_Action_OnEnterWaitForNvm_Bsw_8eb70078: start-on-event=DemSatellite_OsApplication_Untrusted_Core0InternalBehavior/GetEventFreezeFrameDataEx, operation=EvtInfo_AutoCreatedDemEvent_ESH_Action_OnEnterWaitForNvm_BswMReportFailToDemRef.GetEventFreezeFrameDataEx
        OpEventGetEventFreezeFrameDataEx_GetEventFreezeFrameDataEx_EvtInfo_AutoCreatedDemEvent_ESH_Action_OnEnterWakeup_BswMRep_2b89659e: start-on-event=DemSatellite_OsApplication_Untrusted_Core0InternalBehavior/GetEventFreezeFrameDataEx, operation=EvtInfo_AutoCreatedDemEvent_ESH_Action_OnEnterWakeup_BswMReportFailToDemRef.GetEventFreezeFrameDataEx
        OpEventGetEventFreezeFrameDataEx_GetEventFreezeFrameDataEx_EvtInfo_AutoCreatedDemEvent_ESH_Action_OnEnterWakeup_BswMRep_ff3e4a94: start-on-event=DemSatellite_OsApplication_Untrusted_Core0InternalBehavior/GetEventFreezeFrameDataEx, operation=EvtInfo_AutoCreatedDemEvent_ESH_Action_OnEnterWakeup_BswMReportFailToDemRef_1.GetEventFreezeFrameDataEx
        OpEventGetEventFreezeFrameDataEx_GetEventFreezeFrameDataEx_EvtInfo_AutoCreatedDemEvent_ESH_Action_SelfRunRequestTimer_S_55c45bbc: start-on-event=DemSatellite_OsApplication_Untrusted_Core0InternalBehavior/GetEventFreezeFrameDataEx, operation=EvtInfo_AutoCreatedDemEvent_ESH_Action_SelfRunRequestTimer_Start_BswMReportFailToDemRef.GetEventFreezeFrameDataEx
        OpEventGetEventFreezeFrameDataEx_GetEventFreezeFrameDataEx_EvtInfo_AutoCreatedDemEvent_ESH_Action_SelfRunRequestTimer_S_99ed6f52: start-on-event=DemSatellite_OsApplication_Untrusted_Core0InternalBehavior/GetEventFreezeFrameDataEx, operation=EvtInfo_AutoCreatedDemEvent_ESH_Action_SelfRunRequestTimer_Start_BswMReportFailToDemRef_1.GetEventFreezeFrameDataEx
        OpEventGetEventFreezeFrameDataEx_GetEventFreezeFrameDataEx_EvtInfo_AutoCreatedDemEvent_ESH_Action_SwitchPostRun_BswMRep_00ba4d09: start-on-event=DemSatellite_OsApplication_Untrusted_Core0InternalBehavior/GetEventFreezeFrameDataEx, operation=EvtInfo_AutoCreatedDemEvent_ESH_Action_SwitchPostRun_BswMReportFailToDemRef.GetEventFreezeFrameDataEx
        OpEventGetEventFreezeFrameDataEx_GetEventFreezeFrameDataEx_EvtInfo_AutoCreatedDemEvent_ESH_Action_SwitchRun_BswMReportF_cbd64269: start-on-event=DemSatellite_OsApplication_Untrusted_Core0InternalBehavior/GetEventFreezeFrameDataEx, operation=EvtInfo_AutoCreatedDemEvent_ESH_Action_SwitchRun_BswMReportFailToDemRef.GetEventFreezeFrameDataEx
        OpEventGetEventFreezeFrameDataEx_GetEventFreezeFrameDataEx_EvtInfo_AutoCreatedDemEvent_ESH_Action_SwitchRun_BswMReportF_01c968da: start-on-event=DemSatellite_OsApplication_Untrusted_Core0InternalBehavior/GetEventFreezeFrameDataEx, operation=EvtInfo_AutoCreatedDemEvent_ESH_Action_SwitchRun_BswMReportFailToDemRef_1.GetEventFreezeFrameDataEx
        OpEventGetEventFreezeFrameDataEx_GetEventFreezeFrameDataEx_EvtInfo_AutoCreatedDemEvent_ESH_Action_SwitchShutdown_BswMRe_ce3545f5: start-on-event=DemSatellite_OsApplication_Untrusted_Core0InternalBehavior/GetEventFreezeFrameDataEx, operation=EvtInfo_AutoCreatedDemEvent_ESH_Action_SwitchShutdown_BswMReportFailToDemRef.GetEventFreezeFrameDataEx
        OpEventGetEventFreezeFrameDataEx_GetEventFreezeFrameDataEx_EvtInfo_AutoCreatedDemEvent_ESH_Action_SwitchShutdown_BswMRe_42593d8c: start-on-event=DemSatellite_OsApplication_Untrusted_Core0InternalBehavior/GetEventFreezeFrameDataEx, operation=EvtInfo_AutoCreatedDemEvent_ESH_Action_SwitchShutdown_BswMReportFailToDemRef_1.GetEventFreezeFrameDataEx
        OpEventGetEventFreezeFrameDataEx_GetEventFreezeFrameDataEx_EvtInfo_AutoCreatedDemEvent_ESH_Action_SwitchWakeup_BswMRepo_32dca8ea: start-on-event=DemSatellite_OsApplication_Untrusted_Core0InternalBehavior/GetEventFreezeFrameDataEx, operation=EvtInfo_AutoCreatedDemEvent_ESH_Action_SwitchWakeup_BswMReportFailToDemRef.GetEventFreezeFrameDataEx
        OpEventGetEventFreezeFrameDataEx_GetEventFreezeFrameDataEx_EvtInfo_AutoCreatedDemEvent_ESH_Action_SwitchWakeup_BswMRepo_51b8513e: start-on-event=DemSatellite_OsApplication_Untrusted_Core0InternalBehavior/GetEventFreezeFrameDataEx, operation=EvtInfo_AutoCreatedDemEvent_ESH_Action_SwitchWakeup_BswMReportFailToDemRef_1.GetEventFreezeFrameDataEx
        OpEventGetEventFreezeFrameDataEx_GetEventFreezeFrameDataEx_EvtInfo_AutoCreatedDemEvent_ESH_Action_WriteAllTimer_Start_B_4209e2f9: start-on-event=DemSatellite_OsApplication_Untrusted_Core0InternalBehavior/GetEventFreezeFrameDataEx, operation=EvtInfo_AutoCreatedDemEvent_ESH_Action_WriteAllTimer_Start_BswMReportFailToDemRef.GetEventFreezeFrameDataEx
        OpEventGetEventFreezeFrameDataEx_GetEventFreezeFrameDataEx_EvtInfo_AutoCreatedDemEvent_ESH_Action_WriteAllTimer_Stop_Bs_fccc3779: start-on-event=DemSatellite_OsApplication_Untrusted_Core0InternalBehavior/GetEventFreezeFrameDataEx, operation=EvtInfo_AutoCreatedDemEvent_ESH_Action_WriteAllTimer_Stop_BswMReportFailToDemRef.GetEventFreezeFrameDataEx
        OpEventGetEventFreezeFrameDataEx_GetEventFreezeFrameDataEx_EvtInfo_AutoCreatedDemEvent_ESH_Action_WriteAllTimer_Stop_Bs_6b64c822: start-on-event=DemSatellite_OsApplication_Untrusted_Core0InternalBehavior/GetEventFreezeFrameDataEx, operation=EvtInfo_AutoCreatedDemEvent_ESH_Action_WriteAllTimer_Stop_BswMReportFailToDemRef_1.GetEventFreezeFrameDataEx
        OpEventGetEventFreezeFrameDataEx_GetEventFreezeFrameDataEx_EvtInfo_AutoCreatedDemEvent_ESH_DemInit_BswMReportFailToDemRef: start-on-event=DemSatellite_OsApplication_Untrusted_Core0InternalBehavior/GetEventFreezeFrameDataEx, operation=EvtInfo_AutoCreatedDemEvent_ESH_DemInit_BswMReportFailToDemRef.GetEventFreezeFrameDataEx
        OpEventGetEventFreezeFrameDataEx_GetEventFreezeFrameDataEx_EvtInfo_AutoCreatedDemEvent_ESH_PostRunNested_BswMReportFailToDemRef: start-on-event=DemSatellite_OsApplication_Untrusted_Core0InternalBehavior/GetEventFreezeFrameDataEx, operation=EvtInfo_AutoCreatedDemEvent_ESH_PostRunNested_BswMReportFailToDemRef.GetEventFreezeFrameDataEx
        OpEventGetEventFreezeFrameDataEx_GetEventFreezeFrameDataEx_EvtInfo_AutoCreatedDemEvent_ESH_PostRunToPrepNested_BswMRepo_ee7860f9: start-on-event=DemSatellite_OsApplication_Untrusted_Core0InternalBehavior/GetEventFreezeFrameDataEx, operation=EvtInfo_AutoCreatedDemEvent_ESH_PostRunToPrepNested_BswMReportFailToDemRef.GetEventFreezeFrameDataEx
        OpEventGetEventFreezeFrameDataEx_GetEventFreezeFrameDataEx_EvtInfo_AutoCreatedDemEvent_ESH_Action_ExitExclusiveArea_Bsw_f60d889c: start-on-event=DemSatellite_OsApplication_Untrusted_Core0InternalBehavior/GetEventFreezeFrameDataEx, operation=EvtInfo_AutoCreatedDemEvent_ESH_Action_ExitExclusiveArea_BswMReportFailToDemRef_1.GetEventFreezeFrameDataEx
        OpEventGetEventFreezeFrameDataEx_GetEventFreezeFrameDataEx_EvtInfo_AutoCreatedDemEvent_INIT_Action_BrsHw_EnableHwAccess_d0750b9a: start-on-event=DemSatellite_OsApplication_Untrusted_Core0InternalBehavior/GetEventFreezeFrameDataEx, operation=EvtInfo_AutoCreatedDemEvent_INIT_Action_BrsHw_EnableHwAccess_BswMReportFailToDemRef.GetEventFreezeFrameDataEx
        OpEventGetEventFreezeFrameDataEx_GetEventFreezeFrameDataEx_EvtInfo_AutoCreatedDemEvent_INIT_Action_CanIf_Init_BswMRepor_b374e263: start-on-event=DemSatellite_OsApplication_Untrusted_Core0InternalBehavior/GetEventFreezeFrameDataEx, operation=EvtInfo_AutoCreatedDemEvent_INIT_Action_CanIf_Init_BswMReportFailToDemRef.GetEventFreezeFrameDataEx
        OpEventGetEventFreezeFrameDataEx_GetEventFreezeFrameDataEx_EvtInfo_AutoCreatedDemEvent_INIT_Action_CanNm_Init_BswMRepor_0d82e595: start-on-event=DemSatellite_OsApplication_Untrusted_Core0InternalBehavior/GetEventFreezeFrameDataEx, operation=EvtInfo_AutoCreatedDemEvent_INIT_Action_CanNm_Init_BswMReportFailToDemRef.GetEventFreezeFrameDataEx
        OpEventGetEventFreezeFrameDataEx_GetEventFreezeFrameDataEx_EvtInfo_AutoCreatedDemEvent_INIT_Action_CanSM_Init_BswMRepor_5e1bb4f5: start-on-event=DemSatellite_OsApplication_Untrusted_Core0InternalBehavior/GetEventFreezeFrameDataEx, operation=EvtInfo_AutoCreatedDemEvent_INIT_Action_CanSM_Init_BswMReportFailToDemRef.GetEventFreezeFrameDataEx
        OpEventGetEventFreezeFrameDataEx_GetEventFreezeFrameDataEx_EvtInfo_AutoCreatedDemEvent_INIT_Action_CanTp_Init_BswMRepor_21a4f2d4: start-on-event=DemSatellite_OsApplication_Untrusted_Core0InternalBehavior/GetEventFreezeFrameDataEx, operation=EvtInfo_AutoCreatedDemEvent_INIT_Action_CanTp_Init_BswMReportFailToDemRef.GetEventFreezeFrameDataEx
        OpEventGetEventFreezeFrameDataEx_GetEventFreezeFrameDataEx_EvtInfo_AutoCreatedDemEvent_INIT_Action_Can_Init_BswMReportF_5362b0e5: start-on-event=DemSatellite_OsApplication_Untrusted_Core0InternalBehavior/GetEventFreezeFrameDataEx, operation=EvtInfo_AutoCreatedDemEvent_INIT_Action_Can_Init_BswMReportFailToDemRef.GetEventFreezeFrameDataEx
        OpEventGetEventFreezeFrameDataEx_GetEventFreezeFrameDataEx_EvtInfo_AutoCreatedDemEvent_INIT_Action_ComM_Init_BswMReport_96b1b1c2: start-on-event=DemSatellite_OsApplication_Untrusted_Core0InternalBehavior/GetEventFreezeFrameDataEx, operation=EvtInfo_AutoCreatedDemEvent_INIT_Action_ComM_Init_BswMReportFailToDemRef.GetEventFreezeFrameDataEx
        OpEventGetEventFreezeFrameDataEx_GetEventFreezeFrameDataEx_EvtInfo_AutoCreatedDemEvent_INIT_Action_Com_Init_BswMReportF_475e8fb8: start-on-event=DemSatellite_OsApplication_Untrusted_Core0InternalBehavior/GetEventFreezeFrameDataEx, operation=EvtInfo_AutoCreatedDemEvent_INIT_Action_Com_Init_BswMReportFailToDemRef.GetEventFreezeFrameDataEx
        OpEventGetEventFreezeFrameDataEx_GetEventFreezeFrameDataEx_EvtInfo_AutoCreatedDemEvent_INIT_Action_Dcm_Init_BswMReportF_a61c87ae: start-on-event=DemSatellite_OsApplication_Untrusted_Core0InternalBehavior/GetEventFreezeFrameDataEx, operation=EvtInfo_AutoCreatedDemEvent_INIT_Action_Dcm_Init_BswMReportFailToDemRef.GetEventFreezeFrameDataEx
        OpEventGetEventFreezeFrameDataEx_GetEventFreezeFrameDataEx_EvtInfo_AutoCreatedDemEvent_INIT_Action_Dem_Init_BswMReportF_2f5ecd9e: start-on-event=DemSatellite_OsApplication_Untrusted_Core0InternalBehavior/GetEventFreezeFrameDataEx, operation=EvtInfo_AutoCreatedDemEvent_INIT_Action_Dem_Init_BswMReportFailToDemRef.GetEventFreezeFrameDataEx
        OpEventGetEventFreezeFrameDataEx_GetEventFreezeFrameDataEx_EvtInfo_AutoCreatedDemEvent_INIT_Action_EnableInterrupts_Bsw_2cd46a5b: start-on-event=DemSatellite_OsApplication_Untrusted_Core0InternalBehavior/GetEventFreezeFrameDataEx, operation=EvtInfo_AutoCreatedDemEvent_INIT_Action_EnableInterrupts_BswMReportFailToDemRef.GetEventFreezeFrameDataEx
        OpEventGetEventFreezeFrameDataEx_GetEventFreezeFrameDataEx_EvtInfo_AutoCreatedDemEvent_INIT_Action_Fee_Init_BswMReportF_9c4dd99e: start-on-event=DemSatellite_OsApplication_Untrusted_Core0InternalBehavior/GetEventFreezeFrameDataEx, operation=EvtInfo_AutoCreatedDemEvent_INIT_Action_Fee_Init_BswMReportFailToDemRef.GetEventFreezeFrameDataEx
        OpEventGetEventFreezeFrameDataEx_GetEventFreezeFrameDataEx_EvtInfo_AutoCreatedDemEvent_INIT_Action_Issm_Init_BswMReport_f8869427: start-on-event=DemSatellite_OsApplication_Untrusted_Core0InternalBehavior/GetEventFreezeFrameDataEx, operation=EvtInfo_AutoCreatedDemEvent_INIT_Action_Issm_Init_BswMReportFailToDemRef.GetEventFreezeFrameDataEx
        OpEventGetEventFreezeFrameDataEx_GetEventFreezeFrameDataEx_EvtInfo_AutoCreatedDemEvent_INIT_Action_J1939Nm_Init_BswMRep_ece268e6: start-on-event=DemSatellite_OsApplication_Untrusted_Core0InternalBehavior/GetEventFreezeFrameDataEx, operation=EvtInfo_AutoCreatedDemEvent_INIT_Action_J1939Nm_Init_BswMReportFailToDemRef.GetEventFreezeFrameDataEx
        OpEventGetEventFreezeFrameDataEx_GetEventFreezeFrameDataEx_EvtInfo_AutoCreatedDemEvent_INIT_Action_J1939Rm_Init_BswMRep_55fbc6c5: start-on-event=DemSatellite_OsApplication_Untrusted_Core0InternalBehavior/GetEventFreezeFrameDataEx, operation=EvtInfo_AutoCreatedDemEvent_INIT_Action_J1939Rm_Init_BswMReportFailToDemRef.GetEventFreezeFrameDataEx
        OpEventGetEventFreezeFrameDataEx_GetEventFreezeFrameDataEx_EvtInfo_AutoCreatedDemEvent_INIT_Action_J1939Tp_Init_BswMRep_c0c47fa7: start-on-event=DemSatellite_OsApplication_Untrusted_Core0InternalBehavior/GetEventFreezeFrameDataEx, operation=EvtInfo_AutoCreatedDemEvent_INIT_Action_J1939Tp_Init_BswMReportFailToDemRef.GetEventFreezeFrameDataEx
        OpEventGetEventFreezeFrameDataEx_GetEventFreezeFrameDataEx_EvtInfo_AutoCreatedDemEvent_INIT_Action_LinIf_Init_BswMRepor_bc58a537: start-on-event=DemSatellite_OsApplication_Untrusted_Core0InternalBehavior/GetEventFreezeFrameDataEx, operation=EvtInfo_AutoCreatedDemEvent_INIT_Action_LinIf_Init_BswMReportFailToDemRef.GetEventFreezeFrameDataEx
        OpEventGetEventFreezeFrameDataEx_GetEventFreezeFrameDataEx_EvtInfo_AutoCreatedDemEvent_INIT_Action_LinSM_Init_BswMRepor_5137f3a1: start-on-event=DemSatellite_OsApplication_Untrusted_Core0InternalBehavior/GetEventFreezeFrameDataEx, operation=EvtInfo_AutoCreatedDemEvent_INIT_Action_LinSM_Init_BswMReportFailToDemRef.GetEventFreezeFrameDataEx
        OpEventGetEventFreezeFrameDataEx_GetEventFreezeFrameDataEx_EvtInfo_AutoCreatedDemEvent_INIT_Action_LinTp_Init_BswMRepor_2e88b580: start-on-event=DemSatellite_OsApplication_Untrusted_Core0InternalBehavior/GetEventFreezeFrameDataEx, operation=EvtInfo_AutoCreatedDemEvent_INIT_Action_LinTp_Init_BswMReportFailToDemRef.GetEventFreezeFrameDataEx
        OpEventGetEventFreezeFrameDataEx_GetEventFreezeFrameDataEx_EvtInfo_AutoCreatedDemEvent_INIT_Action_Lin_Init_BswMReportF_349c725b: start-on-event=DemSatellite_OsApplication_Untrusted_Core0InternalBehavior/GetEventFreezeFrameDataEx, operation=EvtInfo_AutoCreatedDemEvent_INIT_Action_Lin_Init_BswMReportFailToDemRef.GetEventFreezeFrameDataEx
        OpEventGetEventFreezeFrameDataEx_GetEventFreezeFrameDataEx_EvtInfo_AutoCreatedDemEvent_INIT_Action_Nm_Init_BswMReportFa_162264dd: start-on-event=DemSatellite_OsApplication_Untrusted_Core0InternalBehavior/GetEventFreezeFrameDataEx, operation=EvtInfo_AutoCreatedDemEvent_INIT_Action_Nm_Init_BswMReportFailToDemRef.GetEventFreezeFrameDataEx
        OpEventGetEventFreezeFrameDataEx_GetEventFreezeFrameDataEx_EvtInfo_AutoCreatedDemEvent_INIT_Action_NvMReadAll_BswMRepor_8fc89e33: start-on-event=DemSatellite_OsApplication_Untrusted_Core0InternalBehavior/GetEventFreezeFrameDataEx, operation=EvtInfo_AutoCreatedDemEvent_INIT_Action_NvMReadAll_BswMReportFailToDemRef.GetEventFreezeFrameDataEx
        OpEventGetEventFreezeFrameDataEx_GetEventFreezeFrameDataEx_EvtInfo_AutoCreatedDemEvent_INIT_Action_NvM_Init_BswMReportF_a7035fe5: start-on-event=DemSatellite_OsApplication_Untrusted_Core0InternalBehavior/GetEventFreezeFrameDataEx, operation=EvtInfo_AutoCreatedDemEvent_INIT_Action_NvM_Init_BswMReportFailToDemRef.GetEventFreezeFrameDataEx
        OpEventGetEventFreezeFrameDataEx_GetEventFreezeFrameDataEx_EvtInfo_AutoCreatedDemEvent_INIT_Action_PduR_Init_BswMReport_b408cb76: start-on-event=DemSatellite_OsApplication_Untrusted_Core0InternalBehavior/GetEventFreezeFrameDataEx, operation=EvtInfo_AutoCreatedDemEvent_INIT_Action_PduR_Init_BswMReportFailToDemRef.GetEventFreezeFrameDataEx
        OpEventGetEventFreezeFrameDataEx_GetEventFreezeFrameDataEx_EvtInfo_AutoCreatedDemEvent_INIT_Action_RteStart_BswMReportF_ed913b3d: start-on-event=DemSatellite_OsApplication_Untrusted_Core0InternalBehavior/GetEventFreezeFrameDataEx, operation=EvtInfo_AutoCreatedDemEvent_INIT_Action_RteStart_BswMReportFailToDemRef.GetEventFreezeFrameDataEx
        OpEventGetEventFreezeFrameDataEx_GetEventFreezeFrameDataEx_EvtInfo_AutoCreatedDemEvent_CHNL_17344684_CANSM_E_MODE_REQUE_f9bcbd58: start-on-event=DemSatellite_OsApplication_Untrusted_Core0InternalBehavior/GetEventFreezeFrameDataEx, operation=EvtInfo_AutoCreatedDemEvent_CHNL_17344684_CANSM_E_MODE_REQUEST_TIMEOUT.GetEventFreezeFrameDataEx
        OpEventGetEventFreezeFrameDataEx_GetEventFreezeFrameDataEx_EvtInfo_AutoCreatedDemEvent_CHNL_17344684_CANSM_E_BUS_OFF: start-on-event=DemSatellite_OsApplication_Untrusted_Core0InternalBehavior/GetEventFreezeFrameDataEx, operation=EvtInfo_AutoCreatedDemEvent_CHNL_17344684_CANSM_E_BUS_OFF.GetEventFreezeFrameDataEx
        OpEventGetEventFreezeFrameDataEx_GetEventFreezeFrameDataEx_EvtInfo_AutoCreatedDemEvent_CHNL_53cce282_CANSM_E_MODE_REQUE_8e03e9ea: start-on-event=DemSatellite_OsApplication_Untrusted_Core0InternalBehavior/GetEventFreezeFrameDataEx, operation=EvtInfo_AutoCreatedDemEvent_CHNL_53cce282_CANSM_E_MODE_REQUEST_TIMEOUT.GetEventFreezeFrameDataEx
        OpEventGetEventFreezeFrameDataEx_GetEventFreezeFrameDataEx_EvtInfo_AutoCreatedDemEvent_CHNL_53cce282_CANSM_E_BUS_OFF: start-on-event=DemSatellite_OsApplication_Untrusted_Core0InternalBehavior/GetEventFreezeFrameDataEx, operation=EvtInfo_AutoCreatedDemEvent_CHNL_53cce282_CANSM_E_BUS_OFF.GetEventFreezeFrameDataEx
        OpEventGetEventFreezeFrameDataEx_GetEventFreezeFrameDataEx_EvtInfo_AutoCreatedDemEvent_CHNL_a6b6a922_CANSM_E_MODE_REQUE_2d868e5b: start-on-event=DemSatellite_OsApplication_Untrusted_Core0InternalBehavior/GetEventFreezeFrameDataEx, operation=EvtInfo_AutoCreatedDemEvent_CHNL_a6b6a922_CANSM_E_MODE_REQUEST_TIMEOUT.GetEventFreezeFrameDataEx
        OpEventGetEventFreezeFrameDataEx_GetEventFreezeFrameDataEx_EvtInfo_AutoCreatedDemEvent_CHNL_a6b6a922_CANSM_E_BUS_OFF: start-on-event=DemSatellite_OsApplication_Untrusted_Core0InternalBehavior/GetEventFreezeFrameDataEx, operation=EvtInfo_AutoCreatedDemEvent_CHNL_a6b6a922_CANSM_E_BUS_OFF.GetEventFreezeFrameDataEx
        OpEventGetEventFreezeFrameDataEx_GetEventFreezeFrameDataEx_EvtInfo_AutoCreatedDemEvent_CHNL_df893ad5_CANSM_E_MODE_REQUE_a8d964df: start-on-event=DemSatellite_OsApplication_Untrusted_Core0InternalBehavior/GetEventFreezeFrameDataEx, operation=EvtInfo_AutoCreatedDemEvent_CHNL_df893ad5_CANSM_E_MODE_REQUEST_TIMEOUT.GetEventFreezeFrameDataEx
        OpEventGetEventFreezeFrameDataEx_GetEventFreezeFrameDataEx_EvtInfo_AutoCreatedDemEvent_CHNL_df893ad5_CANSM_E_BUS_OFF: start-on-event=DemSatellite_OsApplication_Untrusted_Core0InternalBehavior/GetEventFreezeFrameDataEx, operation=EvtInfo_AutoCreatedDemEvent_CHNL_df893ad5_CANSM_E_BUS_OFF.GetEventFreezeFrameDataEx
        OpEventGetEventFreezeFrameDataEx_GetEventFreezeFrameDataEx_EvtInfo_AutoCreatedDemEvent_CHNL_e058b4ae_CANSM_E_MODE_REQUE_11420dd3: start-on-event=DemSatellite_OsApplication_Untrusted_Core0InternalBehavior/GetEventFreezeFrameDataEx, operation=EvtInfo_AutoCreatedDemEvent_CHNL_e058b4ae_CANSM_E_MODE_REQUEST_TIMEOUT.GetEventFreezeFrameDataEx
        OpEventGetEventFreezeFrameDataEx_GetEventFreezeFrameDataEx_EvtInfo_AutoCreatedDemEvent_CHNL_e058b4ae_CANSM_E_BUS_OFF: start-on-event=DemSatellite_OsApplication_Untrusted_Core0InternalBehavior/GetEventFreezeFrameDataEx, operation=EvtInfo_AutoCreatedDemEvent_CHNL_e058b4ae_CANSM_E_BUS_OFF.GetEventFreezeFrameDataEx
        OpEventGetEventFreezeFrameDataEx_GetEventFreezeFrameDataEx_EvtInfo_AutoCreatedDemEvent_ECUM_E_RAM_CHECK_FAILED: start-on-event=DemSatellite_OsApplication_Untrusted_Core0InternalBehavior/GetEventFreezeFrameDataEx, operation=EvtInfo_AutoCreatedDemEvent_ECUM_E_RAM_CHECK_FAILED.GetEventFreezeFrameDataEx
        OpEventGetEventFreezeFrameDataEx_GetEventFreezeFrameDataEx_EvtInfo_AutoCreatedDemEvent_ECUM_E_IMPROPER_CALLER: start-on-event=DemSatellite_OsApplication_Untrusted_Core0InternalBehavior/GetEventFreezeFrameDataEx, operation=EvtInfo_AutoCreatedDemEvent_ECUM_E_IMPROPER_CALLER.GetEventFreezeFrameDataEx
        OpEventGetEventFreezeFrameDataEx_GetEventFreezeFrameDataEx_EvtInfo_AutoCreatedDemEvent_ECUM_E_CONFIGURATION_DATA_INCONSISTENT: start-on-event=DemSatellite_OsApplication_Untrusted_Core0InternalBehavior/GetEventFreezeFrameDataEx, operation=EvtInfo_AutoCreatedDemEvent_ECUM_E_CONFIGURATION_DATA_INCONSISTENT.GetEventFreezeFrameDataEx
        OpEventGetEventFreezeFrameDataEx_GetEventFreezeFrameDataEx_EvtInfo_AutoCreatedDemEvent_ECUM_E_ALL_RUN_REQUESTS_KILLED: start-on-event=DemSatellite_OsApplication_Untrusted_Core0InternalBehavior/GetEventFreezeFrameDataEx, operation=EvtInfo_AutoCreatedDemEvent_ECUM_E_ALL_RUN_REQUESTS_KILLED.GetEventFreezeFrameDataEx
        OpEventGetEventFreezeFrameDataEx_GetEventFreezeFrameDataEx_EvtInfo_AutoCreatedDemEvent_FLS_E_WRITE_FAILED: start-on-event=DemSatellite_OsApplication_Untrusted_Core0InternalBehavior/GetEventFreezeFrameDataEx, operation=EvtInfo_AutoCreatedDemEvent_FLS_E_WRITE_FAILED.GetEventFreezeFrameDataEx
        OpEventGetEventFreezeFrameDataEx_GetEventFreezeFrameDataEx_EvtInfo_AutoCreatedDemEvent_FLS_E_UNEXPECTED_FLASH_ID: start-on-event=DemSatellite_OsApplication_Untrusted_Core0InternalBehavior/GetEventFreezeFrameDataEx, operation=EvtInfo_AutoCreatedDemEvent_FLS_E_UNEXPECTED_FLASH_ID.GetEventFreezeFrameDataEx
        OpEventGetEventFreezeFrameDataEx_GetEventFreezeFrameDataEx_EvtInfo_AutoCreatedDemEvent_FLS_E_READ_FAILED: start-on-event=DemSatellite_OsApplication_Untrusted_Core0InternalBehavior/GetEventFreezeFrameDataEx, operation=EvtInfo_AutoCreatedDemEvent_FLS_E_READ_FAILED.GetEventFreezeFrameDataEx
        OpEventGetEventFreezeFrameDataEx_GetEventFreezeFrameDataEx_EvtInfo_AutoCreatedDemEvent_FLS_E_ERASE_FAILED: start-on-event=DemSatellite_OsApplication_Untrusted_Core0InternalBehavior/GetEventFreezeFrameDataEx, operation=EvtInfo_AutoCreatedDemEvent_FLS_E_ERASE_FAILED.GetEventFreezeFrameDataEx
        OpEventGetEventFreezeFrameDataEx_GetEventFreezeFrameDataEx_EvtInfo_AutoCreatedDemEvent_FLS_E_COMPARE_FAILED: start-on-event=DemSatellite_OsApplication_Untrusted_Core0InternalBehavior/GetEventFreezeFrameDataEx, operation=EvtInfo_AutoCreatedDemEvent_FLS_E_COMPARE_FAILED.GetEventFreezeFrameDataEx
        OpEventGetEventFreezeFrameDataEx_GetEventFreezeFrameDataEx_EvtInfo_AutoCreatedDemEvent_GPT_E_TIMEOUT: start-on-event=DemSatellite_OsApplication_Untrusted_Core0InternalBehavior/GetEventFreezeFrameDataEx, operation=EvtInfo_AutoCreatedDemEvent_GPT_E_TIMEOUT.GetEventFreezeFrameDataEx
        OpEventGetEventFreezeFrameDataEx_GetEventFreezeFrameDataEx_EvtInfo_AutoCreatedDemEvent_J1939NM_E_ADDRESS_LOST: start-on-event=DemSatellite_OsApplication_Untrusted_Core0InternalBehavior/GetEventFreezeFrameDataEx, operation=EvtInfo_AutoCreatedDemEvent_J1939NM_E_ADDRESS_LOST.GetEventFreezeFrameDataEx
        OpEventGetEventFreezeFrameDataEx_GetEventFreezeFrameDataEx_EvtInfo_AutoCreatedDemEvent_J1939TpConfiguration_J1939TP_E_C_4d6a4b79: start-on-event=DemSatellite_OsApplication_Untrusted_Core0InternalBehavior/GetEventFreezeFrameDataEx, operation=EvtInfo_AutoCreatedDemEvent_J1939TpConfiguration_J1939TP_E_COMMUNICATION.GetEventFreezeFrameDataEx
        OpEventGetEventFreezeFrameDataEx_GetEventFreezeFrameDataEx_EvtInfo_AutoCreatedDemEvent_LIN_E_TIMEOUT: start-on-event=DemSatellite_OsApplication_Untrusted_Core0InternalBehavior/GetEventFreezeFrameDataEx, operation=EvtInfo_AutoCreatedDemEvent_LIN_E_TIMEOUT.GetEventFreezeFrameDataEx
        OpEventGetEventFreezeFrameDataEx_GetEventFreezeFrameDataEx_EvtInfo_AutoCreatedDemEvent_MCL_E_DMA_UNRECOGNIZED: start-on-event=DemSatellite_OsApplication_Untrusted_Core0InternalBehavior/GetEventFreezeFrameDataEx, operation=EvtInfo_AutoCreatedDemEvent_MCL_E_DMA_UNRECOGNIZED.GetEventFreezeFrameDataEx
        OpEventGetEventFreezeFrameDataEx_GetEventFreezeFrameDataEx_EvtInfo_AutoCreatedDemEvent_MCL_E_DMA_PRIORITY: start-on-event=DemSatellite_OsApplication_Untrusted_Core0InternalBehavior/GetEventFreezeFrameDataEx, operation=EvtInfo_AutoCreatedDemEvent_MCL_E_DMA_PRIORITY.GetEventFreezeFrameDataEx
        OpEventGetEventFreezeFrameDataEx_GetEventFreezeFrameDataEx_EvtInfo_AutoCreatedDemEvent_MCL_E_DMA_INCONSISTENCY: start-on-event=DemSatellite_OsApplication_Untrusted_Core0InternalBehavior/GetEventFreezeFrameDataEx, operation=EvtInfo_AutoCreatedDemEvent_MCL_E_DMA_INCONSISTENCY.GetEventFreezeFrameDataEx
        OpEventGetEventFreezeFrameDataEx_GetEventFreezeFrameDataEx_EvtInfo_AutoCreatedDemEvent_MCL_E_DMA_ECC: start-on-event=DemSatellite_OsApplication_Untrusted_Core0InternalBehavior/GetEventFreezeFrameDataEx, operation=EvtInfo_AutoCreatedDemEvent_MCL_E_DMA_ECC.GetEventFreezeFrameDataEx
        OpEventGetEventFreezeFrameDataEx_GetEventFreezeFrameDataEx_EvtInfo_AutoCreatedDemEvent_MCL_E_DMA_DESCRIPTOR: start-on-event=DemSatellite_OsApplication_Untrusted_Core0InternalBehavior/GetEventFreezeFrameDataEx, operation=EvtInfo_AutoCreatedDemEvent_MCL_E_DMA_DESCRIPTOR.GetEventFreezeFrameDataEx
        OpEventGetEventFreezeFrameDataEx_GetEventFreezeFrameDataEx_EvtInfo_AutoCreatedDemEvent_MCL_E_DMA_BUS: start-on-event=DemSatellite_OsApplication_Untrusted_Core0InternalBehavior/GetEventFreezeFrameDataEx, operation=EvtInfo_AutoCreatedDemEvent_MCL_E_DMA_BUS.GetEventFreezeFrameDataEx
        OpEventGetEventFreezeFrameDataEx_GetEventFreezeFrameDataEx_EvtInfo_AutoCreatedDemEvent_MCU_E_TIMEOUT_FAILURE: start-on-event=DemSatellite_OsApplication_Untrusted_Core0InternalBehavior/GetEventFreezeFrameDataEx, operation=EvtInfo_AutoCreatedDemEvent_MCU_E_TIMEOUT_FAILURE.GetEventFreezeFrameDataEx
        OpEventGetEventFreezeFrameDataEx_GetEventFreezeFrameDataEx_EvtInfo_AutoCreatedDemEvent_MCU_E_SSCM_CER_FAILURE: start-on-event=DemSatellite_OsApplication_Untrusted_Core0InternalBehavior/GetEventFreezeFrameDataEx, operation=EvtInfo_AutoCreatedDemEvent_MCU_E_SSCM_CER_FAILURE.GetEventFreezeFrameDataEx
        OpEventGetEventFreezeFrameDataEx_GetEventFreezeFrameDataEx_EvtInfo_AutoCreatedDemEvent_MCU_E_INVALIDMODE_CONFIG: start-on-event=DemSatellite_OsApplication_Untrusted_Core0InternalBehavior/GetEventFreezeFrameDataEx, operation=EvtInfo_AutoCreatedDemEvent_MCU_E_INVALIDMODE_CONFIG.GetEventFreezeFrameDataEx
        OpEventGetEventFreezeFrameDataEx_GetEventFreezeFrameDataEx_EvtInfo_AutoCreatedDemEvent_MCU_E_CLOCK_FAILURE: start-on-event=DemSatellite_OsApplication_Untrusted_Core0InternalBehavior/GetEventFreezeFrameDataEx, operation=EvtInfo_AutoCreatedDemEvent_MCU_E_CLOCK_FAILURE.GetEventFreezeFrameDataEx
        OpEventGetEventFreezeFrameDataEx_GetEventFreezeFrameDataEx_EvtInfo_AutoCreatedDemEvent_NVM_E_WRONG_BLOCK_ID: start-on-event=DemSatellite_OsApplication_Untrusted_Core0InternalBehavior/GetEventFreezeFrameDataEx, operation=EvtInfo_AutoCreatedDemEvent_NVM_E_WRONG_BLOCK_ID.GetEventFreezeFrameDataEx
        OpEventGetEventFreezeFrameDataEx_GetEventFreezeFrameDataEx_EvtInfo_AutoCreatedDemEvent_NVM_E_WRITE_PROTECTED: start-on-event=DemSatellite_OsApplication_Untrusted_Core0InternalBehavior/GetEventFreezeFrameDataEx, operation=EvtInfo_AutoCreatedDemEvent_NVM_E_WRITE_PROTECTED.GetEventFreezeFrameDataEx
        OpEventGetEventFreezeFrameDataEx_GetEventFreezeFrameDataEx_EvtInfo_AutoCreatedDemEvent_NVM_E_VERIFY_FAILED: start-on-event=DemSatellite_OsApplication_Untrusted_Core0InternalBehavior/GetEventFreezeFrameDataEx, operation=EvtInfo_AutoCreatedDemEvent_NVM_E_VERIFY_FAILED.GetEventFreezeFrameDataEx
        OpEventGetEventFreezeFrameDataEx_GetEventFreezeFrameDataEx_EvtInfo_AutoCreatedDemEvent_NVM_E_REQ_FAILED: start-on-event=DemSatellite_OsApplication_Untrusted_Core0InternalBehavior/GetEventFreezeFrameDataEx, operation=EvtInfo_AutoCreatedDemEvent_NVM_E_REQ_FAILED.GetEventFreezeFrameDataEx
        OpEventGetEventFreezeFrameDataEx_GetEventFreezeFrameDataEx_EvtInfo_AutoCreatedDemEvent_NVM_E_QUEUE_OVERFLOW: start-on-event=DemSatellite_OsApplication_Untrusted_Core0InternalBehavior/GetEventFreezeFrameDataEx, operation=EvtInfo_AutoCreatedDemEvent_NVM_E_QUEUE_OVERFLOW.GetEventFreezeFrameDataEx
