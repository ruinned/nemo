[part 3 of 4: package /MICROSAR/vDem42_swc/ComponentTypes]
AUTOSAR XML (schema 4-2-1)
package /MICROSAR/vDem42_swc/ComponentTypes  (continued)
  service sw component type vDem42: category=SERVICE_COMPONENT  (continued)
    behavior vDem42InternalBehavior: handle-termination-and-restart=NO-SUPPORT, included-data-type-set=data-type=[Dem_DTCFormatType, Dem_DTCOriginType, Dem_UdsStatusByteType, Dem_EventIdType, Dem_MaxDataValueType, Dem_DebouncingStateType, VDem42_DTCFormatType, VDem42_DTCOriginType, VDem42_UdsStatusByteType, VDem42_EventIdType, VDem42_MaxDataValueType, VDem42_DebouncingStateType]  (continued)
      2123 x operation invoked event:  (continued)
        OpEventGetEventFreezeFrameData_GetEventFreezeFrameData_EvtInfo_AutoCreatedDemEvent_CC_EnablePDUGroup_CIOM_oBackbone2_Rx_2e00ffb2: start-on-event=GetEventFreezeFrameData, operation=EvtInfo_AutoCreatedDemEvent_CC_EnablePDUGroup_CIOM_oBackbone2_Rx_4e624434_BswMReportFailToDemRef422.GetEventFreezeFrameData
        OpEventGetEventFreezeFrameData_GetEventFreezeFrameData_EvtInfo_AutoCreatedDemEvent_CC_EnablePDUGroup_CIOM_oBackbone2_Tx_22d6599c: start-on-event=GetEventFreezeFrameData, operation=EvtInfo_AutoCreatedDemEvent_CC_EnablePDUGroup_CIOM_oBackbone2_Tx_1838e3b2_BswMReportFailToDemRef422.GetEventFreezeFrameData
        OpEventGetEventFreezeFrameData_GetEventFreezeFrameData_EvtInfo_AutoCreatedDemEvent_CC_EnablePDUGroup_CIOM_oCabSubnet_Rx_5342b438: start-on-event=GetEventFreezeFrameData, operation=EvtInfo_AutoCreatedDemEvent_CC_EnablePDUGroup_CIOM_oCabSubnet_Rx_063a5fbc_BswMReportFailToDemRef422.GetEventFreezeFrameData
        OpEventGetEventFreezeFrameData_GetEventFreezeFrameData_EvtInfo_AutoCreatedDemEvent_CC_EnablePDUGroup_CIOM_oCabSubnet_Tx_c130eb0a: start-on-event=GetEventFreezeFrameData, operation=EvtInfo_AutoCreatedDemEvent_CC_EnablePDUGroup_CIOM_oCabSubnet_Tx_5060f83a_BswMReportFailToDemRef422.GetEventFreezeFrameData
        OpEventGetEventFreezeFrameData_GetEventFreezeFrameData_EvtInfo_AutoCreatedDemEvent_CC_EnablePDUGroup_CIOM_oFMSNet_Rx_BC_4c5275be: start-on-event=GetEventFreezeFrameData, operation=EvtInfo_AutoCreatedDemEvent_CC_EnablePDUGroup_CIOM_oFMSNet_Rx_BC_dd2c1510_BswMReportFailToDemRef422.GetEventFreezeFrameData
        OpEventGetEventFreezeFrameData_GetEventFreezeFrameData_EvtInfo_AutoCreatedDemEvent_CC_EnablePDUGroup_CIOM_oFMSNet_Tx_0x_bb367406: start-on-event=GetEventFreezeFrameData, operation=EvtInfo_AutoCreatedDemEvent_CC_EnablePDUGroup_CIOM_oFMSNet_Tx_0x31_BC_38fc8c7d_BswMReportFailToDemRef422.GetEventFreezeFrameData
        OpEventGetEventFreezeFrameData_GetEventFreezeFrameData_EvtInfo_AutoCreatedDemEvent_CC_EnablePDUGroup_CIOM_oLIN00_Rx_dd1_5f15136a: start-on-event=GetEventFreezeFrameData, operation=EvtInfo_AutoCreatedDemEvent_CC_EnablePDUGroup_CIOM_oLIN00_Rx_dd181faa_BswMReportFailToDemRef422.GetEventFreezeFrameData
        OpEventGetEventFreezeFrameData_GetEventFreezeFrameData_EvtInfo_AutoCreatedDemEvent_CC_EnablePDUGroup_CIOM_oLIN00_Tx_8b4_23f2dda3: start-on-event=GetEventFreezeFrameData, operation=EvtInfo_AutoCreatedDemEvent_CC_EnablePDUGroup_CIOM_oLIN00_Tx_8b42b82c_BswMReportFailToDemRef422.GetEventFreezeFrameData
        OpEventGetEventFreezeFrameData_GetEventFreezeFrameData_EvtInfo_AutoCreatedDemEvent_CC_EnablePDUGroup_CIOM_oLIN01_Rx_65a_66a5346f: start-on-event=GetEventFreezeFrameData, operation=EvtInfo_AutoCreatedDemEvent_CC_EnablePDUGroup_CIOM_oLIN01_Rx_65a478cf_BswMReportFailToDemRef422.GetEventFreezeFrameData
        OpEventGetEventFreezeFrameData_GetEventFreezeFrameData_EvtInfo_AutoCreatedDemEvent_CC_EnablePDUGroup_CIOM_oLIN01_Tx_33f_f836cec8: start-on-event=GetEventFreezeFrameData, operation=EvtInfo_AutoCreatedDemEvent_CC_EnablePDUGroup_CIOM_oLIN01_Tx_33fedf49_BswMReportFailToDemRef422.GetEventFreezeFrameData
        OpEventGetEventFreezeFrameData_GetEventFreezeFrameData_EvtInfo_AutoCreatedDemEvent_CC_EnablePDUGroup_CIOM_oLIN02_Rx_771_88bcc89b: start-on-event=GetEventFreezeFrameData, operation=EvtInfo_AutoCreatedDemEvent_CC_EnablePDUGroup_CIOM_oLIN02_Rx_7711d721_BswMReportFailToDemRef422.GetEventFreezeFrameData
        OpEventGetEventFreezeFrameData_GetEventFreezeFrameData_EvtInfo_AutoCreatedDemEvent_CC_EnablePDUGroup_CIOM_oLIN02_Tx_214_58897820: start-on-event=GetEventFreezeFrameData, operation=EvtInfo_AutoCreatedDemEvent_CC_EnablePDUGroup_CIOM_oLIN02_Tx_214b70a7_BswMReportFailToDemRef422.GetEventFreezeFrameData
        OpEventGetEventFreezeFrameData_GetEventFreezeFrameData_EvtInfo_AutoCreatedDemEvent_CC_EnablePDUGroup_CIOM_oLIN03_Rx_cfa_14d27f03: start-on-event=GetEventFreezeFrameData, operation=EvtInfo_AutoCreatedDemEvent_CC_EnablePDUGroup_CIOM_oLIN03_Rx_cfadb044_BswMReportFailToDemRef422.GetEventFreezeFrameData
        OpEventGetEventFreezeFrameData_GetEventFreezeFrameData_EvtInfo_AutoCreatedDemEvent_CC_EnablePDUGroup_CIOM_oLIN03_Tx_99f_1b656157: start-on-event=GetEventFreezeFrameData, operation=EvtInfo_AutoCreatedDemEvent_CC_EnablePDUGroup_CIOM_oLIN03_Tx_99f717c2_BswMReportFailToDemRef422.GetEventFreezeFrameData
        OpEventGetEventFreezeFrameData_GetEventFreezeFrameData_EvtInfo_AutoCreatedDemEvent_CC_EnablePDUGroup_CIOM_oLIN04_Rx_527_8661a247: start-on-event=GetEventFreezeFrameData, operation=EvtInfo_AutoCreatedDemEvent_CC_EnablePDUGroup_CIOM_oLIN04_Rx_527a88fd_BswMReportFailToDemRef422.GetEventFreezeFrameData
        OpEventGetEventFreezeFrameData_GetEventFreezeFrameData_EvtInfo_AutoCreatedDemEvent_CC_EnablePDUGroup_CIOM_oLIN04_Tx_042_1969a172: start-on-event=GetEventFreezeFrameData, operation=EvtInfo_AutoCreatedDemEvent_CC_EnablePDUGroup_CIOM_oLIN04_Tx_04202f7b_BswMReportFailToDemRef422.GetEventFreezeFrameData
        OpEventGetEventFreezeFrameData_GetEventFreezeFrameData_EvtInfo_AutoCreatedDemEvent_CC_EnablePDUGroup_CIOM_oSecuritySubn_0bfb25aa: start-on-event=GetEventFreezeFrameData, operation=EvtInfo_AutoCreatedDemEvent_CC_EnablePDUGroup_CIOM_oSecuritySubnet_Rx_3a3c1dbc_BswMReportFailToDemRef422.GetEventFreezeFrameData
        OpEventGetEventFreezeFrameData_GetEventFreezeFrameData_EvtInfo_AutoCreatedDemEvent_CC_EnablePDUGroup_CIOM_oSecuritySubn_8271870c: start-on-event=GetEventFreezeFrameData, operation=EvtInfo_AutoCreatedDemEvent_CC_EnablePDUGroup_CIOM_oSecuritySubnet_Tx_6c66ba3a_BswMReportFailToDemRef422.GetEventFreezeFrameData
        OpEventGetEventFreezeFrameData_GetEventFreezeFrameData_EvtInfo_AutoCreatedDemEvent_CC_J1939RmStateSwitch_CN_Backbone1J1_ce1d5514: start-on-event=GetEventFreezeFrameData, operation=EvtInfo_AutoCreatedDemEvent_CC_J1939RmStateSwitch_CN_Backbone1J1939_0b1f4bae_CIOM_4d5cd289_J1939RM_STATE_OFFLINE_BswMRe_f9c55035.GetEventFreezeFrameData
        OpEventGetEventFreezeFrameData_GetEventFreezeFrameData_EvtInfo_AutoCreatedDemEvent_CC_J1939RmStateSwitch_CN_Backbone1J1_8841d01e: start-on-event=GetEventFreezeFrameData, operation=EvtInfo_AutoCreatedDemEvent_CC_J1939RmStateSwitch_CN_Backbone1J1939_0b1f4bae_CIOM_4d5cd289_J1939RM_STATE_ONLINE_BswMRep_5375d7eb.GetEventFreezeFrameData
        OpEventGetEventFreezeFrameData_GetEventFreezeFrameData_EvtInfo_AutoCreatedDemEvent_CC_J1939RmStateSwitch_CN_FMSNet_fce1_963c75fa: start-on-event=GetEventFreezeFrameData, operation=EvtInfo_AutoCreatedDemEvent_CC_J1939RmStateSwitch_CN_FMSNet_fce1aae5_CIOM_3a3d59b1_J1939RM_STATE_OFFLINE_BswMReportFail_5f9bde08.GetEventFreezeFrameData
        OpEventGetEventFreezeFrameData_GetEventFreezeFrameData_EvtInfo_AutoCreatedDemEvent_CC_J1939RmStateSwitch_CN_FMSNet_fce1_78247974: start-on-event=GetEventFreezeFrameData, operation=EvtInfo_AutoCreatedDemEvent_CC_J1939RmStateSwitch_CN_FMSNet_fce1aae5_CIOM_3a3d59b1_J1939RM_STATE_ONLINE_BswMReportFailT_e97c0723.GetEventFreezeFrameData
        OpEventGetEventFreezeFrameData_GetEventFreezeFrameData_EvtInfo_AutoCreatedDemEvent_CHNL_53cce282_CANSM_E_BUS_OFF422: start-on-event=GetEventFreezeFrameData, operation=EvtInfo_AutoCreatedDemEvent_CHNL_53cce282_CANSM_E_BUS_OFF422.GetEventFreezeFrameData
        OpEventGetEventFreezeFrameData_GetEventFreezeFrameData_EvtInfo_AutoCreatedDemEvent_CHNL_53cce282_CANSM_E_MODE_REQUEST_TIMEOUT422: start-on-event=GetEventFreezeFrameData, operation=EvtInfo_AutoCreatedDemEvent_CHNL_53cce282_CANSM_E_MODE_REQUEST_TIMEOUT422.GetEventFreezeFrameData
        OpEventGetEventFreezeFrameData_GetEventFreezeFrameData_EvtInfo_AutoCreatedDemEvent_CHNL_17344684_CANSM_E_BUS_OFF422: start-on-event=GetEventFreezeFrameData, operation=EvtInfo_AutoCreatedDemEvent_CHNL_17344684_CANSM_E_BUS_OFF422.GetEventFreezeFrameData
        OpEventGetEventFreezeFrameData_GetEventFreezeFrameData_EvtInfo_AutoCreatedDemEvent_CHNL_17344684_CANSM_E_MODE_REQUEST_TIMEOUT422: start-on-event=GetEventFreezeFrameData, operation=EvtInfo_AutoCreatedDemEvent_CHNL_17344684_CANSM_E_MODE_REQUEST_TIMEOUT422.GetEventFreezeFrameData
        OpEventGetEventFreezeFrameData_GetEventFreezeFrameData_EvtInfo_AutoCreatedDemEvent_CHNL_a6b6a922_CANSM_E_BUS_OFF422: start-on-event=GetEventFreezeFrameData, operation=EvtInfo_AutoCreatedDemEvent_CHNL_a6b6a922_CANSM_E_BUS_OFF422.GetEventFreezeFrameData
        OpEventGetEventFreezeFrameData_GetEventFreezeFrameData_EvtInfo_AutoCreatedDemEvent_CHNL_a6b6a922_CANSM_E_MODE_REQUEST_TIMEOUT422: start-on-event=GetEventFreezeFrameData, operation=EvtInfo_AutoCreatedDemEvent_CHNL_a6b6a922_CANSM_E_MODE_REQUEST_TIMEOUT422.GetEventFreezeFrameData
        OpEventGetEventFreezeFrameData_GetEventFreezeFrameData_EvtInfo_AutoCreatedDemEvent_CHNL_df893ad5_CANSM_E_BUS_OFF422: start-on-event=GetEventFreezeFrameData, operation=EvtInfo_AutoCreatedDemEvent_CHNL_df893ad5_CANSM_E_BUS_OFF422.GetEventFreezeFrameData
        OpEventGetEventFreezeFrameData_GetEventFreezeFrameData_EvtInfo_AutoCreatedDemEvent_CHNL_df893ad5_CANSM_E_MODE_REQUEST_TIMEOUT422: start-on-event=GetEventFreezeFrameData, operation=EvtInfo_AutoCreatedDemEvent_CHNL_df893ad5_CANSM_E_MODE_REQUEST_TIMEOUT422.GetEventFreezeFrameData
        OpEventGetEventFreezeFrameData_GetEventFreezeFrameData_EvtInfo_AutoCreatedDemEvent_CHNL_e058b4ae_CANSM_E_BUS_OFF422: start-on-event=GetEventFreezeFrameData, operation=EvtInfo_AutoCreatedDemEvent_CHNL_e058b4ae_CANSM_E_BUS_OFF422.GetEventFreezeFrameData
        OpEventGetEventFreezeFrameData_GetEventFreezeFrameData_EvtInfo_AutoCreatedDemEvent_CHNL_e058b4ae_CANSM_E_MODE_REQUEST_TIMEOUT422: start-on-event=GetEventFreezeFrameData, operation=EvtInfo_AutoCreatedDemEvent_CHNL_e058b4ae_CANSM_E_MODE_REQUEST_TIMEOUT422.GetEventFreezeFrameData
        OpEventGetEventFreezeFrameData_GetEventFreezeFrameData_EvtInfo_AutoCreatedDemEvent_ECUM_E_ALL_RUN_REQUESTS_KILLED422: start-on-event=GetEventFreezeFrameData, operation=EvtInfo_AutoCreatedDemEvent_ECUM_E_ALL_RUN_REQUESTS_KILLED422.GetEventFreezeFrameData
        OpEventGetEventFreezeFrameData_GetEventFreezeFrameData_EvtInfo_AutoCreatedDemEvent_ECUM_E_CONFIGURATION_DATA_INCONSISTENT422: start-on-event=GetEventFreezeFrameData, operation=EvtInfo_AutoCreatedDemEvent_ECUM_E_CONFIGURATION_DATA_INCONSISTENT422.GetEventFreezeFrameData
        OpEventGetEventFreezeFrameData_GetEventFreezeFrameData_EvtInfo_AutoCreatedDemEvent_ECUM_E_IMPROPER_CALLER422: start-on-event=GetEventFreezeFrameData, operation=EvtInfo_AutoCreatedDemEvent_ECUM_E_IMPROPER_CALLER422.GetEventFreezeFrameData
        OpEventGetEventFreezeFrameData_GetEventFreezeFrameData_EvtInfo_AutoCreatedDemEvent_ECUM_E_RAM_CHECK_FAILED422: start-on-event=GetEventFreezeFrameData, operation=EvtInfo_AutoCreatedDemEvent_ECUM_E_RAM_CHECK_FAILED422.GetEventFreezeFrameData
        OpEventGetEventFreezeFrameData_GetEventFreezeFrameData_EvtInfo_AutoCreatedDemEvent_ESH_Action_CancelNvMWriteAll_BswMRep_4a2f1492: start-on-event=GetEventFreezeFrameData, operation=EvtInfo_AutoCreatedDemEvent_ESH_Action_CancelNvMWriteAll_BswMReportFailToDemRef422.GetEventFreezeFrameData
        OpEventGetEventFreezeFrameData_GetEventFreezeFrameData_EvtInfo_AutoCreatedDemEvent_ESH_Action_CancelWriteAllTimer_Start_8393c5c3: start-on-event=GetEventFreezeFrameData, operation=EvtInfo_AutoCreatedDemEvent_ESH_Action_CancelWriteAllTimer_Start_BswMReportFailToDemRef422.GetEventFreezeFrameData
        OpEventGetEventFreezeFrameData_GetEventFreezeFrameData_EvtInfo_AutoCreatedDemEvent_ESH_Action_CancelWriteAllTimer_Stop_5605b301: start-on-event=GetEventFreezeFrameData, operation=EvtInfo_AutoCreatedDemEvent_ESH_Action_CancelWriteAllTimer_Stop_BswMReportFailToDemRef422.GetEventFreezeFrameData
        OpEventGetEventFreezeFrameData_GetEventFreezeFrameData_EvtInfo_AutoCreatedDemEvent_ESH_Action_ComMAllow_CN_Backbone1J19_72c9659e: start-on-event=GetEventFreezeFrameData, operation=EvtInfo_AutoCreatedDemEvent_ESH_Action_ComMAllow_CN_Backbone1J1939_0b1f4bae_BswMReportFailToDemRef422.GetEventFreezeFrameData
        OpEventGetEventFreezeFrameData_GetEventFreezeFrameData_EvtInfo_AutoCreatedDemEvent_ESH_Action_ComMAllow_CN_Backbone1J19_4ebec284: start-on-event=GetEventFreezeFrameData, operation=EvtInfo_AutoCreatedDemEvent_ESH_Action_ComMAllow_CN_Backbone1J1939_0b1f4bae_BswMReportFailToDemRef_1422.GetEventFreezeFrameData
        OpEventGetEventFreezeFrameData_GetEventFreezeFrameData_EvtInfo_AutoCreatedDemEvent_ESH_Action_ComMAllow_CN_Backbone2_78_4a21f073: start-on-event=GetEventFreezeFrameData, operation=EvtInfo_AutoCreatedDemEvent_ESH_Action_ComMAllow_CN_Backbone2_78967e2c_BswMReportFailToDemRef422.GetEventFreezeFrameData
        OpEventGetEventFreezeFrameData_GetEventFreezeFrameData_EvtInfo_AutoCreatedDemEvent_ESH_Action_ComMAllow_CN_Backbone2_78_250b1006: start-on-event=GetEventFreezeFrameData, operation=EvtInfo_AutoCreatedDemEvent_ESH_Action_ComMAllow_CN_Backbone2_78967e2c_BswMReportFailToDemRef_1422.GetEventFreezeFrameData
        OpEventGetEventFreezeFrameData_GetEventFreezeFrameData_EvtInfo_AutoCreatedDemEvent_ESH_Action_ComMAllow_CN_CabSubnet_9e_e62bd6a5: start-on-event=GetEventFreezeFrameData, operation=EvtInfo_AutoCreatedDemEvent_ESH_Action_ComMAllow_CN_CabSubnet_9ea693f1_BswMReportFailToDemRef422.GetEventFreezeFrameData
        OpEventGetEventFreezeFrameData_GetEventFreezeFrameData_EvtInfo_AutoCreatedDemEvent_ESH_Action_ComMAllow_CN_CabSubnet_9e_20645b68: start-on-event=GetEventFreezeFrameData, operation=EvtInfo_AutoCreatedDemEvent_ESH_Action_ComMAllow_CN_CabSubnet_9ea693f1_BswMReportFailToDemRef_1422.GetEventFreezeFrameData
        OpEventGetEventFreezeFrameData_GetEventFreezeFrameData_EvtInfo_AutoCreatedDemEvent_ESH_Action_ComMAllow_CN_FMSNet_fce1a_eea488d7: start-on-event=GetEventFreezeFrameData, operation=EvtInfo_AutoCreatedDemEvent_ESH_Action_ComMAllow_CN_FMSNet_fce1aae5_BswMReportFailToDemRef422.GetEventFreezeFrameData
        OpEventGetEventFreezeFrameData_GetEventFreezeFrameData_EvtInfo_AutoCreatedDemEvent_ESH_Action_ComMAllow_CN_FMSNet_fce1a_b1be3460: start-on-event=GetEventFreezeFrameData, operation=EvtInfo_AutoCreatedDemEvent_ESH_Action_ComMAllow_CN_FMSNet_fce1aae5_BswMReportFailToDemRef_1422.GetEventFreezeFrameData
        OpEventGetEventFreezeFrameData_GetEventFreezeFrameData_EvtInfo_AutoCreatedDemEvent_ESH_Action_ComMAllow_CN_LIN00_2cd9a7_6de53222: start-on-event=GetEventFreezeFrameData, operation=EvtInfo_AutoCreatedDemEvent_ESH_Action_ComMAllow_CN_LIN00_2cd9a7df_BswMReportFailToDemRef422.GetEventFreezeFrameData
        OpEventGetEventFreezeFrameData_GetEventFreezeFrameData_EvtInfo_AutoCreatedDemEvent_ESH_Action_ComMAllow_CN_LIN00_2cd9a7_f3c1f84b: start-on-event=GetEventFreezeFrameData, operation=EvtInfo_AutoCreatedDemEvent_ESH_Action_ComMAllow_CN_LIN00_2cd9a7df_BswMReportFailToDemRef_1422.GetEventFreezeFrameData
        OpEventGetEventFreezeFrameData_GetEventFreezeFrameData_EvtInfo_AutoCreatedDemEvent_ESH_Action_ComMAllow_CN_LIN01_5bde97_56d5434e: start-on-event=GetEventFreezeFrameData, operation=EvtInfo_AutoCreatedDemEvent_ESH_Action_ComMAllow_CN_LIN01_5bde9749_BswMReportFailToDemRef422.GetEventFreezeFrameData
        OpEventGetEventFreezeFrameData_GetEventFreezeFrameData_EvtInfo_AutoCreatedDemEvent_ESH_Action_ComMAllow_CN_LIN01_5bde97_1d8ba67a: start-on-event=GetEventFreezeFrameData, operation=EvtInfo_AutoCreatedDemEvent_ESH_Action_ComMAllow_CN_LIN01_5bde9749_BswMReportFailToDemRef_1422.GetEventFreezeFrameData
        OpEventGetEventFreezeFrameData_GetEventFreezeFrameData_EvtInfo_AutoCreatedDemEvent_ESH_Action_ComMAllow_CN_LIN02_c2d7c6_8fb6837f: start-on-event=GetEventFreezeFrameData, operation=EvtInfo_AutoCreatedDemEvent_ESH_Action_ComMAllow_CN_LIN02_c2d7c6f3_BswMReportFailToDemRef422.GetEventFreezeFrameData
        OpEventGetEventFreezeFrameData_GetEventFreezeFrameData_EvtInfo_AutoCreatedDemEvent_ESH_Action_ComMAllow_CN_LIN02_c2d7c6_40b2ba1b: start-on-event=GetEventFreezeFrameData, operation=EvtInfo_AutoCreatedDemEvent_ESH_Action_ComMAllow_CN_LIN02_c2d7c6f3_BswMReportFailToDemRef_1422.GetEventFreezeFrameData
        OpEventGetEventFreezeFrameData_GetEventFreezeFrameData_EvtInfo_AutoCreatedDemEvent_ESH_Action_ComMAllow_CN_LIN03_b5d0f6_91b4ca4d: start-on-event=GetEventFreezeFrameData, operation=EvtInfo_AutoCreatedDemEvent_ESH_Action_ComMAllow_CN_LIN03_b5d0f665_BswMReportFailToDemRef422.GetEventFreezeFrameData
        OpEventGetEventFreezeFrameData_GetEventFreezeFrameData_EvtInfo_AutoCreatedDemEvent_ESH_Action_ComMAllow_CN_LIN03_b5d0f6_a2c2095c: start-on-event=GetEventFreezeFrameData, operation=EvtInfo_AutoCreatedDemEvent_ESH_Action_ComMAllow_CN_LIN03_b5d0f665_BswMReportFailToDemRef_1422.GetEventFreezeFrameData
        OpEventGetEventFreezeFrameData_GetEventFreezeFrameData_EvtInfo_AutoCreatedDemEvent_ESH_Action_ComMAllow_CN_LIN04_2bb463_1af012d5: start-on-event=GetEventFreezeFrameData, operation=EvtInfo_AutoCreatedDemEvent_ESH_Action_ComMAllow_CN_LIN04_2bb463c6_BswMReportFailToDemRef422.GetEventFreezeFrameData
        OpEventGetEventFreezeFrameData_GetEventFreezeFrameData_EvtInfo_AutoCreatedDemEvent_ESH_Action_ComMAllow_CN_LIN04_2bb463_9352d8ec: start-on-event=GetEventFreezeFrameData, operation=EvtInfo_AutoCreatedDemEvent_ESH_Action_ComMAllow_CN_LIN04_2bb463c6_BswMReportFailToDemRef_1422.GetEventFreezeFrameData
        OpEventGetEventFreezeFrameData_GetEventFreezeFrameData_EvtInfo_AutoCreatedDemEvent_ESH_Action_ComMAllow_CN_SecuritySubn_c81e4cf6: start-on-event=GetEventFreezeFrameData, operation=EvtInfo_AutoCreatedDemEvent_ESH_Action_ComMAllow_CN_SecuritySubnet_e7a0ee54_BswMReportFailToDemRef422.GetEventFreezeFrameData
        OpEventGetEventFreezeFrameData_GetEventFreezeFrameData_EvtInfo_AutoCreatedDemEvent_ESH_Action_ComMAllow_CN_SecuritySubn_a1280190: start-on-event=GetEventFreezeFrameData, operation=EvtInfo_AutoCreatedDemEvent_ESH_Action_ComMAllow_CN_SecuritySubnet_e7a0ee54_BswMReportFailToDemRef_1422.GetEventFreezeFrameData
        OpEventGetEventFreezeFrameData_GetEventFreezeFrameData_EvtInfo_AutoCreatedDemEvent_ESH_Action_ComMCheckPendingRequests_12d2b717: start-on-event=GetEventFreezeFrameData, operation=EvtInfo_AutoCreatedDemEvent_ESH_Action_ComMCheckPendingRequests_BswMReportFailToDemRef422.GetEventFreezeFrameData
        OpEventGetEventFreezeFrameData_GetEventFreezeFrameData_EvtInfo_AutoCreatedDemEvent_ESH_Action_ComMCheckPendingRequests_cc223265: start-on-event=GetEventFreezeFrameData, operation=EvtInfo_AutoCreatedDemEvent_ESH_Action_ComMCheckPendingRequests_BswMReportFailToDemRef_1422.GetEventFreezeFrameData
        OpEventGetEventFreezeFrameData_GetEventFreezeFrameData_EvtInfo_AutoCreatedDemEvent_ESH_Action_ComMCheckPendingRequests_de979d8b: start-on-event=GetEventFreezeFrameData, operation=EvtInfo_AutoCreatedDemEvent_ESH_Action_ComMCheckPendingRequests_BswMReportFailToDemRef_2422.GetEventFreezeFrameData
        OpEventGetEventFreezeFrameData_GetEventFreezeFrameData_EvtInfo_AutoCreatedDemEvent_ESH_Action_ComMDisallow_CN_Backbone1_40a6dca8: start-on-event=GetEventFreezeFrameData, operation=EvtInfo_AutoCreatedDemEvent_ESH_Action_ComMDisallow_CN_Backbone1J1939_0b1f4bae_BswMReportFailToDemRef422.GetEventFreezeFrameData
        OpEventGetEventFreezeFrameData_GetEventFreezeFrameData_EvtInfo_AutoCreatedDemEvent_ESH_Action_ComMDisallow_CN_Backbone2_f180aef8: start-on-event=GetEventFreezeFrameData, operation=EvtInfo_AutoCreatedDemEvent_ESH_Action_ComMDisallow_CN_Backbone2_78967e2c_BswMReportFailToDemRef422.GetEventFreezeFrameData
        OpEventGetEventFreezeFrameData_GetEventFreezeFrameData_EvtInfo_AutoCreatedDemEvent_ESH_Action_ComMDisallow_CN_CabSubnet_5d8a882e: start-on-event=GetEventFreezeFrameData, operation=EvtInfo_AutoCreatedDemEvent_ESH_Action_ComMDisallow_CN_CabSubnet_9ea693f1_BswMReportFailToDemRef422.GetEventFreezeFrameData
        OpEventGetEventFreezeFrameData_GetEventFreezeFrameData_EvtInfo_AutoCreatedDemEvent_ESH_Action_ComMDisallow_CN_FMSNet_fc_46d6b0cf: start-on-event=GetEventFreezeFrameData, operation=EvtInfo_AutoCreatedDemEvent_ESH_Action_ComMDisallow_CN_FMSNet_fce1aae5_BswMReportFailToDemRef422.GetEventFreezeFrameData
        OpEventGetEventFreezeFrameData_GetEventFreezeFrameData_EvtInfo_AutoCreatedDemEvent_ESH_Action_ComMDisallow_CN_LIN00_2cd_78027f8f: start-on-event=GetEventFreezeFrameData, operation=EvtInfo_AutoCreatedDemEvent_ESH_Action_ComMDisallow_CN_LIN00_2cd9a7df_BswMReportFailToDemRef422.GetEventFreezeFrameData
        OpEventGetEventFreezeFrameData_GetEventFreezeFrameData_EvtInfo_AutoCreatedDemEvent_ESH_Action_ComMDisallow_CN_LIN01_5bd_43320ee3: start-on-event=GetEventFreezeFrameData, operation=EvtInfo_AutoCreatedDemEvent_ESH_Action_ComMDisallow_CN_LIN01_5bde9749_BswMReportFailToDemRef422.GetEventFreezeFrameData
        OpEventGetEventFreezeFrameData_GetEventFreezeFrameData_EvtInfo_AutoCreatedDemEvent_ESH_Action_ComMDisallow_CN_LIN02_c2d_9a51ced2: start-on-event=GetEventFreezeFrameData, operation=EvtInfo_AutoCreatedDemEvent_ESH_Action_ComMDisallow_CN_LIN02_c2d7c6f3_BswMReportFailToDemRef422.GetEventFreezeFrameData
        OpEventGetEventFreezeFrameData_GetEventFreezeFrameData_EvtInfo_AutoCreatedDemEvent_ESH_Action_ComMDisallow_CN_LIN03_b5d_845387e0: start-on-event=GetEventFreezeFrameData, operation=EvtInfo_AutoCreatedDemEvent_ESH_Action_ComMDisallow_CN_LIN03_b5d0f665_BswMReportFailToDemRef422.GetEventFreezeFrameData
        OpEventGetEventFreezeFrameData_GetEventFreezeFrameData_EvtInfo_AutoCreatedDemEvent_ESH_Action_ComMDisallow_CN_LIN04_2bb_0f175f78: start-on-event=GetEventFreezeFrameData, operation=EvtInfo_AutoCreatedDemEvent_ESH_Action_ComMDisallow_CN_LIN04_2bb463c6_BswMReportFailToDemRef422.GetEventFreezeFrameData
        OpEventGetEventFreezeFrameData_GetEventFreezeFrameData_EvtInfo_AutoCreatedDemEvent_ESH_Action_ComMDisallow_CN_SecurityS_fa71f5c0: start-on-event=GetEventFreezeFrameData, operation=EvtInfo_AutoCreatedDemEvent_ESH_Action_ComMDisallow_CN_SecuritySubnet_e7a0ee54_BswMReportFailToDemRef422.GetEventFreezeFrameData
        OpEventGetEventFreezeFrameData_GetEventFreezeFrameData_EvtInfo_AutoCreatedDemEvent_ESH_Action_DemInit_BswMReportFailToDemRef422: start-on-event=GetEventFreezeFrameData, operation=EvtInfo_AutoCreatedDemEvent_ESH_Action_DemInit_BswMReportFailToDemRef422.GetEventFreezeFrameData
        OpEventGetEventFreezeFrameData_GetEventFreezeFrameData_EvtInfo_AutoCreatedDemEvent_ESH_Action_DemInitialized_BswMReport_f4791c48: start-on-event=GetEventFreezeFrameData, operation=EvtInfo_AutoCreatedDemEvent_ESH_Action_DemInitialized_BswMReportFailToDemRef422.GetEventFreezeFrameData
        OpEventGetEventFreezeFrameData_GetEventFreezeFrameData_EvtInfo_AutoCreatedDemEvent_ESH_Action_DemNotInitialized_BswMRep_a3a067fa: start-on-event=GetEventFreezeFrameData, operation=EvtInfo_AutoCreatedDemEvent_ESH_Action_DemNotInitialized_BswMReportFailToDemRef422.GetEventFreezeFrameData
        OpEventGetEventFreezeFrameData_GetEventFreezeFrameData_EvtInfo_AutoCreatedDemEvent_ESH_Action_DemShutdown_BswMReportFai_64f2a2c9: start-on-event=GetEventFreezeFrameData, operation=EvtInfo_AutoCreatedDemEvent_ESH_Action_DemShutdown_BswMReportFailToDemRef422.GetEventFreezeFrameData
        OpEventGetEventFreezeFrameData_GetEventFreezeFrameData_EvtInfo_AutoCreatedDemEvent_ESH_Action_ESH_PostRun_BswMReportFai_ea0682aa: start-on-event=GetEventFreezeFrameData, operation=EvtInfo_AutoCreatedDemEvent_ESH_Action_ESH_PostRun_BswMReportFailToDemRef422.GetEventFreezeFrameData
        OpEventGetEventFreezeFrameData_GetEventFreezeFrameData_EvtInfo_AutoCreatedDemEvent_ESH_Action_ESH_PrepShutdown_BswMRepo_2e94291d: start-on-event=GetEventFreezeFrameData, operation=EvtInfo_AutoCreatedDemEvent_ESH_Action_ESH_PrepShutdown_BswMReportFailToDemRef422.GetEventFreezeFrameData
        OpEventGetEventFreezeFrameData_GetEventFreezeFrameData_EvtInfo_AutoCreatedDemEvent_ESH_Action_ESH_PrepShutdown_BswMRepo_217a58ea: start-on-event=GetEventFreezeFrameData, operation=EvtInfo_AutoCreatedDemEvent_ESH_Action_ESH_PrepShutdown_BswMReportFailToDemRef_1422.GetEventFreezeFrameData
        OpEventGetEventFreezeFrameData_GetEventFreezeFrameData_EvtInfo_AutoCreatedDemEvent_ESH_Action_ESH_Run_BswMReportFailToDemRef422: start-on-event=GetEventFreezeFrameData, operation=EvtInfo_AutoCreatedDemEvent_ESH_Action_ESH_Run_BswMReportFailToDemRef422.GetEventFreezeFrameData
        OpEventGetEventFreezeFrameData_GetEventFreezeFrameData_EvtInfo_AutoCreatedDemEvent_ESH_Action_ESH_Run_BswMReportFailToD_cae88c18: start-on-event=GetEventFreezeFrameData, operation=EvtInfo_AutoCreatedDemEvent_ESH_Action_ESH_Run_BswMReportFailToDemRef_1422.GetEventFreezeFrameData
        OpEventGetEventFreezeFrameData_GetEventFreezeFrameData_EvtInfo_AutoCreatedDemEvent_ESH_Action_ESH_WaitForNvm_BswMReport_0fe12db2: start-on-event=GetEventFreezeFrameData, operation=EvtInfo_AutoCreatedDemEvent_ESH_Action_ESH_WaitForNvm_BswMReportFailToDemRef422.GetEventFreezeFrameData
        OpEventGetEventFreezeFrameData_GetEventFreezeFrameData_EvtInfo_AutoCreatedDemEvent_ESH_Action_ESH_Wakeup_BswMReportFail_836eb933: start-on-event=GetEventFreezeFrameData, operation=EvtInfo_AutoCreatedDemEvent_ESH_Action_ESH_Wakeup_BswMReportFailToDemRef422.GetEventFreezeFrameData
        OpEventGetEventFreezeFrameData_GetEventFreezeFrameData_EvtInfo_AutoCreatedDemEvent_ESH_Action_ESH_Wakeup_BswMReportFail_da726f78: start-on-event=GetEventFreezeFrameData, operation=EvtInfo_AutoCreatedDemEvent_ESH_Action_ESH_Wakeup_BswMReportFailToDemRef_1422.GetEventFreezeFrameData
        OpEventGetEventFreezeFrameData_GetEventFreezeFrameData_EvtInfo_AutoCreatedDemEvent_ESH_Action_EcuMClearValidatedWakeupE_74983d45: start-on-event=GetEventFreezeFrameData, operation=EvtInfo_AutoCreatedDemEvent_ESH_Action_EcuMClearValidatedWakeupEvents_BswMReportFailToDemRef422.GetEventFreezeFrameData
        OpEventGetEventFreezeFrameData_GetEventFreezeFrameData_EvtInfo_AutoCreatedDemEvent_ESH_Action_EcuMGoToSelectedShutdownT_8f507250: start-on-event=GetEventFreezeFrameData, operation=EvtInfo_AutoCreatedDemEvent_ESH_Action_EcuMGoToSelectedShutdownTarget_BswMReportFailToDemRef422.GetEventFreezeFrameData
        OpEventGetEventFreezeFrameData_GetEventFreezeFrameData_EvtInfo_AutoCreatedDemEvent_ESH_Action_EnterExclusiveArea_BswMRe_6c43523d: start-on-event=GetEventFreezeFrameData, operation=EvtInfo_AutoCreatedDemEvent_ESH_Action_EnterExclusiveArea_BswMReportFailToDemRef422.GetEventFreezeFrameData
        OpEventGetEventFreezeFrameData_GetEventFreezeFrameData_EvtInfo_AutoCreatedDemEvent_ESH_Action_EnterExclusiveArea_BswMRe_7329962b: start-on-event=GetEventFreezeFrameData, operation=EvtInfo_AutoCreatedDemEvent_ESH_Action_EnterExclusiveArea_BswMReportFailToDemRef_1422.GetEventFreezeFrameData
        OpEventGetEventFreezeFrameData_GetEventFreezeFrameData_EvtInfo_AutoCreatedDemEvent_ESH_Action_ExitExclusiveArea_BswMRep_f39634e8: start-on-event=GetEventFreezeFrameData, operation=EvtInfo_AutoCreatedDemEvent_ESH_Action_ExitExclusiveArea_BswMReportFailToDemRef422.GetEventFreezeFrameData
        OpEventGetEventFreezeFrameData_GetEventFreezeFrameData_EvtInfo_AutoCreatedDemEvent_ESH_Action_ExitExclusiveArea_BswMRep_2bb7fcc9: start-on-event=GetEventFreezeFrameData, operation=EvtInfo_AutoCreatedDemEvent_ESH_Action_ExitExclusiveArea_BswMReportFailToDemRef_1422.GetEventFreezeFrameData
        OpEventGetEventFreezeFrameData_GetEventFreezeFrameData_EvtInfo_AutoCreatedDemEvent_ESH_Action_NvMWriteAll_BswMReportFai_a19ef3db: start-on-event=GetEventFreezeFrameData, operation=EvtInfo_AutoCreatedDemEvent_ESH_Action_NvMWriteAll_BswMReportFailToDemRef422.GetEventFreezeFrameData
        OpEventGetEventFreezeFrameData_GetEventFreezeFrameData_EvtInfo_AutoCreatedDemEvent_ESH_Action_OnEnterPostRun_BswMReport_697c008e: start-on-event=GetEventFreezeFrameData, operation=EvtInfo_AutoCreatedDemEvent_ESH_Action_OnEnterPostRun_BswMReportFailToDemRef422.GetEventFreezeFrameData
        OpEventGetEventFreezeFrameData_GetEventFreezeFrameData_EvtInfo_AutoCreatedDemEvent_ESH_Action_OnEnterPrepShutdown_BswMR_144df867: start-on-event=GetEventFreezeFrameData, operation=EvtInfo_AutoCreatedDemEvent_ESH_Action_OnEnterPrepShutdown_BswMReportFailToDemRef422.GetEventFreezeFrameData
        OpEventGetEventFreezeFrameData_GetEventFreezeFrameData_EvtInfo_AutoCreatedDemEvent_ESH_Action_OnEnterPrepShutdown_BswMR_057e110d: start-on-event=GetEventFreezeFrameData, operation=EvtInfo_AutoCreatedDemEvent_ESH_Action_OnEnterPrepShutdown_BswMReportFailToDemRef_1422.GetEventFreezeFrameData
        OpEventGetEventFreezeFrameData_GetEventFreezeFrameData_EvtInfo_AutoCreatedDemEvent_ESH_Action_OnEnterRun_BswMReportFail_af0e8976: start-on-event=GetEventFreezeFrameData, operation=EvtInfo_AutoCreatedDemEvent_ESH_Action_OnEnterRun_BswMReportFailToDemRef422.GetEventFreezeFrameData
        OpEventGetEventFreezeFrameData_GetEventFreezeFrameData_EvtInfo_AutoCreatedDemEvent_ESH_Action_OnEnterRun_BswMReportFail_71a5c8f4: start-on-event=GetEventFreezeFrameData, operation=EvtInfo_AutoCreatedDemEvent_ESH_Action_OnEnterRun_BswMReportFailToDemRef_1422.GetEventFreezeFrameData
        OpEventGetEventFreezeFrameData_GetEventFreezeFrameData_EvtInfo_AutoCreatedDemEvent_ESH_Action_OnEnterShutdown_BswMRepor_c6afa0dd: start-on-event=GetEventFreezeFrameData, operation=EvtInfo_AutoCreatedDemEvent_ESH_Action_OnEnterShutdown_BswMReportFailToDemRef422.GetEventFreezeFrameData
        OpEventGetEventFreezeFrameData_GetEventFreezeFrameData_EvtInfo_AutoCreatedDemEvent_ESH_Action_OnEnterWaitForNvm_BswMRep_89c0a1e6: start-on-event=GetEventFreezeFrameData, operation=EvtInfo_AutoCreatedDemEvent_ESH_Action_OnEnterWaitForNvm_BswMReportFailToDemRef422.GetEventFreezeFrameData
        OpEventGetEventFreezeFrameData_GetEventFreezeFrameData_EvtInfo_AutoCreatedDemEvent_ESH_Action_OnEnterWakeup_BswMReportF_2a695a24: start-on-event=GetEventFreezeFrameData, operation=EvtInfo_AutoCreatedDemEvent_ESH_Action_OnEnterWakeup_BswMReportFailToDemRef422.GetEventFreezeFrameData
        OpEventGetEventFreezeFrameData_GetEventFreezeFrameData_EvtInfo_AutoCreatedDemEvent_ESH_Action_OnEnterWakeup_BswMReportF_e6f2f12b: start-on-event=GetEventFreezeFrameData, operation=EvtInfo_AutoCreatedDemEvent_ESH_Action_OnEnterWakeup_BswMReportFailToDemRef_1422.GetEventFreezeFrameData
        OpEventGetEventFreezeFrameData_GetEventFreezeFrameData_EvtInfo_AutoCreatedDemEvent_ESH_Action_SelfRunRequestTimer_Start_2d794993: start-on-event=GetEventFreezeFrameData, operation=EvtInfo_AutoCreatedDemEvent_ESH_Action_SelfRunRequestTimer_Start_BswMReportFailToDemRef422.GetEventFreezeFrameData
        OpEventGetEventFreezeFrameData_GetEventFreezeFrameData_EvtInfo_AutoCreatedDemEvent_ESH_Action_SelfRunRequestTimer_Start_c9c88f9a: start-on-event=GetEventFreezeFrameData, operation=EvtInfo_AutoCreatedDemEvent_ESH_Action_SelfRunRequestTimer_Start_BswMReportFailToDemRef_1422.GetEventFreezeFrameData
        OpEventGetEventFreezeFrameData_GetEventFreezeFrameData_EvtInfo_AutoCreatedDemEvent_ESH_Action_SwitchPostRun_BswMReportF_30b83bc6: start-on-event=GetEventFreezeFrameData, operation=EvtInfo_AutoCreatedDemEvent_ESH_Action_SwitchPostRun_BswMReportFailToDemRef422.GetEventFreezeFrameData
        OpEventGetEventFreezeFrameData_GetEventFreezeFrameData_EvtInfo_AutoCreatedDemEvent_ESH_Action_SwitchRun_BswMReportFailT_3fb7ff8a: start-on-event=GetEventFreezeFrameData, operation=EvtInfo_AutoCreatedDemEvent_ESH_Action_SwitchRun_BswMReportFailToDemRef422.GetEventFreezeFrameData
        OpEventGetEventFreezeFrameData_GetEventFreezeFrameData_EvtInfo_AutoCreatedDemEvent_ESH_Action_SwitchRun_BswMReportFailT_70ca22f5: start-on-event=GetEventFreezeFrameData, operation=EvtInfo_AutoCreatedDemEvent_ESH_Action_SwitchRun_BswMReportFailToDemRef_1422.GetEventFreezeFrameData
        OpEventGetEventFreezeFrameData_GetEventFreezeFrameData_EvtInfo_AutoCreatedDemEvent_ESH_Action_SwitchShutdown_BswMReport_bef1ad44: start-on-event=GetEventFreezeFrameData, operation=EvtInfo_AutoCreatedDemEvent_ESH_Action_SwitchShutdown_BswMReportFailToDemRef422.GetEventFreezeFrameData
        OpEventGetEventFreezeFrameData_GetEventFreezeFrameData_EvtInfo_AutoCreatedDemEvent_ESH_Action_SwitchShutdown_BswMReport_a0d669ab: start-on-event=GetEventFreezeFrameData, operation=EvtInfo_AutoCreatedDemEvent_ESH_Action_SwitchShutdown_BswMReportFailToDemRef_1422.GetEventFreezeFrameData
        OpEventGetEventFreezeFrameData_GetEventFreezeFrameData_EvtInfo_AutoCreatedDemEvent_ESH_Action_SwitchWakeup_BswMReportFa_5d6f0558: start-on-event=GetEventFreezeFrameData, operation=EvtInfo_AutoCreatedDemEvent_ESH_Action_SwitchWakeup_BswMReportFailToDemRef422.GetEventFreezeFrameData
        OpEventGetEventFreezeFrameData_GetEventFreezeFrameData_EvtInfo_AutoCreatedDemEvent_ESH_Action_SwitchWakeup_BswMReportFa_9eacfcb2: start-on-event=GetEventFreezeFrameData, operation=EvtInfo_AutoCreatedDemEvent_ESH_Action_SwitchWakeup_BswMReportFailToDemRef_1422.GetEventFreezeFrameData
        OpEventGetEventFreezeFrameData_GetEventFreezeFrameData_EvtInfo_AutoCreatedDemEvent_ESH_Action_WriteAllTimer_Start_BswMR_fdd4b282: start-on-event=GetEventFreezeFrameData, operation=EvtInfo_AutoCreatedDemEvent_ESH_Action_WriteAllTimer_Start_BswMReportFailToDemRef422.GetEventFreezeFrameData
        OpEventGetEventFreezeFrameData_GetEventFreezeFrameData_EvtInfo_AutoCreatedDemEvent_ESH_Action_WriteAllTimer_Stop_BswMRe_a00e4f0c: start-on-event=GetEventFreezeFrameData, operation=EvtInfo_AutoCreatedDemEvent_ESH_Action_WriteAllTimer_Stop_BswMReportFailToDemRef422.GetEventFreezeFrameData
        OpEventGetEventFreezeFrameData_GetEventFreezeFrameData_EvtInfo_AutoCreatedDemEvent_ESH_Action_WriteAllTimer_Stop_BswMRe_d672310d: start-on-event=GetEventFreezeFrameData, operation=EvtInfo_AutoCreatedDemEvent_ESH_Action_WriteAllTimer_Stop_BswMReportFailToDemRef_1422.GetEventFreezeFrameData
        OpEventGetEventFreezeFrameData_GetEventFreezeFrameData_EvtInfo_AutoCreatedDemEvent_ESH_DemInit_BswMReportFailToDemRef422: start-on-event=GetEventFreezeFrameData, operation=EvtInfo_AutoCreatedDemEvent_ESH_DemInit_BswMReportFailToDemRef422.GetEventFreezeFrameData
        OpEventGetEventFreezeFrameData_GetEventFreezeFrameData_EvtInfo_AutoCreatedDemEvent_ESH_PostRunNested_BswMReportFailToDemRef422: start-on-event=GetEventFreezeFrameData, operation=EvtInfo_AutoCreatedDemEvent_ESH_PostRunNested_BswMReportFailToDemRef422.GetEventFreezeFrameData
        OpEventGetEventFreezeFrameData_GetEventFreezeFrameData_EvtInfo_AutoCreatedDemEvent_ESH_PostRunToPrepNested_BswMReportFa_9197221a: start-on-event=GetEventFreezeFrameData, operation=EvtInfo_AutoCreatedDemEvent_ESH_PostRunToPrepNested_BswMReportFailToDemRef422.GetEventFreezeFrameData
        OpEventGetEventFreezeFrameData_GetEventFreezeFrameData_EvtInfo_AutoCreatedDemEvent_ESH_RunToPostRunNested_BswMReportFai_c61ae4be: start-on-event=GetEventFreezeFrameData, operation=EvtInfo_AutoCreatedDemEvent_ESH_RunToPostRunNested_BswMReportFailToDemRef422.GetEventFreezeFrameData
        OpEventGetEventFreezeFrameData_GetEventFreezeFrameData_EvtInfo_AutoCreatedDemEvent_FLS_E_COMPARE_FAILED422: start-on-event=GetEventFreezeFrameData, operation=EvtInfo_AutoCreatedDemEvent_FLS_E_COMPARE_FAILED422.GetEventFreezeFrameData
        OpEventGetEventFreezeFrameData_GetEventFreezeFrameData_EvtInfo_AutoCreatedDemEvent_FLS_E_ERASE_FAILED422: start-on-event=GetEventFreezeFrameData, operation=EvtInfo_AutoCreatedDemEvent_FLS_E_ERASE_FAILED422.GetEventFreezeFrameData
        OpEventGetEventFreezeFrameData_GetEventFreezeFrameData_EvtInfo_AutoCreatedDemEvent_FLS_E_READ_FAILED422: start-on-event=GetEventFreezeFrameData, operation=EvtInfo_AutoCreatedDemEvent_FLS_E_READ_FAILED422.GetEventFreezeFrameData
        OpEventGetEventFreezeFrameData_GetEventFreezeFrameData_EvtInfo_AutoCreatedDemEvent_FLS_E_UNEXPECTED_FLASH_ID422: start-on-event=GetEventFreezeFrameData, operation=EvtInfo_AutoCreatedDemEvent_FLS_E_UNEXPECTED_FLASH_ID422.GetEventFreezeFrameData
        OpEventGetEventFreezeFrameData_GetEventFreezeFrameData_EvtInfo_AutoCreatedDemEvent_FLS_E_WRITE_FAILED422: start-on-event=GetEventFreezeFrameData, operation=EvtInfo_AutoCreatedDemEvent_FLS_E_WRITE_FAILED422.GetEventFreezeFrameData
        OpEventGetEventFreezeFrameData_GetEventFreezeFrameData_EvtInfo_AutoCreatedDemEvent_GPT_E_TIMEOUT422: start-on-event=GetEventFreezeFrameData, operation=EvtInfo_AutoCreatedDemEvent_GPT_E_TIMEOUT422.GetEventFreezeFrameData
        OpEventGetEventFreezeFrameData_GetEventFreezeFrameData_EvtInfo_AutoCreatedDemEvent_INIT_Action_BrsHw_EnableHwAccess_Bsw_bc1a727b: start-on-event=GetEventFreezeFrameData, operation=EvtInfo_AutoCreatedDemEvent_INIT_Action_BrsHw_EnableHwAccess_BswMReportFailToDemRef422.GetEventFreezeFrameData
        OpEventGetEventFreezeFrameData_GetEventFreezeFrameData_EvtInfo_AutoCreatedDemEvent_INIT_Action_CanIf_Init_BswMReportFai_cef95828: start-on-event=GetEventFreezeFrameData, operation=EvtInfo_AutoCreatedDemEvent_INIT_Action_CanIf_Init_BswMReportFailToDemRef422.GetEventFreezeFrameData
        OpEventGetEventFreezeFrameData_GetEventFreezeFrameData_EvtInfo_AutoCreatedDemEvent_INIT_Action_CanNm_Init_BswMReportFai_642f961a: start-on-event=GetEventFreezeFrameData, operation=EvtInfo_AutoCreatedDemEvent_INIT_Action_CanNm_Init_BswMReportFailToDemRef422.GetEventFreezeFrameData
        OpEventGetEventFreezeFrameData_GetEventFreezeFrameData_EvtInfo_AutoCreatedDemEvent_INIT_Action_CanSM_Init_BswMReportFai_068b1a9c: start-on-event=GetEventFreezeFrameData, operation=EvtInfo_AutoCreatedDemEvent_INIT_Action_CanSM_Init_BswMReportFailToDemRef422.GetEventFreezeFrameData
        OpEventGetEventFreezeFrameData_GetEventFreezeFrameData_EvtInfo_AutoCreatedDemEvent_INIT_Action_CanTp_Init_BswMReportFai_c2f970aa: start-on-event=GetEventFreezeFrameData, operation=EvtInfo_AutoCreatedDemEvent_INIT_Action_CanTp_Init_BswMReportFailToDemRef422.GetEventFreezeFrameData
        OpEventGetEventFreezeFrameData_GetEventFreezeFrameData_EvtInfo_AutoCreatedDemEvent_INIT_Action_Can_Init_BswMReportFailT_3d1ee95c: start-on-event=GetEventFreezeFrameData, operation=EvtInfo_AutoCreatedDemEvent_INIT_Action_Can_Init_BswMReportFailToDemRef422.GetEventFreezeFrameData
        OpEventGetEventFreezeFrameData_GetEventFreezeFrameData_EvtInfo_AutoCreatedDemEvent_INIT_Action_ComM_Init_BswMReportFail_8f31b05b: start-on-event=GetEventFreezeFrameData, operation=EvtInfo_AutoCreatedDemEvent_INIT_Action_ComM_Init_BswMReportFailToDemRef422.GetEventFreezeFrameData
        OpEventGetEventFreezeFrameData_GetEventFreezeFrameData_EvtInfo_AutoCreatedDemEvent_INIT_Action_Com_Init_BswMReportFailT_2ecb0210: start-on-event=GetEventFreezeFrameData, operation=EvtInfo_AutoCreatedDemEvent_INIT_Action_Com_Init_BswMReportFailToDemRef422.GetEventFreezeFrameData
        OpEventGetEventFreezeFrameData_GetEventFreezeFrameData_EvtInfo_AutoCreatedDemEvent_INIT_Action_Dcm_Init_BswMReportFailT_666b7787: start-on-event=GetEventFreezeFrameData, operation=EvtInfo_AutoCreatedDemEvent_INIT_Action_Dcm_Init_BswMReportFailToDemRef422.GetEventFreezeFrameData
        OpEventGetEventFreezeFrameData_GetEventFreezeFrameData_EvtInfo_AutoCreatedDemEvent_INIT_Action_Dem_Init_BswMReportFailT_d04415ad: start-on-event=GetEventFreezeFrameData, operation=EvtInfo_AutoCreatedDemEvent_INIT_Action_Dem_Init_BswMReportFailToDemRef422.GetEventFreezeFrameData
        OpEventGetEventFreezeFrameData_GetEventFreezeFrameData_EvtInfo_AutoCreatedDemEvent_INIT_Action_EnableInterrupts_BswMRep_f862ea32: start-on-event=GetEventFreezeFrameData, operation=EvtInfo_AutoCreatedDemEvent_INIT_Action_EnableInterrupts_BswMReportFailToDemRef422.GetEventFreezeFrameData
        OpEventGetEventFreezeFrameData_GetEventFreezeFrameData_EvtInfo_AutoCreatedDemEvent_INIT_Action_Fee_Init_BswMReportFailT_7a548395: start-on-event=GetEventFreezeFrameData, operation=EvtInfo_AutoCreatedDemEvent_INIT_Action_Fee_Init_BswMReportFailToDemRef422.GetEventFreezeFrameData
        OpEventGetEventFreezeFrameData_GetEventFreezeFrameData_EvtInfo_AutoCreatedDemEvent_INIT_Action_Issm_Init_BswMReportFail_7056d796: start-on-event=GetEventFreezeFrameData, operation=EvtInfo_AutoCreatedDemEvent_INIT_Action_Issm_Init_BswMReportFailToDemRef422.GetEventFreezeFrameData
        OpEventGetEventFreezeFrameData_GetEventFreezeFrameData_EvtInfo_AutoCreatedDemEvent_INIT_Action_J1939Nm_Init_BswMReportF_1f45a596: start-on-event=GetEventFreezeFrameData, operation=EvtInfo_AutoCreatedDemEvent_INIT_Action_J1939Nm_Init_BswMReportFailToDemRef422.GetEventFreezeFrameData
        OpEventGetEventFreezeFrameData_GetEventFreezeFrameData_EvtInfo_AutoCreatedDemEvent_INIT_Action_J1939Rm_Init_BswMReportF_71a16431: start-on-event=GetEventFreezeFrameData, operation=EvtInfo_AutoCreatedDemEvent_INIT_Action_J1939Rm_Init_BswMReportFailToDemRef422.GetEventFreezeFrameData
        OpEventGetEventFreezeFrameData_GetEventFreezeFrameData_EvtInfo_AutoCreatedDemEvent_INIT_Action_J1939Tp_Init_BswMReportF_b9934326: start-on-event=GetEventFreezeFrameData, operation=EvtInfo_AutoCreatedDemEvent_INIT_Action_J1939Tp_Init_BswMReportFailToDemRef422.GetEventFreezeFrameData
        OpEventGetEventFreezeFrameData_GetEventFreezeFrameData_EvtInfo_AutoCreatedDemEvent_INIT_Action_LinIf_Init_BswMReportFai_28ac6b6a: start-on-event=GetEventFreezeFrameData, operation=EvtInfo_AutoCreatedDemEvent_INIT_Action_LinIf_Init_BswMReportFailToDemRef422.GetEventFreezeFrameData
        OpEventGetEventFreezeFrameData_GetEventFreezeFrameData_EvtInfo_AutoCreatedDemEvent_INIT_Action_LinSM_Init_BswMReportFai_e0de29de: start-on-event=GetEventFreezeFrameData, operation=EvtInfo_AutoCreatedDemEvent_INIT_Action_LinSM_Init_BswMReportFailToDemRef422.GetEventFreezeFrameData
        OpEventGetEventFreezeFrameData_GetEventFreezeFrameData_EvtInfo_AutoCreatedDemEvent_INIT_Action_LinTp_Init_BswMReportFai_24ac43e8: start-on-event=GetEventFreezeFrameData, operation=EvtInfo_AutoCreatedDemEvent_INIT_Action_LinTp_Init_BswMReportFailToDemRef422.GetEventFreezeFrameData
        OpEventGetEventFreezeFrameData_GetEventFreezeFrameData_EvtInfo_AutoCreatedDemEvent_INIT_Action_Lin_Init_BswMReportFailT_511750f6: start-on-event=GetEventFreezeFrameData, operation=EvtInfo_AutoCreatedDemEvent_INIT_Action_Lin_Init_BswMReportFailToDemRef422.GetEventFreezeFrameData
        OpEventGetEventFreezeFrameData_GetEventFreezeFrameData_EvtInfo_AutoCreatedDemEvent_INIT_Action_Nm_Init_BswMReportFailToDemRef422: start-on-event=GetEventFreezeFrameData, operation=EvtInfo_AutoCreatedDemEvent_INIT_Action_Nm_Init_BswMReportFailToDemRef422.GetEventFreezeFrameData
        OpEventGetEventFreezeFrameData_GetEventFreezeFrameData_EvtInfo_AutoCreatedDemEvent_INIT_Action_NvMReadAll_BswMReportFai_e318bff9: start-on-event=GetEventFreezeFrameData, operation=EvtInfo_AutoCreatedDemEvent_INIT_Action_NvMReadAll_BswMReportFailToDemRef422.GetEventFreezeFrameData
        OpEventGetEventFreezeFrameData_GetEventFreezeFrameData_EvtInfo_AutoCreatedDemEvent_INIT_Action_NvM_Init_BswMReportFailT_de4d5745: start-on-event=GetEventFreezeFrameData, operation=EvtInfo_AutoCreatedDemEvent_INIT_Action_NvM_Init_BswMReportFailToDemRef422.GetEventFreezeFrameData
        OpEventGetEventFreezeFrameData_GetEventFreezeFrameData_EvtInfo_AutoCreatedDemEvent_INIT_Action_PduR_Init_BswMReportFail_2a0b7ce1: start-on-event=GetEventFreezeFrameData, operation=EvtInfo_AutoCreatedDemEvent_INIT_Action_PduR_Init_BswMReportFailToDemRef422.GetEventFreezeFrameData
        OpEventGetEventFreezeFrameData_GetEventFreezeFrameData_EvtInfo_AutoCreatedDemEvent_INIT_Action_RteStart_BswMReportFailT_42476f4c: start-on-event=GetEventFreezeFrameData, operation=EvtInfo_AutoCreatedDemEvent_INIT_Action_RteStart_BswMReportFailToDemRef422.GetEventFreezeFrameData
        OpEventGetEventFreezeFrameData_GetEventFreezeFrameData_EvtInfo_AutoCreatedDemEvent_J1939NM_E_ADDRESS_LOST422: start-on-event=GetEventFreezeFrameData, operation=EvtInfo_AutoCreatedDemEvent_J1939NM_E_ADDRESS_LOST422.GetEventFreezeFrameData
        OpEventGetEventFreezeFrameData_GetEventFreezeFrameData_EvtInfo_AutoCreatedDemEvent_J1939TpConfiguration_J1939TP_E_COMMU_b968a31a: start-on-event=GetEventFreezeFrameData, operation=EvtInfo_AutoCreatedDemEvent_J1939TpConfiguration_J1939TP_E_COMMUNICATION422.GetEventFreezeFrameData
        OpEventGetEventFreezeFrameData_GetEventFreezeFrameData_EvtInfo_AutoCreatedDemEvent_LIN_E_TIMEOUT422: start-on-event=GetEventFreezeFrameData, operation=EvtInfo_AutoCreatedDemEvent_LIN_E_TIMEOUT422.GetEventFreezeFrameData
        OpEventGetEventFreezeFrameData_GetEventFreezeFrameData_EvtInfo_AutoCreatedDemEvent_MCL_E_DMA_BUS422: start-on-event=GetEventFreezeFrameData, operation=EvtInfo_AutoCreatedDemEvent_MCL_E_DMA_BUS422.GetEventFreezeFrameData
        OpEventGetEventFreezeFrameData_GetEventFreezeFrameData_EvtInfo_AutoCreatedDemEvent_MCL_E_DMA_DESCRIPTOR422: start-on-event=GetEventFreezeFrameData, operation=EvtInfo_AutoCreatedDemEvent_MCL_E_DMA_DESCRIPTOR422.GetEventFreezeFrameData
        OpEventGetEventFreezeFrameData_GetEventFreezeFrameData_EvtInfo_AutoCreatedDemEvent_MCL_E_DMA_ECC422: start-on-event=GetEventFreezeFrameData, operation=EvtInfo_AutoCreatedDemEvent_MCL_E_DMA_ECC422.GetEventFreezeFrameData
        OpEventGetEventFreezeFrameData_GetEventFreezeFrameData_EvtInfo_AutoCreatedDemEvent_MCL_E_DMA_INCONSISTENCY422: start-on-event=GetEventFreezeFrameData, operation=EvtInfo_AutoCreatedDemEvent_MCL_E_DMA_INCONSISTENCY422.GetEventFreezeFrameData
        OpEventGetEventFreezeFrameData_GetEventFreezeFrameData_EvtInfo_AutoCreatedDemEvent_MCL_E_DMA_PRIORITY422: start-on-event=GetEventFreezeFrameData, operation=EvtInfo_AutoCreatedDemEvent_MCL_E_DMA_PRIORITY422.GetEventFreezeFrameData
        OpEventGetEventFreezeFrameData_GetEventFreezeFrameData_EvtInfo_AutoCreatedDemEvent_MCL_E_DMA_UNRECOGNIZED422: start-on-event=GetEventFreezeFrameData, operation=EvtInfo_AutoCreatedDemEvent_MCL_E_DMA_UNRECOGNIZED422.GetEventFreezeFrameData
        OpEventGetEventFreezeFrameData_GetEventFreezeFrameData_EvtInfo_AutoCreatedDemEvent_MCU_E_CLOCK_FAILURE422: start-on-event=GetEventFreezeFrameData, operation=EvtInfo_AutoCreatedDemEvent_MCU_E_CLOCK_FAILURE422.GetEventFreezeFrameData
        OpEventGetEventFreezeFrameData_GetEventFreezeFrameData_EvtInfo_AutoCreatedDemEvent_MCU_E_INVALIDMODE_CONFIG422: start-on-event=GetEventFreezeFrameData, operation=EvtInfo_AutoCreatedDemEvent_MCU_E_INVALIDMODE_CONFIG422.GetEventFreezeFrameData
        OpEventGetEventFreezeFrameData_GetEventFreezeFrameData_EvtInfo_AutoCreatedDemEvent_MCU_E_SSCM_CER_FAILURE422: start-on-event=GetEventFreezeFrameData, operation=EvtInfo_AutoCreatedDemEvent_MCU_E_SSCM_CER_FAILURE422.GetEventFreezeFrameData
        OpEventGetEventFreezeFrameData_GetEventFreezeFrameData_EvtInfo_AutoCreatedDemEvent_MCU_E_TIMEOUT_FAILURE422: start-on-event=GetEventFreezeFrameData, operation=EvtInfo_AutoCreatedDemEvent_MCU_E_TIMEOUT_FAILURE422.GetEventFreezeFrameData
        OpEventGetEventFreezeFrameData_GetEventFreezeFrameData_EvtInfo_AutoCreatedDemEvent_NVM_E_INTEGRITY_FAILED422: start-on-event=GetEventFreezeFrameData, operation=EvtInfo_AutoCreatedDemEvent_NVM_E_INTEGRITY_FAILED422.GetEventFreezeFrameData
        OpEventGetEventFreezeFrameData_GetEventFreezeFrameData_EvtInfo_AutoCreatedDemEvent_NVM_E_LOSS_OF_REDUNDANCY422: start-on-event=GetEventFreezeFrameData, operation=EvtInfo_AutoCreatedDemEvent_NVM_E_LOSS_OF_REDUNDANCY422.GetEventFreezeFrameData
        OpEventGetEventFreezeFrameData_GetEventFreezeFrameData_EvtInfo_AutoCreatedDemEvent_NVM_E_QUEUE_OVERFLOW422: start-on-event=GetEventFreezeFrameData, operation=EvtInfo_AutoCreatedDemEvent_NVM_E_QUEUE_OVERFLOW422.GetEventFreezeFrameData
        OpEventGetEventFreezeFrameData_GetEventFreezeFrameData_EvtInfo_AutoCreatedDemEvent_NVM_E_REQ_FAILED422: start-on-event=GetEventFreezeFrameData, operation=EvtInfo_AutoCreatedDemEvent_NVM_E_REQ_FAILED422.GetEventFreezeFrameData
        OpEventGetEventFreezeFrameData_GetEventFreezeFrameData_EvtInfo_AutoCreatedDemEvent_NVM_E_VERIFY_FAILED422: start-on-event=GetEventFreezeFrameData, operation=EvtInfo_AutoCreatedDemEvent_NVM_E_VERIFY_FAILED422.GetEventFreezeFrameData
        OpEventGetEventFreezeFrameData_GetEventFreezeFrameData_EvtInfo_AutoCreatedDemEvent_NVM_E_WRITE_PROTECTED422: start-on-event=GetEventFreezeFrameData, operation=EvtInfo_AutoCreatedDemEvent_NVM_E_WRITE_PROTECTED422.GetEventFreezeFrameData
        OpEventGetEventFreezeFrameData_GetEventFreezeFrameData_EvtInfo_AutoCreatedDemEvent_NVM_E_WRONG_BLOCK_ID422: start-on-event=GetEventFreezeFrameData, operation=EvtInfo_AutoCreatedDemEvent_NVM_E_WRONG_BLOCK_ID422.GetEventFreezeFrameData
        OpEventGetEventFreezeFrameData_GetEventFreezeFrameData_EvtInfo_AutoCreatedDemEvent_SPI_E_HARDWARE_ERROR422: start-on-event=GetEventFreezeFrameData, operation=EvtInfo_AutoCreatedDemEvent_SPI_E_HARDWARE_ERROR422.GetEventFreezeFrameData
        OpEventGetEventFreezeFrameData_GetEventFreezeFrameData_EvtInfo_AutoCreatedDemEvent_SpiDriver_SPI_E_HARDWARE_ERROR422: start-on-event=GetEventFreezeFrameData, operation=EvtInfo_AutoCreatedDemEvent_SpiDriver_SPI_E_HARDWARE_ERROR422.GetEventFreezeFrameData
        OpEventGetEventFreezeFrameData_GetEventFreezeFrameData_EvtInfo_AutoCreatedDemEvent_WDG_E_CORRUPT_CONFIG422: start-on-event=GetEventFreezeFrameData, operation=EvtInfo_AutoCreatedDemEvent_WDG_E_CORRUPT_CONFIG422.GetEventFreezeFrameData
        OpEventGetEventFreezeFrameData_GetEventFreezeFrameData_EvtInfo_AutoCreatedDemEvent_WDG_E_DISABLE_REJECTED422: start-on-event=GetEventFreezeFrameData, operation=EvtInfo_AutoCreatedDemEvent_WDG_E_DISABLE_REJECTED422.GetEventFreezeFrameData
        OpEventGetEventFreezeFrameData_GetEventFreezeFrameData_EvtInfo_AutoCreatedDemEvent_WDG_E_FORBIDDEN_INVOCATION422: start-on-event=GetEventFreezeFrameData, operation=EvtInfo_AutoCreatedDemEvent_WDG_E_FORBIDDEN_INVOCATION422.GetEventFreezeFrameData
        OpEventGetEventFreezeFrameData_GetEventFreezeFrameData_EvtInfo_AutoCreatedDemEvent_WDG_E_INVALID_CALL422: start-on-event=GetEventFreezeFrameData, operation=EvtInfo_AutoCreatedDemEvent_WDG_E_INVALID_CALL422.GetEventFreezeFrameData
        OpEventGetEventFreezeFrameData_GetEventFreezeFrameData_EvtInfo_AutoCreatedDemEvent_WDG_E_INVALID_PARAMETER422: start-on-event=GetEventFreezeFrameData, operation=EvtInfo_AutoCreatedDemEvent_WDG_E_INVALID_PARAMETER422.GetEventFreezeFrameData
        OpEventGetEventFreezeFrameData_GetEventFreezeFrameData_EvtInfo_AutoCreatedDemEvent_WDG_E_MODE_FAILED422: start-on-event=GetEventFreezeFrameData, operation=EvtInfo_AutoCreatedDemEvent_WDG_E_MODE_FAILED422.GetEventFreezeFrameData
        OpEventGetEventFreezeFrameData_GetEventFreezeFrameData_EvtInfo_AutoCreatedDemEvent_WDG_E_UNLOCKED422: start-on-event=GetEventFreezeFrameData, operation=EvtInfo_AutoCreatedDemEvent_WDG_E_UNLOCKED422.GetEventFreezeFrameData
        OpEventGetEventFreezeFrameDataEx_GetEventFreezeFrameDataEx_EvtInfo_AutoCreatedDemEvent_ADC_E_TIMEOUT422: start-on-event=GetEventFreezeFrameDataEx, operation=EvtInfo_AutoCreatedDemEvent_ADC_E_TIMEOUT422.GetEventFreezeFrameDataEx
        OpEventGetEventFreezeFrameDataEx_GetEventFreezeFrameDataEx_EvtInfo_AutoCreatedDemEvent_CC_DisableDM_CIOM_oBackbone1J193_d12ecea0: start-on-event=GetEventFreezeFrameDataEx, operation=EvtInfo_AutoCreatedDemEvent_CC_DisableDM_CIOM_oBackbone1J1939_Rx_BC_405bc776_BswMReportFailToDemRef422.GetEventFreezeFrameDataEx
        OpEventGetEventFreezeFrameDataEx_GetEventFreezeFrameDataEx_EvtInfo_AutoCreatedDemEvent_CC_DisableDM_CIOM_oBackbone2_Rx_4fa91a6a: start-on-event=GetEventFreezeFrameDataEx, operation=EvtInfo_AutoCreatedDemEvent_CC_DisableDM_CIOM_oBackbone2_Rx_4e624434_BswMReportFailToDemRef422.GetEventFreezeFrameDataEx
        OpEventGetEventFreezeFrameDataEx_GetEventFreezeFrameDataEx_EvtInfo_AutoCreatedDemEvent_CC_DisableDM_CIOM_oCabSubnet_Rx_32eb51e0: start-on-event=GetEventFreezeFrameDataEx, operation=EvtInfo_AutoCreatedDemEvent_CC_DisableDM_CIOM_oCabSubnet_Rx_063a5fbc_BswMReportFailToDemRef422.GetEventFreezeFrameDataEx
        OpEventGetEventFreezeFrameDataEx_GetEventFreezeFrameDataEx_EvtInfo_AutoCreatedDemEvent_CC_DisableDM_CIOM_oFMSNet_Rx_BC_2dfb9066: start-on-event=GetEventFreezeFrameDataEx, operation=EvtInfo_AutoCreatedDemEvent_CC_DisableDM_CIOM_oFMSNet_Rx_BC_dd2c1510_BswMReportFailToDemRef422.GetEventFreezeFrameDataEx
        OpEventGetEventFreezeFrameDataEx_GetEventFreezeFrameDataEx_EvtInfo_AutoCreatedDemEvent_CC_DisableDM_CIOM_oSecuritySubne_f9909c31: start-on-event=GetEventFreezeFrameDataEx, operation=EvtInfo_AutoCreatedDemEvent_CC_DisableDM_CIOM_oSecuritySubnet_Rx_3a3c1dbc_BswMReportFailToDemRef422.GetEventFreezeFrameDataEx
        OpEventGetEventFreezeFrameDataEx_GetEventFreezeFrameDataEx_EvtInfo_AutoCreatedDemEvent_CC_DisablePDUGroup_CIOM_oBackbon_09565995: start-on-event=GetEventFreezeFrameDataEx, operation=EvtInfo_AutoCreatedDemEvent_CC_DisablePDUGroup_CIOM_oBackbone1J1939_Rx_BC_405bc776_BswMReportFailToDemRef422.GetEventFreezeFrameDataEx
        OpEventGetEventFreezeFrameDataEx_GetEventFreezeFrameDataEx_EvtInfo_AutoCreatedDemEvent_CC_DisablePDUGroup_CIOM_oBackbon_ddbb1e90: start-on-event=GetEventFreezeFrameDataEx, operation=EvtInfo_AutoCreatedDemEvent_CC_DisablePDUGroup_CIOM_oBackbone1J1939_Tx_0x31_BC_3782f500_BswMReportFailToDemRef422.GetEventFreezeFrameDataEx
        OpEventGetEventFreezeFrameDataEx_GetEventFreezeFrameDataEx_EvtInfo_AutoCreatedDemEvent_CC_DisablePDUGroup_CIOM_oBackbon_d8a927f1: start-on-event=GetEventFreezeFrameDataEx, operation=EvtInfo_AutoCreatedDemEvent_CC_DisablePDUGroup_CIOM_oBackbone2_Rx_4e624434_BswMReportFailToDemRef422.GetEventFreezeFrameDataEx
        OpEventGetEventFreezeFrameDataEx_GetEventFreezeFrameDataEx_EvtInfo_AutoCreatedDemEvent_CC_DisablePDUGroup_CIOM_oBackbon_d47f81df: start-on-event=GetEventFreezeFrameDataEx, operation=EvtInfo_AutoCreatedDemEvent_CC_DisablePDUGroup_CIOM_oBackbone2_Tx_1838e3b2_BswMReportFailToDemRef422.GetEventFreezeFrameDataEx
        OpEventGetEventFreezeFrameDataEx_GetEventFreezeFrameDataEx_EvtInfo_AutoCreatedDemEvent_CC_DisablePDUGroup_CIOM_oCabSubn_a5eb6c7b: start-on-event=GetEventFreezeFrameDataEx, operation=EvtInfo_AutoCreatedDemEvent_CC_DisablePDUGroup_CIOM_oCabSubnet_Rx_063a5fbc_BswMReportFailToDemRef422.GetEventFreezeFrameDataEx
        OpEventGetEventFreezeFrameDataEx_GetEventFreezeFrameDataEx_EvtInfo_AutoCreatedDemEvent_CC_DisablePDUGroup_CIOM_oCabSubn_37993349: start-on-event=GetEventFreezeFrameDataEx, operation=EvtInfo_AutoCreatedDemEvent_CC_DisablePDUGroup_CIOM_oCabSubnet_Tx_5060f83a_BswMReportFailToDemRef422.GetEventFreezeFrameDataEx
        OpEventGetEventFreezeFrameDataEx_GetEventFreezeFrameDataEx_EvtInfo_AutoCreatedDemEvent_CC_DisablePDUGroup_CIOM_oFMSNet_bafbadfd: start-on-event=GetEventFreezeFrameDataEx, operation=EvtInfo_AutoCreatedDemEvent_CC_DisablePDUGroup_CIOM_oFMSNet_Rx_BC_dd2c1510_BswMReportFailToDemRef422.GetEventFreezeFrameDataEx
        OpEventGetEventFreezeFrameDataEx_GetEventFreezeFrameDataEx_EvtInfo_AutoCreatedDemEvent_CC_DisablePDUGroup_CIOM_oFMSNet_d3cae73d: start-on-event=GetEventFreezeFrameDataEx, operation=EvtInfo_AutoCreatedDemEvent_CC_DisablePDUGroup_CIOM_oFMSNet_Tx_0x31_BC_38fc8c7d_BswMReportFailToDemRef422.GetEventFreezeFrameDataEx
        OpEventGetEventFreezeFrameDataEx_GetEventFreezeFrameDataEx_EvtInfo_AutoCreatedDemEvent_CC_DisablePDUGroup_CIOM_oLIN00_R_a58a08ca: start-on-event=GetEventFreezeFrameDataEx, operation=EvtInfo_AutoCreatedDemEvent_CC_DisablePDUGroup_CIOM_oLIN00_Rx_dd181faa_BswMReportFailToDemRef422.GetEventFreezeFrameDataEx
        OpEventGetEventFreezeFrameDataEx_GetEventFreezeFrameDataEx_EvtInfo_AutoCreatedDemEvent_CC_DisablePDUGroup_CIOM_oLIN00_T_d96dc603: start-on-event=GetEventFreezeFrameDataEx, operation=EvtInfo_AutoCreatedDemEvent_CC_DisablePDUGroup_CIOM_oLIN00_Tx_8b42b82c_BswMReportFailToDemRef422.GetEventFreezeFrameDataEx
        OpEventGetEventFreezeFrameDataEx_GetEventFreezeFrameDataEx_EvtInfo_AutoCreatedDemEvent_CC_DisablePDUGroup_CIOM_oLIN01_R_9c3a2fcf: start-on-event=GetEventFreezeFrameDataEx, operation=EvtInfo_AutoCreatedDemEvent_CC_DisablePDUGroup_CIOM_oLIN01_Rx_65a478cf_BswMReportFailToDemRef422.GetEventFreezeFrameDataEx
        OpEventGetEventFreezeFrameDataEx_GetEventFreezeFrameDataEx_EvtInfo_AutoCreatedDemEvent_CC_DisablePDUGroup_CIOM_oLIN01_T_02a9d568: start-on-event=GetEventFreezeFrameDataEx, operation=EvtInfo_AutoCreatedDemEvent_CC_DisablePDUGroup_CIOM_oLIN01_Tx_33fedf49_BswMReportFailToDemRef422.GetEventFreezeFrameDataEx
        OpEventGetEventFreezeFrameDataEx_GetEventFreezeFrameDataEx_EvtInfo_AutoCreatedDemEvent_CC_DisablePDUGroup_CIOM_oLIN02_R_7223d33b: start-on-event=GetEventFreezeFrameDataEx, operation=EvtInfo_AutoCreatedDemEvent_CC_DisablePDUGroup_CIOM_oLIN02_Rx_7711d721_BswMReportFailToDemRef422.GetEventFreezeFrameDataEx
        OpEventGetEventFreezeFrameDataEx_GetEventFreezeFrameDataEx_EvtInfo_AutoCreatedDemEvent_CC_DisablePDUGroup_CIOM_oLIN02_T_a2166380: start-on-event=GetEventFreezeFrameDataEx, operation=EvtInfo_AutoCreatedDemEvent_CC_DisablePDUGroup_CIOM_oLIN02_Tx_214b70a7_BswMReportFailToDemRef422.GetEventFreezeFrameDataEx
        OpEventGetEventFreezeFrameDataEx_GetEventFreezeFrameDataEx_EvtInfo_AutoCreatedDemEvent_CC_DisablePDUGroup_CIOM_oLIN03_R_ee4d64a3: start-on-event=GetEventFreezeFrameDataEx, operation=EvtInfo_AutoCreatedDemEvent_CC_DisablePDUGroup_CIOM_oLIN03_Rx_cfadb044_BswMReportFailToDemRef422.GetEventFreezeFrameDataEx
        OpEventGetEventFreezeFrameDataEx_GetEventFreezeFrameDataEx_EvtInfo_AutoCreatedDemEvent_CC_DisablePDUGroup_CIOM_oLIN03_T_e1fa7af7: start-on-event=GetEventFreezeFrameDataEx, operation=EvtInfo_AutoCreatedDemEvent_CC_DisablePDUGroup_CIOM_oLIN03_Tx_99f717c2_BswMReportFailToDemRef422.GetEventFreezeFrameDataEx
        OpEventGetEventFreezeFrameDataEx_GetEventFreezeFrameDataEx_EvtInfo_AutoCreatedDemEvent_CC_DisablePDUGroup_CIOM_oLIN04_R_7cfeb9e7: start-on-event=GetEventFreezeFrameDataEx, operation=EvtInfo_AutoCreatedDemEvent_CC_DisablePDUGroup_CIOM_oLIN04_Rx_527a88fd_BswMReportFailToDemRef422.GetEventFreezeFrameDataEx
        OpEventGetEventFreezeFrameDataEx_GetEventFreezeFrameDataEx_EvtInfo_AutoCreatedDemEvent_CC_DisablePDUGroup_CIOM_oLIN04_T_e3f6bad2: start-on-event=GetEventFreezeFrameDataEx, operation=EvtInfo_AutoCreatedDemEvent_CC_DisablePDUGroup_CIOM_oLIN04_Tx_04202f7b_BswMReportFailToDemRef422.GetEventFreezeFrameDataEx
        OpEventGetEventFreezeFrameDataEx_GetEventFreezeFrameDataEx_EvtInfo_AutoCreatedDemEvent_CC_DisablePDUGroup_CIOM_oSecurit_6307b691: start-on-event=GetEventFreezeFrameDataEx, operation=EvtInfo_AutoCreatedDemEvent_CC_DisablePDUGroup_CIOM_oSecuritySubnet_Rx_3a3c1dbc_BswMReportFailToDemRef422.GetEventFreezeFrameDataEx
        OpEventGetEventFreezeFrameDataEx_GetEventFreezeFrameDataEx_EvtInfo_AutoCreatedDemEvent_CC_DisablePDUGroup_CIOM_oSecurit_ea8d1437: start-on-event=GetEventFreezeFrameDataEx, operation=EvtInfo_AutoCreatedDemEvent_CC_DisablePDUGroup_CIOM_oSecuritySubnet_Tx_6c66ba3a_BswMReportFailToDemRef422.GetEventFreezeFrameDataEx
        OpEventGetEventFreezeFrameDataEx_GetEventFreezeFrameDataEx_EvtInfo_AutoCreatedDemEvent_CC_EnableDM_CIOM_oBackbone1J1939_bf7214c4: start-on-event=GetEventFreezeFrameDataEx, operation=EvtInfo_AutoCreatedDemEvent_CC_EnableDM_CIOM_oBackbone1J1939_Rx_BC_405bc776_BswMReportFailToDemRef422.GetEventFreezeFrameDataEx
        OpEventGetEventFreezeFrameDataEx_GetEventFreezeFrameDataEx_EvtInfo_AutoCreatedDemEvent_CC_EnableDM_CIOM_oBackbone2_Rx_4_c078f02d: start-on-event=GetEventFreezeFrameDataEx, operation=EvtInfo_AutoCreatedDemEvent_CC_EnableDM_CIOM_oBackbone2_Rx_4e624434_BswMReportFailToDemRef422.GetEventFreezeFrameDataEx
        OpEventGetEventFreezeFrameDataEx_GetEventFreezeFrameDataEx_EvtInfo_AutoCreatedDemEvent_CC_EnableDM_CIOM_oCabSubnet_Rx_0_bd3abba7: start-on-event=GetEventFreezeFrameDataEx, operation=EvtInfo_AutoCreatedDemEvent_CC_EnableDM_CIOM_oCabSubnet_Rx_063a5fbc_BswMReportFailToDemRef422.GetEventFreezeFrameDataEx
        OpEventGetEventFreezeFrameDataEx_GetEventFreezeFrameDataEx_EvtInfo_AutoCreatedDemEvent_CC_EnableDM_CIOM_oFMSNet_Rx_BC_d_a22a7a21: start-on-event=GetEventFreezeFrameDataEx, operation=EvtInfo_AutoCreatedDemEvent_CC_EnableDM_CIOM_oFMSNet_Rx_BC_dd2c1510_BswMReportFailToDemRef422.GetEventFreezeFrameDataEx
        OpEventGetEventFreezeFrameDataEx_GetEventFreezeFrameDataEx_EvtInfo_AutoCreatedDemEvent_CC_EnableDM_CIOM_oSecuritySubnet_9ad162b7: start-on-event=GetEventFreezeFrameDataEx, operation=EvtInfo_AutoCreatedDemEvent_CC_EnableDM_CIOM_oSecuritySubnet_Rx_3a3c1dbc_BswMReportFailToDemRef422.GetEventFreezeFrameDataEx
        OpEventGetEventFreezeFrameDataEx_GetEventFreezeFrameDataEx_EvtInfo_AutoCreatedDemEvent_CC_EnablePDUGroup_CIOM_oBackbone_9ae42511: start-on-event=GetEventFreezeFrameDataEx, operation=EvtInfo_AutoCreatedDemEvent_CC_EnablePDUGroup_CIOM_oBackbone1J1939_Rx_BC_405bc776_BswMReportFailToDemRef422.GetEventFreezeFrameDataEx
        OpEventGetEventFreezeFrameDataEx_GetEventFreezeFrameDataEx_EvtInfo_AutoCreatedDemEvent_CC_EnablePDUGroup_CIOM_oBackbone_2482e441: start-on-event=GetEventFreezeFrameDataEx, operation=EvtInfo_AutoCreatedDemEvent_CC_EnablePDUGroup_CIOM_oBackbone1J1939_Tx_0x31_BC_3782f500_BswMReportFailToDemRef422.GetEventFreezeFrameDataEx
        OpEventGetEventFreezeFrameDataEx_GetEventFreezeFrameDataEx_EvtInfo_AutoCreatedDemEvent_CC_EnablePDUGroup_CIOM_oBackbone_dc11401a: start-on-event=GetEventFreezeFrameDataEx, operation=EvtInfo_AutoCreatedDemEvent_CC_EnablePDUGroup_CIOM_oBackbone2_Rx_4e624434_BswMReportFailToDemRef422.GetEventFreezeFrameDataEx
        OpEventGetEventFreezeFrameDataEx_GetEventFreezeFrameDataEx_EvtInfo_AutoCreatedDemEvent_CC_EnablePDUGroup_CIOM_oBackbone_d0c7e634: start-on-event=GetEventFreezeFrameDataEx, operation=EvtInfo_AutoCreatedDemEvent_CC_EnablePDUGroup_CIOM_oBackbone2_Tx_1838e3b2_BswMReportFailToDemRef422.GetEventFreezeFrameDataEx
        OpEventGetEventFreezeFrameDataEx_GetEventFreezeFrameDataEx_EvtInfo_AutoCreatedDemEvent_CC_EnablePDUGroup_CIOM_oCabSubne_a1530b90: start-on-event=GetEventFreezeFrameDataEx, operation=EvtInfo_AutoCreatedDemEvent_CC_EnablePDUGroup_CIOM_oCabSubnet_Rx_063a5fbc_BswMReportFailToDemRef422.GetEventFreezeFrameDataEx
        OpEventGetEventFreezeFrameDataEx_GetEventFreezeFrameDataEx_EvtInfo_AutoCreatedDemEvent_CC_EnablePDUGroup_CIOM_oCabSubne_332154a2: start-on-event=GetEventFreezeFrameDataEx, operation=EvtInfo_AutoCreatedDemEvent_CC_EnablePDUGroup_CIOM_oCabSubnet_Tx_5060f83a_BswMReportFailToDemRef422.GetEventFreezeFrameDataEx
        OpEventGetEventFreezeFrameDataEx_GetEventFreezeFrameDataEx_EvtInfo_AutoCreatedDemEvent_CC_EnablePDUGroup_CIOM_oFMSNet_R_be43ca16: start-on-event=GetEventFreezeFrameDataEx, operation=EvtInfo_AutoCreatedDemEvent_CC_EnablePDUGroup_CIOM_oFMSNet_Rx_BC_dd2c1510_BswMReportFailToDemRef422.GetEventFreezeFrameDataEx
        OpEventGetEventFreezeFrameDataEx_GetEventFreezeFrameDataEx_EvtInfo_AutoCreatedDemEvent_CC_EnablePDUGroup_CIOM_oFMSNet_T_851eb4e5: start-on-event=GetEventFreezeFrameDataEx, operation=EvtInfo_AutoCreatedDemEvent_CC_EnablePDUGroup_CIOM_oFMSNet_Tx_0x31_BC_38fc8c7d_BswMReportFailToDemRef422.GetEventFreezeFrameDataEx
        OpEventGetEventFreezeFrameDataEx_GetEventFreezeFrameDataEx_EvtInfo_AutoCreatedDemEvent_CC_EnablePDUGroup_CIOM_oLIN00_Rx_5a6d55bf: start-on-event=GetEventFreezeFrameDataEx, operation=EvtInfo_AutoCreatedDemEvent_CC_EnablePDUGroup_CIOM_oLIN00_Rx_dd181faa_BswMReportFailToDemRef422.GetEventFreezeFrameDataEx
        OpEventGetEventFreezeFrameDataEx_GetEventFreezeFrameDataEx_EvtInfo_AutoCreatedDemEvent_CC_EnablePDUGroup_CIOM_oLIN00_Tx_268a9b76: start-on-event=GetEventFreezeFrameDataEx, operation=EvtInfo_AutoCreatedDemEvent_CC_EnablePDUGroup_CIOM_oLIN00_Tx_8b42b82c_BswMReportFailToDemRef422.GetEventFreezeFrameDataEx
        OpEventGetEventFreezeFrameDataEx_GetEventFreezeFrameDataEx_EvtInfo_AutoCreatedDemEvent_CC_EnablePDUGroup_CIOM_oLIN01_Rx_63dd72ba: start-on-event=GetEventFreezeFrameDataEx, operation=EvtInfo_AutoCreatedDemEvent_CC_EnablePDUGroup_CIOM_oLIN01_Rx_65a478cf_BswMReportFailToDemRef422.GetEventFreezeFrameDataEx
        OpEventGetEventFreezeFrameDataEx_GetEventFreezeFrameDataEx_EvtInfo_AutoCreatedDemEvent_CC_EnablePDUGroup_CIOM_oLIN01_Tx_fd4e881d: start-on-event=GetEventFreezeFrameDataEx, operation=EvtInfo_AutoCreatedDemEvent_CC_EnablePDUGroup_CIOM_oLIN01_Tx_33fedf49_BswMReportFailToDemRef422.GetEventFreezeFrameDataEx
        OpEventGetEventFreezeFrameDataEx_GetEventFreezeFrameDataEx_EvtInfo_AutoCreatedDemEvent_CC_EnablePDUGroup_CIOM_oLIN02_Rx_8dc48e4e: start-on-event=GetEventFreezeFrameDataEx, operation=EvtInfo_AutoCreatedDemEvent_CC_EnablePDUGroup_CIOM_oLIN02_Rx_7711d721_BswMReportFailToDemRef422.GetEventFreezeFrameDataEx
        OpEventGetEventFreezeFrameDataEx_GetEventFreezeFrameDataEx_EvtInfo_AutoCreatedDemEvent_CC_EnablePDUGroup_CIOM_oLIN02_Tx_5df13ef5: start-on-event=GetEventFreezeFrameDataEx, operation=EvtInfo_AutoCreatedDemEvent_CC_EnablePDUGroup_CIOM_oLIN02_Tx_214b70a7_BswMReportFailToDemRef422.GetEventFreezeFrameDataEx
        OpEventGetEventFreezeFrameDataEx_GetEventFreezeFrameDataEx_EvtInfo_AutoCreatedDemEvent_CC_EnablePDUGroup_CIOM_oLIN03_Rx_11aa39d6: start-on-event=GetEventFreezeFrameDataEx, operation=EvtInfo_AutoCreatedDemEvent_CC_EnablePDUGroup_CIOM_oLIN03_Rx_cfadb044_BswMReportFailToDemRef422.GetEventFreezeFrameDataEx
        OpEventGetEventFreezeFrameDataEx_GetEventFreezeFrameDataEx_EvtInfo_AutoCreatedDemEvent_CC_EnablePDUGroup_CIOM_oLIN03_Tx_1e1d2782: start-on-event=GetEventFreezeFrameDataEx, operation=EvtInfo_AutoCreatedDemEvent_CC_EnablePDUGroup_CIOM_oLIN03_Tx_99f717c2_BswMReportFailToDemRef422.GetEventFreezeFrameDataEx
        OpEventGetEventFreezeFrameDataEx_GetEventFreezeFrameDataEx_EvtInfo_AutoCreatedDemEvent_CC_EnablePDUGroup_CIOM_oLIN04_Rx_8319e492: start-on-event=GetEventFreezeFrameDataEx, operation=EvtInfo_AutoCreatedDemEvent_CC_EnablePDUGroup_CIOM_oLIN04_Rx_527a88fd_BswMReportFailToDemRef422.GetEventFreezeFrameDataEx
        OpEventGetEventFreezeFrameDataEx_GetEventFreezeFrameDataEx_EvtInfo_AutoCreatedDemEvent_CC_EnablePDUGroup_CIOM_oLIN04_Tx_1c11e7a7: start-on-event=GetEventFreezeFrameDataEx, operation=EvtInfo_AutoCreatedDemEvent_CC_EnablePDUGroup_CIOM_oLIN04_Tx_04202f7b_BswMReportFailToDemRef422.GetEventFreezeFrameDataEx
        OpEventGetEventFreezeFrameDataEx_GetEventFreezeFrameDataEx_EvtInfo_AutoCreatedDemEvent_CC_EnablePDUGroup_CIOM_oSecurity_35d3e549: start-on-event=GetEventFreezeFrameDataEx, operation=EvtInfo_AutoCreatedDemEvent_CC_EnablePDUGroup_CIOM_oSecuritySubnet_Rx_3a3c1dbc_BswMReportFailToDemRef422.GetEventFreezeFrameDataEx
        OpEventGetEventFreezeFrameDataEx_GetEventFreezeFrameDataEx_EvtInfo_AutoCreatedDemEvent_CC_EnablePDUGroup_CIOM_oSecurity_bc5947ef: start-on-event=GetEventFreezeFrameDataEx, operation=EvtInfo_AutoCreatedDemEvent_CC_EnablePDUGroup_CIOM_oSecuritySubnet_Tx_6c66ba3a_BswMReportFailToDemRef422.GetEventFreezeFrameDataEx
        OpEventGetEventFreezeFrameDataEx_GetEventFreezeFrameDataEx_EvtInfo_AutoCreatedDemEvent_CC_J1939RmStateSwitch_CN_Backbon_33d1a98e: start-on-event=GetEventFreezeFrameDataEx, operation=EvtInfo_AutoCreatedDemEvent_CC_J1939RmStateSwitch_CN_Backbone1J1939_0b1f4bae_CIOM_4d5cd289_J1939RM_STATE_OFFLINE_BswMRe_f9c55035.GetEventFreezeFrameDataEx
        OpEventGetEventFreezeFrameDataEx_GetEventFreezeFrameDataEx_EvtInfo_AutoCreatedDemEvent_CC_J1939RmStateSwitch_CN_Backbon_758d2c84: start-on-event=GetEventFreezeFrameDataEx, operation=EvtInfo_AutoCreatedDemEvent_CC_J1939RmStateSwitch_CN_Backbone1J1939_0b1f4bae_CIOM_4d5cd289_J1939RM_STATE_ONLINE_BswMRep_5375d7eb.GetEventFreezeFrameDataEx
        OpEventGetEventFreezeFrameDataEx_GetEventFreezeFrameDataEx_EvtInfo_AutoCreatedDemEvent_CC_J1939RmStateSwitch_CN_FMSNet_6bf08960: start-on-event=GetEventFreezeFrameDataEx, operation=EvtInfo_AutoCreatedDemEvent_CC_J1939RmStateSwitch_CN_FMSNet_fce1aae5_CIOM_3a3d59b1_J1939RM_STATE_OFFLINE_BswMReportFail_5f9bde08.GetEventFreezeFrameDataEx
        OpEventGetEventFreezeFrameDataEx_GetEventFreezeFrameDataEx_EvtInfo_AutoCreatedDemEvent_CC_J1939RmStateSwitch_CN_FMSNet_85e885ee: start-on-event=GetEventFreezeFrameDataEx, operation=EvtInfo_AutoCreatedDemEvent_CC_J1939RmStateSwitch_CN_FMSNet_fce1aae5_CIOM_3a3d59b1_J1939RM_STATE_ONLINE_BswMReportFailT_e97c0723.GetEventFreezeFrameDataEx
        OpEventGetEventFreezeFrameDataEx_GetEventFreezeFrameDataEx_EvtInfo_AutoCreatedDemEvent_CHNL_53cce282_CANSM_E_BUS_OFF422: start-on-event=GetEventFreezeFrameDataEx, operation=EvtInfo_AutoCreatedDemEvent_CHNL_53cce282_CANSM_E_BUS_OFF422.GetEventFreezeFrameDataEx
        OpEventGetEventFreezeFrameDataEx_GetEventFreezeFrameDataEx_EvtInfo_AutoCreatedDemEvent_CHNL_53cce282_CANSM_E_MODE_REQUE_4b44dd48: start-on-event=GetEventFreezeFrameDataEx, operation=EvtInfo_AutoCreatedDemEvent_CHNL_53cce282_CANSM_E_MODE_REQUEST_TIMEOUT422.GetEventFreezeFrameDataEx
        OpEventGetEventFreezeFrameDataEx_GetEventFreezeFrameDataEx_EvtInfo_AutoCreatedDemEvent_CHNL_17344684_CANSM_E_BUS_OFF422: start-on-event=GetEventFreezeFrameDataEx, operation=EvtInfo_AutoCreatedDemEvent_CHNL_17344684_CANSM_E_BUS_OFF422.GetEventFreezeFrameDataEx
        OpEventGetEventFreezeFrameDataEx_GetEventFreezeFrameDataEx_EvtInfo_AutoCreatedDemEvent_CHNL_17344684_CANSM_E_MODE_REQUE_0897c10c: start-on-event=GetEventFreezeFrameDataEx, operation=EvtInfo_AutoCreatedDemEvent_CHNL_17344684_CANSM_E_MODE_REQUEST_TIMEOUT422.GetEventFreezeFrameDataEx
        OpEventGetEventFreezeFrameDataEx_GetEventFreezeFrameDataEx_EvtInfo_AutoCreatedDemEvent_CHNL_a6b6a922_CANSM_E_BUS_OFF422: start-on-event=GetEventFreezeFrameDataEx, operation=EvtInfo_AutoCreatedDemEvent_CHNL_a6b6a922_CANSM_E_BUS_OFF422.GetEventFreezeFrameDataEx
        OpEventGetEventFreezeFrameDataEx_GetEventFreezeFrameDataEx_EvtInfo_AutoCreatedDemEvent_CHNL_a6b6a922_CANSM_E_MODE_REQUE_38b6c303: start-on-event=GetEventFreezeFrameDataEx, operation=EvtInfo_AutoCreatedDemEvent_CHNL_a6b6a922_CANSM_E_MODE_REQUEST_TIMEOUT422.GetEventFreezeFrameDataEx
        OpEventGetEventFreezeFrameDataEx_GetEventFreezeFrameDataEx_EvtInfo_AutoCreatedDemEvent_CHNL_df893ad5_CANSM_E_BUS_OFF422: start-on-event=GetEventFreezeFrameDataEx, operation=EvtInfo_AutoCreatedDemEvent_CHNL_df893ad5_CANSM_E_BUS_OFF422.GetEventFreezeFrameDataEx
        OpEventGetEventFreezeFrameDataEx_GetEventFreezeFrameDataEx_EvtInfo_AutoCreatedDemEvent_CHNL_df893ad5_CANSM_E_MODE_REQUE_81cf27d9: start-on-event=GetEventFreezeFrameDataEx, operation=EvtInfo_AutoCreatedDemEvent_CHNL_df893ad5_CANSM_E_MODE_REQUEST_TIMEOUT422.GetEventFreezeFrameDataEx
        OpEventGetEventFreezeFrameDataEx_GetEventFreezeFrameDataEx_EvtInfo_AutoCreatedDemEvent_CHNL_e058b4ae_CANSM_E_BUS_OFF422: start-on-event=GetEventFreezeFrameDataEx, operation=EvtInfo_AutoCreatedDemEvent_CHNL_e058b4ae_CANSM_E_BUS_OFF422.GetEventFreezeFrameDataEx
        OpEventGetEventFreezeFrameDataEx_GetEventFreezeFrameDataEx_EvtInfo_AutoCreatedDemEvent_CHNL_e058b4ae_CANSM_E_MODE_REQUE_5b374426: start-on-event=GetEventFreezeFrameDataEx, operation=EvtInfo_AutoCreatedDemEvent_CHNL_e058b4ae_CANSM_E_MODE_REQUEST_TIMEOUT422.GetEventFreezeFrameDataEx
        OpEventGetEventFreezeFrameDataEx_GetEventFreezeFrameDataEx_EvtInfo_AutoCreatedDemEvent_ECUM_E_ALL_RUN_REQUESTS_KILLED422: start-on-event=GetEventFreezeFrameDataEx, operation=EvtInfo_AutoCreatedDemEvent_ECUM_E_ALL_RUN_REQUESTS_KILLED422.GetEventFreezeFrameDataEx
        OpEventGetEventFreezeFrameDataEx_GetEventFreezeFrameDataEx_EvtInfo_AutoCreatedDemEvent_ECUM_E_CONFIGURATION_DATA_INCONSISTENT422: start-on-event=GetEventFreezeFrameDataEx, operation=EvtInfo_AutoCreatedDemEvent_ECUM_E_CONFIGURATION_DATA_INCONSISTENT422.GetEventFreezeFrameDataEx
        OpEventGetEventFreezeFrameDataEx_GetEventFreezeFrameDataEx_EvtInfo_AutoCreatedDemEvent_ECUM_E_IMPROPER_CALLER422: start-on-event=GetEventFreezeFrameDataEx, operation=EvtInfo_AutoCreatedDemEvent_ECUM_E_IMPROPER_CALLER422.GetEventFreezeFrameDataEx
        OpEventGetEventFreezeFrameDataEx_GetEventFreezeFrameDataEx_EvtInfo_AutoCreatedDemEvent_ECUM_E_RAM_CHECK_FAILED422: start-on-event=GetEventFreezeFrameDataEx, operation=EvtInfo_AutoCreatedDemEvent_ECUM_E_RAM_CHECK_FAILED422.GetEventFreezeFrameDataEx
        OpEventGetEventFreezeFrameDataEx_GetEventFreezeFrameDataEx_EvtInfo_AutoCreatedDemEvent_ESH_Action_CancelNvMWriteAll_Bsw_358c3b92: start-on-event=GetEventFreezeFrameDataEx, operation=EvtInfo_AutoCreatedDemEvent_ESH_Action_CancelNvMWriteAll_BswMReportFailToDemRef422.GetEventFreezeFrameDataEx
        OpEventGetEventFreezeFrameDataEx_GetEventFreezeFrameDataEx_EvtInfo_AutoCreatedDemEvent_ESH_Action_CancelWriteAllTimer_S_5e6c98e8: start-on-event=GetEventFreezeFrameDataEx, operation=EvtInfo_AutoCreatedDemEvent_ESH_Action_CancelWriteAllTimer_Start_BswMReportFailToDemRef422.GetEventFreezeFrameDataEx
        OpEventGetEventFreezeFrameDataEx_GetEventFreezeFrameDataEx_EvtInfo_AutoCreatedDemEvent_ESH_Action_CancelWriteAllTimer_S_a424516e: start-on-event=GetEventFreezeFrameDataEx, operation=EvtInfo_AutoCreatedDemEvent_ESH_Action_CancelWriteAllTimer_Stop_BswMReportFailToDemRef422.GetEventFreezeFrameDataEx
        OpEventGetEventFreezeFrameDataEx_GetEventFreezeFrameDataEx_EvtInfo_AutoCreatedDemEvent_ESH_Action_ComMAllow_CN_Backbone_4fc90f73: start-on-event=GetEventFreezeFrameDataEx, operation=EvtInfo_AutoCreatedDemEvent_ESH_Action_ComMAllow_CN_Backbone1J1939_0b1f4bae_BswMReportFailToDemRef422.GetEventFreezeFrameDataEx
        OpEventGetEventFreezeFrameDataEx_GetEventFreezeFrameDataEx_EvtInfo_AutoCreatedDemEvent_ESH_Action_ComMAllow_CN_Backbone_0809fa63: start-on-event=GetEventFreezeFrameDataEx, operation=EvtInfo_AutoCreatedDemEvent_ESH_Action_ComMAllow_CN_Backbone1J1939_0b1f4bae_BswMReportFailToDemRef_1422.GetEventFreezeFrameDataEx
        OpEventGetEventFreezeFrameDataEx_GetEventFreezeFrameDataEx_EvtInfo_AutoCreatedDemEvent_ESH_Action_ComMAllow_CN_Backbone_bc9dae6e: start-on-event=GetEventFreezeFrameDataEx, operation=EvtInfo_AutoCreatedDemEvent_ESH_Action_ComMAllow_CN_Backbone2_78967e2c_BswMReportFailToDemRef422.GetEventFreezeFrameDataEx
        OpEventGetEventFreezeFrameDataEx_GetEventFreezeFrameDataEx_EvtInfo_AutoCreatedDemEvent_ESH_Action_ComMAllow_CN_Backbone_56b4f655: start-on-event=GetEventFreezeFrameDataEx, operation=EvtInfo_AutoCreatedDemEvent_ESH_Action_ComMAllow_CN_Backbone2_78967e2c_BswMReportFailToDemRef_1422.GetEventFreezeFrameDataEx
        OpEventGetEventFreezeFrameDataEx_GetEventFreezeFrameDataEx_EvtInfo_AutoCreatedDemEvent_ESH_Action_ComMAllow_CN_CabSubne_109788b8: start-on-event=GetEventFreezeFrameDataEx, operation=EvtInfo_AutoCreatedDemEvent_ESH_Action_ComMAllow_CN_CabSubnet_9ea693f1_BswMReportFailToDemRef422.GetEventFreezeFrameDataEx
        OpEventGetEventFreezeFrameDataEx_GetEventFreezeFrameDataEx_EvtInfo_AutoCreatedDemEvent_ESH_Action_ComMAllow_CN_CabSubne_53dbbd3b: start-on-event=GetEventFreezeFrameDataEx, operation=EvtInfo_AutoCreatedDemEvent_ESH_Action_ComMAllow_CN_CabSubnet_9ea693f1_BswMReportFailToDemRef_1422.GetEventFreezeFrameDataEx
        OpEventGetEventFreezeFrameDataEx_GetEventFreezeFrameDataEx_EvtInfo_AutoCreatedDemEvent_ESH_Action_ComMAllow_CN_FMSNet_f_f8abed9f: start-on-event=GetEventFreezeFrameDataEx, operation=EvtInfo_AutoCreatedDemEvent_ESH_Action_ComMAllow_CN_FMSNet_fce1aae5_BswMReportFailToDemRef422.GetEventFreezeFrameDataEx
        OpEventGetEventFreezeFrameDataEx_GetEventFreezeFrameDataEx_EvtInfo_AutoCreatedDemEvent_ESH_Action_ComMAllow_CN_FMSNet_f_b4c672b5: start-on-event=GetEventFreezeFrameDataEx, operation=EvtInfo_AutoCreatedDemEvent_ESH_Action_ComMAllow_CN_FMSNet_fce1aae5_BswMReportFailToDemRef_1422.GetEventFreezeFrameDataEx
        OpEventGetEventFreezeFrameDataEx_GetEventFreezeFrameDataEx_EvtInfo_AutoCreatedDemEvent_ESH_Action_ComMAllow_CN_LIN00_2c_0e4f3ffd: start-on-event=GetEventFreezeFrameDataEx, operation=EvtInfo_AutoCreatedDemEvent_ESH_Action_ComMAllow_CN_LIN00_2cd9a7df_BswMReportFailToDemRef422.GetEventFreezeFrameDataEx
        OpEventGetEventFreezeFrameDataEx_GetEventFreezeFrameDataEx_EvtInfo_AutoCreatedDemEvent_ESH_Action_ComMAllow_CN_LIN00_2c_8bd03e8c: start-on-event=GetEventFreezeFrameDataEx, operation=EvtInfo_AutoCreatedDemEvent_ESH_Action_ComMAllow_CN_LIN00_2cd9a7df_BswMReportFailToDemRef_1422.GetEventFreezeFrameDataEx
        OpEventGetEventFreezeFrameDataEx_GetEventFreezeFrameDataEx_EvtInfo_AutoCreatedDemEvent_ESH_Action_ComMAllow_CN_LIN01_5b_357f4e91: start-on-event=GetEventFreezeFrameDataEx, operation=EvtInfo_AutoCreatedDemEvent_ESH_Action_ComMAllow_CN_LIN01_5bde9749_BswMReportFailToDemRef422.GetEventFreezeFrameDataEx
        OpEventGetEventFreezeFrameDataEx_GetEventFreezeFrameDataEx_EvtInfo_AutoCreatedDemEvent_ESH_Action_ComMAllow_CN_LIN01_5b_659a60bd: start-on-event=GetEventFreezeFrameDataEx, operation=EvtInfo_AutoCreatedDemEvent_ESH_Action_ComMAllow_CN_LIN01_5bde9749_BswMReportFailToDemRef_1422.GetEventFreezeFrameDataEx
        OpEventGetEventFreezeFrameDataEx_GetEventFreezeFrameDataEx_EvtInfo_AutoCreatedDemEvent_ESH_Action_ComMAllow_CN_LIN02_c2_ec1c8ea0: start-on-event=GetEventFreezeFrameDataEx, operation=EvtInfo_AutoCreatedDemEvent_ESH_Action_ComMAllow_CN_LIN02_c2d7c6f3_BswMReportFailToDemRef422.GetEventFreezeFrameDataEx
        OpEventGetEventFreezeFrameDataEx_GetEventFreezeFrameDataEx_EvtInfo_AutoCreatedDemEvent_ESH_Action_ComMAllow_CN_LIN02_c2_38a37cdc: start-on-event=GetEventFreezeFrameDataEx, operation=EvtInfo_AutoCreatedDemEvent_ESH_Action_ComMAllow_CN_LIN02_c2d7c6f3_BswMReportFailToDemRef_1422.GetEventFreezeFrameDataEx
        OpEventGetEventFreezeFrameDataEx_GetEventFreezeFrameDataEx_EvtInfo_AutoCreatedDemEvent_ESH_Action_ComMAllow_CN_LIN03_b5_f21ec792: start-on-event=GetEventFreezeFrameDataEx, operation=EvtInfo_AutoCreatedDemEvent_ESH_Action_ComMAllow_CN_LIN03_b5d0f665_BswMReportFailToDemRef422.GetEventFreezeFrameDataEx
        OpEventGetEventFreezeFrameDataEx_GetEventFreezeFrameDataEx_EvtInfo_AutoCreatedDemEvent_ESH_Action_ComMAllow_CN_LIN03_b5_dad3cf9b: start-on-event=GetEventFreezeFrameDataEx, operation=EvtInfo_AutoCreatedDemEvent_ESH_Action_ComMAllow_CN_LIN03_b5d0f665_BswMReportFailToDemRef_1422.GetEventFreezeFrameDataEx
        OpEventGetEventFreezeFrameDataEx_GetEventFreezeFrameDataEx_EvtInfo_AutoCreatedDemEvent_ESH_Action_ComMAllow_CN_LIN04_2b_795a1f0a: start-on-event=GetEventFreezeFrameDataEx, operation=EvtInfo_AutoCreatedDemEvent_ESH_Action_ComMAllow_CN_LIN04_2bb463c6_BswMReportFailToDemRef422.GetEventFreezeFrameDataEx
        OpEventGetEventFreezeFrameDataEx_GetEventFreezeFrameDataEx_EvtInfo_AutoCreatedDemEvent_ESH_Action_ComMAllow_CN_LIN04_2b_eb431e2b: start-on-event=GetEventFreezeFrameDataEx, operation=EvtInfo_AutoCreatedDemEvent_ESH_Action_ComMAllow_CN_LIN04_2bb463c6_BswMReportFailToDemRef_1422.GetEventFreezeFrameDataEx
        OpEventGetEventFreezeFrameDataEx_GetEventFreezeFrameDataEx_EvtInfo_AutoCreatedDemEvent_ESH_Action_ComMAllow_CN_Security_f51e261b: start-on-event=GetEventFreezeFrameDataEx, operation=EvtInfo_AutoCreatedDemEvent_ESH_Action_ComMAllow_CN_SecuritySubnet_e7a0ee54_BswMReportFailToDemRef422.GetEventFreezeFrameDataEx
        OpEventGetEventFreezeFrameDataEx_GetEventFreezeFrameDataEx_EvtInfo_AutoCreatedDemEvent_ESH_Action_ComMAllow_CN_Security_e79f3977: start-on-event=GetEventFreezeFrameDataEx, operation=EvtInfo_AutoCreatedDemEvent_ESH_Action_ComMAllow_CN_SecuritySubnet_e7a0ee54_BswMReportFailToDemRef_1422.GetEventFreezeFrameDataEx
        OpEventGetEventFreezeFrameDataEx_GetEventFreezeFrameDataEx_EvtInfo_AutoCreatedDemEvent_ESH_Action_ComMCheckPendingReque_e0f35578: start-on-event=GetEventFreezeFrameDataEx, operation=EvtInfo_AutoCreatedDemEvent_ESH_Action_ComMCheckPendingRequests_BswMReportFailToDemRef422.GetEventFreezeFrameDataEx
        OpEventGetEventFreezeFrameDataEx_GetEventFreezeFrameDataEx_EvtInfo_AutoCreatedDemEvent_ESH_Action_ComMCheckPendingReque_60433478: start-on-event=GetEventFreezeFrameDataEx, operation=EvtInfo_AutoCreatedDemEvent_ESH_Action_ComMCheckPendingRequests_BswMReportFailToDemRef_1422.GetEventFreezeFrameDataEx
        OpEventGetEventFreezeFrameDataEx_GetEventFreezeFrameDataEx_EvtInfo_AutoCreatedDemEvent_ESH_Action_ComMCheckPendingReque_72f69b96: start-on-event=GetEventFreezeFrameDataEx, operation=EvtInfo_AutoCreatedDemEvent_ESH_Action_ComMCheckPendingRequests_BswMReportFailToDemRef_2422.GetEventFreezeFrameDataEx
        OpEventGetEventFreezeFrameDataEx_GetEventFreezeFrameDataEx_EvtInfo_AutoCreatedDemEvent_ESH_Action_ComMDisallow_CN_Backb_7e8e1c4b: start-on-event=GetEventFreezeFrameDataEx, operation=EvtInfo_AutoCreatedDemEvent_ESH_Action_ComMDisallow_CN_Backbone1J1939_0b1f4bae_BswMReportFailToDemRef422.GetEventFreezeFrameDataEx
        OpEventGetEventFreezeFrameDataEx_GetEventFreezeFrameDataEx_EvtInfo_AutoCreatedDemEvent_ESH_Action_ComMDisallow_CN_Backb_03911150: start-on-event=GetEventFreezeFrameDataEx, operation=EvtInfo_AutoCreatedDemEvent_ESH_Action_ComMDisallow_CN_Backbone2_78967e2c_BswMReportFailToDemRef422.GetEventFreezeFrameDataEx
        OpEventGetEventFreezeFrameDataEx_GetEventFreezeFrameDataEx_EvtInfo_AutoCreatedDemEvent_ESH_Action_ComMDisallow_CN_CabSu_af9b3786: start-on-event=GetEventFreezeFrameDataEx, operation=EvtInfo_AutoCreatedDemEvent_ESH_Action_ComMDisallow_CN_CabSubnet_9ea693f1_BswMReportFailToDemRef422.GetEventFreezeFrameDataEx
        OpEventGetEventFreezeFrameDataEx_GetEventFreezeFrameDataEx_EvtInfo_AutoCreatedDemEvent_ESH_Action_ComMDisallow_CN_FMSNe_b06aeed2: start-on-event=GetEventFreezeFrameDataEx, operation=EvtInfo_AutoCreatedDemEvent_ESH_Action_ComMDisallow_CN_FMSNet_fce1aae5_BswMReportFailToDemRef422.GetEventFreezeFrameDataEx
        OpEventGetEventFreezeFrameDataEx_GetEventFreezeFrameDataEx_EvtInfo_AutoCreatedDemEvent_ESH_Action_ComMDisallow_CN_LIN00_7d7a395a: start-on-event=GetEventFreezeFrameDataEx, operation=EvtInfo_AutoCreatedDemEvent_ESH_Action_ComMDisallow_CN_LIN00_2cd9a7df_BswMReportFailToDemRef422.GetEventFreezeFrameDataEx
        OpEventGetEventFreezeFrameDataEx_GetEventFreezeFrameDataEx_EvtInfo_AutoCreatedDemEvent_ESH_Action_ComMDisallow_CN_LIN01_464a4836: start-on-event=GetEventFreezeFrameDataEx, operation=EvtInfo_AutoCreatedDemEvent_ESH_Action_ComMDisallow_CN_LIN01_5bde9749_BswMReportFailToDemRef422.GetEventFreezeFrameDataEx
        OpEventGetEventFreezeFrameDataEx_GetEventFreezeFrameDataEx_EvtInfo_AutoCreatedDemEvent_ESH_Action_ComMDisallow_CN_LIN02_9f298807: start-on-event=GetEventFreezeFrameDataEx, operation=EvtInfo_AutoCreatedDemEvent_ESH_Action_ComMDisallow_CN_LIN02_c2d7c6f3_BswMReportFailToDemRef422.GetEventFreezeFrameDataEx
        OpEventGetEventFreezeFrameDataEx_GetEventFreezeFrameDataEx_EvtInfo_AutoCreatedDemEvent_ESH_Action_ComMDisallow_CN_LIN03_812bc135: start-on-event=GetEventFreezeFrameDataEx, operation=EvtInfo_AutoCreatedDemEvent_ESH_Action_ComMDisallow_CN_LIN03_b5d0f665_BswMReportFailToDemRef422.GetEventFreezeFrameDataEx
        OpEventGetEventFreezeFrameDataEx_GetEventFreezeFrameDataEx_EvtInfo_AutoCreatedDemEvent_ESH_Action_ComMDisallow_CN_LIN04_0a6f19ad: start-on-event=GetEventFreezeFrameDataEx, operation=EvtInfo_AutoCreatedDemEvent_ESH_Action_ComMDisallow_CN_LIN04_2bb463c6_BswMReportFailToDemRef422.GetEventFreezeFrameDataEx
        OpEventGetEventFreezeFrameDataEx_GetEventFreezeFrameDataEx_EvtInfo_AutoCreatedDemEvent_ESH_Action_ComMDisallow_CN_Secur_c4593523: start-on-event=GetEventFreezeFrameDataEx, operation=EvtInfo_AutoCreatedDemEvent_ESH_Action_ComMDisallow_CN_SecuritySubnet_e7a0ee54_BswMReportFailToDemRef422.GetEventFreezeFrameDataEx
        OpEventGetEventFreezeFrameDataEx_GetEventFreezeFrameDataEx_EvtInfo_AutoCreatedDemEvent_ESH_Action_DemInit_BswMReportFai_983408dc: start-on-event=GetEventFreezeFrameDataEx, operation=EvtInfo_AutoCreatedDemEvent_ESH_Action_DemInit_BswMReportFailToDemRef422.GetEventFreezeFrameDataEx
        OpEventGetEventFreezeFrameDataEx_GetEventFreezeFrameDataEx_EvtInfo_AutoCreatedDemEvent_ESH_Action_DemInitialized_BswMRe_dbbeee35: start-on-event=GetEventFreezeFrameDataEx, operation=EvtInfo_AutoCreatedDemEvent_ESH_Action_DemInitialized_BswMReportFailToDemRef422.GetEventFreezeFrameDataEx
        OpEventGetEventFreezeFrameDataEx_GetEventFreezeFrameDataEx_EvtInfo_AutoCreatedDemEvent_ESH_Action_DemNotInitialized_Bsw_dc0348fa: start-on-event=GetEventFreezeFrameDataEx, operation=EvtInfo_AutoCreatedDemEvent_ESH_Action_DemNotInitialized_BswMReportFailToDemRef422.GetEventFreezeFrameDataEx
        OpEventGetEventFreezeFrameDataEx_GetEventFreezeFrameDataEx_EvtInfo_AutoCreatedDemEvent_ESH_Action_DemShutdown_BswMRepor_223e3acf: start-on-event=GetEventFreezeFrameDataEx, operation=EvtInfo_AutoCreatedDemEvent_ESH_Action_DemShutdown_BswMReportFailToDemRef422.GetEventFreezeFrameDataEx
        OpEventGetEventFreezeFrameDataEx_GetEventFreezeFrameDataEx_EvtInfo_AutoCreatedDemEvent_ESH_Action_ESH_PostRun_BswMRepor_acca1aac: start-on-event=GetEventFreezeFrameDataEx, operation=EvtInfo_AutoCreatedDemEvent_ESH_Action_ESH_PostRun_BswMReportFailToDemRef422.GetEventFreezeFrameDataEx
        OpEventGetEventFreezeFrameDataEx_GetEventFreezeFrameDataEx_EvtInfo_AutoCreatedDemEvent_ESH_Action_ESH_PrepShutdown_BswM_e7b69251: start-on-event=GetEventFreezeFrameDataEx, operation=EvtInfo_AutoCreatedDemEvent_ESH_Action_ESH_PrepShutdown_BswMReportFailToDemRef422.GetEventFreezeFrameDataEx
        OpEventGetEventFreezeFrameDataEx_GetEventFreezeFrameDataEx_EvtInfo_AutoCreatedDemEvent_ESH_Action_ESH_PrepShutdown_BswM_2105fbc5: start-on-event=GetEventFreezeFrameDataEx, operation=EvtInfo_AutoCreatedDemEvent_ESH_Action_ESH_PrepShutdown_BswMReportFailToDemRef_1422.GetEventFreezeFrameDataEx
        OpEventGetEventFreezeFrameDataEx_GetEventFreezeFrameDataEx_EvtInfo_AutoCreatedDemEvent_ESH_Action_ESH_Run_BswMReportFai_f36badc1: start-on-event=GetEventFreezeFrameDataEx, operation=EvtInfo_AutoCreatedDemEvent_ESH_Action_ESH_Run_BswMReportFailToDemRef422.GetEventFreezeFrameDataEx
        OpEventGetEventFreezeFrameDataEx_GetEventFreezeFrameDataEx_EvtInfo_AutoCreatedDemEvent_ESH_Action_ESH_Run_BswMReportFai_e622483f: start-on-event=GetEventFreezeFrameDataEx, operation=EvtInfo_AutoCreatedDemEvent_ESH_Action_ESH_Run_BswMReportFailToDemRef_1422.GetEventFreezeFrameDataEx
        OpEventGetEventFreezeFrameDataEx_GetEventFreezeFrameDataEx_EvtInfo_AutoCreatedDemEvent_ESH_Action_ESH_WaitForNvm_BswMRe_2026dfcf: start-on-event=GetEventFreezeFrameDataEx, operation=EvtInfo_AutoCreatedDemEvent_ESH_Action_ESH_WaitForNvm_BswMReportFailToDemRef422.GetEventFreezeFrameDataEx
        OpEventGetEventFreezeFrameDataEx_GetEventFreezeFrameDataEx_EvtInfo_AutoCreatedDemEvent_ESH_Action_ESH_Wakeup_BswMReport_2648c69c: start-on-event=GetEventFreezeFrameDataEx, operation=EvtInfo_AutoCreatedDemEvent_ESH_Action_ESH_Wakeup_BswMReportFailToDemRef422.GetEventFreezeFrameDataEx
        OpEventGetEventFreezeFrameDataEx_GetEventFreezeFrameDataEx_EvtInfo_AutoCreatedDemEvent_ESH_Action_ESH_Wakeup_BswMReport_335706d5: start-on-event=GetEventFreezeFrameDataEx, operation=EvtInfo_AutoCreatedDemEvent_ESH_Action_ESH_Wakeup_BswMReportFailToDemRef_1422.GetEventFreezeFrameDataEx
        OpEventGetEventFreezeFrameDataEx_GetEventFreezeFrameDataEx_EvtInfo_AutoCreatedDemEvent_ESH_Action_EcuMClearValidatedWak_71e07b90: start-on-event=GetEventFreezeFrameDataEx, operation=EvtInfo_AutoCreatedDemEvent_ESH_Action_EcuMClearValidatedWakeupEvents_BswMReportFailToDemRef422.GetEventFreezeFrameDataEx
        OpEventGetEventFreezeFrameDataEx_GetEventFreezeFrameDataEx_EvtInfo_AutoCreatedDemEvent_ESH_Action_EcuMGoToSelectedShutd_8a283485: start-on-event=GetEventFreezeFrameDataEx, operation=EvtInfo_AutoCreatedDemEvent_ESH_Action_EcuMGoToSelectedShutdownTarget_BswMReportFailToDemRef422.GetEventFreezeFrameDataEx
        OpEventGetEventFreezeFrameDataEx_GetEventFreezeFrameDataEx_EvtInfo_AutoCreatedDemEvent_ESH_Action_EnterExclusiveArea_Bs_6c3cf112: start-on-event=GetEventFreezeFrameDataEx, operation=EvtInfo_AutoCreatedDemEvent_ESH_Action_EnterExclusiveArea_BswMReportFailToDemRef422.GetEventFreezeFrameDataEx
        OpEventGetEventFreezeFrameDataEx_GetEventFreezeFrameDataEx_EvtInfo_AutoCreatedDemEvent_ESH_Action_EnterExclusiveArea_Bs_2eea5c6b: start-on-event=GetEventFreezeFrameDataEx, operation=EvtInfo_AutoCreatedDemEvent_ESH_Action_EnterExclusiveArea_BswMReportFailToDemRef_1422.GetEventFreezeFrameDataEx
        OpEventGetEventFreezeFrameDataEx_GetEventFreezeFrameDataEx_EvtInfo_AutoCreatedDemEvent_ESH_Action_ExitExclusiveArea_Bsw_8c351be8: start-on-event=GetEventFreezeFrameDataEx, operation=EvtInfo_AutoCreatedDemEvent_ESH_Action_ExitExclusiveArea_BswMReportFailToDemRef422.GetEventFreezeFrameDataEx
        OpEventGetEventFreezeFrameDataEx_GetEventFreezeFrameDataEx_EvtInfo_AutoCreatedDemEvent_ESH_Action_ExitExclusiveArea_Bsw_8066be33: start-on-event=GetEventFreezeFrameDataEx, operation=EvtInfo_AutoCreatedDemEvent_ESH_Action_ExitExclusiveArea_BswMReportFailToDemRef_1422.GetEventFreezeFrameDataEx
        OpEventGetEventFreezeFrameDataEx_GetEventFreezeFrameDataEx_EvtInfo_AutoCreatedDemEvent_ESH_Action_NvMWriteAll_BswMRepor_e7526bdd: start-on-event=GetEventFreezeFrameDataEx, operation=EvtInfo_AutoCreatedDemEvent_ESH_Action_NvMWriteAll_BswMReportFailToDemRef422.GetEventFreezeFrameDataEx
        OpEventGetEventFreezeFrameDataEx_GetEventFreezeFrameDataEx_EvtInfo_AutoCreatedDemEvent_ESH_Action_OnEnterPostRun_BswMRe_46bbf2f3: start-on-event=GetEventFreezeFrameDataEx, operation=EvtInfo_AutoCreatedDemEvent_ESH_Action_OnEnterPostRun_BswMReportFailToDemRef422.GetEventFreezeFrameDataEx
        OpEventGetEventFreezeFrameDataEx_GetEventFreezeFrameDataEx_EvtInfo_AutoCreatedDemEvent_ESH_Action_OnEnterPrepShutdown_B_bf9cba9d: start-on-event=GetEventFreezeFrameDataEx, operation=EvtInfo_AutoCreatedDemEvent_ESH_Action_OnEnterPrepShutdown_BswMReportFailToDemRef422.GetEventFreezeFrameDataEx
        OpEventGetEventFreezeFrameDataEx_GetEventFreezeFrameDataEx_EvtInfo_AutoCreatedDemEvent_ESH_Action_OnEnterPrepShutdown_B_73ff9357: start-on-event=GetEventFreezeFrameDataEx, operation=EvtInfo_AutoCreatedDemEvent_ESH_Action_OnEnterPrepShutdown_BswMReportFailToDemRef_1422.GetEventFreezeFrameDataEx
        OpEventGetEventFreezeFrameDataEx_GetEventFreezeFrameDataEx_EvtInfo_AutoCreatedDemEvent_ESH_Action_OnEnterRun_BswMReport_0a28f6d9: start-on-event=GetEventFreezeFrameDataEx, operation=EvtInfo_AutoCreatedDemEvent_ESH_Action_OnEnterRun_BswMReportFailToDemRef422.GetEventFreezeFrameDataEx
        OpEventGetEventFreezeFrameDataEx_GetEventFreezeFrameDataEx_EvtInfo_AutoCreatedDemEvent_ESH_Action_OnEnterRun_BswMReport_9880a159: start-on-event=GetEventFreezeFrameDataEx, operation=EvtInfo_AutoCreatedDemEvent_ESH_Action_OnEnterRun_BswMReportFailToDemRef_1422.GetEventFreezeFrameDataEx
        OpEventGetEventFreezeFrameDataEx_GetEventFreezeFrameDataEx_EvtInfo_AutoCreatedDemEvent_ESH_Action_OnEnterShutdown_BswMR_e8346aae: start-on-event=GetEventFreezeFrameDataEx, operation=EvtInfo_AutoCreatedDemEvent_ESH_Action_OnEnterShutdown_BswMReportFailToDemRef422.GetEventFreezeFrameDataEx
        OpEventGetEventFreezeFrameDataEx_GetEventFreezeFrameDataEx_EvtInfo_AutoCreatedDemEvent_ESH_Action_OnEnterWaitForNvm_Bsw_f6638ee6: start-on-event=GetEventFreezeFrameDataEx, operation=EvtInfo_AutoCreatedDemEvent_ESH_Action_OnEnterWaitForNvm_BswMReportFailToDemRef422.GetEventFreezeFrameDataEx
        OpEventGetEventFreezeFrameDataEx_GetEventFreezeFrameDataEx_EvtInfo_AutoCreatedDemEvent_ESH_Action_OnEnterWakeup_BswMRep_82e7a018: start-on-event=GetEventFreezeFrameDataEx, operation=EvtInfo_AutoCreatedDemEvent_ESH_Action_OnEnterWakeup_BswMReportFailToDemRef422.GetEventFreezeFrameDataEx
        OpEventGetEventFreezeFrameDataEx_GetEventFreezeFrameDataEx_EvtInfo_AutoCreatedDemEvent_ESH_Action_OnEnterWakeup_BswMRep_c8693b58: start-on-event=GetEventFreezeFrameDataEx, operation=EvtInfo_AutoCreatedDemEvent_ESH_Action_OnEnterWakeup_BswMReportFailToDemRef_1422.GetEventFreezeFrameDataEx
        OpEventGetEventFreezeFrameDataEx_GetEventFreezeFrameDataEx_EvtInfo_AutoCreatedDemEvent_ESH_Action_SelfRunRequestTimer_S_f08614b8: start-on-event=GetEventFreezeFrameDataEx, operation=EvtInfo_AutoCreatedDemEvent_ESH_Action_SelfRunRequestTimer_Start_BswMReportFailToDemRef422.GetEventFreezeFrameDataEx
        OpEventGetEventFreezeFrameDataEx_GetEventFreezeFrameDataEx_EvtInfo_AutoCreatedDemEvent_ESH_Action_SelfRunRequestTimer_S_aa628245: start-on-event=GetEventFreezeFrameDataEx, operation=EvtInfo_AutoCreatedDemEvent_ESH_Action_SelfRunRequestTimer_Start_BswMReportFailToDemRef_1422.GetEventFreezeFrameDataEx
        OpEventGetEventFreezeFrameDataEx_GetEventFreezeFrameDataEx_EvtInfo_AutoCreatedDemEvent_ESH_Action_SwitchPostRun_BswMRep_9836c1fa: start-on-event=GetEventFreezeFrameDataEx, operation=EvtInfo_AutoCreatedDemEvent_ESH_Action_SwitchPostRun_BswMReportFailToDemRef422.GetEventFreezeFrameDataEx
        OpEventGetEventFreezeFrameDataEx_GetEventFreezeFrameDataEx_EvtInfo_AutoCreatedDemEvent_ESH_Action_SwitchRun_BswMReportF_137d3bad: start-on-event=GetEventFreezeFrameDataEx, operation=EvtInfo_AutoCreatedDemEvent_ESH_Action_SwitchRun_BswMReportFailToDemRef422.GetEventFreezeFrameDataEx
        OpEventGetEventFreezeFrameDataEx_GetEventFreezeFrameDataEx_EvtInfo_AutoCreatedDemEvent_ESH_Action_SwitchRun_BswMReportF_3606baf3: start-on-event=GetEventFreezeFrameDataEx, operation=EvtInfo_AutoCreatedDemEvent_ESH_Action_SwitchRun_BswMReportFailToDemRef_1422.GetEventFreezeFrameDataEx
        OpEventGetEventFreezeFrameDataEx_GetEventFreezeFrameDataEx_EvtInfo_AutoCreatedDemEvent_ESH_Action_SwitchShutdown_BswMRe_91365f39: start-on-event=GetEventFreezeFrameDataEx, operation=EvtInfo_AutoCreatedDemEvent_ESH_Action_SwitchShutdown_BswMReportFailToDemRef422.GetEventFreezeFrameDataEx
        OpEventGetEventFreezeFrameDataEx_GetEventFreezeFrameDataEx_EvtInfo_AutoCreatedDemEvent_ESH_Action_SwitchShutdown_BswMRe_69f4d2e7: start-on-event=GetEventFreezeFrameDataEx, operation=EvtInfo_AutoCreatedDemEvent_ESH_Action_SwitchShutdown_BswMReportFailToDemRef_1422.GetEventFreezeFrameDataEx
        OpEventGetEventFreezeFrameDataEx_GetEventFreezeFrameDataEx_EvtInfo_AutoCreatedDemEvent_ESH_Action_SwitchWakeup_BswMRepo_b44a6cf5: start-on-event=GetEventFreezeFrameDataEx, operation=EvtInfo_AutoCreatedDemEvent_ESH_Action_SwitchWakeup_BswMReportFailToDemRef422.GetEventFreezeFrameDataEx
        OpEventGetEventFreezeFrameDataEx_GetEventFreezeFrameDataEx_EvtInfo_AutoCreatedDemEvent_ESH_Action_SwitchWakeup_BswMRepo_b16b0ecf: start-on-event=GetEventFreezeFrameDataEx, operation=EvtInfo_AutoCreatedDemEvent_ESH_Action_SwitchWakeup_BswMReportFailToDemRef_1422.GetEventFreezeFrameDataEx
        OpEventGetEventFreezeFrameDataEx_GetEventFreezeFrameDataEx_EvtInfo_AutoCreatedDemEvent_ESH_Action_WriteAllTimer_Start_B_5605f078: start-on-event=GetEventFreezeFrameDataEx, operation=EvtInfo_AutoCreatedDemEvent_ESH_Action_WriteAllTimer_Start_BswMReportFailToDemRef422.GetEventFreezeFrameDataEx
        OpEventGetEventFreezeFrameDataEx_GetEventFreezeFrameDataEx_EvtInfo_AutoCreatedDemEvent_ESH_Action_WriteAllTimer_Stop_Bs_a071ec23: start-on-event=GetEventFreezeFrameDataEx, operation=EvtInfo_AutoCreatedDemEvent_ESH_Action_WriteAllTimer_Stop_BswMReportFailToDemRef422.GetEventFreezeFrameDataEx
        OpEventGetEventFreezeFrameDataEx_GetEventFreezeFrameDataEx_EvtInfo_AutoCreatedDemEvent_ESH_Action_WriteAllTimer_Stop_Bs_8bb1fb4d: start-on-event=GetEventFreezeFrameDataEx, operation=EvtInfo_AutoCreatedDemEvent_ESH_Action_WriteAllTimer_Stop_BswMReportFailToDemRef_1422.GetEventFreezeFrameDataEx
        OpEventGetEventFreezeFrameDataEx_GetEventFreezeFrameDataEx_EvtInfo_AutoCreatedDemEvent_ESH_DemInit_BswMReportFailToDemRef422: start-on-event=GetEventFreezeFrameDataEx, operation=EvtInfo_AutoCreatedDemEvent_ESH_DemInit_BswMReportFailToDemRef422.GetEventFreezeFrameDataEx
        OpEventGetEventFreezeFrameDataEx_GetEventFreezeFrameDataEx_EvtInfo_AutoCreatedDemEvent_ESH_PostRunNested_BswMReportFail_c313bb49: start-on-event=GetEventFreezeFrameDataEx, operation=EvtInfo_AutoCreatedDemEvent_ESH_PostRunNested_BswMReportFailToDemRef422.GetEventFreezeFrameDataEx
        OpEventGetEventFreezeFrameDataEx_GetEventFreezeFrameDataEx_EvtInfo_AutoCreatedDemEvent_ESH_PostRunToPrepNested_BswMRepo_78b24bb7: start-on-event=GetEventFreezeFrameDataEx, operation=EvtInfo_AutoCreatedDemEvent_ESH_PostRunToPrepNested_BswMReportFailToDemRef422.GetEventFreezeFrameDataEx
        OpEventGetEventFreezeFrameDataEx_GetEventFreezeFrameDataEx_EvtInfo_AutoCreatedDemEvent_ESH_RunToPostRunNested_BswMRepor_80d67cb8: start-on-event=GetEventFreezeFrameDataEx, operation=EvtInfo_AutoCreatedDemEvent_ESH_RunToPostRunNested_BswMReportFailToDemRef422.GetEventFreezeFrameDataEx
        OpEventGetEventFreezeFrameDataEx_GetEventFreezeFrameDataEx_EvtInfo_AutoCreatedDemEvent_FLS_E_COMPARE_FAILED422: start-on-event=GetEventFreezeFrameDataEx, operation=EvtInfo_AutoCreatedDemEvent_FLS_E_COMPARE_FAILED422.GetEventFreezeFrameDataEx
        OpEventGetEventFreezeFrameDataEx_GetEventFreezeFrameDataEx_EvtInfo_AutoCreatedDemEvent_FLS_E_ERASE_FAILED422: start-on-event=GetEventFreezeFrameDataEx, operation=EvtInfo_AutoCreatedDemEvent_FLS_E_ERASE_FAILED422.GetEventFreezeFrameDataEx
        OpEventGetEventFreezeFrameDataEx_GetEventFreezeFrameDataEx_EvtInfo_AutoCreatedDemEvent_FLS_E_READ_FAILED422: start-on-event=GetEventFreezeFrameDataEx, operation=EvtInfo_AutoCreatedDemEvent_FLS_E_READ_FAILED422.GetEventFreezeFrameDataEx
        OpEventGetEventFreezeFrameDataEx_GetEventFreezeFrameDataEx_EvtInfo_AutoCreatedDemEvent_FLS_E_UNEXPECTED_FLASH_ID422: start-on-event=GetEventFreezeFrameDataEx, operation=EvtInfo_AutoCreatedDemEvent_FLS_E_UNEXPECTED_FLASH_ID422.GetEventFreezeFrameDataEx
        OpEventGetEventFreezeFrameDataEx_GetEventFreezeFrameDataEx_EvtInfo_AutoCreatedDemEvent_FLS_E_WRITE_FAILED422: start-on-event=GetEventFreezeFrameDataEx, operation=EvtInfo_AutoCreatedDemEvent_FLS_E_WRITE_FAILED422.GetEventFreezeFrameDataEx
        OpEventGetEventFreezeFrameDataEx_GetEventFreezeFrameDataEx_EvtInfo_AutoCreatedDemEvent_GPT_E_TIMEOUT422: start-on-event=GetEventFreezeFrameDataEx, operation=EvtInfo_AutoCreatedDemEvent_GPT_E_TIMEOUT422.GetEventFreezeFrameDataEx
        OpEventGetEventFreezeFrameDataEx_GetEventFreezeFrameDataEx_EvtInfo_AutoCreatedDemEvent_INIT_Action_BrsHw_EnableHwAccess_ca9bf021: start-on-event=GetEventFreezeFrameDataEx, operation=EvtInfo_AutoCreatedDemEvent_INIT_Action_BrsHw_EnableHwAccess_BswMReportFailToDemRef422.GetEventFreezeFrameDataEx
        OpEventGetEventFreezeFrameDataEx_GetEventFreezeFrameDataEx_EvtInfo_AutoCreatedDemEvent_INIT_Action_CanIf_Init_BswMRepor_8835c02e: start-on-event=GetEventFreezeFrameDataEx, operation=EvtInfo_AutoCreatedDemEvent_INIT_Action_CanIf_Init_BswMReportFailToDemRef422.GetEventFreezeFrameDataEx
        OpEventGetEventFreezeFrameDataEx_GetEventFreezeFrameDataEx_EvtInfo_AutoCreatedDemEvent_INIT_Action_CanNm_Init_BswMRepor_22e30e1c: start-on-event=GetEventFreezeFrameDataEx, operation=EvtInfo_AutoCreatedDemEvent_INIT_Action_CanNm_Init_BswMReportFailToDemRef422.GetEventFreezeFrameDataEx
        OpEventGetEventFreezeFrameDataEx_GetEventFreezeFrameDataEx_EvtInfo_AutoCreatedDemEvent_INIT_Action_CanSM_Init_BswMRepor_4047829a: start-on-event=GetEventFreezeFrameDataEx, operation=EvtInfo_AutoCreatedDemEvent_INIT_Action_CanSM_Init_BswMReportFailToDemRef422.GetEventFreezeFrameDataEx
        OpEventGetEventFreezeFrameDataEx_GetEventFreezeFrameDataEx_EvtInfo_AutoCreatedDemEvent_INIT_Action_CanTp_Init_BswMRepor_8435e8ac: start-on-event=GetEventFreezeFrameDataEx, operation=EvtInfo_AutoCreatedDemEvent_INIT_Action_CanTp_Init_BswMReportFailToDemRef422.GetEventFreezeFrameDataEx
        OpEventGetEventFreezeFrameDataEx_GetEventFreezeFrameDataEx_EvtInfo_AutoCreatedDemEvent_INIT_Action_Can_Init_BswMReportF_11d42d7b: start-on-event=GetEventFreezeFrameDataEx, operation=EvtInfo_AutoCreatedDemEvent_INIT_Action_Can_Init_BswMReportFailToDemRef422.GetEventFreezeFrameDataEx
        OpEventGetEventFreezeFrameDataEx_GetEventFreezeFrameDataEx_EvtInfo_AutoCreatedDemEvent_INIT_Action_ComM_Init_BswMReport_2a17cff4: start-on-event=GetEventFreezeFrameDataEx, operation=EvtInfo_AutoCreatedDemEvent_INIT_Action_ComM_Init_BswMReportFailToDemRef422.GetEventFreezeFrameDataEx
        OpEventGetEventFreezeFrameDataEx_GetEventFreezeFrameDataEx_EvtInfo_AutoCreatedDemEvent_INIT_Action_Com_Init_BswMReportF_0201c637: start-on-event=GetEventFreezeFrameDataEx, operation=EvtInfo_AutoCreatedDemEvent_INIT_Action_Com_Init_BswMReportFailToDemRef422.GetEventFreezeFrameDataEx
        OpEventGetEventFreezeFrameDataEx_GetEventFreezeFrameDataEx_EvtInfo_AutoCreatedDemEvent_INIT_Action_Dcm_Init_BswMReportF_4aa1b3a0: start-on-event=GetEventFreezeFrameDataEx, operation=EvtInfo_AutoCreatedDemEvent_INIT_Action_Dcm_Init_BswMReportFailToDemRef422.GetEventFreezeFrameDataEx
        OpEventGetEventFreezeFrameDataEx_GetEventFreezeFrameDataEx_EvtInfo_AutoCreatedDemEvent_INIT_Action_Dem_Init_BswMReportF_fc8ed18a: start-on-event=GetEventFreezeFrameDataEx, operation=EvtInfo_AutoCreatedDemEvent_INIT_Action_Dem_Init_BswMReportFailToDemRef422.GetEventFreezeFrameDataEx
        OpEventGetEventFreezeFrameDataEx_GetEventFreezeFrameDataEx_EvtInfo_AutoCreatedDemEvent_INIT_Action_EnableInterrupts_Bsw_87c1c532: start-on-event=GetEventFreezeFrameDataEx, operation=EvtInfo_AutoCreatedDemEvent_INIT_Action_EnableInterrupts_BswMReportFailToDemRef422.GetEventFreezeFrameDataEx
        OpEventGetEventFreezeFrameDataEx_GetEventFreezeFrameDataEx_EvtInfo_AutoCreatedDemEvent_INIT_Action_Fee_Init_BswMReportF_569e47b2: start-on-event=GetEventFreezeFrameDataEx, operation=EvtInfo_AutoCreatedDemEvent_INIT_Action_Fee_Init_BswMReportFailToDemRef422.GetEventFreezeFrameDataEx
        OpEventGetEventFreezeFrameDataEx_GetEventFreezeFrameDataEx_EvtInfo_AutoCreatedDemEvent_INIT_Action_Issm_Init_BswMReport_d570a839: start-on-event=GetEventFreezeFrameDataEx, operation=EvtInfo_AutoCreatedDemEvent_INIT_Action_Issm_Init_BswMReportFailToDemRef422.GetEventFreezeFrameDataEx
        OpEventGetEventFreezeFrameDataEx_GetEventFreezeFrameDataEx_EvtInfo_AutoCreatedDemEvent_INIT_Action_J1939Nm_Init_BswMRep_b7cb5faa: start-on-event=GetEventFreezeFrameDataEx, operation=EvtInfo_AutoCreatedDemEvent_INIT_Action_J1939Nm_Init_BswMReportFailToDemRef422.GetEventFreezeFrameDataEx
        OpEventGetEventFreezeFrameDataEx_GetEventFreezeFrameDataEx_EvtInfo_AutoCreatedDemEvent_INIT_Action_J1939Rm_Init_BswMRep_d92f9e0d: start-on-event=GetEventFreezeFrameDataEx, operation=EvtInfo_AutoCreatedDemEvent_INIT_Action_J1939Rm_Init_BswMReportFailToDemRef422.GetEventFreezeFrameDataEx
        OpEventGetEventFreezeFrameDataEx_GetEventFreezeFrameDataEx_EvtInfo_AutoCreatedDemEvent_INIT_Action_J1939Tp_Init_BswMRep_111db91a: start-on-event=GetEventFreezeFrameDataEx, operation=EvtInfo_AutoCreatedDemEvent_INIT_Action_J1939Tp_Init_BswMReportFailToDemRef422.GetEventFreezeFrameDataEx
        OpEventGetEventFreezeFrameDataEx_GetEventFreezeFrameDataEx_EvtInfo_AutoCreatedDemEvent_INIT_Action_LinIf_Init_BswMRepor_6e60f36c: start-on-event=GetEventFreezeFrameDataEx, operation=EvtInfo_AutoCreatedDemEvent_INIT_Action_LinIf_Init_BswMReportFailToDemRef422.GetEventFreezeFrameDataEx
        OpEventGetEventFreezeFrameDataEx_GetEventFreezeFrameDataEx_EvtInfo_AutoCreatedDemEvent_INIT_Action_LinSM_Init_BswMRepor_a612b1d8: start-on-event=GetEventFreezeFrameDataEx, operation=EvtInfo_AutoCreatedDemEvent_INIT_Action_LinSM_Init_BswMReportFailToDemRef422.GetEventFreezeFrameDataEx
        OpEventGetEventFreezeFrameDataEx_GetEventFreezeFrameDataEx_EvtInfo_AutoCreatedDemEvent_INIT_Action_LinTp_Init_BswMRepor_6260dbee: start-on-event=GetEventFreezeFrameDataEx, operation=EvtInfo_AutoCreatedDemEvent_INIT_Action_LinTp_Init_BswMReportFailToDemRef422.GetEventFreezeFrameDataEx
        OpEventGetEventFreezeFrameDataEx_GetEventFreezeFrameDataEx_EvtInfo_AutoCreatedDemEvent_INIT_Action_Lin_Init_BswMReportF_7ddd94d1: start-on-event=GetEventFreezeFrameDataEx, operation=EvtInfo_AutoCreatedDemEvent_INIT_Action_Lin_Init_BswMReportFailToDemRef422.GetEventFreezeFrameDataEx
        OpEventGetEventFreezeFrameDataEx_GetEventFreezeFrameDataEx_EvtInfo_AutoCreatedDemEvent_INIT_Action_Nm_Init_BswMReportFa_a824d89d: start-on-event=GetEventFreezeFrameDataEx, operation=EvtInfo_AutoCreatedDemEvent_INIT_Action_Nm_Init_BswMReportFailToDemRef422.GetEventFreezeFrameDataEx
        OpEventGetEventFreezeFrameDataEx_GetEventFreezeFrameDataEx_EvtInfo_AutoCreatedDemEvent_INIT_Action_NvMReadAll_BswMRepor_a5d427ff: start-on-event=GetEventFreezeFrameDataEx, operation=EvtInfo_AutoCreatedDemEvent_INIT_Action_NvMReadAll_BswMReportFailToDemRef422.GetEventFreezeFrameDataEx
        OpEventGetEventFreezeFrameDataEx_GetEventFreezeFrameDataEx_EvtInfo_AutoCreatedDemEvent_INIT_Action_NvM_Init_BswMReportF_f2879362: start-on-event=GetEventFreezeFrameDataEx, operation=EvtInfo_AutoCreatedDemEvent_INIT_Action_NvM_Init_BswMReportFailToDemRef422.GetEventFreezeFrameDataEx
        OpEventGetEventFreezeFrameDataEx_GetEventFreezeFrameDataEx_EvtInfo_AutoCreatedDemEvent_INIT_Action_PduR_Init_BswMReport_8f2d034e: start-on-event=GetEventFreezeFrameDataEx, operation=EvtInfo_AutoCreatedDemEvent_INIT_Action_PduR_Init_BswMReportFailToDemRef422.GetEventFreezeFrameDataEx
        OpEventGetEventFreezeFrameDataEx_GetEventFreezeFrameDataEx_EvtInfo_AutoCreatedDemEvent_INIT_Action_RteStart_BswMReportF_6e8dab6b: start-on-event=GetEventFreezeFrameDataEx, operation=EvtInfo_AutoCreatedDemEvent_INIT_Action_RteStart_BswMReportFailToDemRef422.GetEventFreezeFrameDataEx
        OpEventGetEventFreezeFrameDataEx_GetEventFreezeFrameDataEx_EvtInfo_AutoCreatedDemEvent_J1939NM_E_ADDRESS_LOST422: start-on-event=GetEventFreezeFrameDataEx, operation=EvtInfo_AutoCreatedDemEvent_J1939NM_E_ADDRESS_LOST422.GetEventFreezeFrameDataEx
        OpEventGetEventFreezeFrameDataEx_GetEventFreezeFrameDataEx_EvtInfo_AutoCreatedDemEvent_J1939TpConfiguration_J1939TP_E_C_1c4edcb5: start-on-event=GetEventFreezeFrameDataEx, operation=EvtInfo_AutoCreatedDemEvent_J1939TpConfiguration_J1939TP_E_COMMUNICATION422.GetEventFreezeFrameDataEx
        OpEventGetEventFreezeFrameDataEx_GetEventFreezeFrameDataEx_EvtInfo_AutoCreatedDemEvent_LIN_E_TIMEOUT422: start-on-event=GetEventFreezeFrameDataEx, operation=EvtInfo_AutoCreatedDemEvent_LIN_E_TIMEOUT422.GetEventFreezeFrameDataEx
        OpEventGetEventFreezeFrameDataEx_GetEventFreezeFrameDataEx_EvtInfo_AutoCreatedDemEvent_MCL_E_DMA_BUS422: start-on-event=GetEventFreezeFrameDataEx, operation=EvtInfo_AutoCreatedDemEvent_MCL_E_DMA_BUS422.GetEventFreezeFrameDataEx
        OpEventGetEventFreezeFrameDataEx_GetEventFreezeFrameDataEx_EvtInfo_AutoCreatedDemEvent_MCL_E_DMA_DESCRIPTOR422: start-on-event=GetEventFreezeFrameDataEx, operation=EvtInfo_AutoCreatedDemEvent_MCL_E_DMA_DESCRIPTOR422.GetEventFreezeFrameDataEx
        OpEventGetEventFreezeFrameDataEx_GetEventFreezeFrameDataEx_EvtInfo_AutoCreatedDemEvent_MCL_E_DMA_ECC422: start-on-event=GetEventFreezeFrameDataEx, operation=EvtInfo_AutoCreatedDemEvent_MCL_E_DMA_ECC422.GetEventFreezeFrameDataEx
        OpEventGetEventFreezeFrameDataEx_GetEventFreezeFrameDataEx_EvtInfo_AutoCreatedDemEvent_MCL_E_DMA_INCONSISTENCY422: start-on-event=GetEventFreezeFrameDataEx, operation=EvtInfo_AutoCreatedDemEvent_MCL_E_DMA_INCONSISTENCY422.GetEventFreezeFrameDataEx
        OpEventGetEventFreezeFrameDataEx_GetEventFreezeFrameDataEx_EvtInfo_AutoCreatedDemEvent_MCL_E_DMA_PRIORITY422: start-on-event=GetEventFreezeFrameDataEx, operation=EvtInfo_AutoCreatedDemEvent_MCL_E_DMA_PRIORITY422.GetEventFreezeFrameDataEx
        OpEventGetEventFreezeFrameDataEx_GetEventFreezeFrameDataEx_EvtInfo_AutoCreatedDemEvent_MCL_E_DMA_UNRECOGNIZED422: start-on-event=GetEventFreezeFrameDataEx, operation=EvtInfo_AutoCreatedDemEvent_MCL_E_DMA_UNRECOGNIZED422.GetEventFreezeFrameDataEx
        OpEventGetEventFreezeFrameDataEx_GetEventFreezeFrameDataEx_EvtInfo_AutoCreatedDemEvent_MCU_E_CLOCK_FAILURE422: start-on-event=GetEventFreezeFrameDataEx, operation=EvtInfo_AutoCreatedDemEvent_MCU_E_CLOCK_FAILURE422.GetEventFreezeFrameDataEx
        OpEventGetEventFreezeFrameDataEx_GetEventFreezeFrameDataEx_EvtInfo_AutoCreatedDemEvent_MCU_E_INVALIDMODE_CONFIG422: start-on-event=GetEventFreezeFrameDataEx, operation=EvtInfo_AutoCreatedDemEvent_MCU_E_INVALIDMODE_CONFIG422.GetEventFreezeFrameDataEx
        OpEventGetEventFreezeFrameDataEx_GetEventFreezeFrameDataEx_EvtInfo_AutoCreatedDemEvent_MCU_E_SSCM_CER_FAILURE422: start-on-event=GetEventFreezeFrameDataEx, operation=EvtInfo_AutoCreatedDemEvent_MCU_E_SSCM_CER_FAILURE422.GetEventFreezeFrameDataEx
        OpEventGetEventFreezeFrameDataEx_GetEventFreezeFrameDataEx_EvtInfo_AutoCreatedDemEvent_MCU_E_TIMEOUT_FAILURE422: start-on-event=GetEventFreezeFrameDataEx, operation=EvtInfo_AutoCreatedDemEvent_MCU_E_TIMEOUT_FAILURE422.GetEventFreezeFrameDataEx
        OpEventGetEventFreezeFrameDataEx_GetEventFreezeFrameDataEx_EvtInfo_AutoCreatedDemEvent_NVM_E_INTEGRITY_FAILED422: start-on-event=GetEventFreezeFrameDataEx, operation=EvtInfo_AutoCreatedDemEvent_NVM_E_INTEGRITY_FAILED422.GetEventFreezeFrameDataEx
        OpEventGetEventFreezeFrameDataEx_GetEventFreezeFrameDataEx_EvtInfo_AutoCreatedDemEvent_NVM_E_LOSS_OF_REDUNDANCY422: start-on-event=GetEventFreezeFrameDataEx, operation=EvtInfo_AutoCreatedDemEvent_NVM_E_LOSS_OF_REDUNDANCY422.GetEventFreezeFrameDataEx
        OpEventGetEventFreezeFrameDataEx_GetEventFreezeFrameDataEx_EvtInfo_AutoCreatedDemEvent_NVM_E_QUEUE_OVERFLOW422: start-on-event=GetEventFreezeFrameDataEx, operation=EvtInfo_AutoCreatedDemEvent_NVM_E_QUEUE_OVERFLOW422.GetEventFreezeFrameDataEx
        OpEventGetEventFreezeFrameDataEx_GetEventFreezeFrameDataEx_EvtInfo_AutoCreatedDemEvent_NVM_E_REQ_FAILED422: start-on-event=GetEventFreezeFrameDataEx, operation=EvtInfo_AutoCreatedDemEvent_NVM_E_REQ_FAILED422.GetEventFreezeFrameDataEx
        OpEventGetEventFreezeFrameDataEx_GetEventFreezeFrameDataEx_EvtInfo_AutoCreatedDemEvent_NVM_E_VERIFY_FAILED422: start-on-event=GetEventFreezeFrameDataEx, operation=EvtInfo_AutoCreatedDemEvent_NVM_E_VERIFY_FAILED422.GetEventFreezeFrameDataEx
        OpEventGetEventFreezeFrameDataEx_GetEventFreezeFrameDataEx_EvtInfo_AutoCreatedDemEvent_NVM_E_WRITE_PROTECTED422: start-on-event=GetEventFreezeFrameDataEx, operation=EvtInfo_AutoCreatedDemEvent_NVM_E_WRITE_PROTECTED422.GetEventFreezeFrameDataEx
        OpEventGetEventFreezeFrameDataEx_GetEventFreezeFrameDataEx_EvtInfo_AutoCreatedDemEvent_NVM_E_WRONG_BLOCK_ID422: start-on-event=GetEventFreezeFrameDataEx, operation=EvtInfo_AutoCreatedDemEvent_NVM_E_WRONG_BLOCK_ID422.GetEventFreezeFrameDataEx
        OpEventGetEventFreezeFrameDataEx_GetEventFreezeFrameDataEx_EvtInfo_AutoCreatedDemEvent_SPI_E_HARDWARE_ERROR422: start-on-event=GetEventFreezeFrameDataEx, operation=EvtInfo_AutoCreatedDemEvent_SPI_E_HARDWARE_ERROR422.GetEventFreezeFrameDataEx
        OpEventGetEventFreezeFrameDataEx_GetEventFreezeFrameDataEx_EvtInfo_AutoCreatedDemEvent_SpiDriver_SPI_E_HARDWARE_ERROR422: start-on-event=GetEventFreezeFrameDataEx, operation=EvtInfo_AutoCreatedDemEvent_SpiDriver_SPI_E_HARDWARE_ERROR422.GetEventFreezeFrameDataEx
        OpEventGetEventFreezeFrameDataEx_GetEventFreezeFrameDataEx_EvtInfo_AutoCreatedDemEvent_WDG_E_CORRUPT_CONFIG422: start-on-event=GetEventFreezeFrameDataEx, operation=EvtInfo_AutoCreatedDemEvent_WDG_E_CORRUPT_CONFIG422.GetEventFreezeFrameDataEx
        OpEventGetEventFreezeFrameDataEx_GetEventFreezeFrameDataEx_EvtInfo_AutoCreatedDemEvent_WDG_E_DISABLE_REJECTED422: start-on-event=GetEventFreezeFrameDataEx, operation=EvtInfo_AutoCreatedDemEvent_WDG_E_DISABLE_REJECTED422.GetEventFreezeFrameDataEx
        OpEventGetEventFreezeFrameDataEx_GetEventFreezeFrameDataEx_EvtInfo_AutoCreatedDemEvent_WDG_E_FORBIDDEN_INVOCATION422: start-on-event=GetEventFreezeFrameDataEx, operation=EvtInfo_AutoCreatedDemEvent_WDG_E_FORBIDDEN_INVOCATION422.GetEventFreezeFrameDataEx
        OpEventGetEventFreezeFrameDataEx_GetEventFreezeFrameDataEx_EvtInfo_AutoCreatedDemEvent_WDG_E_INVALID_CALL422: start-on-event=GetEventFreezeFrameDataEx, operation=EvtInfo_AutoCreatedDemEvent_WDG_E_INVALID_CALL422.GetEventFreezeFrameDataEx
        OpEventGetEventFreezeFrameDataEx_GetEventFreezeFrameDataEx_EvtInfo_AutoCreatedDemEvent_WDG_E_INVALID_PARAMETER422: start-on-event=GetEventFreezeFrameDataEx, operation=EvtInfo_AutoCreatedDemEvent_WDG_E_INVALID_PARAMETER422.GetEventFreezeFrameDataEx
        OpEventGetEventFreezeFrameDataEx_GetEventFreezeFrameDataEx_EvtInfo_AutoCreatedDemEvent_WDG_E_MODE_FAILED422: start-on-event=GetEventFreezeFrameDataEx, operation=EvtInfo_AutoCreatedDemEvent_WDG_E_MODE_FAILED422.GetEventFreezeFrameDataEx
        OpEventGetEventFreezeFrameDataEx_GetEventFreezeFrameDataEx_EvtInfo_AutoCreatedDemEvent_WDG_E_UNLOCKED422: start-on-event=GetEventFreezeFrameDataEx, operation=EvtInfo_AutoCreatedDemEvent_WDG_E_UNLOCKED422.GetEventFreezeFrameDataEx
        OpEventGetEventExtendedDataRecord_GetEventExtendedDataRecord_EvtInfo_AutoCreatedDemEvent_ADC_E_TIMEOUT422: start-on-event=GetEventExtendedDataRecord, operation=EvtInfo_AutoCreatedDemEvent_ADC_E_TIMEOUT422.GetEventExtendedDataRecord
        OpEventGetEventExtendedDataRecord_GetEventExtendedDataRecord_EvtInfo_AutoCreatedDemEvent_CC_DisableDM_CIOM_oBackbone1J1_b9835931: start-on-event=GetEventExtendedDataRecord, operation=EvtInfo_AutoCreatedDemEvent_CC_DisableDM_CIOM_oBackbone1J1939_Rx_BC_405bc776_BswMReportFailToDemRef422.GetEventExtendedDataRecord
        OpEventGetEventExtendedDataRecord_GetEventExtendedDataRecord_EvtInfo_AutoCreatedDemEvent_CC_DisableDM_CIOM_oBackbone2_R_0822c9cc: start-on-event=GetEventExtendedDataRecord, operation=EvtInfo_AutoCreatedDemEvent_CC_DisableDM_CIOM_oBackbone2_Rx_4e624434_BswMReportFailToDemRef422.GetEventExtendedDataRecord
        OpEventGetEventExtendedDataRecord_GetEventExtendedDataRecord_EvtInfo_AutoCreatedDemEvent_CC_DisableDM_CIOM_oCabSubnet_R_75608246: start-on-event=GetEventExtendedDataRecord, operation=EvtInfo_AutoCreatedDemEvent_CC_DisableDM_CIOM_oCabSubnet_Rx_063a5fbc_BswMReportFailToDemRef422.GetEventExtendedDataRecord
        OpEventGetEventExtendedDataRecord_GetEventExtendedDataRecord_EvtInfo_AutoCreatedDemEvent_CC_DisableDM_CIOM_oFMSNet_Rx_B_6a7043c0: start-on-event=GetEventExtendedDataRecord, operation=EvtInfo_AutoCreatedDemEvent_CC_DisableDM_CIOM_oFMSNet_Rx_BC_dd2c1510_BswMReportFailToDemRef422.GetEventExtendedDataRecord
        OpEventGetEventExtendedDataRecord_GetEventExtendedDataRecord_EvtInfo_AutoCreatedDemEvent_CC_DisableDM_CIOM_oSecuritySub_604ecdd3: start-on-event=GetEventExtendedDataRecord, operation=EvtInfo_AutoCreatedDemEvent_CC_DisableDM_CIOM_oSecuritySubnet_Rx_3a3c1dbc_BswMReportFailToDemRef422.GetEventExtendedDataRecord
        OpEventGetEventExtendedDataRecord_GetEventExtendedDataRecord_EvtInfo_AutoCreatedDemEvent_CC_DisablePDUGroup_CIOM_oBackb_458f3c33: start-on-event=GetEventExtendedDataRecord, operation=EvtInfo_AutoCreatedDemEvent_CC_DisablePDUGroup_CIOM_oBackbone1J1939_Rx_BC_405bc776_BswMReportFailToDemRef422.GetEventExtendedDataRecord
        OpEventGetEventExtendedDataRecord_GetEventExtendedDataRecord_EvtInfo_AutoCreatedDemEvent_CC_DisablePDUGroup_CIOM_oBackb_f0b07d21: start-on-event=GetEventExtendedDataRecord, operation=EvtInfo_AutoCreatedDemEvent_CC_DisablePDUGroup_CIOM_oBackbone1J1939_Tx_0x31_BC_3782f500_BswMReportFailToDemRef422.GetEventExtendedDataRecord
        OpEventGetEventExtendedDataRecord_GetEventExtendedDataRecord_EvtInfo_AutoCreatedDemEvent_CC_DisablePDUGroup_CIOM_oBackb_96347af4: start-on-event=GetEventExtendedDataRecord, operation=EvtInfo_AutoCreatedDemEvent_CC_DisablePDUGroup_CIOM_oBackbone2_Rx_4e624434_BswMReportFailToDemRef422.GetEventExtendedDataRecord
        OpEventGetEventExtendedDataRecord_GetEventExtendedDataRecord_EvtInfo_AutoCreatedDemEvent_CC_DisablePDUGroup_CIOM_oBackb_9ae2dcda: start-on-event=GetEventExtendedDataRecord, operation=EvtInfo_AutoCreatedDemEvent_CC_DisablePDUGroup_CIOM_oBackbone2_Tx_1838e3b2_BswMReportFailToDemRef422.GetEventExtendedDataRecord
        OpEventGetEventExtendedDataRecord_GetEventExtendedDataRecord_EvtInfo_AutoCreatedDemEvent_CC_DisablePDUGroup_CIOM_oCabSu_eb76317e: start-on-event=GetEventExtendedDataRecord, operation=EvtInfo_AutoCreatedDemEvent_CC_DisablePDUGroup_CIOM_oCabSubnet_Rx_063a5fbc_BswMReportFailToDemRef422.GetEventExtendedDataRecord
        OpEventGetEventExtendedDataRecord_GetEventExtendedDataRecord_EvtInfo_AutoCreatedDemEvent_CC_DisablePDUGroup_CIOM_oCabSu_79046e4c: start-on-event=GetEventExtendedDataRecord, operation=EvtInfo_AutoCreatedDemEvent_CC_DisablePDUGroup_CIOM_oCabSubnet_Tx_5060f83a_BswMReportFailToDemRef422.GetEventExtendedDataRecord
        OpEventGetEventExtendedDataRecord_GetEventExtendedDataRecord_EvtInfo_AutoCreatedDemEvent_CC_DisablePDUGroup_CIOM_oFMSNe_f466f0f8: start-on-event=GetEventExtendedDataRecord, operation=EvtInfo_AutoCreatedDemEvent_CC_DisablePDUGroup_CIOM_oFMSNet_Rx_BC_dd2c1510_BswMReportFailToDemRef422.GetEventExtendedDataRecord
        OpEventGetEventExtendedDataRecord_GetEventExtendedDataRecord_EvtInfo_AutoCreatedDemEvent_CC_DisablePDUGroup_CIOM_oFMSNe_b97cf61a: start-on-event=GetEventExtendedDataRecord, operation=EvtInfo_AutoCreatedDemEvent_CC_DisablePDUGroup_CIOM_oFMSNet_Tx_0x31_BC_38fc8c7d_BswMReportFailToDemRef422.GetEventExtendedDataRecord
        OpEventGetEventExtendedDataRecord_GetEventExtendedDataRecord_EvtInfo_AutoCreatedDemEvent_CC_DisablePDUGroup_CIOM_oLIN00_420dd740: start-on-event=GetEventExtendedDataRecord, operation=EvtInfo_AutoCreatedDemEvent_CC_DisablePDUGroup_CIOM_oLIN00_Rx_dd181faa_BswMReportFailToDemRef422.GetEventExtendedDataRecord
        OpEventGetEventExtendedDataRecord_GetEventExtendedDataRecord_EvtInfo_AutoCreatedDemEvent_CC_DisablePDUGroup_CIOM_oLIN00_3eea1989: start-on-event=GetEventExtendedDataRecord, operation=EvtInfo_AutoCreatedDemEvent_CC_DisablePDUGroup_CIOM_oLIN00_Tx_8b42b82c_BswMReportFailToDemRef422.GetEventExtendedDataRecord
        OpEventGetEventExtendedDataRecord_GetEventExtendedDataRecord_EvtInfo_AutoCreatedDemEvent_CC_DisablePDUGroup_CIOM_oLIN01_7bbdf045: start-on-event=GetEventExtendedDataRecord, operation=EvtInfo_AutoCreatedDemEvent_CC_DisablePDUGroup_CIOM_oLIN01_Rx_65a478cf_BswMReportFailToDemRef422.GetEventExtendedDataRecord
        OpEventGetEventExtendedDataRecord_GetEventExtendedDataRecord_EvtInfo_AutoCreatedDemEvent_CC_DisablePDUGroup_CIOM_oLIN01_e52e0ae2: start-on-event=GetEventExtendedDataRecord, operation=EvtInfo_AutoCreatedDemEvent_CC_DisablePDUGroup_CIOM_oLIN01_Tx_33fedf49_BswMReportFailToDemRef422.GetEventExtendedDataRecord
        OpEventGetEventExtendedDataRecord_GetEventExtendedDataRecord_EvtInfo_AutoCreatedDemEvent_CC_DisablePDUGroup_CIOM_oLIN02_95a40cb1: start-on-event=GetEventExtendedDataRecord, operation=EvtInfo_AutoCreatedDemEvent_CC_DisablePDUGroup_CIOM_oLIN02_Rx_7711d721_BswMReportFailToDemRef422.GetEventExtendedDataRecord
        OpEventGetEventExtendedDataRecord_GetEventExtendedDataRecord_EvtInfo_AutoCreatedDemEvent_CC_DisablePDUGroup_CIOM_oLIN02_4591bc0a: start-on-event=GetEventExtendedDataRecord, operation=EvtInfo_AutoCreatedDemEvent_CC_DisablePDUGroup_CIOM_oLIN02_Tx_214b70a7_BswMReportFailToDemRef422.GetEventExtendedDataRecord
        OpEventGetEventExtendedDataRecord_GetEventExtendedDataRecord_EvtInfo_AutoCreatedDemEvent_CC_DisablePDUGroup_CIOM_oLIN03_09cabb29: start-on-event=GetEventExtendedDataRecord, operation=EvtInfo_AutoCreatedDemEvent_CC_DisablePDUGroup_CIOM_oLIN03_Rx_cfadb044_BswMReportFailToDemRef422.GetEventExtendedDataRecord
        OpEventGetEventExtendedDataRecord_GetEventExtendedDataRecord_EvtInfo_AutoCreatedDemEvent_CC_DisablePDUGroup_CIOM_oLIN03_067da57d: start-on-event=GetEventExtendedDataRecord, operation=EvtInfo_AutoCreatedDemEvent_CC_DisablePDUGroup_CIOM_oLIN03_Tx_99f717c2_BswMReportFailToDemRef422.GetEventExtendedDataRecord
        OpEventGetEventExtendedDataRecord_GetEventExtendedDataRecord_EvtInfo_AutoCreatedDemEvent_CC_DisablePDUGroup_CIOM_oLIN04_9b79666d: start-on-event=GetEventExtendedDataRecord, operation=EvtInfo_AutoCreatedDemEvent_CC_DisablePDUGroup_CIOM_oLIN04_Rx_527a88fd_BswMReportFailToDemRef422.GetEventExtendedDataRecord
        OpEventGetEventExtendedDataRecord_GetEventExtendedDataRecord_EvtInfo_AutoCreatedDemEvent_CC_DisablePDUGroup_CIOM_oLIN04_04716558: start-on-event=GetEventExtendedDataRecord, operation=EvtInfo_AutoCreatedDemEvent_CC_DisablePDUGroup_CIOM_oLIN04_Tx_04202f7b_BswMReportFailToDemRef422.GetEventExtendedDataRecord
        OpEventGetEventExtendedDataRecord_GetEventExtendedDataRecord_EvtInfo_AutoCreatedDemEvent_CC_DisablePDUGroup_CIOM_oSecur_09b1a7b6: start-on-event=GetEventExtendedDataRecord, operation=EvtInfo_AutoCreatedDemEvent_CC_DisablePDUGroup_CIOM_oSecuritySubnet_Rx_3a3c1dbc_BswMReportFailToDemRef422.GetEventExtendedDataRecord
        OpEventGetEventExtendedDataRecord_GetEventExtendedDataRecord_EvtInfo_AutoCreatedDemEvent_CC_DisablePDUGroup_CIOM_oSecur_803b0510: start-on-event=GetEventExtendedDataRecord, operation=EvtInfo_AutoCreatedDemEvent_CC_DisablePDUGroup_CIOM_oSecuritySubnet_Tx_6c66ba3a_BswMReportFailToDemRef422.GetEventExtendedDataRecord
        OpEventGetEventExtendedDataRecord_GetEventExtendedDataRecord_EvtInfo_AutoCreatedDemEvent_CC_EnableDM_CIOM_oBackbone1J19_cf567d16: start-on-event=GetEventExtendedDataRecord, operation=EvtInfo_AutoCreatedDemEvent_CC_EnableDM_CIOM_oBackbone1J1939_Rx_BC_405bc776_BswMReportFailToDemRef422.GetEventExtendedDataRecord
        OpEventGetEventExtendedDataRecord_GetEventExtendedDataRecord_EvtInfo_AutoCreatedDemEvent_CC_EnableDM_CIOM_oBackbone2_Rx_f96429c3: start-on-event=GetEventExtendedDataRecord, operation=EvtInfo_AutoCreatedDemEvent_CC_EnableDM_CIOM_oBackbone2_Rx_4e624434_BswMReportFailToDemRef422.GetEventExtendedDataRecord
        OpEventGetEventExtendedDataRecord_GetEventExtendedDataRecord_EvtInfo_AutoCreatedDemEvent_CC_EnableDM_CIOM_oCabSubnet_Rx_84266249: start-on-event=GetEventExtendedDataRecord, operation=EvtInfo_AutoCreatedDemEvent_CC_EnableDM_CIOM_oCabSubnet_Rx_063a5fbc_BswMReportFailToDemRef422.GetEventExtendedDataRecord
        OpEventGetEventExtendedDataRecord_GetEventExtendedDataRecord_EvtInfo_AutoCreatedDemEvent_CC_EnableDM_CIOM_oFMSNet_Rx_BC_9b36a3cf: start-on-event=GetEventExtendedDataRecord, operation=EvtInfo_AutoCreatedDemEvent_CC_EnableDM_CIOM_oFMSNet_Rx_BC_dd2c1510_BswMReportFailToDemRef422.GetEventExtendedDataRecord
        OpEventGetEventExtendedDataRecord_GetEventExtendedDataRecord_EvtInfo_AutoCreatedDemEvent_CC_EnableDM_CIOM_oSecuritySubn_4dd13ab4: start-on-event=GetEventExtendedDataRecord, operation=EvtInfo_AutoCreatedDemEvent_CC_EnableDM_CIOM_oSecuritySubnet_Rx_3a3c1dbc_BswMReportFailToDemRef422.GetEventExtendedDataRecord
        OpEventGetEventExtendedDataRecord_GetEventExtendedDataRecord_EvtInfo_AutoCreatedDemEvent_CC_EnablePDUGroup_CIOM_oBackbo_2a91dd30: start-on-event=GetEventExtendedDataRecord, operation=EvtInfo_AutoCreatedDemEvent_CC_EnablePDUGroup_CIOM_oBackbone1J1939_Rx_BC_405bc776_BswMReportFailToDemRef422.GetEventExtendedDataRecord
        OpEventGetEventExtendedDataRecord_GetEventExtendedDataRecord_EvtInfo_AutoCreatedDemEvent_CC_EnablePDUGroup_CIOM_oBackbo_2d0ed8be: start-on-event=GetEventExtendedDataRecord, operation=EvtInfo_AutoCreatedDemEvent_CC_EnablePDUGroup_CIOM_oBackbone1J1939_Tx_0x31_BC_3782f500_BswMReportFailToDemRef422.GetEventExtendedDataRecord
        OpEventGetEventExtendedDataRecord_GetEventExtendedDataRecord_EvtInfo_AutoCreatedDemEvent_CC_EnablePDUGroup_CIOM_oBackbo_45cf11f8: start-on-event=GetEventExtendedDataRecord, operation=EvtInfo_AutoCreatedDemEvent_CC_EnablePDUGroup_CIOM_oBackbone2_Rx_4e624434_BswMReportFailToDemRef422.GetEventExtendedDataRecord
        OpEventGetEventExtendedDataRecord_GetEventExtendedDataRecord_EvtInfo_AutoCreatedDemEvent_CC_EnablePDUGroup_CIOM_oBackbo_4919b7d6: start-on-event=GetEventExtendedDataRecord, operation=EvtInfo_AutoCreatedDemEvent_CC_EnablePDUGroup_CIOM_oBackbone2_Tx_1838e3b2_BswMReportFailToDemRef422.GetEventExtendedDataRecord
        OpEventGetEventExtendedDataRecord_GetEventExtendedDataRecord_EvtInfo_AutoCreatedDemEvent_CC_EnablePDUGroup_CIOM_oCabSub_388d5a72: start-on-event=GetEventExtendedDataRecord, operation=EvtInfo_AutoCreatedDemEvent_CC_EnablePDUGroup_CIOM_oCabSubnet_Rx_063a5fbc_BswMReportFailToDemRef422.GetEventExtendedDataRecord
        OpEventGetEventExtendedDataRecord_GetEventExtendedDataRecord_EvtInfo_AutoCreatedDemEvent_CC_EnablePDUGroup_CIOM_oCabSub_aaff0540: start-on-event=GetEventExtendedDataRecord, operation=EvtInfo_AutoCreatedDemEvent_CC_EnablePDUGroup_CIOM_oCabSubnet_Tx_5060f83a_BswMReportFailToDemRef422.GetEventExtendedDataRecord
        OpEventGetEventExtendedDataRecord_GetEventExtendedDataRecord_EvtInfo_AutoCreatedDemEvent_CC_EnablePDUGroup_CIOM_oFMSNet_279d9bf4: start-on-event=GetEventExtendedDataRecord, operation=EvtInfo_AutoCreatedDemEvent_CC_EnablePDUGroup_CIOM_oFMSNet_Rx_BC_dd2c1510_BswMReportFailToDemRef422.GetEventExtendedDataRecord
        OpEventGetEventExtendedDataRecord_GetEventExtendedDataRecord_EvtInfo_AutoCreatedDemEvent_CC_EnablePDUGroup_CIOM_oFMSNet_832f61f4: start-on-event=GetEventExtendedDataRecord, operation=EvtInfo_AutoCreatedDemEvent_CC_EnablePDUGroup_CIOM_oFMSNet_Tx_0x31_BC_38fc8c7d_BswMReportFailToDemRef422.GetEventExtendedDataRecord
        OpEventGetEventExtendedDataRecord_GetEventExtendedDataRecord_EvtInfo_AutoCreatedDemEvent_CC_EnablePDUGroup_CIOM_oLIN00_659fd8b1: start-on-event=GetEventExtendedDataRecord, operation=EvtInfo_AutoCreatedDemEvent_CC_EnablePDUGroup_CIOM_oLIN00_Rx_dd181faa_BswMReportFailToDemRef422.GetEventExtendedDataRecord
        OpEventGetEventExtendedDataRecord_GetEventExtendedDataRecord_EvtInfo_AutoCreatedDemEvent_CC_EnablePDUGroup_CIOM_oLIN00_19781678: start-on-event=GetEventExtendedDataRecord, operation=EvtInfo_AutoCreatedDemEvent_CC_EnablePDUGroup_CIOM_oLIN00_Tx_8b42b82c_BswMReportFailToDemRef422.GetEventExtendedDataRecord
        OpEventGetEventExtendedDataRecord_GetEventExtendedDataRecord_EvtInfo_AutoCreatedDemEvent_CC_EnablePDUGroup_CIOM_oLIN01_5c2fffb4: start-on-event=GetEventExtendedDataRecord, operation=EvtInfo_AutoCreatedDemEvent_CC_EnablePDUGroup_CIOM_oLIN01_Rx_65a478cf_BswMReportFailToDemRef422.GetEventExtendedDataRecord
        OpEventGetEventExtendedDataRecord_GetEventExtendedDataRecord_EvtInfo_AutoCreatedDemEvent_CC_EnablePDUGroup_CIOM_oLIN01_c2bc0513: start-on-event=GetEventExtendedDataRecord, operation=EvtInfo_AutoCreatedDemEvent_CC_EnablePDUGroup_CIOM_oLIN01_Tx_33fedf49_BswMReportFailToDemRef422.GetEventExtendedDataRecord
        OpEventGetEventExtendedDataRecord_GetEventExtendedDataRecord_EvtInfo_AutoCreatedDemEvent_CC_EnablePDUGroup_CIOM_oLIN02_b2360340: start-on-event=GetEventExtendedDataRecord, operation=EvtInfo_AutoCreatedDemEvent_CC_EnablePDUGroup_CIOM_oLIN02_Rx_7711d721_BswMReportFailToDemRef422.GetEventExtendedDataRecord
        OpEventGetEventExtendedDataRecord_GetEventExtendedDataRecord_EvtInfo_AutoCreatedDemEvent_CC_EnablePDUGroup_CIOM_oLIN02_6203b3fb: start-on-event=GetEventExtendedDataRecord, operation=EvtInfo_AutoCreatedDemEvent_CC_EnablePDUGroup_CIOM_oLIN02_Tx_214b70a7_BswMReportFailToDemRef422.GetEventExtendedDataRecord
        OpEventGetEventExtendedDataRecord_GetEventExtendedDataRecord_EvtInfo_AutoCreatedDemEvent_CC_EnablePDUGroup_CIOM_oLIN03_2e58b4d8: start-on-event=GetEventExtendedDataRecord, operation=EvtInfo_AutoCreatedDemEvent_CC_EnablePDUGroup_CIOM_oLIN03_Rx_cfadb044_BswMReportFailToDemRef422.GetEventExtendedDataRecord
        OpEventGetEventExtendedDataRecord_GetEventExtendedDataRecord_EvtInfo_AutoCreatedDemEvent_CC_EnablePDUGroup_CIOM_oLIN03_21efaa8c: start-on-event=GetEventExtendedDataRecord, operation=EvtInfo_AutoCreatedDemEvent_CC_EnablePDUGroup_CIOM_oLIN03_Tx_99f717c2_BswMReportFailToDemRef422.GetEventExtendedDataRecord
        OpEventGetEventExtendedDataRecord_GetEventExtendedDataRecord_EvtInfo_AutoCreatedDemEvent_CC_EnablePDUGroup_CIOM_oLIN04_bceb699c: start-on-event=GetEventExtendedDataRecord, operation=EvtInfo_AutoCreatedDemEvent_CC_EnablePDUGroup_CIOM_oLIN04_Rx_527a88fd_BswMReportFailToDemRef422.GetEventExtendedDataRecord
        OpEventGetEventExtendedDataRecord_GetEventExtendedDataRecord_EvtInfo_AutoCreatedDemEvent_CC_EnablePDUGroup_CIOM_oLIN04_23e36aa9: start-on-event=GetEventExtendedDataRecord, operation=EvtInfo_AutoCreatedDemEvent_CC_EnablePDUGroup_CIOM_oLIN04_Tx_04202f7b_BswMReportFailToDemRef422.GetEventExtendedDataRecord
        OpEventGetEventExtendedDataRecord_GetEventExtendedDataRecord_EvtInfo_AutoCreatedDemEvent_CC_EnablePDUGroup_CIOM_oSecuri_33e23058: start-on-event=GetEventExtendedDataRecord, operation=EvtInfo_AutoCreatedDemEvent_CC_EnablePDUGroup_CIOM_oSecuritySubnet_Rx_3a3c1dbc_BswMReportFailToDemRef422.GetEventExtendedDataRecord
        OpEventGetEventExtendedDataRecord_GetEventExtendedDataRecord_EvtInfo_AutoCreatedDemEvent_CC_EnablePDUGroup_CIOM_oSecuri_ba6892fe: start-on-event=GetEventExtendedDataRecord, operation=EvtInfo_AutoCreatedDemEvent_CC_EnablePDUGroup_CIOM_oSecuritySubnet_Tx_6c66ba3a_BswMReportFailToDemRef422.GetEventExtendedDataRecord
        OpEventGetEventExtendedDataRecord_GetEventExtendedDataRecord_EvtInfo_AutoCreatedDemEvent_CC_J1939RmStateSwitch_CN_Backb_99e1ec4b: start-on-event=GetEventExtendedDataRecord, operation=EvtInfo_AutoCreatedDemEvent_CC_J1939RmStateSwitch_CN_Backbone1J1939_0b1f4bae_CIOM_4d5cd289_J1939RM_STATE_OFFLINE_BswMRe_f9c55035.GetEventExtendedDataRecord
        OpEventGetEventExtendedDataRecord_GetEventExtendedDataRecord_EvtInfo_AutoCreatedDemEvent_CC_J1939RmStateSwitch_CN_Backb_dfbd6941: start-on-event=GetEventExtendedDataRecord, operation=EvtInfo_AutoCreatedDemEvent_CC_J1939RmStateSwitch_CN_Backbone1J1939_0b1f4bae_CIOM_4d5cd289_J1939RM_STATE_ONLINE_BswMRep_5375d7eb.GetEventExtendedDataRecord
        OpEventGetEventExtendedDataRecord_GetEventExtendedDataRecord_EvtInfo_AutoCreatedDemEvent_CC_J1939RmStateSwitch_CN_FMSNe_c1c0cca5: start-on-event=GetEventExtendedDataRecord, operation=EvtInfo_AutoCreatedDemEvent_CC_J1939RmStateSwitch_CN_FMSNet_fce1aae5_CIOM_3a3d59b1_J1939RM_STATE_OFFLINE_BswMReportFail_5f9bde08.GetEventExtendedDataRecord
        OpEventGetEventExtendedDataRecord_GetEventExtendedDataRecord_EvtInfo_AutoCreatedDemEvent_CC_J1939RmStateSwitch_CN_FMSNe_2fd8c02b: start-on-event=GetEventExtendedDataRecord, operation=EvtInfo_AutoCreatedDemEvent_CC_J1939RmStateSwitch_CN_FMSNet_fce1aae5_CIOM_3a3d59b1_J1939RM_STATE_ONLINE_BswMReportFailT_e97c0723.GetEventExtendedDataRecord
        OpEventGetEventExtendedDataRecord_GetEventExtendedDataRecord_EvtInfo_AutoCreatedDemEvent_CHNL_53cce282_CANSM_E_BUS_OFF422: start-on-event=GetEventExtendedDataRecord, operation=EvtInfo_AutoCreatedDemEvent_CHNL_53cce282_CANSM_E_BUS_OFF422.GetEventExtendedDataRecord
        OpEventGetEventExtendedDataRecord_GetEventExtendedDataRecord_EvtInfo_AutoCreatedDemEvent_CHNL_53cce282_CANSM_E_MODE_REQ_3020b977: start-on-event=GetEventExtendedDataRecord, operation=EvtInfo_AutoCreatedDemEvent_CHNL_53cce282_CANSM_E_MODE_REQUEST_TIMEOUT422.GetEventExtendedDataRecord
        OpEventGetEventExtendedDataRecord_GetEventExtendedDataRecord_EvtInfo_AutoCreatedDemEvent_CHNL_17344684_CANSM_E_BUS_OFF422: start-on-event=GetEventExtendedDataRecord, operation=EvtInfo_AutoCreatedDemEvent_CHNL_17344684_CANSM_E_BUS_OFF422.GetEventExtendedDataRecord
        OpEventGetEventExtendedDataRecord_GetEventExtendedDataRecord_EvtInfo_AutoCreatedDemEvent_CHNL_17344684_CANSM_E_MODE_REQ_73f3a533: start-on-event=GetEventExtendedDataRecord, operation=EvtInfo_AutoCreatedDemEvent_CHNL_17344684_CANSM_E_MODE_REQUEST_TIMEOUT422.GetEventExtendedDataRecord
        OpEventGetEventExtendedDataRecord_GetEventExtendedDataRecord_EvtInfo_AutoCreatedDemEvent_CHNL_a6b6a922_CANSM_E_BUS_OFF422: start-on-event=GetEventExtendedDataRecord, operation=EvtInfo_AutoCreatedDemEvent_CHNL_a6b6a922_CANSM_E_BUS_OFF422.GetEventExtendedDataRecord
        OpEventGetEventExtendedDataRecord_GetEventExtendedDataRecord_EvtInfo_AutoCreatedDemEvent_CHNL_a6b6a922_CANSM_E_MODE_REQ_43d2a73c: start-on-event=GetEventExtendedDataRecord, operation=EvtInfo_AutoCreatedDemEvent_CHNL_a6b6a922_CANSM_E_MODE_REQUEST_TIMEOUT422.GetEventExtendedDataRecord
        OpEventGetEventExtendedDataRecord_GetEventExtendedDataRecord_EvtInfo_AutoCreatedDemEvent_CHNL_df893ad5_CANSM_E_BUS_OFF422: start-on-event=GetEventExtendedDataRecord, operation=EvtInfo_AutoCreatedDemEvent_CHNL_df893ad5_CANSM_E_BUS_OFF422.GetEventExtendedDataRecord
        OpEventGetEventExtendedDataRecord_GetEventExtendedDataRecord_EvtInfo_AutoCreatedDemEvent_CHNL_df893ad5_CANSM_E_MODE_REQ_faab43e6: start-on-event=GetEventExtendedDataRecord, operation=EvtInfo_AutoCreatedDemEvent_CHNL_df893ad5_CANSM_E_MODE_REQUEST_TIMEOUT422.GetEventExtendedDataRecord
        OpEventGetEventExtendedDataRecord_GetEventExtendedDataRecord_EvtInfo_AutoCreatedDemEvent_CHNL_e058b4ae_CANSM_E_BUS_OFF422: start-on-event=GetEventExtendedDataRecord, operation=EvtInfo_AutoCreatedDemEvent_CHNL_e058b4ae_CANSM_E_BUS_OFF422.GetEventExtendedDataRecord
        OpEventGetEventExtendedDataRecord_GetEventExtendedDataRecord_EvtInfo_AutoCreatedDemEvent_CHNL_e058b4ae_CANSM_E_MODE_REQ_20532019: start-on-event=GetEventExtendedDataRecord, operation=EvtInfo_AutoCreatedDemEvent_CHNL_e058b4ae_CANSM_E_MODE_REQUEST_TIMEOUT422.GetEventExtendedDataRecord
        OpEventGetEventExtendedDataRecord_GetEventExtendedDataRecord_EvtInfo_AutoCreatedDemEvent_ECUM_E_ALL_RUN_REQUESTS_KILLED422: start-on-event=GetEventExtendedDataRecord, operation=EvtInfo_AutoCreatedDemEvent_ECUM_E_ALL_RUN_REQUESTS_KILLED422.GetEventExtendedDataRecord
        OpEventGetEventExtendedDataRecord_GetEventExtendedDataRecord_EvtInfo_AutoCreatedDemEvent_ECUM_E_CONFIGURATION_DATA_INCO_c734e572: start-on-event=GetEventExtendedDataRecord, operation=EvtInfo_AutoCreatedDemEvent_ECUM_E_CONFIGURATION_DATA_INCONSISTENT422.GetEventExtendedDataRecord
        OpEventGetEventExtendedDataRecord_GetEventExtendedDataRecord_EvtInfo_AutoCreatedDemEvent_ECUM_E_IMPROPER_CALLER422: start-on-event=GetEventExtendedDataRecord, operation=EvtInfo_AutoCreatedDemEvent_ECUM_E_IMPROPER_CALLER422.GetEventExtendedDataRecord
        OpEventGetEventExtendedDataRecord_GetEventExtendedDataRecord_EvtInfo_AutoCreatedDemEvent_ECUM_E_RAM_CHECK_FAILED422: start-on-event=GetEventExtendedDataRecord, operation=EvtInfo_AutoCreatedDemEvent_ECUM_E_RAM_CHECK_FAILED422.GetEventExtendedDataRecord
        OpEventGetEventExtendedDataRecord_GetEventExtendedDataRecord_EvtInfo_AutoCreatedDemEvent_ESH_Action_CancelNvMWriteAll_B_8eb90f24: start-on-event=GetEventExtendedDataRecord, operation=EvtInfo_AutoCreatedDemEvent_ESH_Action_CancelNvMWriteAll_BswMReportFailToDemRef422.GetEventExtendedDataRecord
        OpEventGetEventExtendedDataRecord_GetEventExtendedDataRecord_EvtInfo_AutoCreatedDemEvent_ESH_Action_CancelWriteAllTimer_21796992: start-on-event=GetEventExtendedDataRecord, operation=EvtInfo_AutoCreatedDemEvent_ESH_Action_CancelWriteAllTimer_Start_BswMReportFailToDemRef422.GetEventExtendedDataRecord
        OpEventGetEventExtendedDataRecord_GetEventExtendedDataRecord_EvtInfo_AutoCreatedDemEvent_ESH_Action_CancelWriteAllTimer_dbd89022: start-on-event=GetEventExtendedDataRecord, operation=EvtInfo_AutoCreatedDemEvent_ESH_Action_CancelWriteAllTimer_Stop_BswMReportFailToDemRef422.GetEventExtendedDataRecord
        OpEventGetEventExtendedDataRecord_GetEventExtendedDataRecord_EvtInfo_AutoCreatedDemEvent_ESH_Action_ComMAllow_CN_Backbo_3fed66a1: start-on-event=GetEventExtendedDataRecord, operation=EvtInfo_AutoCreatedDemEvent_ESH_Action_ComMAllow_CN_Backbone1J1939_0b1f4bae_BswMReportFailToDemRef422.GetEventExtendedDataRecord
        OpEventGetEventExtendedDataRecord_GetEventExtendedDataRecord_EvtInfo_AutoCreatedDemEvent_ESH_Action_ComMAllow_CN_Backbo_8f69f426: start-on-event=GetEventExtendedDataRecord, operation=EvtInfo_AutoCreatedDemEvent_ESH_Action_ComMAllow_CN_Backbone1J1939_0b1f4bae_BswMReportFailToDemRef_1422.GetEventExtendedDataRecord
        OpEventGetEventExtendedDataRecord_GetEventExtendedDataRecord_EvtInfo_AutoCreatedDemEvent_ESH_Action_ComMAllow_CN_Backbo_5b1a71e4: start-on-event=GetEventExtendedDataRecord, operation=EvtInfo_AutoCreatedDemEvent_ESH_Action_ComMAllow_CN_Backbone2_78967e2c_BswMReportFailToDemRef422.GetEventExtendedDataRecord
        OpEventGetEventExtendedDataRecord_GetEventExtendedDataRecord_EvtInfo_AutoCreatedDemEvent_ESH_Action_ComMAllow_CN_Backbo_81b4ae56: start-on-event=GetEventExtendedDataRecord, operation=EvtInfo_AutoCreatedDemEvent_ESH_Action_ComMAllow_CN_Backbone2_78967e2c_BswMReportFailToDemRef_1422.GetEventExtendedDataRecord
        OpEventGetEventExtendedDataRecord_GetEventExtendedDataRecord_EvtInfo_AutoCreatedDemEvent_ESH_Action_ComMAllow_CN_CabSub_f7105732: start-on-event=GetEventExtendedDataRecord, operation=EvtInfo_AutoCreatedDemEvent_ESH_Action_ComMAllow_CN_CabSubnet_9ea693f1_BswMReportFailToDemRef422.GetEventExtendedDataRecord
        OpEventGetEventExtendedDataRecord_GetEventExtendedDataRecord_EvtInfo_AutoCreatedDemEvent_ESH_Action_ComMAllow_CN_CabSub_84dbe538: start-on-event=GetEventExtendedDataRecord, operation=EvtInfo_AutoCreatedDemEvent_ESH_Action_ComMAllow_CN_CabSubnet_9ea693f1_BswMReportFailToDemRef_1422.GetEventExtendedDataRecord
        OpEventGetEventExtendedDataRecord_GetEventExtendedDataRecord_EvtInfo_AutoCreatedDemEvent_ESH_Action_ComMAllow_CN_FMSNet_c1b73471: start-on-event=GetEventExtendedDataRecord, operation=EvtInfo_AutoCreatedDemEvent_ESH_Action_ComMAllow_CN_FMSNet_fce1aae5_BswMReportFailToDemRef422.GetEventExtendedDataRecord
        OpEventGetEventExtendedDataRecord_GetEventExtendedDataRecord_EvtInfo_AutoCreatedDemEvent_ESH_Action_ComMAllow_CN_FMSNet_8b34ffbb: start-on-event=GetEventExtendedDataRecord, operation=EvtInfo_AutoCreatedDemEvent_ESH_Action_ComMAllow_CN_FMSNet_fce1aae5_BswMReportFailToDemRef_1422.GetEventExtendedDataRecord
        OpEventGetEventExtendedDataRecord_GetEventExtendedDataRecord_EvtInfo_AutoCreatedDemEvent_ESH_Action_ComMAllow_CN_LIN00_1125131e: start-on-event=GetEventExtendedDataRecord, operation=EvtInfo_AutoCreatedDemEvent_ESH_Action_ComMAllow_CN_LIN00_2cd9a7df_BswMReportFailToDemRef422.GetEventExtendedDataRecord
        OpEventGetEventExtendedDataRecord_GetEventExtendedDataRecord_EvtInfo_AutoCreatedDemEvent_ESH_Action_ComMAllow_CN_LIN00_cc5bed2a: start-on-event=GetEventExtendedDataRecord, operation=EvtInfo_AutoCreatedDemEvent_ESH_Action_ComMAllow_CN_LIN00_2cd9a7df_BswMReportFailToDemRef_1422.GetEventExtendedDataRecord
        OpEventGetEventExtendedDataRecord_GetEventExtendedDataRecord_EvtInfo_AutoCreatedDemEvent_ESH_Action_ComMAllow_CN_LIN01_2a156272: start-on-event=GetEventExtendedDataRecord, operation=EvtInfo_AutoCreatedDemEvent_ESH_Action_ComMAllow_CN_LIN01_5bde9749_BswMReportFailToDemRef422.GetEventExtendedDataRecord
        OpEventGetEventExtendedDataRecord_GetEventExtendedDataRecord_EvtInfo_AutoCreatedDemEvent_ESH_Action_ComMAllow_CN_LIN01_2211b31b: start-on-event=GetEventExtendedDataRecord, operation=EvtInfo_AutoCreatedDemEvent_ESH_Action_ComMAllow_CN_LIN01_5bde9749_BswMReportFailToDemRef_1422.GetEventExtendedDataRecord
        OpEventGetEventExtendedDataRecord_GetEventExtendedDataRecord_EvtInfo_AutoCreatedDemEvent_ESH_Action_ComMAllow_CN_LIN02_f376a243: start-on-event=GetEventExtendedDataRecord, operation=EvtInfo_AutoCreatedDemEvent_ESH_Action_ComMAllow_CN_LIN02_c2d7c6f3_BswMReportFailToDemRef422.GetEventExtendedDataRecord
        OpEventGetEventExtendedDataRecord_GetEventExtendedDataRecord_EvtInfo_AutoCreatedDemEvent_ESH_Action_ComMAllow_CN_LIN02_7f28af7a: start-on-event=GetEventExtendedDataRecord, operation=EvtInfo_AutoCreatedDemEvent_ESH_Action_ComMAllow_CN_LIN02_c2d7c6f3_BswMReportFailToDemRef_1422.GetEventExtendedDataRecord
        OpEventGetEventExtendedDataRecord_GetEventExtendedDataRecord_EvtInfo_AutoCreatedDemEvent_ESH_Action_ComMAllow_CN_LIN03_ed74eb71: start-on-event=GetEventExtendedDataRecord, operation=EvtInfo_AutoCreatedDemEvent_ESH_Action_ComMAllow_CN_LIN03_b5d0f665_BswMReportFailToDemRef422.GetEventExtendedDataRecord
        OpEventGetEventExtendedDataRecord_GetEventExtendedDataRecord_EvtInfo_AutoCreatedDemEvent_ESH_Action_ComMAllow_CN_LIN03_9d581c3d: start-on-event=GetEventExtendedDataRecord, operation=EvtInfo_AutoCreatedDemEvent_ESH_Action_ComMAllow_CN_LIN03_b5d0f665_BswMReportFailToDemRef_1422.GetEventExtendedDataRecord
        OpEventGetEventExtendedDataRecord_GetEventExtendedDataRecord_EvtInfo_AutoCreatedDemEvent_ESH_Action_ComMAllow_CN_LIN04_663033e9: start-on-event=GetEventExtendedDataRecord, operation=EvtInfo_AutoCreatedDemEvent_ESH_Action_ComMAllow_CN_LIN04_2bb463c6_BswMReportFailToDemRef422.GetEventExtendedDataRecord
        OpEventGetEventExtendedDataRecord_GetEventExtendedDataRecord_EvtInfo_AutoCreatedDemEvent_ESH_Action_ComMAllow_CN_LIN04_acc8cd8d: start-on-event=GetEventExtendedDataRecord, operation=EvtInfo_AutoCreatedDemEvent_ESH_Action_ComMAllow_CN_LIN04_2bb463c6_BswMReportFailToDemRef_1422.GetEventExtendedDataRecord
        OpEventGetEventExtendedDataRecord_GetEventExtendedDataRecord_EvtInfo_AutoCreatedDemEvent_ESH_Action_ComMAllow_CN_Securi_853a4fc9: start-on-event=GetEventExtendedDataRecord, operation=EvtInfo_AutoCreatedDemEvent_ESH_Action_ComMAllow_CN_SecuritySubnet_e7a0ee54_BswMReportFailToDemRef422.GetEventExtendedDataRecord
        OpEventGetEventExtendedDataRecord_GetEventExtendedDataRecord_EvtInfo_AutoCreatedDemEvent_ESH_Action_ComMAllow_CN_Securi_60ff3732: start-on-event=GetEventExtendedDataRecord, operation=EvtInfo_AutoCreatedDemEvent_ESH_Action_ComMAllow_CN_SecuritySubnet_e7a0ee54_BswMReportFailToDemRef_1422.GetEventExtendedDataRecord
        OpEventGetEventExtendedDataRecord_GetEventExtendedDataRecord_EvtInfo_AutoCreatedDemEvent_ESH_Action_ComMCheckPendingReq_9f0f9434: start-on-event=GetEventExtendedDataRecord, operation=EvtInfo_AutoCreatedDemEvent_ESH_Action_ComMCheckPendingRequests_BswMReportFailToDemRef422.GetEventExtendedDataRecord
        OpEventGetEventExtendedDataRecord_GetEventExtendedDataRecord_EvtInfo_AutoCreatedDemEvent_ESH_Action_ComMCheckPendingReq_d0ecb9ab: start-on-event=GetEventExtendedDataRecord, operation=EvtInfo_AutoCreatedDemEvent_ESH_Action_ComMCheckPendingRequests_BswMReportFailToDemRef_1422.GetEventExtendedDataRecord
        OpEventGetEventExtendedDataRecord_GetEventExtendedDataRecord_EvtInfo_AutoCreatedDemEvent_ESH_Action_ComMCheckPendingReq_c2591645: start-on-event=GetEventExtendedDataRecord, operation=EvtInfo_AutoCreatedDemEvent_ESH_Action_ComMCheckPendingRequests_BswMReportFailToDemRef_2422.GetEventExtendedDataRecord
        OpEventGetEventExtendedDataRecord_GetEventExtendedDataRecord_EvtInfo_AutoCreatedDemEvent_ESH_Action_ComMDisallow_CN_Bac_78bfc95a: start-on-event=GetEventExtendedDataRecord, operation=EvtInfo_AutoCreatedDemEvent_ESH_Action_ComMDisallow_CN_Backbone1J1939_0b1f4bae_BswMReportFailToDemRef422.GetEventExtendedDataRecord
        OpEventGetEventExtendedDataRecord_GetEventExtendedDataRecord_EvtInfo_AutoCreatedDemEvent_ESH_Action_ComMDisallow_CN_Bac_9a4f40b2: start-on-event=GetEventExtendedDataRecord, operation=EvtInfo_AutoCreatedDemEvent_ESH_Action_ComMDisallow_CN_Backbone2_78967e2c_BswMReportFailToDemRef422.GetEventExtendedDataRecord
        OpEventGetEventExtendedDataRecord_GetEventExtendedDataRecord_EvtInfo_AutoCreatedDemEvent_ESH_Action_ComMDisallow_CN_Cab_36456664: start-on-event=GetEventExtendedDataRecord, operation=EvtInfo_AutoCreatedDemEvent_ESH_Action_ComMDisallow_CN_CabSubnet_9ea693f1_BswMReportFailToDemRef422.GetEventExtendedDataRecord
        OpEventGetEventExtendedDataRecord_GetEventExtendedDataRecord_EvtInfo_AutoCreatedDemEvent_ESH_Action_ComMDisallow_CN_FMS_57ed3158: start-on-event=GetEventExtendedDataRecord, operation=EvtInfo_AutoCreatedDemEvent_ESH_Action_ComMDisallow_CN_FMSNet_fce1aae5_BswMReportFailToDemRef422.GetEventExtendedDataRecord
        OpEventGetEventExtendedDataRecord_GetEventExtendedDataRecord_EvtInfo_AutoCreatedDemEvent_ESH_Action_ComMDisallow_CN_LIN_4288b454: start-on-event=GetEventExtendedDataRecord, operation=EvtInfo_AutoCreatedDemEvent_ESH_Action_ComMDisallow_CN_LIN00_2cd9a7df_BswMReportFailToDemRef422.GetEventExtendedDataRecord
        OpEventGetEventExtendedDataRecord_GetEventExtendedDataRecord_EvtInfo_AutoCreatedDemEvent_ESH_Action_ComMDisallow_CN_LIN_79b8c538: start-on-event=GetEventExtendedDataRecord, operation=EvtInfo_AutoCreatedDemEvent_ESH_Action_ComMDisallow_CN_LIN01_5bde9749_BswMReportFailToDemRef422.GetEventExtendedDataRecord
        OpEventGetEventExtendedDataRecord_GetEventExtendedDataRecord_EvtInfo_AutoCreatedDemEvent_ESH_Action_ComMDisallow_CN_LIN_a0db0509: start-on-event=GetEventExtendedDataRecord, operation=EvtInfo_AutoCreatedDemEvent_ESH_Action_ComMDisallow_CN_LIN02_c2d7c6f3_BswMReportFailToDemRef422.GetEventExtendedDataRecord
        OpEventGetEventExtendedDataRecord_GetEventExtendedDataRecord_EvtInfo_AutoCreatedDemEvent_ESH_Action_ComMDisallow_CN_LIN_bed94c3b: start-on-event=GetEventExtendedDataRecord, operation=EvtInfo_AutoCreatedDemEvent_ESH_Action_ComMDisallow_CN_LIN03_b5d0f665_BswMReportFailToDemRef422.GetEventExtendedDataRecord
        OpEventGetEventExtendedDataRecord_GetEventExtendedDataRecord_EvtInfo_AutoCreatedDemEvent_ESH_Action_ComMDisallow_CN_LIN_359d94a3: start-on-event=GetEventExtendedDataRecord, operation=EvtInfo_AutoCreatedDemEvent_ESH_Action_ComMDisallow_CN_LIN04_2bb463c6_BswMReportFailToDemRef422.GetEventExtendedDataRecord
        OpEventGetEventExtendedDataRecord_GetEventExtendedDataRecord_EvtInfo_AutoCreatedDemEvent_ESH_Action_ComMDisallow_CN_Sec_c268e032: start-on-event=GetEventExtendedDataRecord, operation=EvtInfo_AutoCreatedDemEvent_ESH_Action_ComMDisallow_CN_SecuritySubnet_e7a0ee54_BswMReportFailToDemRef422.GetEventExtendedDataRecord
        OpEventGetEventExtendedDataRecord_GetEventExtendedDataRecord_EvtInfo_AutoCreatedDemEvent_ESH_Action_DemInit_BswMReportF_4d7b9916: start-on-event=GetEventExtendedDataRecord, operation=EvtInfo_AutoCreatedDemEvent_ESH_Action_DemInit_BswMReportFailToDemRef422.GetEventExtendedDataRecord
        OpEventGetEventExtendedDataRecord_GetEventExtendedDataRecord_EvtInfo_AutoCreatedDemEvent_ESH_Action_DemInitialized_BswM_aec06d25: start-on-event=GetEventExtendedDataRecord, operation=EvtInfo_AutoCreatedDemEvent_ESH_Action_DemInitialized_BswMReportFailToDemRef422.GetEventExtendedDataRecord
        OpEventGetEventExtendedDataRecord_GetEventExtendedDataRecord_EvtInfo_AutoCreatedDemEvent_ESH_Action_DemNotInitialized_B_67367c4c: start-on-event=GetEventExtendedDataRecord, operation=EvtInfo_AutoCreatedDemEvent_ESH_Action_DemNotInitialized_BswMReportFailToDemRef422.GetEventExtendedDataRecord
        OpEventGetEventExtendedDataRecord_GetEventExtendedDataRecord_EvtInfo_AutoCreatedDemEvent_ESH_Action_DemShutdown_BswMRep_464793fb: start-on-event=GetEventExtendedDataRecord, operation=EvtInfo_AutoCreatedDemEvent_ESH_Action_DemShutdown_BswMReportFailToDemRef422.GetEventExtendedDataRecord
        OpEventGetEventExtendedDataRecord_GetEventExtendedDataRecord_EvtInfo_AutoCreatedDemEvent_ESH_Action_ESH_PostRun_BswMRep_c8b3b398: start-on-event=GetEventExtendedDataRecord, operation=EvtInfo_AutoCreatedDemEvent_ESH_Action_ESH_PostRun_BswMReportFailToDemRef422.GetEventExtendedDataRecord
        OpEventGetEventExtendedDataRecord_GetEventExtendedDataRecord_EvtInfo_AutoCreatedDemEvent_ESH_Action_ESH_PrepShutdown_Bs_d9c527e4: start-on-event=GetEventExtendedDataRecord, operation=EvtInfo_AutoCreatedDemEvent_ESH_Action_ESH_PrepShutdown_BswMReportFailToDemRef422.GetEventExtendedDataRecord
        OpEventGetEventExtendedDataRecord_GetEventExtendedDataRecord_EvtInfo_AutoCreatedDemEvent_ESH_Action_ESH_PrepShutdown_Bs_03bcd848: start-on-event=GetEventExtendedDataRecord, operation=EvtInfo_AutoCreatedDemEvent_ESH_Action_ESH_PrepShutdown_BswMReportFailToDemRef_1422.GetEventExtendedDataRecord
        OpEventGetEventExtendedDataRecord_GetEventExtendedDataRecord_EvtInfo_AutoCreatedDemEvent_ESH_Action_ESH_Run_BswMReportF_26243c0b: start-on-event=GetEventExtendedDataRecord, operation=EvtInfo_AutoCreatedDemEvent_ESH_Action_ESH_Run_BswMReportFailToDemRef422.GetEventExtendedDataRecord
        OpEventGetEventExtendedDataRecord_GetEventExtendedDataRecord_EvtInfo_AutoCreatedDemEvent_ESH_Action_ESH_Run_BswMReportF_503f0166: start-on-event=GetEventExtendedDataRecord, operation=EvtInfo_AutoCreatedDemEvent_ESH_Action_ESH_Run_BswMReportFailToDemRef_1422.GetEventExtendedDataRecord
        OpEventGetEventExtendedDataRecord_GetEventExtendedDataRecord_EvtInfo_AutoCreatedDemEvent_ESH_Action_ESH_WaitForNvm_BswM_55585cdf: start-on-event=GetEventExtendedDataRecord, operation=EvtInfo_AutoCreatedDemEvent_ESH_Action_ESH_WaitForNvm_BswMReportFailToDemRef422.GetEventExtendedDataRecord
        OpEventGetEventExtendedDataRecord_GetEventExtendedDataRecord_EvtInfo_AutoCreatedDemEvent_ESH_Action_ESH_Wakeup_BswMRepo_34493285: start-on-event=GetEventExtendedDataRecord, operation=EvtInfo_AutoCreatedDemEvent_ESH_Action_ESH_Wakeup_BswMReportFailToDemRef422.GetEventExtendedDataRecord
        OpEventGetEventExtendedDataRecord_GetEventExtendedDataRecord_EvtInfo_AutoCreatedDemEvent_ESH_Action_ESH_Wakeup_BswMRepo_12878bc9: start-on-event=GetEventExtendedDataRecord, operation=EvtInfo_AutoCreatedDemEvent_ESH_Action_ESH_Wakeup_BswMReportFailToDemRef_1422.GetEventExtendedDataRecord
        OpEventGetEventExtendedDataRecord_GetEventExtendedDataRecord_EvtInfo_AutoCreatedDemEvent_ESH_Action_EcuMClearValidatedW_4e12f69e: start-on-event=GetEventExtendedDataRecord, operation=EvtInfo_AutoCreatedDemEvent_ESH_Action_EcuMClearValidatedWakeupEvents_BswMReportFailToDemRef422.GetEventExtendedDataRecord
        OpEventGetEventExtendedDataRecord_GetEventExtendedDataRecord_EvtInfo_AutoCreatedDemEvent_ESH_Action_EcuMGoToSelectedShu_b5dab98b: start-on-event=GetEventExtendedDataRecord, operation=EvtInfo_AutoCreatedDemEvent_ESH_Action_EcuMGoToSelectedShutdownTarget_BswMReportFailToDemRef422.GetEventExtendedDataRecord
        OpEventGetEventExtendedDataRecord_GetEventExtendedDataRecord_EvtInfo_AutoCreatedDemEvent_ESH_Action_EnterExclusiveArea_4e85d29f: start-on-event=GetEventExtendedDataRecord, operation=EvtInfo_AutoCreatedDemEvent_ESH_Action_EnterExclusiveArea_BswMReportFailToDemRef422.GetEventExtendedDataRecord
        OpEventGetEventExtendedDataRecord_GetEventExtendedDataRecord_EvtInfo_AutoCreatedDemEvent_ESH_Action_EnterExclusiveArea_02a0e9a6: start-on-event=GetEventExtendedDataRecord, operation=EvtInfo_AutoCreatedDemEvent_ESH_Action_EnterExclusiveArea_BswMReportFailToDemRef_1422.GetEventExtendedDataRecord
        OpEventGetEventExtendedDataRecord_GetEventExtendedDataRecord_EvtInfo_AutoCreatedDemEvent_ESH_Action_ExitExclusiveArea_B_37002f5e: start-on-event=GetEventExtendedDataRecord, operation=EvtInfo_AutoCreatedDemEvent_ESH_Action_ExitExclusiveArea_BswMReportFailToDemRef422.GetEventExtendedDataRecord
        OpEventGetEventExtendedDataRecord_GetEventExtendedDataRecord_EvtInfo_AutoCreatedDemEvent_ESH_Action_ExitExclusiveArea_B_134df88d: start-on-event=GetEventExtendedDataRecord, operation=EvtInfo_AutoCreatedDemEvent_ESH_Action_ExitExclusiveArea_BswMReportFailToDemRef_1422.GetEventExtendedDataRecord
        OpEventGetEventExtendedDataRecord_GetEventExtendedDataRecord_EvtInfo_AutoCreatedDemEvent_ESH_Action_NvMWriteAll_BswMRep_832bc2e9: start-on-event=GetEventExtendedDataRecord, operation=EvtInfo_AutoCreatedDemEvent_ESH_Action_NvMWriteAll_BswMReportFailToDemRef422.GetEventExtendedDataRecord
        OpEventGetEventExtendedDataRecord_GetEventExtendedDataRecord_EvtInfo_AutoCreatedDemEvent_ESH_Action_OnEnterPostRun_BswM_33c571e3: start-on-event=GetEventExtendedDataRecord, operation=EvtInfo_AutoCreatedDemEvent_ESH_Action_OnEnterPostRun_BswMReportFailToDemRef422.GetEventExtendedDataRecord
        OpEventGetEventExtendedDataRecord_GetEventExtendedDataRecord_EvtInfo_AutoCreatedDemEvent_ESH_Action_OnEnterPrepShutdown_2cb7fc23: start-on-event=GetEventExtendedDataRecord, operation=EvtInfo_AutoCreatedDemEvent_ESH_Action_OnEnterPrepShutdown_BswMReportFailToDemRef422.GetEventExtendedDataRecord
        OpEventGetEventExtendedDataRecord_GetEventExtendedDataRecord_EvtInfo_AutoCreatedDemEvent_ESH_Action_OnEnterPrepShutdown_960667ef: start-on-event=GetEventExtendedDataRecord, operation=EvtInfo_AutoCreatedDemEvent_ESH_Action_OnEnterPrepShutdown_BswMReportFailToDemRef_1422.GetEventExtendedDataRecord
        OpEventGetEventExtendedDataRecord_GetEventExtendedDataRecord_EvtInfo_AutoCreatedDemEvent_ESH_Action_OnEnterRun_BswMRepo_182902c0: start-on-event=GetEventExtendedDataRecord, operation=EvtInfo_AutoCreatedDemEvent_ESH_Action_OnEnterRun_BswMReportFailToDemRef422.GetEventExtendedDataRecord
        OpEventGetEventExtendedDataRecord_GetEventExtendedDataRecord_EvtInfo_AutoCreatedDemEvent_ESH_Action_OnEnterRun_BswMRepo_b9502c45: start-on-event=GetEventExtendedDataRecord, operation=EvtInfo_AutoCreatedDemEvent_ESH_Action_OnEnterRun_BswMReportFailToDemRef_1422.GetEventExtendedDataRecord
        OpEventGetEventExtendedDataRecord_GetEventExtendedDataRecord_EvtInfo_AutoCreatedDemEvent_ESH_Action_OnEnterShutdown_Bsw_f5f60449: start-on-event=GetEventExtendedDataRecord, operation=EvtInfo_AutoCreatedDemEvent_ESH_Action_OnEnterShutdown_BswMReportFailToDemRef422.GetEventExtendedDataRecord
        OpEventGetEventExtendedDataRecord_GetEventExtendedDataRecord_EvtInfo_AutoCreatedDemEvent_ESH_Action_OnEnterWaitForNvm_B_4d56ba50: start-on-event=GetEventExtendedDataRecord, operation=EvtInfo_AutoCreatedDemEvent_ESH_Action_OnEnterWaitForNvm_BswMReportFailToDemRef422.GetEventExtendedDataRecord
        OpEventGetEventExtendedDataRecord_GetEventExtendedDataRecord_EvtInfo_AutoCreatedDemEvent_ESH_Action_OnEnterWakeup_BswMR_96c72cda: start-on-event=GetEventExtendedDataRecord, operation=EvtInfo_AutoCreatedDemEvent_ESH_Action_OnEnterWakeup_BswMReportFailToDemRef422.GetEventExtendedDataRecord
        OpEventGetEventExtendedDataRecord_GetEventExtendedDataRecord_EvtInfo_AutoCreatedDemEvent_ESH_Action_OnEnterWakeup_BswMR_d5ab55bf: start-on-event=GetEventExtendedDataRecord, operation=EvtInfo_AutoCreatedDemEvent_ESH_Action_OnEnterWakeup_BswMReportFailToDemRef_1422.GetEventExtendedDataRecord
        OpEventGetEventExtendedDataRecord_GetEventExtendedDataRecord_EvtInfo_AutoCreatedDemEvent_ESH_Action_SelfRunRequestTimer_8f93e5c2: start-on-event=GetEventExtendedDataRecord, operation=EvtInfo_AutoCreatedDemEvent_ESH_Action_SelfRunRequestTimer_Start_BswMReportFailToDemRef422.GetEventExtendedDataRecord
        OpEventGetEventExtendedDataRecord_GetEventExtendedDataRecord_EvtInfo_AutoCreatedDemEvent_ESH_Action_SelfRunRequestTimer_b508aea6: start-on-event=GetEventExtendedDataRecord, operation=EvtInfo_AutoCreatedDemEvent_ESH_Action_SelfRunRequestTimer_Start_BswMReportFailToDemRef_1422.GetEventExtendedDataRecord
        OpEventGetEventExtendedDataRecord_GetEventExtendedDataRecord_EvtInfo_AutoCreatedDemEvent_ESH_Action_SwitchPostRun_BswMR_8c164d38: start-on-event=GetEventExtendedDataRecord, operation=EvtInfo_AutoCreatedDemEvent_ESH_Action_SwitchPostRun_BswMReportFailToDemRef422.GetEventExtendedDataRecord
        OpEventGetEventExtendedDataRecord_GetEventExtendedDataRecord_EvtInfo_AutoCreatedDemEvent_ESH_Action_SwitchRun_BswMRepor_a56072f4: start-on-event=GetEventExtendedDataRecord, operation=EvtInfo_AutoCreatedDemEvent_ESH_Action_SwitchRun_BswMReportFailToDemRef422.GetEventExtendedDataRecord
        OpEventGetEventExtendedDataRecord_GetEventExtendedDataRecord_EvtInfo_AutoCreatedDemEvent_ESH_Action_SwitchRun_BswMRepor_527f13c7: start-on-event=GetEventExtendedDataRecord, operation=EvtInfo_AutoCreatedDemEvent_ESH_Action_SwitchRun_BswMReportFailToDemRef_1422.GetEventExtendedDataRecord
        OpEventGetEventExtendedDataRecord_GetEventExtendedDataRecord_EvtInfo_AutoCreatedDemEvent_ESH_Action_SwitchShutdown_BswM_e448dc29: start-on-event=GetEventExtendedDataRecord, operation=EvtInfo_AutoCreatedDemEvent_ESH_Action_SwitchShutdown_BswMReportFailToDemRef422.GetEventExtendedDataRecord
        OpEventGetEventExtendedDataRecord_GetEventExtendedDataRecord_EvtInfo_AutoCreatedDemEvent_ESH_Action_SwitchShutdown_BswM_57876752: start-on-event=GetEventExtendedDataRecord, operation=EvtInfo_AutoCreatedDemEvent_ESH_Action_SwitchShutdown_BswMReportFailToDemRef_1422.GetEventExtendedDataRecord
        OpEventGetEventExtendedDataRecord_GetEventExtendedDataRecord_EvtInfo_AutoCreatedDemEvent_ESH_Action_SwitchWakeup_BswMRe_959ae1e9: start-on-event=GetEventExtendedDataRecord, operation=EvtInfo_AutoCreatedDemEvent_ESH_Action_SwitchWakeup_BswMReportFailToDemRef422.GetEventExtendedDataRecord
        OpEventGetEventExtendedDataRecord_GetEventExtendedDataRecord_EvtInfo_AutoCreatedDemEvent_ESH_Action_SwitchWakeup_BswMRe_c4158ddf: start-on-event=GetEventExtendedDataRecord, operation=EvtInfo_AutoCreatedDemEvent_ESH_Action_SwitchWakeup_BswMReportFailToDemRef_1422.GetEventExtendedDataRecord
        OpEventGetEventExtendedDataRecord_GetEventExtendedDataRecord_EvtInfo_AutoCreatedDemEvent_ESH_Action_WriteAllTimer_Start_c52eb6c6: start-on-event=GetEventExtendedDataRecord, operation=EvtInfo_AutoCreatedDemEvent_ESH_Action_WriteAllTimer_Start_BswMReportFailToDemRef422.GetEventExtendedDataRecord
        OpEventGetEventExtendedDataRecord_GetEventExtendedDataRecord_EvtInfo_AutoCreatedDemEvent_ESH_Action_WriteAllTimer_Stop_82c8cfae: start-on-event=GetEventExtendedDataRecord, operation=EvtInfo_AutoCreatedDemEvent_ESH_Action_WriteAllTimer_Stop_BswMReportFailToDemRef422.GetEventExtendedDataRecord
        OpEventGetEventExtendedDataRecord_GetEventExtendedDataRecord_EvtInfo_AutoCreatedDemEvent_ESH_Action_WriteAllTimer_Stop_a7fb4e80: start-on-event=GetEventExtendedDataRecord, operation=EvtInfo_AutoCreatedDemEvent_ESH_Action_WriteAllTimer_Stop_BswMReportFailToDemRef_1422.GetEventExtendedDataRecord
        OpEventGetEventExtendedDataRecord_GetEventExtendedDataRecord_EvtInfo_AutoCreatedDemEvent_ESH_DemInit_BswMReportFailToDemRef422: start-on-event=GetEventExtendedDataRecord, operation=EvtInfo_AutoCreatedDemEvent_ESH_DemInit_BswMReportFailToDemRef422.GetEventExtendedDataRecord
        OpEventGetEventExtendedDataRecord_GetEventExtendedDataRecord_EvtInfo_AutoCreatedDemEvent_ESH_PostRunNested_BswMReportFa_ecc3956b: start-on-event=GetEventExtendedDataRecord, operation=EvtInfo_AutoCreatedDemEvent_ESH_PostRunNested_BswMReportFailToDemRef422.GetEventExtendedDataRecord
        OpEventGetEventExtendedDataRecord_GetEventExtendedDataRecord_EvtInfo_AutoCreatedDemEvent_ESH_PostRunToPrepNested_BswMRe_5962c6ab: start-on-event=GetEventExtendedDataRecord, operation=EvtInfo_AutoCreatedDemEvent_ESH_PostRunToPrepNested_BswMReportFailToDemRef422.GetEventExtendedDataRecord
        OpEventGetEventExtendedDataRecord_GetEventExtendedDataRecord_EvtInfo_AutoCreatedDemEvent_ESH_RunToPostRunNested_BswMRep_e4afd58c: start-on-event=GetEventExtendedDataRecord, operation=EvtInfo_AutoCreatedDemEvent_ESH_RunToPostRunNested_BswMReportFailToDemRef422.GetEventExtendedDataRecord
        OpEventGetEventExtendedDataRecord_GetEventExtendedDataRecord_EvtInfo_AutoCreatedDemEvent_FLS_E_COMPARE_FAILED422: start-on-event=GetEventExtendedDataRecord, operation=EvtInfo_AutoCreatedDemEvent_FLS_E_COMPARE_FAILED422.GetEventExtendedDataRecord
        OpEventGetEventExtendedDataRecord_GetEventExtendedDataRecord_EvtInfo_AutoCreatedDemEvent_FLS_E_ERASE_FAILED422: start-on-event=GetEventExtendedDataRecord, operation=EvtInfo_AutoCreatedDemEvent_FLS_E_ERASE_FAILED422.GetEventExtendedDataRecord
        OpEventGetEventExtendedDataRecord_GetEventExtendedDataRecord_EvtInfo_AutoCreatedDemEvent_FLS_E_READ_FAILED422: start-on-event=GetEventExtendedDataRecord, operation=EvtInfo_AutoCreatedDemEvent_FLS_E_READ_FAILED422.GetEventExtendedDataRecord
        OpEventGetEventExtendedDataRecord_GetEventExtendedDataRecord_EvtInfo_AutoCreatedDemEvent_FLS_E_UNEXPECTED_FLASH_ID422: start-on-event=GetEventExtendedDataRecord, operation=EvtInfo_AutoCreatedDemEvent_FLS_E_UNEXPECTED_FLASH_ID422.GetEventExtendedDataRecord
        OpEventGetEventExtendedDataRecord_GetEventExtendedDataRecord_EvtInfo_AutoCreatedDemEvent_FLS_E_WRITE_FAILED422: start-on-event=GetEventExtendedDataRecord, operation=EvtInfo_AutoCreatedDemEvent_FLS_E_WRITE_FAILED422.GetEventExtendedDataRecord
        OpEventGetEventExtendedDataRecord_GetEventExtendedDataRecord_EvtInfo_AutoCreatedDemEvent_GPT_E_TIMEOUT422: start-on-event=GetEventExtendedDataRecord, operation=EvtInfo_AutoCreatedDemEvent_GPT_E_TIMEOUT422.GetEventExtendedDataRecord
        OpEventGetEventExtendedDataRecord_GetEventExtendedDataRecord_EvtInfo_AutoCreatedDemEvent_INIT_Action_BrsHw_EnableHwAcce_2f620499: start-on-event=GetEventExtendedDataRecord, operation=EvtInfo_AutoCreatedDemEvent_INIT_Action_BrsHw_EnableHwAccess_BswMReportFailToDemRef422.GetEventExtendedDataRecord
        OpEventGetEventExtendedDataRecord_GetEventExtendedDataRecord_EvtInfo_AutoCreatedDemEvent_INIT_Action_CanIf_Init_BswMRep_ec4c691a: start-on-event=GetEventExtendedDataRecord, operation=EvtInfo_AutoCreatedDemEvent_INIT_Action_CanIf_Init_BswMReportFailToDemRef422.GetEventExtendedDataRecord
        OpEventGetEventExtendedDataRecord_GetEventExtendedDataRecord_EvtInfo_AutoCreatedDemEvent_INIT_Action_CanNm_Init_BswMRep_469aa728: start-on-event=GetEventExtendedDataRecord, operation=EvtInfo_AutoCreatedDemEvent_INIT_Action_CanNm_Init_BswMReportFailToDemRef422.GetEventExtendedDataRecord
        OpEventGetEventExtendedDataRecord_GetEventExtendedDataRecord_EvtInfo_AutoCreatedDemEvent_INIT_Action_CanSM_Init_BswMRep_243e2bae: start-on-event=GetEventExtendedDataRecord, operation=EvtInfo_AutoCreatedDemEvent_INIT_Action_CanSM_Init_BswMReportFailToDemRef422.GetEventExtendedDataRecord
        OpEventGetEventExtendedDataRecord_GetEventExtendedDataRecord_EvtInfo_AutoCreatedDemEvent_INIT_Action_CanTp_Init_BswMRep_e04c4198: start-on-event=GetEventExtendedDataRecord, operation=EvtInfo_AutoCreatedDemEvent_INIT_Action_CanTp_Init_BswMReportFailToDemRef422.GetEventExtendedDataRecord
        OpEventGetEventExtendedDataRecord_GetEventExtendedDataRecord_EvtInfo_AutoCreatedDemEvent_INIT_Action_Can_Init_BswMRepor_a7c96422: start-on-event=GetEventExtendedDataRecord, operation=EvtInfo_AutoCreatedDemEvent_INIT_Action_Can_Init_BswMReportFailToDemRef422.GetEventExtendedDataRecord
        OpEventGetEventExtendedDataRecord_GetEventExtendedDataRecord_EvtInfo_AutoCreatedDemEvent_INIT_Action_ComM_Init_BswMRepo_38163bed: start-on-event=GetEventExtendedDataRecord, operation=EvtInfo_AutoCreatedDemEvent_INIT_Action_ComM_Init_BswMReportFailToDemRef422.GetEventExtendedDataRecord
        OpEventGetEventExtendedDataRecord_GetEventExtendedDataRecord_EvtInfo_AutoCreatedDemEvent_INIT_Action_Com_Init_BswMRepor_b41c8f6e: start-on-event=GetEventExtendedDataRecord, operation=EvtInfo_AutoCreatedDemEvent_INIT_Action_Com_Init_BswMReportFailToDemRef422.GetEventExtendedDataRecord
        OpEventGetEventExtendedDataRecord_GetEventExtendedDataRecord_EvtInfo_AutoCreatedDemEvent_INIT_Action_Dcm_Init_BswMRepor_fcbcfaf9: start-on-event=GetEventExtendedDataRecord, operation=EvtInfo_AutoCreatedDemEvent_INIT_Action_Dcm_Init_BswMReportFailToDemRef422.GetEventExtendedDataRecord
        OpEventGetEventExtendedDataRecord_GetEventExtendedDataRecord_EvtInfo_AutoCreatedDemEvent_INIT_Action_Dem_Init_BswMRepor_4a9398d3: start-on-event=GetEventExtendedDataRecord, operation=EvtInfo_AutoCreatedDemEvent_INIT_Action_Dem_Init_BswMReportFailToDemRef422.GetEventExtendedDataRecord
        OpEventGetEventExtendedDataRecord_GetEventExtendedDataRecord_EvtInfo_AutoCreatedDemEvent_INIT_Action_EnableInterrupts_B_3cf4f184: start-on-event=GetEventExtendedDataRecord, operation=EvtInfo_AutoCreatedDemEvent_INIT_Action_EnableInterrupts_BswMReportFailToDemRef422.GetEventExtendedDataRecord
        OpEventGetEventExtendedDataRecord_GetEventExtendedDataRecord_EvtInfo_AutoCreatedDemEvent_INIT_Action_Fee_Init_BswMRepor_e0830eeb: start-on-event=GetEventExtendedDataRecord, operation=EvtInfo_AutoCreatedDemEvent_INIT_Action_Fee_Init_BswMReportFailToDemRef422.GetEventExtendedDataRecord
        OpEventGetEventExtendedDataRecord_GetEventExtendedDataRecord_EvtInfo_AutoCreatedDemEvent_INIT_Action_Issm_Init_BswMRepo_c7715c20: start-on-event=GetEventExtendedDataRecord, operation=EvtInfo_AutoCreatedDemEvent_INIT_Action_Issm_Init_BswMReportFailToDemRef422.GetEventExtendedDataRecord
        OpEventGetEventExtendedDataRecord_GetEventExtendedDataRecord_EvtInfo_AutoCreatedDemEvent_INIT_Action_J1939Nm_Init_BswMR_a3ebd368: start-on-event=GetEventExtendedDataRecord, operation=EvtInfo_AutoCreatedDemEvent_INIT_Action_J1939Nm_Init_BswMReportFailToDemRef422.GetEventExtendedDataRecord
        OpEventGetEventExtendedDataRecord_GetEventExtendedDataRecord_EvtInfo_AutoCreatedDemEvent_INIT_Action_J1939Rm_Init_BswMR_cd0f12cf: start-on-event=GetEventExtendedDataRecord, operation=EvtInfo_AutoCreatedDemEvent_INIT_Action_J1939Rm_Init_BswMReportFailToDemRef422.GetEventExtendedDataRecord
        OpEventGetEventExtendedDataRecord_GetEventExtendedDataRecord_EvtInfo_AutoCreatedDemEvent_INIT_Action_J1939Tp_Init_BswMR_053d35d8: start-on-event=GetEventExtendedDataRecord, operation=EvtInfo_AutoCreatedDemEvent_INIT_Action_J1939Tp_Init_BswMReportFailToDemRef422.GetEventExtendedDataRecord
        OpEventGetEventExtendedDataRecord_GetEventExtendedDataRecord_EvtInfo_AutoCreatedDemEvent_INIT_Action_LinIf_Init_BswMRep_0a195a58: start-on-event=GetEventExtendedDataRecord, operation=EvtInfo_AutoCreatedDemEvent_INIT_Action_LinIf_Init_BswMReportFailToDemRef422.GetEventExtendedDataRecord
        OpEventGetEventExtendedDataRecord_GetEventExtendedDataRecord_EvtInfo_AutoCreatedDemEvent_INIT_Action_LinSM_Init_BswMRep_c26b18ec: start-on-event=GetEventExtendedDataRecord, operation=EvtInfo_AutoCreatedDemEvent_INIT_Action_LinSM_Init_BswMReportFailToDemRef422.GetEventExtendedDataRecord
        OpEventGetEventExtendedDataRecord_GetEventExtendedDataRecord_EvtInfo_AutoCreatedDemEvent_INIT_Action_LinTp_Init_BswMRep_061972da: start-on-event=GetEventExtendedDataRecord, operation=EvtInfo_AutoCreatedDemEvent_INIT_Action_LinTp_Init_BswMReportFailToDemRef422.GetEventExtendedDataRecord
        OpEventGetEventExtendedDataRecord_GetEventExtendedDataRecord_EvtInfo_AutoCreatedDemEvent_INIT_Action_Lin_Init_BswMRepor_cbc0dd88: start-on-event=GetEventExtendedDataRecord, operation=EvtInfo_AutoCreatedDemEvent_INIT_Action_Lin_Init_BswMReportFailToDemRef422.GetEventExtendedDataRecord
        OpEventGetEventExtendedDataRecord_GetEventExtendedDataRecord_EvtInfo_AutoCreatedDemEvent_INIT_Action_Nm_Init_BswMReport_d340bca2: start-on-event=GetEventExtendedDataRecord, operation=EvtInfo_AutoCreatedDemEvent_INIT_Action_Nm_Init_BswMReportFailToDemRef422.GetEventExtendedDataRecord
        OpEventGetEventExtendedDataRecord_GetEventExtendedDataRecord_EvtInfo_AutoCreatedDemEvent_INIT_Action_NvMReadAll_BswMRep_c1ad8ecb: start-on-event=GetEventExtendedDataRecord, operation=EvtInfo_AutoCreatedDemEvent_INIT_Action_NvMReadAll_BswMReportFailToDemRef422.GetEventExtendedDataRecord
        OpEventGetEventExtendedDataRecord_GetEventExtendedDataRecord_EvtInfo_AutoCreatedDemEvent_INIT_Action_NvM_Init_BswMRepor_449ada3b: start-on-event=GetEventExtendedDataRecord, operation=EvtInfo_AutoCreatedDemEvent_INIT_Action_NvM_Init_BswMReportFailToDemRef422.GetEventExtendedDataRecord
        OpEventGetEventExtendedDataRecord_GetEventExtendedDataRecord_EvtInfo_AutoCreatedDemEvent_INIT_Action_PduR_Init_BswMRepo_9d2cf757: start-on-event=GetEventExtendedDataRecord, operation=EvtInfo_AutoCreatedDemEvent_INIT_Action_PduR_Init_BswMReportFailToDemRef422.GetEventExtendedDataRecord
        OpEventGetEventExtendedDataRecord_GetEventExtendedDataRecord_EvtInfo_AutoCreatedDemEvent_INIT_Action_RteStart_BswMRepor_d890e232: start-on-event=GetEventExtendedDataRecord, operation=EvtInfo_AutoCreatedDemEvent_INIT_Action_RteStart_BswMReportFailToDemRef422.GetEventExtendedDataRecord
        OpEventGetEventExtendedDataRecord_GetEventExtendedDataRecord_EvtInfo_AutoCreatedDemEvent_J1939NM_E_ADDRESS_LOST422: start-on-event=GetEventExtendedDataRecord, operation=EvtInfo_AutoCreatedDemEvent_J1939NM_E_ADDRESS_LOST422.GetEventExtendedDataRecord
        OpEventGetEventExtendedDataRecord_GetEventExtendedDataRecord_EvtInfo_AutoCreatedDemEvent_J1939TpConfiguration_J1939TP_E_0e4f28ac: start-on-event=GetEventExtendedDataRecord, operation=EvtInfo_AutoCreatedDemEvent_J1939TpConfiguration_J1939TP_E_COMMUNICATION422.GetEventExtendedDataRecord
        OpEventGetEventExtendedDataRecord_GetEventExtendedDataRecord_EvtInfo_AutoCreatedDemEvent_LIN_E_TIMEOUT422: start-on-event=GetEventExtendedDataRecord, operation=EvtInfo_AutoCreatedDemEvent_LIN_E_TIMEOUT422.GetEventExtendedDataRecord
        OpEventGetEventExtendedDataRecord_GetEventExtendedDataRecord_EvtInfo_AutoCreatedDemEvent_MCL_E_DMA_BUS422: start-on-event=GetEventExtendedDataRecord, operation=EvtInfo_AutoCreatedDemEvent_MCL_E_DMA_BUS422.GetEventExtendedDataRecord
        OpEventGetEventExtendedDataRecord_GetEventExtendedDataRecord_EvtInfo_AutoCreatedDemEvent_MCL_E_DMA_DESCRIPTOR422: start-on-event=GetEventExtendedDataRecord, operation=EvtInfo_AutoCreatedDemEvent_MCL_E_DMA_DESCRIPTOR422.GetEventExtendedDataRecord
        OpEventGetEventExtendedDataRecord_GetEventExtendedDataRecord_EvtInfo_AutoCreatedDemEvent_MCL_E_DMA_ECC422: start-on-event=GetEventExtendedDataRecord, operation=EvtInfo_AutoCreatedDemEvent_MCL_E_DMA_ECC422.GetEventExtendedDataRecord
        OpEventGetEventExtendedDataRecord_GetEventExtendedDataRecord_EvtInfo_AutoCreatedDemEvent_MCL_E_DMA_INCONSISTENCY422: start-on-event=GetEventExtendedDataRecord, operation=EvtInfo_AutoCreatedDemEvent_MCL_E_DMA_INCONSISTENCY422.GetEventExtendedDataRecord
        OpEventGetEventExtendedDataRecord_GetEventExtendedDataRecord_EvtInfo_AutoCreatedDemEvent_MCL_E_DMA_PRIORITY422: start-on-event=GetEventExtendedDataRecord, operation=EvtInfo_AutoCreatedDemEvent_MCL_E_DMA_PRIORITY422.GetEventExtendedDataRecord
        OpEventGetEventExtendedDataRecord_GetEventExtendedDataRecord_EvtInfo_AutoCreatedDemEvent_MCL_E_DMA_UNRECOGNIZED422: start-on-event=GetEventExtendedDataRecord, operation=EvtInfo_AutoCreatedDemEvent_MCL_E_DMA_UNRECOGNIZED422.GetEventExtendedDataRecord
        OpEventGetEventExtendedDataRecord_GetEventExtendedDataRecord_EvtInfo_AutoCreatedDemEvent_MCU_E_CLOCK_FAILURE422: start-on-event=GetEventExtendedDataRecord, operation=EvtInfo_AutoCreatedDemEvent_MCU_E_CLOCK_FAILURE422.GetEventExtendedDataRecord
        OpEventGetEventExtendedDataRecord_GetEventExtendedDataRecord_EvtInfo_AutoCreatedDemEvent_MCU_E_INVALIDMODE_CONFIG422: start-on-event=GetEventExtendedDataRecord, operation=EvtInfo_AutoCreatedDemEvent_MCU_E_INVALIDMODE_CONFIG422.GetEventExtendedDataRecord
        OpEventGetEventExtendedDataRecord_GetEventExtendedDataRecord_EvtInfo_AutoCreatedDemEvent_MCU_E_SSCM_CER_FAILURE422: start-on-event=GetEventExtendedDataRecord, operation=EvtInfo_AutoCreatedDemEvent_MCU_E_SSCM_CER_FAILURE422.GetEventExtendedDataRecord
        OpEventGetEventExtendedDataRecord_GetEventExtendedDataRecord_EvtInfo_AutoCreatedDemEvent_MCU_E_TIMEOUT_FAILURE422: start-on-event=GetEventExtendedDataRecord, operation=EvtInfo_AutoCreatedDemEvent_MCU_E_TIMEOUT_FAILURE422.GetEventExtendedDataRecord
        OpEventGetEventExtendedDataRecord_GetEventExtendedDataRecord_EvtInfo_AutoCreatedDemEvent_NVM_E_INTEGRITY_FAILED422: start-on-event=GetEventExtendedDataRecord, operation=EvtInfo_AutoCreatedDemEvent_NVM_E_INTEGRITY_FAILED422.GetEventExtendedDataRecord
        OpEventGetEventExtendedDataRecord_GetEventExtendedDataRecord_EvtInfo_AutoCreatedDemEvent_NVM_E_LOSS_OF_REDUNDANCY422: start-on-event=GetEventExtendedDataRecord, operation=EvtInfo_AutoCreatedDemEvent_NVM_E_LOSS_OF_REDUNDANCY422.GetEventExtendedDataRecord
        OpEventGetEventExtendedDataRecord_GetEventExtendedDataRecord_EvtInfo_AutoCreatedDemEvent_NVM_E_QUEUE_OVERFLOW422: start-on-event=GetEventExtendedDataRecord, operation=EvtInfo_AutoCreatedDemEvent_NVM_E_QUEUE_OVERFLOW422.GetEventExtendedDataRecord
        OpEventGetEventExtendedDataRecord_GetEventExtendedDataRecord_EvtInfo_AutoCreatedDemEvent_NVM_E_REQ_FAILED422: start-on-event=GetEventExtendedDataRecord, operation=EvtInfo_AutoCreatedDemEvent_NVM_E_REQ_FAILED422.GetEventExtendedDataRecord
        OpEventGetEventExtendedDataRecord_GetEventExtendedDataRecord_EvtInfo_AutoCreatedDemEvent_NVM_E_VERIFY_FAILED422: start-on-event=GetEventExtendedDataRecord, operation=EvtInfo_AutoCreatedDemEvent_NVM_E_VERIFY_FAILED422.GetEventExtendedDataRecord
        OpEventGetEventExtendedDataRecord_GetEventExtendedDataRecord_EvtInfo_AutoCreatedDemEvent_NVM_E_WRITE_PROTECTED422: start-on-event=GetEventExtendedDataRecord, operation=EvtInfo_AutoCreatedDemEvent_NVM_E_WRITE_PROTECTED422.GetEventExtendedDataRecord
        OpEventGetEventExtendedDataRecord_GetEventExtendedDataRecord_EvtInfo_AutoCreatedDemEvent_NVM_E_WRONG_BLOCK_ID422: start-on-event=GetEventExtendedDataRecord, operation=EvtInfo_AutoCreatedDemEvent_NVM_E_WRONG_BLOCK_ID422.GetEventExtendedDataRecord
        OpEventGetEventExtendedDataRecord_GetEventExtendedDataRecord_EvtInfo_AutoCreatedDemEvent_SPI_E_HARDWARE_ERROR422: start-on-event=GetEventExtendedDataRecord, operation=EvtInfo_AutoCreatedDemEvent_SPI_E_HARDWARE_ERROR422.GetEventExtendedDataRecord
        OpEventGetEventExtendedDataRecord_GetEventExtendedDataRecord_EvtInfo_AutoCreatedDemEvent_SpiDriver_SPI_E_HARDWARE_ERROR422: start-on-event=GetEventExtendedDataRecord, operation=EvtInfo_AutoCreatedDemEvent_SpiDriver_SPI_E_HARDWARE_ERROR422.GetEventExtendedDataRecord
        OpEventGetEventExtendedDataRecord_GetEventExtendedDataRecord_EvtInfo_AutoCreatedDemEvent_WDG_E_CORRUPT_CONFIG422: start-on-event=GetEventExtendedDataRecord, operation=EvtInfo_AutoCreatedDemEvent_WDG_E_CORRUPT_CONFIG422.GetEventExtendedDataRecord
        OpEventGetEventExtendedDataRecord_GetEventExtendedDataRecord_EvtInfo_AutoCreatedDemEvent_WDG_E_DISABLE_REJECTED422: start-on-event=GetEventExtendedDataRecord, operation=EvtInfo_AutoCreatedDemEvent_WDG_E_DISABLE_REJECTED422.GetEventExtendedDataRecord
        OpEventGetEventExtendedDataRecord_GetEventExtendedDataRecord_EvtInfo_AutoCreatedDemEvent_WDG_E_FORBIDDEN_INVOCATION422: start-on-event=GetEventExtendedDataRecord, operation=EvtInfo_AutoCreatedDemEvent_WDG_E_FORBIDDEN_INVOCATION422.GetEventExtendedDataRecord
        OpEventGetEventExtendedDataRecord_GetEventExtendedDataRecord_EvtInfo_AutoCreatedDemEvent_WDG_E_INVALID_CALL422: start-on-event=GetEventExtendedDataRecord, operation=EvtInfo_AutoCreatedDemEvent_WDG_E_INVALID_CALL422.GetEventExtendedDataRecord
        OpEventGetEventExtendedDataRecord_GetEventExtendedDataRecord_EvtInfo_AutoCreatedDemEvent_WDG_E_INVALID_PARAMETER422: start-on-event=GetEventExtendedDataRecord, operation=EvtInfo_AutoCreatedDemEvent_WDG_E_INVALID_PARAMETER422.GetEventExtendedDataRecord
        OpEventGetEventExtendedDataRecord_GetEventExtendedDataRecord_EvtInfo_AutoCreatedDemEvent_WDG_E_MODE_FAILED422: start-on-event=GetEventExtendedDataRecord, operation=EvtInfo_AutoCreatedDemEvent_WDG_E_MODE_FAILED422.GetEventExtendedDataRecord
        OpEventGetEventExtendedDataRecord_GetEventExtendedDataRecord_EvtInfo_AutoCreatedDemEvent_WDG_E_UNLOCKED422: start-on-event=GetEventExtendedDataRecord, operation=EvtInfo_AutoCreatedDemEvent_WDG_E_UNLOCKED422.GetEventExtendedDataRecord
