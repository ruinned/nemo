AUTOSAR XML (schema 4-2-1)
package /MICROSAR/J1939Rm_swc/DataTypes
  4 x impl type:
    NetworkHandleType: range raw 0..255, implementation-data-type=uint8, type-emitter=J1939Rm
    J1939Rm_AckCode: compu {0=J1939RM_ACK_POSITIVE, 1=J1939RM_ACK_NEGATIVE, 2=J1939RM_ACK_ACCESS_DENIED, 3=J1939RM_ACK_CANNOT_RESPOND}, range raw 0..3, implementation-data-type=uint8  # This type represents the available kinds of acknowledgements.
    J1939Rm_ExtIdType: compu {0=J1939RM_EXTID_NONE, 1=J1939RM_EXTID_ONE, 2=J1939RM_EXTID_TWO, 3=J1939RM_EXTID_THREE, 4=J1939RM_EXTID_GF}, range raw 0..4, implementation-data-type=uint8  # This type represents the available kinds of extended identifier usage.
    J1939Rm_ExtIdInfoType: category=STRUCTURE  # This type represents a set of extended identifiers.
      4 x element, all with category=TYPE_REFERENCE:
        ExtIdType: implementation-data-type=J1939Rm_ExtIdType
        ExtId{1..3}: implementation-data-type=uint8
package /MICROSAR/J1939Rm_swc/Interfaces
  6 x client server interface, all with is-service=true, service-kind=VENDOR-SPECIFIC:
    AppSendAck
      operation SendAck: possible-error=[AppSendAck/E_OK, AppSendAck/E_NOT_OK]  # Requests transmission of an Acknowledgement PG.
        7 x arg, all with direction=IN:
          channel: type=NetworkHandleType  # Channel on which the acknowledgement shall be sent.
          ackPgn: type=uint32  # Acknowledged PGN.
          extIdInfo: type=J1939Rm_ExtIdInfoType  # Extended identifier bytes.
          ackCode: type=J1939Rm_AckCode  # Type of acknowledgement, see definition of J1939Rm_AckCode for available codes.
          ackAddress: type=uint8  # Address of the node that sent the request.
          priority: type=uint8  # Priority of the Acknowledgement PG.
          broadcast: type=boolean  # Indicates whether the ACKM is a response to a broadcast request.
      error E_OK: error-code=0
      error E_NOT_OK: error-code=1
    AppSendRequest
      operation SendRequest: possible-error=[AppSendRequest/E_OK, AppSendRequest/E_NOT_OK]  # Requests transmission of a Request PG.
        6 x arg, all with direction=IN:
          channel: type=NetworkHandleType  # Channel on which the request shall be sent.
          requestedPgn: type=uint32  # PGN of the requested PG.
          extIdInfo: type=J1939Rm_ExtIdInfoType  # Extended identifier bytes.
          destAddress: type=uint8  # Address of the destination node or 0xFF for broadcast.
          priority: type=uint8  # Priority of the Request PG.
          checkTimeout: type=boolean  # TRUE: Timeout supervision will be performed FALSE: No timeout supervision will be started
      error E_OK: error-code=0
      error E_NOT_OK: error-code=1
    AppCancelRequestTimeout
      operation CancelRequestTimeout: possible-error=[AppCancelRequestTimeout/E_OK, AppCancelRequestTimeout/E_NOT_OK]  # Cancels timeout monitoring of a Request. If the request is not active, or timeout monitoring was not requested, this call has no effect.
        4 x arg, all with direction=IN:
          channel: type=NetworkHandleType  # Channel on which the request was sent.
          requestedPgn: type=uint32  # PGN of the requested PG.
          extIdInfo: type=J1939Rm_ExtIdInfoType  # Extended identifier bytes.
          destAddress: type=uint8  # Address of the destination node or 0xFF for broadcast.
      error E_OK: error-code=0
      error E_NOT_OK: error-code=1
    AppAckIndication
      operation AckIndication: possible-error=[AppAckIndication/E_OK, AppAckIndication/E_NOT_OK]  # Indicates reception of an Acknowledgement PG.
        8 x arg, all with direction=IN:
          node: type=uint8  # Node by which the acknowledgement was received.
          channel: type=NetworkHandleType  # Channel on which the acknowledgement was received.
          ackPgn: type=uint32  # Acknowledged PGN.
          extIdInfo: type=J1939Rm_ExtIdInfoType  # Extended identifier bytes.
          ackCode: type=J1939Rm_AckCode  # Type of acknowledgement, see definition of J1939Rm_AckCode for available codes.
          ackAddress: type=uint8  # Address of this node.
          sourceAddress: type=uint8  # Address of the node that sent the Acknowledgement PG.
          priority: type=uint8  # Priority of the Acknowledgement PG.
      error E_OK: error-code=0
      error E_NOT_OK: error-code=1
    AppRequestIndication
      operation RequestIndication: possible-error=[AppRequestIndication/E_OK, AppRequestIndication/E_NOT_OK]  # Indicates reception of a Request PG.
        7 x arg, all with direction=IN:
          node: type=uint8  # Node by which the request was received.
          channel: type=NetworkHandleType  # Channel on which the request was received.
          requestedPgn: type=uint32  # PGN of the requested PG.
          extIdInfo: type=J1939Rm_ExtIdInfoType  # Extended identifier bytes.
          sourceAddress: type=uint8  # Address of the node that sent the Request PG.
          destAddress: type=uint8  # Address of this node or 0xFF for broadcast.
          priority: type=uint8  # Priority of the Request PG.
      error E_OK: error-code=0
      error E_NOT_OK: error-code=1
    AppRequestTimeoutIndication
      operation RequestTimeoutIndication: possible-error=[AppRequestTimeoutIndication/E_OK, AppRequestTimeoutIndication/E_NOT_OK]  # Indicates timeout of a request triggered with the same parameters.
        5 x arg, all with direction=IN:
          node: type=uint8  # Node by which the request was sent.
          channel: type=NetworkHandleType  # Channel on which the request was sent.
          requestedPgn: type=uint32  # PGN of the requested PG.
          extIdInfo: type=J1939Rm_ExtIdInfoType  # Extended identifier bytes.
          destAddress: type=uint8  # Address of the destination node or 0xFF for broadcast.
      error E_OK: error-code=0
      error E_NOT_OK: error-code=1
package /MICROSAR/J1939Rm_swc/ComponentTypes
  service sw component type J1939Rm: category=SERVICE_COMPONENT
    behavior J1939RmInternalBehavior: handle-termination-and-restart=NO-SUPPORT, included-data-type-set=data-type=[J1939Rm_AckCode, J1939Rm_ExtIdType, J1939Rm_ExtIdInfoType]
      timing event Timer_J1939Rm_MainFunction: start-on-event=J1939Rm_MainFunction, period=0.01
      runnable J1939Rm_MainFunction
  swc implementation J1939RmImplementation: programming-language=C, behavior=J1939RmInternalBehavior
