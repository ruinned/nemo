AUTOSAR XML (schema 4-3-0)
package /cdd_spi/CddSwComponentTypes
  complex device driver sw component type SPI
    behavior InternalBehavior
      timing event TE_RE_ASW_FG1_spi_10ms: start-on-event=RE_ASW_FG1_spi_10ms, period=0.01
      runnable RE_ASW_FG1_spi_10ms: symbol=cdd_spi_10ms
