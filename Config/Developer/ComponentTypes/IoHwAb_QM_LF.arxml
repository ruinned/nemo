AUTOSAR XML (schema 4-3-0)
package /ComponentTypes
  ecu abstraction sw component type IoHwAb_QM_LF_COMTP
    behavior IoHwAb_QM_LF_COMTP_InternalBehavior
      timing event TMT_Re_IoHwAb_QM_LF_COMTP: start-on-event=Re_IoHwAb_QM_LF_COMTP, period=0.01
      runnable Re_IoHwAb_QM_LF_COMTP
  swc implementation IoHwAb_QM_LF_COMTP_Implementation: behavior=IoHwAb_QM_LF_COMTP_InternalBehavior
