AUTOSAR XML (schema 4-3-0)
package /VehicleProject
  system System
    root-software-compositions:
      root sw composition prototype EcuSwComposition: software-composition=ECU_Composition
package /ECUCompositionTypes
  composition sw component type ECU_Composition
