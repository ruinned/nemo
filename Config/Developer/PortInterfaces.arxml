AUTOSAR XML (schema 4-3-0)
package /Predefined_DEV/PortInterfaces
  43 x client server interface:
    NvMNotifyInitBlock: is-service=true
      operation InitBlock
    NvSWC_NvMNotifyInitBlock
      operation InitBlock
    NvMAdministration: is-service=true
      operation SetBlockProtection: possible-error=NvMAdministration/E_NOT_OK
        arg ProtectionEnabled: type=boolean, direction=IN, server-argument-impl-policy=USE-ARGUMENT-TYPE
      error E_NOT_OK: error-code=1
    NvSWC_NvMAdministration
      operation SetBlockProtection: possible-error=NvSWC_NvMAdministration/E_NOT_OK
        arg ProtectionEnabled: type=boolean, direction=IN, server-argument-impl-policy=USE-ARGUMENT-TYPE
      error E_NOT_OK: error-code=1
    NvMService: is-service=true
      operation GetErrorStatus: possible-error=NvMService/E_NOT_OK
        arg ErrorStatus: type=NvM_RequestResultType, direction=OUT, server-argument-impl-policy=USE-ARGUMENT-TYPE
      error E_NOT_OK: error-code=1
    NvMService_AC2: is-service=true
      operation GetErrorStatus: possible-error=NvMService_AC2/E_NOT_OK
        arg ErrorStatus: type=NvM_RequestResultType, direction=OUT, server-argument-impl-policy=USE-ARGUMENT-TYPE
      operation ReadBlock: possible-error=NvMService_AC2/E_NOT_OK
        arg DstPtr: type=dtRef_VOID, direction=IN, server-argument-impl-policy=USE-ARGUMENT-TYPE
      operation WriteBlock: possible-error=NvMService_AC2/E_NOT_OK
        arg SrcPtr: type=dtRef_const_VOID, direction=IN, server-argument-impl-policy=USE-ARGUMENT-TYPE
      error E_NOT_OK: error-code=1
    NvMService_AC2_Defs: is-service=true
      4 x operation, all with possible-error=NvMService_AC2_Defs/E_NOT_OK:
        GetErrorStatus
          arg ErrorStatus: type=NvM_RequestResultType, direction=OUT, server-argument-impl-policy=USE-ARGUMENT-TYPE
        ReadBlock
          arg DstPtr: type=dtRef_VOID, direction=IN, server-argument-impl-policy=USE-ARGUMENT-TYPE
        RestoreBlockDefaults
          arg DstPtr: type=dtRef_VOID, direction=IN, server-argument-impl-policy=USE-ARGUMENT-TYPE
        WriteBlock
          arg SrcPtr: type=dtRef_const_VOID, direction=IN, server-argument-impl-policy=USE-ARGUMENT-TYPE
      error E_NOT_OK: error-code=1
    NvMService_AC2_DS: is-service=true
      5 x operation, all with possible-error=NvMService_AC2_DS/E_NOT_OK:
        GetDataIndex
          arg DataIndex: type=uint8, direction=OUT, server-argument-impl-policy=USE-ARGUMENT-TYPE
        GetErrorStatus
          arg ErrorStatus: type=NvM_RequestResultType, direction=OUT, server-argument-impl-policy=USE-ARGUMENT-TYPE
        ReadBlock
          arg DstPtr: type=dtRef_VOID, direction=IN, server-argument-impl-policy=USE-ARGUMENT-TYPE
        SetDataIndex
          arg DataIndex: type=uint8, direction=IN, server-argument-impl-policy=USE-ARGUMENT-TYPE
        WriteBlock
          arg SrcPtr: type=dtRef_const_VOID, direction=IN, server-argument-impl-policy=USE-ARGUMENT-TYPE
      error E_NOT_OK: error-code=1
    NvMService_AC2_DS_Defs: is-service=true
      6 x operation, all with possible-error=NvMService_AC2_DS_Defs/E_NOT_OK:
        GetDataIndex
          arg DataIndex: type=uint8, direction=OUT, server-argument-impl-policy=USE-ARGUMENT-TYPE
        GetErrorStatus
          arg ErrorStatus: type=NvM_RequestResultType, direction=OUT, server-argument-impl-policy=USE-ARGUMENT-TYPE
        ReadBlock
          arg DstPtr: type=dtRef_VOID, direction=IN, server-argument-impl-policy=USE-ARGUMENT-TYPE
        RestoreBlockDefaults
          arg DstPtr: type=dtRef_VOID, direction=IN, server-argument-impl-policy=USE-ARGUMENT-TYPE
        SetDataIndex
          arg DataIndex: type=uint8, direction=IN, server-argument-impl-policy=USE-ARGUMENT-TYPE
        WriteBlock
          arg SrcPtr: type=dtRef_const_VOID, direction=IN, server-argument-impl-policy=USE-ARGUMENT-TYPE
      error E_NOT_OK: error-code=1
    NvMService_AC2_SRBS: is-service=true
      4 x operation, all with possible-error=NvMService_AC2_SRBS/E_NOT_OK:
        GetErrorStatus
          arg ErrorStatus: type=NvM_RequestResultType, direction=OUT, server-argument-impl-policy=USE-ARGUMENT-TYPE
        ReadBlock
          arg DstPtr: type=dtRef_VOID, direction=IN, server-argument-impl-policy=USE-ARGUMENT-TYPE
        SetRamBlockStatus
          arg RamBlockStatus: type=boolean, direction=IN, server-argument-impl-policy=USE-ARGUMENT-TYPE
        WriteBlock
          arg SrcPtr: type=dtRef_const_VOID, direction=IN, server-argument-impl-policy=USE-ARGUMENT-TYPE
      error E_NOT_OK: error-code=1
    NvMService_AC2_SRBS_Defs: is-service=true
      5 x operation, all with possible-error=NvMService_AC2_SRBS_Defs/E_NOT_OK:
        GetErrorStatus
          arg ErrorStatus: type=NvM_RequestResultType, direction=OUT, server-argument-impl-policy=USE-ARGUMENT-TYPE
        ReadBlock
          arg DstPtr: type=dtRef_VOID, direction=IN, server-argument-impl-policy=USE-ARGUMENT-TYPE
        RestoreBlockDefaults
          arg DstPtr: type=dtRef_VOID, direction=IN, server-argument-impl-policy=USE-ARGUMENT-TYPE
        SetRamBlockStatus
          arg RamBlockStatus: type=boolean, direction=IN, server-argument-impl-policy=USE-ARGUMENT-TYPE
        WriteBlock
          arg SrcPtr: type=dtRef_const_VOID, direction=IN, server-argument-impl-policy=USE-ARGUMENT-TYPE
      error E_NOT_OK: error-code=1
    NvMService_AC2_SRBS_DS: is-service=true
      6 x operation, all with possible-error=NvMService_AC2_SRBS_DS/E_NOT_OK:
        GetDataIndex
          arg DataIndex: type=uint8, direction=OUT, server-argument-impl-policy=USE-ARGUMENT-TYPE
        GetErrorStatus
          arg ErrorStatus: type=NvM_RequestResultType, direction=OUT, server-argument-impl-policy=USE-ARGUMENT-TYPE
        ReadBlock
          arg DstPtr: type=dtRef_VOID, direction=IN, server-argument-impl-policy=USE-ARGUMENT-TYPE
        SetDataIndex
          arg DataIndex: type=uint8, direction=IN, server-argument-impl-policy=USE-ARGUMENT-TYPE
        SetRamBlockStatus
          arg RamBlockStatus: type=boolean, direction=IN, server-argument-impl-policy=USE-ARGUMENT-TYPE
        WriteBlock
          arg SrcPtr: type=dtRef_const_VOID, direction=IN, server-argument-impl-policy=USE-ARGUMENT-TYPE
      error E_NOT_OK: error-code=1
    NvMService_AC2_SRBS_DS_Defs: is-service=true
      7 x operation, all with possible-error=NvMService_AC2_SRBS_DS_Defs/E_NOT_OK:
        GetDataIndex
          arg DataIndex: type=uint8, direction=OUT, server-argument-impl-policy=USE-ARGUMENT-TYPE
        GetErrorStatus
          arg ErrorStatus: type=NvM_RequestResultType, direction=OUT, server-argument-impl-policy=USE-ARGUMENT-TYPE
        ReadBlock
          arg DstPtr: type=dtRef_VOID, direction=IN, server-argument-impl-policy=USE-ARGUMENT-TYPE
        RestoreBlockDefaults
          arg DstPtr: type=dtRef_VOID, direction=IN, server-argument-impl-policy=USE-ARGUMENT-TYPE
        SetDataIndex
          arg DataIndex: type=uint8, direction=IN, server-argument-impl-policy=USE-ARGUMENT-TYPE
        SetRamBlockStatus
          arg RamBlockStatus: type=boolean, direction=IN, server-argument-impl-policy=USE-ARGUMENT-TYPE
        WriteBlock
          arg SrcPtr: type=dtRef_const_VOID, direction=IN, server-argument-impl-policy=USE-ARGUMENT-TYPE
      error E_NOT_OK: error-code=1
    NvMService_AC3: is-service=true
      5 x operation, all with possible-error=NvMService_AC3/E_NOT_OK:
        EraseBlock
        GetErrorStatus
          arg ErrorStatus: type=NvM_RequestResultType, direction=OUT, server-argument-impl-policy=USE-ARGUMENT-TYPE
        InvalidateNvBlock
        ReadBlock
          arg DstPtr: type=dtRef_VOID, direction=IN, server-argument-impl-policy=USE-ARGUMENT-TYPE
        WriteBlock
          arg SrcPtr: type=dtRef_const_VOID, direction=IN, server-argument-impl-policy=USE-ARGUMENT-TYPE
      error E_NOT_OK: error-code=1
    NvMService_AC3_Defs: is-service=true
      6 x operation, all with possible-error=NvMService_AC3_Defs/E_NOT_OK:
        EraseBlock
        GetErrorStatus
          arg ErrorStatus: type=NvM_RequestResultType, direction=OUT, server-argument-impl-policy=USE-ARGUMENT-TYPE
        InvalidateNvBlock
        ReadBlock
          arg DstPtr: type=dtRef_VOID, direction=IN, server-argument-impl-policy=USE-ARGUMENT-TYPE
        RestoreBlockDefaults
          arg DstPtr: type=dtRef_VOID, direction=IN, server-argument-impl-policy=USE-ARGUMENT-TYPE
        WriteBlock
          arg SrcPtr: type=dtRef_const_VOID, direction=IN, server-argument-impl-policy=USE-ARGUMENT-TYPE
      error E_NOT_OK: error-code=1
    NvMService_AC3_DS: is-service=true
      7 x operation, all with possible-error=NvMService_AC3_DS/E_NOT_OK:
        EraseBlock
        GetDataIndex
          arg DataIndex: type=uint8, direction=OUT, server-argument-impl-policy=USE-ARGUMENT-TYPE
        GetErrorStatus
          arg ErrorStatus: type=NvM_RequestResultType, direction=OUT, server-argument-impl-policy=USE-ARGUMENT-TYPE
        InvalidateNvBlock
        ReadBlock
          arg DstPtr: type=dtRef_VOID, direction=IN, server-argument-impl-policy=USE-ARGUMENT-TYPE
        SetDataIndex
          arg DataIndex: type=uint8, direction=IN, server-argument-impl-policy=USE-ARGUMENT-TYPE
        WriteBlock
          arg SrcPtr: type=dtRef_const_VOID, direction=IN, server-argument-impl-policy=USE-ARGUMENT-TYPE
      error E_NOT_OK: error-code=1
    NvMService_AC3_DS_Defs: is-service=true
      8 x operation, all with possible-error=NvMService_AC3_DS_Defs/E_NOT_OK:
        EraseBlock
        GetDataIndex
          arg DataIndex: type=uint8, direction=OUT, server-argument-impl-policy=USE-ARGUMENT-TYPE
        GetErrorStatus
          arg ErrorStatus: type=NvM_RequestResultType, direction=OUT, server-argument-impl-policy=USE-ARGUMENT-TYPE
        InvalidateNvBlock
        ReadBlock
          arg DstPtr: type=dtRef_VOID, direction=IN, server-argument-impl-policy=USE-ARGUMENT-TYPE
        RestoreBlockDefaults
          arg DstPtr: type=dtRef_VOID, direction=IN, server-argument-impl-policy=USE-ARGUMENT-TYPE
        SetDataIndex
          arg DataIndex: type=uint8, direction=IN, server-argument-impl-policy=USE-ARGUMENT-TYPE
        WriteBlock
          arg SrcPtr: type=dtRef_const_VOID, direction=IN, server-argument-impl-policy=USE-ARGUMENT-TYPE
      error E_NOT_OK: error-code=1
    NvMService_AC3_SRBS: is-service=true
      6 x operation, all with possible-error=NvMService_AC3_SRBS/E_NOT_OK:
        EraseBlock
        GetErrorStatus
          arg ErrorStatus: type=NvM_RequestResultType, direction=OUT, server-argument-impl-policy=USE-ARGUMENT-TYPE
        InvalidateNvBlock
        ReadBlock
          arg DstPtr: type=dtRef_VOID, direction=IN, server-argument-impl-policy=USE-ARGUMENT-TYPE
        SetRamBlockStatus
          arg RamBlockStatus: type=boolean, direction=IN, server-argument-impl-policy=USE-ARGUMENT-TYPE
        WriteBlock
          arg SrcPtr: type=dtRef_const_VOID, direction=IN, server-argument-impl-policy=USE-ARGUMENT-TYPE
      error E_NOT_OK: error-code=1
    NvMService_AC3_SRBS_Defs: is-service=true
      7 x operation, all with possible-error=NvMService_AC3_SRBS_Defs/E_NOT_OK:
        EraseBlock
        GetErrorStatus
          arg ErrorStatus: type=NvM_RequestResultType, direction=OUT, server-argument-impl-policy=USE-ARGUMENT-TYPE
        InvalidateNvBlock
        ReadBlock
          arg DstPtr: type=dtRef_VOID, direction=IN, server-argument-impl-policy=USE-ARGUMENT-TYPE
        RestoreBlockDefaults
          arg DstPtr: type=dtRef_VOID, direction=IN, server-argument-impl-policy=USE-ARGUMENT-TYPE
        SetRamBlockStatus
          arg RamBlockStatus: type=boolean, direction=IN, server-argument-impl-policy=USE-ARGUMENT-TYPE
        WriteBlock
          arg SrcPtr: type=dtRef_const_VOID, direction=IN, server-argument-impl-policy=USE-ARGUMENT-TYPE
      error E_NOT_OK: error-code=1
    NvMService_AC3_SRBS_DS: is-service=true
      8 x operation, all with possible-error=NvMService_AC3_SRBS_DS/E_NOT_OK:
        EraseBlock
        GetDataIndex
          arg DataIndex: type=uint8, direction=OUT, server-argument-impl-policy=USE-ARGUMENT-TYPE
        GetErrorStatus
          arg ErrorStatus: type=NvM_RequestResultType, direction=OUT, server-argument-impl-policy=USE-ARGUMENT-TYPE
        InvalidateNvBlock
        ReadBlock
          arg DstPtr: type=dtRef_VOID, direction=IN, server-argument-impl-policy=USE-ARGUMENT-TYPE
        SetDataIndex
          arg DataIndex: type=uint8, direction=IN, server-argument-impl-policy=USE-ARGUMENT-TYPE
        SetRamBlockStatus
          arg RamBlockStatus: type=boolean, direction=IN, server-argument-impl-policy=USE-ARGUMENT-TYPE
        WriteBlock
          arg SrcPtr: type=dtRef_const_VOID, direction=IN, server-argument-impl-policy=USE-ARGUMENT-TYPE
      error E_NOT_OK: error-code=1
    NvMService_AC3_SRBS_DS_Defs: is-service=true
      9 x operation, all with possible-error=NvMService_AC3_SRBS_DS_Defs/E_NOT_OK:
        EraseBlock
        GetDataIndex
          arg DataIndex: type=uint8, direction=OUT, server-argument-impl-policy=USE-ARGUMENT-TYPE
        GetErrorStatus
          arg ErrorStatus: type=NvM_RequestResultType, direction=OUT, server-argument-impl-policy=USE-ARGUMENT-TYPE
        InvalidateNvBlock
        ReadBlock
          arg DstPtr: type=dtRef_VOID, direction=IN, server-argument-impl-policy=USE-ARGUMENT-TYPE
        RestoreBlockDefaults
          arg DstPtr: type=dtRef_VOID, direction=IN, server-argument-impl-policy=USE-ARGUMENT-TYPE
        SetDataIndex
          arg DataIndex: type=uint8, direction=IN, server-argument-impl-policy=USE-ARGUMENT-TYPE
        SetRamBlockStatus
          arg RamBlockStatus: type=boolean, direction=IN, server-argument-impl-policy=USE-ARGUMENT-TYPE
        WriteBlock
          arg SrcPtr: type=dtRef_const_VOID, direction=IN, server-argument-impl-policy=USE-ARGUMENT-TYPE
      error E_NOT_OK: error-code=1
    NvMService_SRBS: is-service=true
      operation GetErrorStatus: possible-error=NvMService_SRBS/E_NOT_OK
        arg ErrorStatus: type=NvM_RequestResultType, direction=OUT, server-argument-impl-policy=USE-ARGUMENT-TYPE
      operation SetRamBlockStatus: possible-error=NvMService_SRBS/E_NOT_OK
        arg RamBlockStatus: type=boolean, direction=IN, server-argument-impl-policy=USE-ARGUMENT-TYPE
      error E_NOT_OK: error-code=1
    NvSWC_NvMService
      operation GetErrorStatus: possible-error=NvSWC_NvMService/E_NOT_OK
        arg ErrorStatus: type=NvM_RequestResultType, direction=OUT, server-argument-impl-policy=USE-ARGUMENT-TYPE
      error E_NOT_OK: error-code=1
    NvSWC_NvMService_AC2
      operation GetErrorStatus: possible-error=NvSWC_NvMService_AC2/E_NOT_OK
        arg ErrorStatus: type=NvM_RequestResultType, direction=OUT, server-argument-impl-policy=USE-ARGUMENT-TYPE
      operation ReadBlock: possible-error=NvSWC_NvMService_AC2/E_NOT_OK
        arg DstPtr: type=dtRef_VOID, direction=IN, server-argument-impl-policy=USE-ARGUMENT-TYPE
      operation WriteBlock: possible-error=NvSWC_NvMService_AC2/E_NOT_OK
        arg SrcPtr: type=dtRef_const_VOID, direction=IN, server-argument-impl-policy=USE-ARGUMENT-TYPE
      error E_NOT_OK: error-code=1
    NvSWC_NvMService_AC2_Defs
      4 x operation, all with possible-error=NvSWC_NvMService_AC2_Defs/E_NOT_OK:
        GetErrorStatus
          arg ErrorStatus: type=NvM_RequestResultType, direction=OUT, server-argument-impl-policy=USE-ARGUMENT-TYPE
        ReadBlock
          arg DstPtr: type=dtRef_VOID, direction=IN, server-argument-impl-policy=USE-ARGUMENT-TYPE
        RestoreBlockDefaults
          arg DstPtr: type=dtRef_VOID, direction=IN, server-argument-impl-policy=USE-ARGUMENT-TYPE
        WriteBlock
          arg SrcPtr: type=dtRef_const_VOID, direction=IN, server-argument-impl-policy=USE-ARGUMENT-TYPE
      error E_NOT_OK: error-code=1
    NvSWC_NvMService_AC2_DS
      5 x operation, all with possible-error=NvSWC_NvMService_AC2_DS/E_NOT_OK:
        GetDataIndex
          arg DataIndex: type=uint8, direction=OUT, server-argument-impl-policy=USE-ARGUMENT-TYPE
        GetErrorStatus
          arg ErrorStatus: type=NvM_RequestResultType, direction=OUT, server-argument-impl-policy=USE-ARGUMENT-TYPE
        ReadBlock
          arg DstPtr: type=dtRef_VOID, direction=IN, server-argument-impl-policy=USE-ARGUMENT-TYPE
        SetDataIndex
          arg DataIndex: type=uint8, direction=IN, server-argument-impl-policy=USE-ARGUMENT-TYPE
        WriteBlock
          arg SrcPtr: type=dtRef_const_VOID, direction=IN, server-argument-impl-policy=USE-ARGUMENT-TYPE
      error E_NOT_OK: error-code=1
    NvSWC_NvMService_AC2_DS_Defs
      6 x operation, all with possible-error=NvSWC_NvMService_AC2_DS_Defs/E_NOT_OK:
        GetDataIndex
          arg DataIndex: type=uint8, direction=OUT, server-argument-impl-policy=USE-ARGUMENT-TYPE
        GetErrorStatus
          arg ErrorStatus: type=NvM_RequestResultType, direction=OUT, server-argument-impl-policy=USE-ARGUMENT-TYPE
        ReadBlock
          arg DstPtr: type=dtRef_VOID, direction=IN, server-argument-impl-policy=USE-ARGUMENT-TYPE
        RestoreBlockDefaults
          arg DstPtr: type=dtRef_VOID, direction=IN, server-argument-impl-policy=USE-ARGUMENT-TYPE
        SetDataIndex
          arg DataIndex: type=uint8, direction=IN, server-argument-impl-policy=USE-ARGUMENT-TYPE
        WriteBlock
          arg SrcPtr: type=dtRef_const_VOID, direction=IN, server-argument-impl-policy=USE-ARGUMENT-TYPE
      error E_NOT_OK: error-code=1
    NvSWC_NvMService_AC2_SRBS
      4 x operation, all with possible-error=NvSWC_NvMService_AC2_SRBS/E_NOT_OK:
        GetErrorStatus
          arg ErrorStatus: type=NvM_RequestResultType, direction=OUT, server-argument-impl-policy=USE-ARGUMENT-TYPE
        ReadBlock
          arg DstPtr: type=dtRef_VOID, direction=IN, server-argument-impl-policy=USE-ARGUMENT-TYPE
        SetRamBlockStatus
          arg RamBlockStatus: type=boolean, direction=IN, server-argument-impl-policy=USE-ARGUMENT-TYPE
        WriteBlock
          arg SrcPtr: type=dtRef_const_VOID, direction=IN, server-argument-impl-policy=USE-ARGUMENT-TYPE
      error E_NOT_OK: error-code=1
    NvSWC_NvMService_AC2_SRBS_Defs
      5 x operation, all with possible-error=NvSWC_NvMService_AC2_SRBS_Defs/E_NOT_OK:
        GetErrorStatus
          arg ErrorStatus: type=NvM_RequestResultType, direction=OUT, server-argument-impl-policy=USE-ARGUMENT-TYPE
        ReadBlock
          arg DstPtr: type=dtRef_VOID, direction=IN, server-argument-impl-policy=USE-ARGUMENT-TYPE
        RestoreBlockDefaults
          arg DstPtr: type=dtRef_VOID, direction=IN, server-argument-impl-policy=USE-ARGUMENT-TYPE
        SetRamBlockStatus
          arg RamBlockStatus: type=boolean, direction=IN, server-argument-impl-policy=USE-ARGUMENT-TYPE
        WriteBlock
          arg SrcPtr: type=dtRef_const_VOID, direction=IN, server-argument-impl-policy=USE-ARGUMENT-TYPE
      error E_NOT_OK: error-code=1
    NvSWC_NvMService_AC2_SRBS_DS
      6 x operation, all with possible-error=NvSWC_NvMService_AC2_SRBS_DS/E_NOT_OK:
        GetDataIndex
          arg DataIndex: type=uint8, direction=OUT, server-argument-impl-policy=USE-ARGUMENT-TYPE
        GetErrorStatus
          arg ErrorStatus: type=NvM_RequestResultType, direction=OUT, server-argument-impl-policy=USE-ARGUMENT-TYPE
        ReadBlock
          arg DstPtr: type=dtRef_VOID, direction=IN, server-argument-impl-policy=USE-ARGUMENT-TYPE
        SetDataIndex
          arg DataIndex: type=uint8, direction=IN, server-argument-impl-policy=USE-ARGUMENT-TYPE
        SetRamBlockStatus
          arg RamBlockStatus: type=boolean, direction=IN, server-argument-impl-policy=USE-ARGUMENT-TYPE
        WriteBlock
          arg SrcPtr: type=dtRef_const_VOID, direction=IN, server-argument-impl-policy=USE-ARGUMENT-TYPE
      error E_NOT_OK: error-code=1
    NvSWC_NvMService_AC2_SRBS_DS_Defs
      7 x operation, all with possible-error=NvSWC_NvMService_AC2_SRBS_DS_Defs/E_NOT_OK:
        GetDataIndex
          arg DataIndex: type=uint8, direction=OUT, server-argument-impl-policy=USE-ARGUMENT-TYPE
        GetErrorStatus
          arg ErrorStatus: type=NvM_RequestResultType, direction=OUT, server-argument-impl-policy=USE-ARGUMENT-TYPE
        ReadBlock
          arg DstPtr: type=dtRef_VOID, direction=IN, server-argument-impl-policy=USE-ARGUMENT-TYPE
        RestoreBlockDefaults
          arg DstPtr: type=dtRef_VOID, direction=IN, server-argument-impl-policy=USE-ARGUMENT-TYPE
        SetDataIndex
          arg DataIndex: type=uint8, direction=IN, server-argument-impl-policy=USE-ARGUMENT-TYPE
        SetRamBlockStatus
          arg RamBlockStatus: type=boolean, direction=IN, server-argument-impl-policy=USE-ARGUMENT-TYPE
        WriteBlock
          arg SrcPtr: type=dtRef_const_VOID, direction=IN, server-argument-impl-policy=USE-ARGUMENT-TYPE
      error E_NOT_OK: error-code=1
    NvSWC_NvMService_AC3
      5 x operation, all with possible-error=NvSWC_NvMService_AC3/E_NOT_OK:
        EraseBlock
        GetErrorStatus
          arg ErrorStatus: type=NvM_RequestResultType, direction=OUT, server-argument-impl-policy=USE-ARGUMENT-TYPE
        InvalidateNvBlock
        ReadBlock
          arg DstPtr: type=dtRef_VOID, direction=IN, server-argument-impl-policy=USE-ARGUMENT-TYPE
        WriteBlock
          arg SrcPtr: type=dtRef_const_VOID, direction=IN, server-argument-impl-policy=USE-ARGUMENT-TYPE
      error E_NOT_OK: error-code=1
    NvSWC_NvMService_AC3_Defs
      6 x operation, all with possible-error=NvSWC_NvMService_AC3_Defs/E_NOT_OK:
        EraseBlock
        GetErrorStatus
          arg ErrorStatus: type=NvM_RequestResultType, direction=OUT, server-argument-impl-policy=USE-ARGUMENT-TYPE
        InvalidateNvBlock
        ReadBlock
          arg DstPtr: type=dtRef_VOID, direction=IN, server-argument-impl-policy=USE-ARGUMENT-TYPE
        RestoreBlockDefaults
          arg DstPtr: type=dtRef_VOID, direction=IN, server-argument-impl-policy=USE-ARGUMENT-TYPE
        WriteBlock
          arg SrcPtr: type=dtRef_const_VOID, direction=IN, server-argument-impl-policy=USE-ARGUMENT-TYPE
      error E_NOT_OK: error-code=1
    NvSWC_NvMService_AC3_DS
      7 x operation, all with possible-error=NvSWC_NvMService_AC3_DS/E_NOT_OK:
        EraseBlock
        GetDataIndex
          arg DataIndex: type=uint8, direction=OUT, server-argument-impl-policy=USE-ARGUMENT-TYPE
        GetErrorStatus
          arg ErrorStatus: type=NvM_RequestResultType, direction=OUT, server-argument-impl-policy=USE-ARGUMENT-TYPE
        InvalidateNvBlock
        ReadBlock
          arg DstPtr: type=dtRef_VOID, direction=IN, server-argument-impl-policy=USE-ARGUMENT-TYPE
        SetDataIndex
          arg DataIndex: type=uint8, direction=IN, server-argument-impl-policy=USE-ARGUMENT-TYPE
        WriteBlock
          arg SrcPtr: type=dtRef_const_VOID, direction=IN, server-argument-impl-policy=USE-ARGUMENT-TYPE
      error E_NOT_OK: error-code=1
    NvSWC_NvMService_AC3_DS_Defs
      8 x operation, all with possible-error=NvSWC_NvMService_AC3_DS_Defs/E_NOT_OK:
        EraseBlock
        GetDataIndex
          arg DataIndex: type=uint8, direction=OUT, server-argument-impl-policy=USE-ARGUMENT-TYPE
        GetErrorStatus
          arg ErrorStatus: type=NvM_RequestResultType, direction=OUT, server-argument-impl-policy=USE-ARGUMENT-TYPE
        InvalidateNvBlock
        ReadBlock
          arg DstPtr: type=dtRef_VOID, direction=IN, server-argument-impl-policy=USE-ARGUMENT-TYPE
        RestoreBlockDefaults
          arg DstPtr: type=dtRef_VOID, direction=IN, server-argument-impl-policy=USE-ARGUMENT-TYPE
        SetDataIndex
          arg DataIndex: type=uint8, direction=IN, server-argument-impl-policy=USE-ARGUMENT-TYPE
        WriteBlock
          arg SrcPtr: type=dtRef_const_VOID, direction=IN, server-argument-impl-policy=USE-ARGUMENT-TYPE
      error E_NOT_OK: error-code=1
    NvSWC_NvMService_AC3_SRBS
      6 x operation, all with possible-error=NvSWC_NvMService_AC3_SRBS/E_NOT_OK:
        EraseBlock
        GetErrorStatus
          arg ErrorStatus: type=NvM_RequestResultType, direction=OUT, server-argument-impl-policy=USE-ARGUMENT-TYPE
        InvalidateNvBlock
        ReadBlock
          arg DstPtr: type=dtRef_VOID, direction=IN, server-argument-impl-policy=USE-ARGUMENT-TYPE
        SetRamBlockStatus
          arg RamBlockStatus: type=boolean, direction=IN, server-argument-impl-policy=USE-ARGUMENT-TYPE
        WriteBlock
          arg SrcPtr: type=dtRef_const_VOID, direction=IN, server-argument-impl-policy=USE-ARGUMENT-TYPE
      error E_NOT_OK: error-code=1
    NvSWC_NvMService_AC3_SRBS_Defs
      7 x operation, all with possible-error=NvSWC_NvMService_AC3_SRBS_Defs/E_NOT_OK:
        EraseBlock
        GetErrorStatus
          arg ErrorStatus: type=NvM_RequestResultType, direction=OUT, server-argument-impl-policy=USE-ARGUMENT-TYPE
        InvalidateNvBlock
        ReadBlock
          arg DstPtr: type=dtRef_VOID, direction=IN, server-argument-impl-policy=USE-ARGUMENT-TYPE
        RestoreBlockDefaults
          arg DstPtr: type=dtRef_VOID, direction=IN, server-argument-impl-policy=USE-ARGUMENT-TYPE
        SetRamBlockStatus
          arg RamBlockStatus: type=boolean, direction=IN, server-argument-impl-policy=USE-ARGUMENT-TYPE
        WriteBlock
          arg SrcPtr: type=dtRef_const_VOID, direction=IN, server-argument-impl-policy=USE-ARGUMENT-TYPE
      error E_NOT_OK: error-code=1
    NvSWC_NvMService_AC3_SRBS_DS
      8 x operation, all with possible-error=NvSWC_NvMService_AC3_SRBS_DS/E_NOT_OK:
        EraseBlock
        GetDataIndex
          arg DataIndex: type=uint8, direction=OUT, server-argument-impl-policy=USE-ARGUMENT-TYPE
        GetErrorStatus
          arg ErrorStatus: type=NvM_RequestResultType, direction=OUT, server-argument-impl-policy=USE-ARGUMENT-TYPE
        InvalidateNvBlock
        ReadBlock
          arg DstPtr: type=dtRef_VOID, direction=IN, server-argument-impl-policy=USE-ARGUMENT-TYPE
        SetDataIndex
          arg DataIndex: type=uint8, direction=IN, server-argument-impl-policy=USE-ARGUMENT-TYPE
        SetRamBlockStatus
          arg RamBlockStatus: type=boolean, direction=IN, server-argument-impl-policy=USE-ARGUMENT-TYPE
        WriteBlock
          arg SrcPtr: type=dtRef_const_VOID, direction=IN, server-argument-impl-policy=USE-ARGUMENT-TYPE
      error E_NOT_OK: error-code=1
    NvSWC_NvMService_AC3_SRBS_DS_Defs
      9 x operation, all with possible-error=NvSWC_NvMService_AC3_SRBS_DS_Defs/E_NOT_OK:
        EraseBlock
        GetDataIndex
          arg DataIndex: type=uint8, direction=OUT, server-argument-impl-policy=USE-ARGUMENT-TYPE
        GetErrorStatus
          arg ErrorStatus: type=NvM_RequestResultType, direction=OUT, server-argument-impl-policy=USE-ARGUMENT-TYPE
        InvalidateNvBlock
        ReadBlock
          arg DstPtr: type=dtRef_VOID, direction=IN, server-argument-impl-policy=USE-ARGUMENT-TYPE
        RestoreBlockDefaults
          arg DstPtr: type=dtRef_VOID, direction=IN, server-argument-impl-policy=USE-ARGUMENT-TYPE
        SetDataIndex
          arg DataIndex: type=uint8, direction=IN, server-argument-impl-policy=USE-ARGUMENT-TYPE
        SetRamBlockStatus
          arg RamBlockStatus: type=boolean, direction=IN, server-argument-impl-policy=USE-ARGUMENT-TYPE
        WriteBlock
          arg SrcPtr: type=dtRef_const_VOID, direction=IN, server-argument-impl-policy=USE-ARGUMENT-TYPE
      error E_NOT_OK: error-code=1
    NvSWC_NvMService_SRBS
      operation GetErrorStatus: possible-error=NvSWC_NvMService_SRBS/E_NOT_OK
        arg ErrorStatus: type=NvM_RequestResultType, direction=OUT, server-argument-impl-policy=USE-ARGUMENT-TYPE
      operation SetRamBlockStatus: possible-error=NvSWC_NvMService_SRBS/E_NOT_OK
        arg RamBlockStatus: type=boolean, direction=IN, server-argument-impl-policy=USE-ARGUMENT-TYPE
      error E_NOT_OK: error-code=1
    NvMNotifyJobFinished: is-service=true
      operation JobFinished
        arg ServiceId: type=NvM_ServiceIdType, direction=IN, server-argument-impl-policy=USE-ARGUMENT-TYPE
        arg JobResult: type=NvM_RequestResultType, direction=IN, server-argument-impl-policy=USE-ARGUMENT-TYPE
    NvSWC_NvMNotifyJobFinished
      operation JobFinished
        arg ServiceId: type=NvM_ServiceIdType, direction=IN, server-argument-impl-policy=USE-ARGUMENT-TYPE
        arg JobResult: type=NvM_RequestResultType, direction=IN, server-argument-impl-policy=USE-ARGUMENT-TYPE
    CallbackDTCStatusChange: is-service=true, service-kind=DIAGNOSTIC-EVENT-MANAGER
      operation DTCStatusChanged: possible-error=CallbackDTCStatusChange/E_NOT_OK
        arg DTC: type=uint32, direction=IN, server-argument-impl-policy=USE-ARGUMENT-TYPE
        arg DTCStatusOld: type=Dem_UdsStatusByteType, direction=IN, server-argument-impl-policy=USE-ARGUMENT-TYPE
        arg DTCStatusNew: type=Dem_UdsStatusByteType, direction=IN, server-argument-impl-policy=USE-ARGUMENT-TYPE
      error E_NOT_OK: error-code=1
package /PortInterfaces
  126 x sender receiver interface:
    SwitchDetectionNeeded2L3
      data SwitchDetectionNeeded2L3: type=SwitchDetectionNeeded2L3
    FSP1SwitchStatusL3
      data FSP1SwitchStatusL3: type=FSP1SwitchStatusL3
    FSP2SwitchStatusL3
      data FSP2SwitchStatusL3: type=FSP2SwitchStatusL3
    FSP2DiagInfoL3
      data FSP2DiagInfoL3: type=FSP2DiagInfoL3
    FSP1ResponseErrorL3
      data FSP1ResponseErrorL3: type=FSP1ResponseErrorL3
    LIN_TCP_KnobPostionStatus
      data LIN_TCP_KnobPostionStatus: type=LIN_TCP_KnobPostionStatus
    SwitchDetectionNeeded1L3
      data SwitchDetectionNeeded1L3: type=SwitchDetectionNeeded1L3
    FSP1DiagInfoL3
      data FSP1DiagInfoL3: type=FSP1DiagInfoL3
    SwitchDetectionResp2L3
      data SwitchDetectionResp2L3: type=SwitchDetectionResp2L3
    SwitchDetectionResp1L3
      data SwitchDetectionResp1L3: type=SwitchDetectionResp1L3
    ResponseErrorTCP
      data ResponseErrorTCP: type=ResponseErrorTCP
    LIN_TCP_ABS_ButtonStatus
      data LIN_TCP_ABS_ButtonStatus: type=LIN_TCP_ABS_ButtonStatus
    LIN_TCP_TCS_ButtonStatus
      data LIN_TCP_TCS_ButtonStatus: type=LIN_TCP_TCS_ButtonStatus
    FSP2ResponseErrorL3
      data FSP2ResponseErrorL3: type=FSP2ResponseErrorL3
    DiagInfoTCP
      data DiagInfoTCP: type=DiagInfoTCP
    LIN_TCP_ATC_ButtonStatus
      data LIN_TCP_ATC_ButtonStatus: type=LIN_TCP_ATC_ButtonStatus
    LIN_TCP_ESC_ButtonStatus
      data LIN_TCP_ESC_ButtonStatus: type=LIN_TCP_ESC_ButtonStatus
    ATC_Indication
      data ATC_Indication: type=ATC_Indication
    ABS_Indication
      data ABS_Indication: type=ABS_Indication
    ESC_Indication
      data ESC_Indication: type=ESC_Indication
    FSP1IndicationCmdL3
      data FSP1IndicationCmdL3: type=FSP1IndicationCmdL3
    TCS_Indication
      data TCS_Indication: type=TCS_Indication
    FSP2IndicationCmdL3
      data FSP2IndicationCmdL3: type=FSP2IndicationCmdL3
    Debug_PVT_Fob_1BTN_ID
      data Debug_PVT_Fob_1BTN_ID: type=Debug_PVT_Fob_1BTN_ID
    Debug_PVT_Fob_2BTN_ID
      data Debug_PVT_Fob_2BTN_ID: type=Debug_PVT_Fob_2BTN_ID
    Debug_PVT_Fob_ID
      data Debug_PVT_Fob_ID: type=Debug_PVT_Fob_ID
    Debug_PVT_Fob_RF_RollingCounter
      data Debug_PVT_Fob_RF_RollingCounter: type=Debug_PVT_Fob_RF_RollingCounter
    Debug_PVT_Fob_Select
      data Debug_PVT_Fob_Select: type=Debug_PVT_Fob_Select
    Debug_PVT_Fob_Volt_Low
      data Debug_PVT_Fob_Volt_Low: type=Debug_PVT_Fob_Volt_Low
    Debug_PVT_SCIM_Ctrl_12VDCDC
      data Debug_PVT_SCIM_Ctrl_12VDCDC: type=Debug_PVT_SCIM_Ctrl_12VDCDC
    Debug_PVT_SCIM_Ctrl_12VLiving
      data Debug_PVT_SCIM_Ctrl_12VLiving: type=Debug_PVT_SCIM_Ctrl_12VLiving
    Debug_PVT_SCIM_Ctrl_12VParked
      data Debug_PVT_SCIM_Ctrl_12VParked: type=Debug_PVT_SCIM_Ctrl_12VParked
    Debug_PVT_SCIM_Ctrl_BHS1
      data Debug_PVT_SCIM_Ctrl_BHS1: type=Debug_PVT_SCIM_Ctrl_BHS1
    Debug_PVT_SCIM_Ctrl_BHS2
      data Debug_PVT_SCIM_Ctrl_BHS2: type=Debug_PVT_SCIM_Ctrl_BHS2
    Debug_PVT_SCIM_Ctrl_BHS3
      data Debug_PVT_SCIM_Ctrl_BHS3: type=Debug_PVT_SCIM_Ctrl_BHS3
    Debug_PVT_SCIM_Ctrl_BHS4
      data Debug_PVT_SCIM_Ctrl_BHS4: type=Debug_PVT_SCIM_Ctrl_BHS4
    Debug_PVT_SCIM_Ctrl_DaiPullUp
      data Debug_PVT_SCIM_Ctrl_DaiPullUp: type=Debug_PVT_SCIM_Ctrl_DaiPullUp
    Debug_PVT_SCIM_Ctrl_LivingPullUp
      data Debug_PVT_SCIM_Ctrl_LivingPullUp: type=Debug_PVT_SCIM_Ctrl_LivingPullUp
    Debug_PVT_SCIM_Ctrl_ParkedPullUp
      data Debug_PVT_SCIM_Ctrl_ParkedPullUp: type=Debug_PVT_SCIM_Ctrl_ParkedPullUp
    Debug_PVT_SCIM_Ctrl_WHS1
      data Debug_PVT_SCIM_Ctrl_WHS1: type=Debug_PVT_SCIM_Ctrl_WHS1
    Debug_PVT_SCIM_Ctrl_WHS1_Duty
      data Debug_PVT_SCIM_Ctrl_WHS1_Duty: type=Debug_PVT_SCIM_Ctrl_WHS1_Duty
    Debug_PVT_SCIM_Ctrl_WHS1_Freq
      data Debug_PVT_SCIM_Ctrl_WHS1_Freq: type=Debug_PVT_SCIM_Ctrl_WHS1_Freq
    Debug_PVT_SCIM_Ctrl_WHS2
      data Debug_PVT_SCIM_Ctrl_WHS2: type=Debug_PVT_SCIM_Ctrl_WHS2
    Debug_PVT_SCIM_Ctrl_WHS2_Duty
      data Debug_PVT_SCIM_Ctrl_WHS2_Duty: type=Debug_PVT_SCIM_Ctrl_WHS2_Duty
    Debug_PVT_SCIM_Ctrl_WHS2_Freq
      data Debug_PVT_SCIM_Ctrl_WHS2_Freq: type=Debug_PVT_SCIM_Ctrl_WHS2_Freq
    Debug_PVT_SCIM_Ctrl_WLS1
      data Debug_PVT_SCIM_Ctrl_WLS1: type=Debug_PVT_SCIM_Ctrl_WLS1
    Debug_PVT_SCIM_Ctrl_WLS1_Duty
      data Debug_PVT_SCIM_Ctrl_WLS1_Duty: type=Debug_PVT_SCIM_Ctrl_WLS1_Duty
    Debug_PVT_SCIM_Ctrl_WLS1_Freq
      data Debug_PVT_SCIM_Ctrl_WLS1_Freq: type=Debug_PVT_SCIM_Ctrl_WLS1_Freq
    Debug_PVT_SCIM_Ctrl_WLS2
      data Debug_PVT_SCIM_Ctrl_WLS2: type=Debug_PVT_SCIM_Ctrl_WLS2
    Debug_PVT_SCIM_Ctrl_WLS2Duty
      data Debug_PVT_SCIM_Ctrl_WLS2Duty: type=Debug_PVT_SCIM_Ctrl_WLS2Duty
    Debug_PVT_SCIM_Ctrl_WLS2Freq
      data Debug_PVT_SCIM_Ctrl_WLS2Freq: type=Debug_PVT_SCIM_Ctrl_WLS2Freq
    Debug_PVT_SCIM_Ctrl_WLS3
      data Debug_PVT_SCIM_Ctrl_WLS3: type=Debug_PVT_SCIM_Ctrl_WLS3
    Debug_PVT_SCIM_Ctrl_WLS3Duty
      data Debug_PVT_SCIM_Ctrl_WLS3Duty: type=Debug_PVT_SCIM_Ctrl_WLS3Duty
    Debug_PVT_SCIM_Ctrl_WLS3Freq
      data Debug_PVT_SCIM_Ctrl_WLS3Freq: type=Debug_PVT_SCIM_Ctrl_WLS3Freq
    Debug_PVT_SCIM_RD_12VDCDCFault
      data Debug_PVT_SCIM_RD_12VDCDCFault: type=Debug_PVT_SCIM_RD_12VDCDCFault
    Debug_PVT_SCIM_RD_12VDCDCVolt
      data Debug_PVT_SCIM_RD_12VDCDCVolt: type=Debug_PVT_SCIM_RD_12VDCDCVolt
    Debug_PVT_SCIM_RD_12VLivingFault
      data Debug_PVT_SCIM_RD_12VLivingFault: type=Debug_PVT_SCIM_RD_12VLivingFault
    Debug_PVT_SCIM_RD_12VLivingVolt
      data Debug_PVT_SCIM_RD_12VLivingVolt: type=Debug_PVT_SCIM_RD_12VLivingVolt
    Debug_PVT_SCIM_RD_12VParkedFault
      data Debug_PVT_SCIM_RD_12VParkedFault: type=Debug_PVT_SCIM_RD_12VParkedFault
    Debug_PVT_SCIM_RD_12VParkedVolt
      data Debug_PVT_SCIM_RD_12VParkedVolt: type=Debug_PVT_SCIM_RD_12VParkedVolt
    Debug_PVT_SCIM_RD_ADI01
      data Debug_PVT_SCIM_RD_ADI01: type=Debug_PVT_SCIM_RD_ADI01
    Debug_PVT_SCIM_RD_ADI02
      data Debug_PVT_SCIM_RD_ADI02: type=Debug_PVT_SCIM_RD_ADI02
    Debug_PVT_SCIM_RD_ADI03
      data Debug_PVT_SCIM_RD_ADI03: type=Debug_PVT_SCIM_RD_ADI03
    Debug_PVT_SCIM_RD_ADI04
      data Debug_PVT_SCIM_RD_ADI04: type=Debug_PVT_SCIM_RD_ADI04
    Debug_PVT_SCIM_RD_ADI05
      data Debug_PVT_SCIM_RD_ADI05: type=Debug_PVT_SCIM_RD_ADI05
    Debug_PVT_SCIM_RD_ADI06
      data Debug_PVT_SCIM_RD_ADI06: type=Debug_PVT_SCIM_RD_ADI06
    Debug_PVT_SCIM_RD_ADI07
      data Debug_PVT_SCIM_RD_ADI07: type=Debug_PVT_SCIM_RD_ADI07
    Debug_PVT_SCIM_RD_ADI08
      data Debug_PVT_SCIM_RD_ADI08: type=Debug_PVT_SCIM_RD_ADI08
    Debug_PVT_SCIM_RD_ADI09
      data Debug_PVT_SCIM_RD_ADI09: type=Debug_PVT_SCIM_RD_ADI09
    Debug_PVT_SCIM_RD_ADI10
      data Debug_PVT_SCIM_RD_ADI10: type=Debug_PVT_SCIM_RD_ADI10
    Debug_PVT_SCIM_RD_ADI11
      data Debug_PVT_SCIM_RD_ADI11: type=Debug_PVT_SCIM_RD_ADI11
    Debug_PVT_SCIM_RD_ADI12
      data Debug_PVT_SCIM_RD_ADI12: type=Debug_PVT_SCIM_RD_ADI12
    Debug_PVT_SCIM_RD_ADI13
      data Debug_PVT_SCIM_RD_ADI13: type=Debug_PVT_SCIM_RD_ADI13
    Debug_PVT_SCIM_RD_ADI14
      data Debug_PVT_SCIM_RD_ADI14: type=Debug_PVT_SCIM_RD_ADI14
    Debug_PVT_SCIM_RD_ADI15
      data Debug_PVT_SCIM_RD_ADI15: type=Debug_PVT_SCIM_RD_ADI15
    Debug_PVT_SCIM_RD_ADI16
      data Debug_PVT_SCIM_RD_ADI16: type=Debug_PVT_SCIM_RD_ADI16
    Debug_PVT_SCIM_RD_BHS1_Fault
      data Debug_PVT_SCIM_RD_BHS1_Fault: type=Debug_PVT_SCIM_RD_BHS1_Fault
    Debug_PVT_SCIM_RD_BHS1_Volt
      data Debug_PVT_SCIM_RD_BHS1_Volt: type=Debug_PVT_SCIM_RD_BHS1_Volt
    Debug_PVT_SCIM_RD_BHS2_Fault
      data Debug_PVT_SCIM_RD_BHS2_Fault: type=Debug_PVT_SCIM_RD_BHS2_Fault
    Debug_PVT_SCIM_RD_BHS2_Volt
      data Debug_PVT_SCIM_RD_BHS2_Volt: type=Debug_PVT_SCIM_RD_BHS2_Volt
    Debug_PVT_SCIM_RD_BHS3_Fault
      data Debug_PVT_SCIM_RD_BHS3_Fault: type=Debug_PVT_SCIM_RD_BHS3_Fault
    Debug_PVT_SCIM_RD_BHS3_Volt
      data Debug_PVT_SCIM_RD_BHS3_Volt: type=Debug_PVT_SCIM_RD_BHS3_Volt
    Debug_PVT_SCIM_RD_BHS4_Fault
      data Debug_PVT_SCIM_RD_BHS4_Fault: type=Debug_PVT_SCIM_RD_BHS4_Fault
    Debug_PVT_SCIM_RD_BHS4_Volt
      data Debug_PVT_SCIM_RD_BHS4_Volt: type=Debug_PVT_SCIM_RD_BHS4_Volt
    Debug_PVT_SCIM_RD_DAI1
      data Debug_PVT_SCIM_RD_DAI1: type=Debug_PVT_SCIM_RD_DAI1
    Debug_PVT_SCIM_RD_DAI2
      data Debug_PVT_SCIM_RD_DAI2: type=Debug_PVT_SCIM_RD_DAI2
    Debug_PVT_SCIM_RD_VBAT
      data Debug_PVT_SCIM_RD_VBAT: type=Debug_PVT_SCIM_RD_VBAT
    Debug_PVT_SCIM_RD_VBAT_Fault
      data Debug_PVT_SCIM_RD_VBAT_Fault: type=Debug_PVT_SCIM_RD_VBAT_Fault
    Debug_PVT_SCIM_RD_WHS1_Duty
      data Debug_PVT_SCIM_RD_WHS1_Duty: type=Debug_PVT_SCIM_RD_WHS1_Duty
    Debug_PVT_SCIM_RD_WHS1_Fault
      data Debug_PVT_SCIM_RD_WHS1_Fault: type=Debug_PVT_SCIM_RD_WHS1_Fault
    Debug_PVT_SCIM_RD_WHS1_Freq
      data Debug_PVT_SCIM_RD_WHS1_Freq: type=Debug_PVT_SCIM_RD_WHS1_Freq
    Debug_PVT_SCIM_RD_WHS1_Volt
      data Debug_PVT_SCIM_RD_WHS1_Volt: type=Debug_PVT_SCIM_RD_WHS1_Volt
    Debug_PVT_SCIM_RD_WHS2_Duty
      data Debug_PVT_SCIM_RD_WHS2_Duty: type=Debug_PVT_SCIM_RD_WHS2_Duty
    Debug_PVT_SCIM_RD_WHS2_Fault
      data Debug_PVT_SCIM_RD_WHS2_Fault: type=Debug_PVT_SCIM_RD_WHS2_Fault
    Debug_PVT_SCIM_RD_WHS2_Freq
      data Debug_PVT_SCIM_RD_WHS2_Freq: type=Debug_PVT_SCIM_RD_WHS2_Freq
    Debug_PVT_SCIM_RD_WHS2_Volt
      data Debug_PVT_SCIM_RD_WHS2_Volt: type=Debug_PVT_SCIM_RD_WHS2_Volt
    Debug_PVT_SCIM_RD_WLS1_Duty
      data Debug_PVT_SCIM_RD_WLS1_Duty: type=Debug_PVT_SCIM_RD_WLS1_Duty
    Debug_PVT_SCIM_RD_WLS1_Fault
      data Debug_PVT_SCIM_RD_WLS1_Fault: type=Debug_PVT_SCIM_RD_WLS1_Fault
    Debug_PVT_SCIM_RD_WLS1_Freq
      data Debug_PVT_SCIM_RD_WLS1_Freq: type=Debug_PVT_SCIM_RD_WLS1_Freq
    Debug_PVT_SCIM_RD_WLS1_Volt
      data Debug_PVT_SCIM_RD_WLS1_Volt: type=Debug_PVT_SCIM_RD_WLS1_Volt
    Debug_PVT_SCIM_RD_WLS2_Duty
      data Debug_PVT_SCIM_RD_WLS2_Duty: type=Debug_PVT_SCIM_RD_WLS2_Duty
    Debug_PVT_SCIM_RD_WLS2_Fault
      data Debug_PVT_SCIM_RD_WLS2_Fault: type=Debug_PVT_SCIM_RD_WLS2_Fault
    Debug_PVT_SCIM_RD_WLS2_Freq
      data Debug_PVT_SCIM_RD_WLS2_Freq: type=Debug_PVT_SCIM_RD_WLS2_Freq
    Debug_PVT_SCIM_RD_WLS2_Volt
      data Debug_PVT_SCIM_RD_WLS2_Volt: type=Debug_PVT_SCIM_RD_WLS2_Volt
    Debug_PVT_SCIM_RD_WLS3_Duty
      data Debug_PVT_SCIM_RD_WLS3_Duty: type=Debug_PVT_SCIM_RD_WLS3_Duty
    Debug_PVT_SCIM_RD_WLS3_Fault
      data Debug_PVT_SCIM_RD_WLS3_Fault: type=Debug_PVT_SCIM_RD_WLS3_Fault
    Debug_PVT_SCIM_RD_WLS3_Freq
      data Debug_PVT_SCIM_RD_WLS3_Freq: type=Debug_PVT_SCIM_RD_WLS3_Freq
    Debug_PVT_SCIM_RD_WLS3_Volt
      data Debug_PVT_SCIM_RD_WLS3_Volt: type=Debug_PVT_SCIM_RD_WLS3_Volt
    Debug_PVT_SCIM_RF_BAT
      data Debug_PVT_SCIM_RF_BAT: type=Debug_PVT_SCIM_RF_BAT
    Debug_PVT_SCIM_RF_BtnPressIndex
      data Debug_PVT_SCIM_RF_BtnPressIndex: type=Debug_PVT_SCIM_RF_BtnPressIndex
    Debug_PVT_SCIM_RF_Button1_ID
      data Debug_PVT_SCIM_RF_Button1_ID: type=Debug_PVT_SCIM_RF_Button1_ID
    Debug_PVT_SCIM_RF_Button1_Time
      data Debug_PVT_SCIM_RF_Button1_Time: type=Debug_PVT_SCIM_RF_Button1_Time
    Debug_PVT_SCIM_RF_Button2_ID
      data Debug_PVT_SCIM_RF_Button2_ID: type=Debug_PVT_SCIM_RF_Button2_ID
    Debug_PVT_SCIM_RF_Button2_Time
      data Debug_PVT_SCIM_RF_Button2_Time: type=Debug_PVT_SCIM_RF_Button2_Time
    Debug_PVT_SCIM_RF_KeyfobSerialNb
      data Debug_PVT_SCIM_RF_KeyfobSerialNb: type=Debug_PVT_SCIM_RF_KeyfobSerialNb
    Debug_PVT_SCIM_RF_RollingCounter
      data Debug_PVT_SCIM_RF_RollingCounter: type=Debug_PVT_SCIM_RF_RollingCounter
    Debug_PVT_SCIM_Task1_Time
      data Debug_PVT_SCIM_Task1_Time: type=Debug_PVT_SCIM_Task1_Time
    Debug_PVT_SCIM_Task2_Time
      data Debug_PVT_SCIM_Task2_Time: type=Debug_PVT_SCIM_Task2_Time
    Debug_PVT_SCIM_Task3_Time
      data Debug_PVT_SCIM_Task3_Time: type=Debug_PVT_SCIM_Task3_Time
    Debug_PVT_SCIM_Task4_Time
      data Debug_PVT_SCIM_Task4_Time: type=Debug_PVT_SCIM_Task4_Time
    Debug_PVT_SCIM_Task5_Time
      data Debug_PVT_SCIM_Task5_Time: type=Debug_PVT_SCIM_Task5_Time
    Debug_PVT_SCIM_Task6_Time
      data Debug_PVT_SCIM_Task6_Time: type=Debug_PVT_SCIM_Task6_Time
    Debug_PVT_SCIM_Task7_Time
      data Debug_PVT_SCIM_Task7_Time: type=Debug_PVT_SCIM_Task7_Time
    Debug_PVT_SCIM_TSincePwrOn_Long
      data Debug_PVT_SCIM_TSincePwrOn_Long: type=Debug_PVT_SCIM_TSincePwrOn_Long
    Debug_PVT_SCIM_TSincePwrOn_Short
      data Debug_PVT_SCIM_TSincePwrOn_Short: type=Debug_PVT_SCIM_TSincePwrOn_Short
    Debug_PVT_SCIM_TSinceWkUp_Short
      data Debug_PVT_SCIM_TSinceWkUp_Short: type=Debug_PVT_SCIM_TSinceWkUp_Short
  6 x client server interface:
    Do12VInterface_I
      4 x operation:
        GetDo12VPinsState
          6 x arg, all with server-argument-impl-policy=USE-ARGUMENT-TYPE:
            SelectParkedOrLivingPin: type=uint8, direction=IN
            IsDo12VActivated: type=boolean, direction=OUT
            BatteryVoltage: type=VGTT_EcuPinVoltage_0V2, direction=OUT
            DcdcRefVoltage: type=uint16, direction=OUT
            Do12VPinVoltage: type=VGTT_EcuPinVoltage_0V2, direction=OUT
            DiagStatus: type=VGTT_EcuPinDiagStatus, direction=OUT
        SetDcdc12VActive
          arg Activation: type=boolean, direction=IN, server-argument-impl-policy=USE-ARGUMENT-TYPE
        SetDo12VLivingActive
          arg Activation: type=boolean, direction=IN, server-argument-impl-policy=USE-ARGUMENT-TYPE
        SetDo12VParkedActive
          arg Activation: type=boolean, direction=IN, server-argument-impl-policy=USE-ARGUMENT-TYPE
    DobhsCtrlInterface_I
      operation GetDobhsPinState
        4 x arg, all with direction=OUT, server-argument-impl-policy=USE-ARGUMENT-TYPE:
          IsDoActivated: type=boolean
          DoPinVoltage: type=uint16
          BatteryVoltage: type=uint16
          DiagStatus: type=VGTT_EcuPinDiagStatus
      operation SetDobhsActive
        arg Activation: type=boolean, direction=IN, server-argument-impl-policy=USE-ARGUMENT-TYPE
    DowhsInterface_I
      operation GetDoPinStateOne
        7 x arg, all with server-argument-impl-policy=USE-ARGUMENT-TYPE:
          DoPinRef: type=uint8, direction=IN
          IsDoActivated: type=boolean, direction=OUT
          DoPinVoltage: type=uint16, direction=OUT
          BatteryVoltage: type=uint16, direction=OUT
          DutyCycle: type=uint8, direction=OUT
          Period: type=uint16, direction=OUT
          DiagStatus: type=VGTT_EcuPinDiagStatus, direction=OUT
      operation SetDowhsActive
        arg OutputId: type=uint8, direction=IN, server-argument-impl-policy=USE-ARGUMENT-TYPE
        arg Period: type=uint16, direction=IN, server-argument-impl-policy=USE-ARGUMENT-TYPE
        arg DutyCycle: type=uint8, direction=IN, server-argument-impl-policy=USE-ARGUMENT-TYPE
    DowlsInterface_I
      operation GetDoPinStateOne
        7 x arg, all with server-argument-impl-policy=USE-ARGUMENT-TYPE:
          DoPinRef: type=uint8, direction=IN
          IsDoActivated: type=boolean, direction=OUT
          DoPinVoltage: type=uint16, direction=OUT
          BatteryVoltage: type=uint16, direction=OUT
          DutyCycle: type=uint8, direction=OUT
          Period: type=uint16, direction=OUT
          DiagStatus: type=VGTT_EcuPinDiagStatus, direction=OUT
      operation SetDowlsActive
        arg OutputId: type=uint8, direction=IN, server-argument-impl-policy=USE-ARGUMENT-TYPE
        arg Period: type=uint16, direction=IN, server-argument-impl-policy=USE-ARGUMENT-TYPE
        arg DutyCycle: type=uint8, direction=IN, server-argument-impl-policy=USE-ARGUMENT-TYPE
    AdiInterface_I
      4 x operation:
        GetAdiPinState
          arg AdiPinRef: type=uint8, direction=IN, server-argument-impl-policy=USE-ARGUMENT-TYPE
          arg AdiPinVoltage: type=uint16, direction=OUT, server-argument-impl-policy=USE-ARGUMENT-TYPE
          arg PullUpVoltage: type=VGTT_EcuPinVoltage_0V2, direction=OUT, server-argument-impl-policy=USE-ARGUMENT-TYPE
        GetAdiPinStateAll
          arg VoltageOnAdiPins: type=VGTT_ScimAdiPinsState, direction=OUT, server-argument-impl-policy=USE-ARGUMENT-TYPE
          arg PullUpVoltage: type=VGTT_EcuPinVoltage_0V2, direction=OUT, server-argument-impl-policy=USE-ARGUMENT-TYPE
        GetPullUpState
          arg PullUpVoltage_Living: type=VGTT_EcuPinVoltage_0V2, direction=OUT, server-argument-impl-policy=USE-ARGUMENT-TYPE
          arg PullUpVoltage_Parked: type=VGTT_EcuPinVoltage_0V2, direction=OUT, server-argument-impl-policy=USE-ARGUMENT-TYPE
        SetPullUp
          arg ActivateLivingPullUp: type=boolean, direction=IN, server-argument-impl-policy=USE-ARGUMENT-TYPE
          arg ActivateParkedPullUp: type=boolean, direction=IN, server-argument-impl-policy=USE-ARGUMENT-TYPE
          arg ActivateDAIPullUp: type=boolean, direction=IN, server-argument-impl-policy=USE-ARGUMENT-TYPE
    DowInterface_I
      operation GetDoPinStateOne
        7 x arg, all with server-argument-impl-policy=USE-ARGUMENT-TYPE:
          DoPinRef: type=uint8, direction=IN
          IsDoActivated: type=boolean, direction=OUT
          DoPinVoltage: type=VGTT_EcuPinVoltage_0V2, direction=OUT
          BatteryVoltage: type=VGTT_EcuPinVoltage_0V2, direction=OUT
          DutyCycle: type=uint8, direction=OUT
          Period: type=uint16, direction=OUT
          DiagStatus: type=VGTT_EcuPinDiagStatus, direction=OUT
      operation SetDowActive
        arg OutputId: type=uint8, direction=IN, server-argument-impl-policy=USE-ARGUMENT-TYPE
        arg Period: type=uint16, direction=IN, server-argument-impl-policy=USE-ARGUMENT-TYPE
        arg DutyCycle: type=uint8, direction=IN, server-argument-impl-policy=USE-ARGUMENT-TYPE
  250 x sender receiver interface:
    Debug_PVT_SCIM_Ctrl_BHS3_1
      data Debug_PVT_SCIM_Ctrl_BHS3: type=Debug_PVT_SCIM_Ctrl_BHS3_1
    Debug_PVT_SCIM_Ctrl_BHS2_1
      data Debug_PVT_SCIM_Ctrl_BHS2: type=Debug_PVT_SCIM_Ctrl_BHS2_1
    Debug_PVT_SCIM_Ctrl_BHS1_1
      data Debug_PVT_SCIM_Ctrl_BHS1: type=Debug_PVT_SCIM_Ctrl_BHS1_1
    Debug_PVT_SCIM_Ctrl_BHS4_1
      data Debug_PVT_SCIM_Ctrl_BHS4: type=Debug_PVT_SCIM_Ctrl_BHS4_1
    Debug_PVT_SCIM_RD_BHS3_Volt_1
      data Debug_PVT_SCIM_RD_BHS3_Volt: type=Debug_PVT_SCIM_RD_BHS3_Volt_1
    Debug_PVT_SCIM_RD_BHS1_Volt_1
      data Debug_PVT_SCIM_RD_BHS1_Volt: type=Debug_PVT_SCIM_RD_BHS1_Volt_1
    Debug_PVT_SCIM_RD_BHS3_Fault_1
      data Debug_PVT_SCIM_RD_BHS3_Fault: type=Debug_PVT_SCIM_RD_BHS3_Fault_1
    Debug_PVT_SCIM_RD_BHS1_Fault_1
      data Debug_PVT_SCIM_RD_BHS1_Fault: type=Debug_PVT_SCIM_RD_BHS1_Fault_1
    Debug_PVT_SCIM_RD_BHS2_Fault_1
      data Debug_PVT_SCIM_RD_BHS2_Fault: type=Debug_PVT_SCIM_RD_BHS2_Fault_1
    Debug_PVT_SCIM_RD_BHS2_Volt_1
      data Debug_PVT_SCIM_RD_BHS2_Volt: type=Debug_PVT_SCIM_RD_BHS2_Volt_1
    Debug_PVT_SCIM_RD_BHS4_Fault_1
      data Debug_PVT_SCIM_RD_BHS4_Fault: type=Debug_PVT_SCIM_RD_BHS4_Fault_1
    Debug_PVT_SCIM_RD_BHS4_Volt_1
      data Debug_PVT_SCIM_RD_BHS4_Volt: type=Debug_PVT_SCIM_RD_BHS4_Volt_1
    Debug_PVT_SCIM_Ctrl_DaiPullUp_1
      data Debug_PVT_SCIM_Ctrl_DaiPullUp: type=Debug_PVT_SCIM_Ctrl_DaiPullUp_1
    Debug_PVT_SCIM_RD_ADI09_1
      data Debug_PVT_SCIM_RD_ADI09: type=Debug_PVT_SCIM_RD_ADI09_1
    Debug_PVT_SCIM_RD_ADI16_1
      data Debug_PVT_SCIM_RD_ADI16: type=Debug_PVT_SCIM_RD_ADI16_1
    Debug_PVT_SCIM_RD_ADI07_1
      data Debug_PVT_SCIM_RD_ADI07: type=Debug_PVT_SCIM_RD_ADI07_1
    Debug_PVT_SCIM_RD_ADI02_1
      data Debug_PVT_SCIM_RD_ADI02: type=Debug_PVT_SCIM_RD_ADI02_1
    Debug_PVT_SCIM_RD_DAI1_1
      data Debug_PVT_SCIM_RD_DAI1: type=Debug_PVT_SCIM_RD_DAI1_1
    Debug_PVT_SCIM_RD_ADI10_1
      data Debug_PVT_SCIM_RD_ADI10: type=Debug_PVT_SCIM_RD_ADI10_1
    Debug_PVT_SCIM_RD_ADI06_1
      data Debug_PVT_SCIM_RD_ADI06: type=Debug_PVT_SCIM_RD_ADI06_1
    Debug_PVT_SCIM_RD_ADI01_1
      data Debug_PVT_SCIM_RD_ADI01: type=Debug_PVT_SCIM_RD_ADI01_1
    Debug_PVT_SCIM_RD_ADI03_1
      data Debug_PVT_SCIM_RD_ADI03: type=Debug_PVT_SCIM_RD_ADI03_1
    Debug_PVT_SCIM_RD_ADI11_1
      data Debug_PVT_SCIM_RD_ADI11: type=Debug_PVT_SCIM_RD_ADI11_1
    Debug_PVT_SCIM_RD_ADI14_1
      data Debug_PVT_SCIM_RD_ADI14: type=Debug_PVT_SCIM_RD_ADI14_1
    Debug_PVT_SCIM_RD_ADI13_1
      data Debug_PVT_SCIM_RD_ADI13: type=Debug_PVT_SCIM_RD_ADI13_1
    Debug_PVT_SCIM_RD_ADI04_1
      data Debug_PVT_SCIM_RD_ADI04: type=Debug_PVT_SCIM_RD_ADI04_1
    Debug_PVT_SCIM_RD_ADI12_1
      data Debug_PVT_SCIM_RD_ADI12: type=Debug_PVT_SCIM_RD_ADI12_1
    Debug_PVT_SCIM_RD_ADI15_1
      data Debug_PVT_SCIM_RD_ADI15: type=Debug_PVT_SCIM_RD_ADI15_1
    Debug_PVT_SCIM_RD_ADI05_1
      data Debug_PVT_SCIM_RD_ADI05: type=Debug_PVT_SCIM_RD_ADI05_1
    Debug_PVT_SCIM_RD_DAI2_1
      data Debug_PVT_SCIM_RD_DAI2: type=Debug_PVT_SCIM_RD_DAI2_1
    Debug_PVT_SCIM_RD_ADI08_1
      data Debug_PVT_SCIM_RD_ADI08: type=Debug_PVT_SCIM_RD_ADI08_1
    LIN_BunkH2RoofhatchCloseBtn_St
      data LIN_BunkH2RoofhatchCloseBtn_St: type=LIN_BunkH2RoofhatchCloseBtn_St
    LIN_BunkH2LockButtonStatus
      data LIN_BunkH2LockButtonStatus: type=LIN_BunkH2LockButtonStatus
    LIN_AlmClkSetCurAlm_rqst_sg
      data LIN_AlmClkSetCurAlm_rqst_sg: type=LIN_AlmClkSetCurAlm_rqst_sg
    LIN_BunkH2IntLightIncBtn_stat
      data LIN_BunkH2IntLightIncBtn_stat: type=LIN_BunkH2IntLightIncBtn_stat
    LIN_BunkH2Fade_ButtonStatus
      data LIN_BunkH2Fade_ButtonStatus: type=LIN_BunkH2Fade_ButtonStatus
    SwitchDetectionNeeded1L1
      data SwitchDetectionNeeded1L1: type=SwitchDetectionNeeded1L1
    LIN_BunkH2PowerWinOpenPSBtn_st
      data LIN_BunkH2PowerWinOpenPSBtn_st: type=LIN_BunkH2PowerWinOpenPSBtn_st
    LIN_IntLghtDimmingLvlDecBtn_s
      data LIN_IntLghtDimmingLvlDecBtn_s: type=LIN_IntLghtDimmingLvlDecBtn_s
    LIN_IntLghtDimmingLvlIncBtn_s
      data LIN_IntLghtDimmingLvlIncBtn_s: type=LIN_IntLghtDimmingLvlIncBtn_s
    ResponseErrorLECM2
      data ResponseErrorLECM2: type=ResponseErrorLECM2
    LIN_BunkH2PHTi_rqs_sg
      data LIN_BunkH2PHTi_rqs_sg: type=LIN_BunkH2PHTi_rqs_sg
    ResponseErrorLECMBasic
      data ResponseErrorLECMBasic: type=ResponseErrorLECMBasic
    LIN_BunkH2VolumeDown_ButtonSta
      data LIN_BunkH2VolumeDown_ButtonSta: type=LIN_BunkH2VolumeDown_ButtonSta
    LIN_BunkH2IntLightDecBtn_stat
      data LIN_BunkH2IntLightDecBtn_stat: type=LIN_BunkH2IntLightDecBtn_stat
    FSP2DiagInfoL1
      data FSP2DiagInfoL1: type=FSP2DiagInfoL1
    LIN_BunkBAudioOnOff_ButtonStat
      data LIN_BunkBAudioOnOff_ButtonStat: type=LIN_BunkBAudioOnOff_ButtonStat
    DiagInfoLECM2
      data DiagInfoLECM2: type=DiagInfoLECM2
    SwitchDetectionNeeded2L1
      data SwitchDetectionNeeded2L1: type=SwitchDetectionNeeded2L1
    DiagInfoLECMBasic
      data DiagInfoLECMBasic: type=DiagInfoLECMBasic
    LIN_BunkBVolumeDown_ButtonStat
      data LIN_BunkBVolumeDown_ButtonStat: type=LIN_BunkBVolumeDown_ButtonStat
    LIN_IntLghtModeSelrFreeWheel_s
      data LIN_IntLghtModeSelrFreeWheel_s: type=LIN_IntLghtModeSelrFreeWheel_s
    LIN_BunkH2OnOFF_ButtonStatus
      data LIN_BunkH2OnOFF_ButtonStatus: type=LIN_BunkH2OnOFF_ButtonStatus
    FSP1ResponseErrorL1
      data FSP1ResponseErrorL1: type=FSP1ResponseErrorL1
    LIN_BunkH2VolumeUp_ButtonStatu
      data LIN_BunkH2VolumeUp_ButtonStatu: type=LIN_BunkH2VolumeUp_ButtonStatu
    ResponseErrorILCP1
      data ResponseErrorILCP1: type=ResponseErrorILCP1
    LIN_BunkH2Phone_ButtonStatus
      data LIN_BunkH2Phone_ButtonStatus: type=LIN_BunkH2Phone_ButtonStatus
    FSP2SwitchStatusL1
      data FSP2SwitchStatusL1: type=FSP2SwitchStatusL1
    FSP2ResponseErrorL1
      data FSP2ResponseErrorL1: type=FSP2ResponseErrorL1
    FSP1SwitchStatusL1
      data FSP1SwitchStatusL1: type=FSP1SwitchStatusL1
    LIN_BunkH2PowerWinCloseDSBtn_s
      data LIN_BunkH2PowerWinCloseDSBtn_s: type=LIN_BunkH2PowerWinCloseDSBtn_s
    LIN_BunkH2PowerWinOpenDSBtn_st
      data LIN_BunkH2PowerWinOpenDSBtn_st: type=LIN_BunkH2PowerWinOpenDSBtn_st
    LIN_DoorAutoFuncBtn_stat
      data LIN_DoorAutoFuncBtn_stat: type=LIN_DoorAutoFuncBtn_stat
    LIN_BunkH2TempDec_ButtonStatus
      data LIN_BunkH2TempDec_ButtonStatus: type=LIN_BunkH2TempDec_ButtonStatus
    LIN_BunkBVolumeUp_ButtonStat
      data LIN_BunkBVolumeUp_ButtonStat: type=LIN_BunkBVolumeUp_ButtonStat
    LIN_BunkBIntLightActvnBtn_stat
      data LIN_BunkBIntLightActvnBtn_stat: type=LIN_BunkBIntLightActvnBtn_stat
    LIN_BunkH2PowerWinClosePSBtn_s
      data LIN_BunkH2PowerWinClosePSBtn_s: type=LIN_BunkH2PowerWinClosePSBtn_s
    LIN_BunkBParkHeater_ButtonStat
      data LIN_BunkBParkHeater_ButtonStat: type=LIN_BunkBParkHeater_ButtonStat
    LIN_BunkH2ParkHeater_ButtonSta
      data LIN_BunkH2ParkHeater_ButtonSta: type=LIN_BunkH2ParkHeater_ButtonSta
    LIN_BunkBTempInc_ButtonStat
      data LIN_BunkBTempInc_ButtonStat: type=LIN_BunkBTempInc_ButtonStat
    LIN_BunkH2AudioOnOff_ButtonSta
      data LIN_BunkH2AudioOnOff_ButtonSta: type=LIN_BunkH2AudioOnOff_ButtonSta
    SwitchDetectionResp2L1
      data SwitchDetectionResp2L1: type=SwitchDetectionResp2L1
    LIN_BunkH2IntLightActvnBtn_sta
      data LIN_BunkH2IntLightActvnBtn_sta: type=LIN_BunkH2IntLightActvnBtn_sta
    LIN_BunkH2RoofhatchOpenBtn_Sta
      data LIN_BunkH2RoofhatchOpenBtn_Sta: type=LIN_BunkH2RoofhatchOpenBtn_Sta
    SwitchDetectionResp1L1
      data SwitchDetectionResp1L1: type=SwitchDetectionResp1L1
    FSP1DiagInfoL1
      data FSP1DiagInfoL1: type=FSP1DiagInfoL1
    DiagInfoILCP1
      data DiagInfoILCP1: type=DiagInfoILCP1
    LIN_BunkBTempDec_ButtonStat
      data LIN_BunkBTempDec_ButtonStat: type=LIN_BunkBTempDec_ButtonStat
    LIN_BunkH2TempInc_ButtonStatus
      data LIN_BunkH2TempInc_ButtonStatus: type=LIN_BunkH2TempInc_ButtonStatus
    LIN_IntLightMaxModeInd_cmd
      data LIN_IntLightMaxModeInd_cmd: type=LIN_IntLightMaxModeInd_cmd
    LIN_AlmClkCurAlarm_stat_sg
      data LIN_AlmClkCurAlarm_stat_sg: type=LIN_AlmClkCurAlarm_stat_sg
    FSP1IndicationCmdL1
      data FSP1IndicationCmdL1: type=FSP1IndicationCmdL1
    LIN_DoorAutoFuncInd_cmd
      data LIN_DoorAutoFuncInd_cmd: type=LIN_DoorAutoFuncInd_cmd
    LIN_IntLightNightModeInd_cmd
      data LIN_IntLightNightModeInd_cmd: type=LIN_IntLightNightModeInd_cmd
    LIN_IntLightRestingModeInd_cmd
      data LIN_IntLightRestingModeInd_cmd: type=LIN_IntLightRestingModeInd_cmd
    LIN_AudioVolumeIndicationCmd
      data LIN_AudioVolumeIndicationCmd: type=LIN_AudioVolumeIndicationCmd
    LIN_IntLghtOffModeInd_cmd
      data LIN_IntLghtOffModeInd_cmd: type=LIN_IntLghtOffModeInd_cmd
    FSP2IndicationCmdL1
      data FSP2IndicationCmdL1: type=FSP2IndicationCmdL1
    LIN_PhoneButtonIndication_cmd
      data LIN_PhoneButtonIndication_cmd: type=LIN_PhoneButtonIndication_cmd
    LIN_AudioSystemStatus
      data LIN_AudioSystemStatus: type=LIN_AudioSystemStatus
    LIN_BTStatus
      data LIN_BTStatus: type=LIN_BTStatus
    DoorLock_stat
      data DoorLock_stat: type=DoorLock_stat
    LIN_IntLghtLvlIndScaled_cmd
      data LIN_IntLghtLvlIndScaled_cmd: type=LIN_IntLghtLvlIndScaled_cmd
    LIN_IntLghtModeInd_cmd_sg
      data LIN_IntLghtModeInd_cmd_sg: type=LIN_IntLghtModeInd_cmd_sg
    FSP3ResponseErrorL2
      data FSP3ResponseErrorL2: type=FSP3ResponseErrorL2
    FSP1SwitchStatusL2
      data FSP1SwitchStatusL2: type=FSP1SwitchStatusL2
    SwitchDetectionResp1L2
      data SwitchDetectionResp1L2: type=SwitchDetectionResp1L2
    SwitchDetectionNeeded2L2
      data SwitchDetectionNeeded2L2: type=SwitchDetectionNeeded2L2
    FSP3SwitchStatusL2
      data FSP3SwitchStatusL2: type=FSP3SwitchStatusL2
    FSP3DiagInfoL2
      data FSP3DiagInfoL2: type=FSP3DiagInfoL2
    FSP1DiagInfoL2
      data FSP1DiagInfoL2: type=FSP1DiagInfoL2
    FSP4ResponseErrorL2
      data FSP4ResponseErrorL2: type=FSP4ResponseErrorL2
    FSP4DiagInfoL2
      data FSP4DiagInfoL2: type=FSP4DiagInfoL2
    FSP2DiagInfoL2
      data FSP2DiagInfoL2: type=FSP2DiagInfoL2
    SwitchDetectionResp4L2
      data SwitchDetectionResp4L2: type=SwitchDetectionResp4L2
    FSP4SwitchStatusL2
      data FSP4SwitchStatusL2: type=FSP4SwitchStatusL2
    FSP1ResponseErrorL2
      data FSP1ResponseErrorL2: type=FSP1ResponseErrorL2
    SwitchDetectionResp2L2
      data SwitchDetectionResp2L2: type=SwitchDetectionResp2L2
    FSP2SwitchStatusL2
      data FSP2SwitchStatusL2: type=FSP2SwitchStatusL2
    SwitchDetectionNeeded1L2
      data SwitchDetectionNeeded1L2: type=SwitchDetectionNeeded1L2
    FSP2ResponseErrorL2
      data FSP2ResponseErrorL2: type=FSP2ResponseErrorL2
    SwitchDetectionNeeded3L2
      data SwitchDetectionNeeded3L2: type=SwitchDetectionNeeded3L2
    SwitchDetectionResp3L2
      data SwitchDetectionResp3L2: type=SwitchDetectionResp3L2
    SwitchDetectionNeeded4L2
      data SwitchDetectionNeeded4L2: type=SwitchDetectionNeeded4L2
    FSP3IndicationCmdL2
      data FSP3IndicationCmdL2: type=FSP3IndicationCmdL2
    FSP1IndicationCmdL2
      data FSP1IndicationCmdL2: type=FSP1IndicationCmdL2
    FSP4IndicationCmdL2
      data FSP4IndicationCmdL2: type=FSP4IndicationCmdL2
    FSP2IndicationCmdL2
      data FSP2IndicationCmdL2: type=FSP2IndicationCmdL2
    ResponseErrorELCP1
      data ResponseErrorELCP1: type=ResponseErrorELCP1
    SwitchDetectionNeeded1L5
      data SwitchDetectionNeeded1L5: type=SwitchDetectionNeeded1L5
    LIN_WRDownButtonStatus
      data LIN_WRDownButtonStatus: type=LIN_WRDownButtonStatus
    FSP1SwitchStatusL4
      data FSP1SwitchStatusL4: type=FSP1SwitchStatusL4
    LIN_IntLghtNightModeBt2_s
      data LIN_IntLghtNightModeBt2_s: type=LIN_IntLghtNightModeBt2_s
    ResponseErrorILCP2
      data ResponseErrorILCP2: type=ResponseErrorILCP2
    FSP1ResponseErrorL4
      data FSP1ResponseErrorL4: type=FSP1ResponseErrorL4
    LIN_DifflockMode_Wheelstatus
      data LIN_DifflockMode_Wheelstatus: type=LIN_DifflockMode_Wheelstatus
    LIN_LKSPushButton
      data LIN_LKSPushButton: type=LIN_LKSPushButton
    LIN_LightMode_Status_2
      data LIN_LightMode_Status_2: type=LIN_LightMode_Status_2
    LIN_SpeedControlModeWheelStat
      data LIN_SpeedControlModeWheelStat: type=LIN_SpeedControlModeWheelStat
    LIN_BackButtonStatus
      data LIN_BackButtonStatus: type=LIN_BackButtonStatus
    LIN_MemButtonStatus
      data LIN_MemButtonStatus: type=LIN_MemButtonStatus
    SwitchDetectionResp1L4
      data SwitchDetectionResp1L4: type=SwitchDetectionResp1L4
    LIN_SelectButtonStatus
      data LIN_SelectButtonStatus: type=LIN_SelectButtonStatus
    LIN_IntLghtDimmingLvlFreeWhl_s
      data LIN_IntLghtDimmingLvlFreeWhl_s: type=LIN_IntLghtDimmingLvlFreeWhl_s
    LIN_FogLightRear_ButtonStat_1
      data LIN_FogLightRear_ButtonStat_1: type=LIN_FogLightRear_ButtonStat_1
    LIN_SpeedControlModeButtonStat
      data LIN_SpeedControlModeButtonStat: type=LIN_SpeedControlModeButtonStat
    DiagInfoDLFW
      data DiagInfoDLFW: type=DiagInfoDLFW
    LIN_FogLightRear_ButtonStat_2
      data LIN_FogLightRear_ButtonStat_2: type=LIN_FogLightRear_ButtonStat_2
    LIN_StopButtonStatus
      data LIN_StopButtonStatus: type=LIN_StopButtonStatus
    DiagInfoRCECS
      data DiagInfoRCECS: type=DiagInfoRCECS
    LIN_LightMode_Status_1
      data LIN_LightMode_Status_1: type=LIN_LightMode_Status_1
    LIN_WRUpButtonStatus
      data LIN_WRUpButtonStatus: type=LIN_WRUpButtonStatus
    LIN_DifflockDeactivationBtn_st
      data LIN_DifflockDeactivationBtn_st: type=LIN_DifflockDeactivationBtn_st
    LIN_IntLghtCenterBtnFreeWhl_s
      data LIN_IntLghtCenterBtnFreeWhl_s: type=LIN_IntLghtCenterBtnFreeWhl_s
    SwitchDetectionResp1L5
      data SwitchDetectionResp1L5: type=SwitchDetectionResp1L5
    FSP1DiagInfoL5
      data FSP1DiagInfoL5: type=FSP1DiagInfoL5
    LIN_EscButtonMuddySiteStatus
      data LIN_EscButtonMuddySiteStatus: type=LIN_EscButtonMuddySiteStatus
    FSP1SwitchStatusL5
      data FSP1SwitchStatusL5: type=FSP1SwitchStatusL5
    SwitchDetectionNeeded1L4
      data SwitchDetectionNeeded1L4: type=SwitchDetectionNeeded1L4
    LIN_AdjustButtonStatus
      data LIN_AdjustButtonStatus: type=LIN_AdjustButtonStatus
    ResponseErrorDLFW
      data ResponseErrorDLFW: type=ResponseErrorDLFW
    LIN_BlackPanelMode_ButtonStat
      data LIN_BlackPanelMode_ButtonStat: type=LIN_BlackPanelMode_ButtonStat
    FSP1DiagInfoL4
      data FSP1DiagInfoL4: type=FSP1DiagInfoL4
    LIN_FCWPushButton
      data LIN_FCWPushButton: type=LIN_FCWPushButton
    ResponseErrorRCECS
      data ResponseErrorRCECS: type=ResponseErrorRCECS
    DiagInfoELCP2
      data DiagInfoELCP2: type=DiagInfoELCP2
    DiagInfoCCFW
      data DiagInfoCCFW: type=DiagInfoCCFW
    DiagInfoILCP2
      data DiagInfoILCP2: type=DiagInfoILCP2
    DiagInfoELCP1
      data DiagInfoELCP1: type=DiagInfoELCP1
    LIN_BackLightDimming_Status
      data LIN_BackLightDimming_Status: type=LIN_BackLightDimming_Status
    FSP1ResponseErrorL5
      data FSP1ResponseErrorL5: type=FSP1ResponseErrorL5
    LIN_DRL_ButtonStatus
      data LIN_DRL_ButtonStatus: type=LIN_DRL_ButtonStatus
    ResponseErrorELCP2
      data ResponseErrorELCP2: type=ResponseErrorELCP2
    ResponseErrorCCFW
      data ResponseErrorCCFW: type=ResponseErrorCCFW
    LIN_LevelingThumbwheel_stat
      data LIN_LevelingThumbwheel_stat: type=LIN_LevelingThumbwheel_stat
    LIN_Offroad_ButtonStatus
      data LIN_Offroad_ButtonStatus: type=LIN_Offroad_ButtonStatus
    LIN_FogLightFront_ButtonStat_2
      data LIN_FogLightFront_ButtonStat_2: type=LIN_FogLightFront_ButtonStat_2
    LIN_RearWorkProjector_BtnStat
      data LIN_RearWorkProjector_BtnStat: type=LIN_RearWorkProjector_BtnStat
    LIN_HeadLampUpDown_SwitchStatu
      data LIN_HeadLampUpDown_SwitchStatu: type=LIN_HeadLampUpDown_SwitchStatu
    LIN_FogLightFront_ButtonStat_1
      data LIN_FogLightFront_ButtonStat_1: type=LIN_FogLightFront_ButtonStat_1
    LIN_IntLghtMaxModeBtnPnl2_s
      data LIN_IntLghtMaxModeBtnPnl2_s: type=LIN_IntLghtMaxModeBtnPnl2_s
    LIN_IntLghtRestModeBtnPnl2_s
      data LIN_IntLghtRestModeBtnPnl2_s: type=LIN_IntLghtRestModeBtnPnl2_s
    LIN_ACCOrCCIndication
      data LIN_ACCOrCCIndication: type=LIN_ACCOrCCIndication
    LIN_M3_DeviceIndication
      data LIN_M3_DeviceIndication: type=LIN_M3_DeviceIndication
    LIN_EscButtonMuddySiteDeviceIn
      data LIN_EscButtonMuddySiteDeviceIn: type=LIN_EscButtonMuddySiteDeviceIn
    LIN_M1_DeviceIndication
      data LIN_M1_DeviceIndication: type=LIN_M1_DeviceIndication
    LIN_ShortPulseMaxLength
      data LIN_ShortPulseMaxLength: type=LIN_ShortPulseMaxLength
    LIN_FCW_DeviceIndication
      data LIN_FCW_DeviceIndication: type=LIN_FCW_DeviceIndication
    LIN_DrivingLightPlus_Indicatio
      data LIN_DrivingLightPlus_Indicatio: type=LIN_DrivingLightPlus_Indicatio
    LIN_RearFog_Indication
      data LIN_RearFog_Indication: type=LIN_RearFog_Indication
    LIN_Offroad_Indication
      data LIN_Offroad_Indication: type=LIN_Offroad_Indication
    LIN_LKS_DeviceIndication
      data LIN_LKS_DeviceIndication: type=LIN_LKS_DeviceIndication
    LIN_Down_DeviceIndication
      data LIN_Down_DeviceIndication: type=LIN_Down_DeviceIndication
    LIN_M2_DeviceIndication
      data LIN_M2_DeviceIndication: type=LIN_M2_DeviceIndication
    LIN_ParkingLight_Indication
      data LIN_ParkingLight_Indication: type=LIN_ParkingLight_Indication
    FSP1IndicationCmdL5
      data FSP1IndicationCmdL5: type=FSP1IndicationCmdL5
    LIN_FrontFog_Indication
      data LIN_FrontFog_Indication: type=LIN_FrontFog_Indication
    LIN_ASLIndication
      data LIN_ASLIndication: type=LIN_ASLIndication
    LIN_DaytimeRunningLight_Indica
      data LIN_DaytimeRunningLight_Indica: type=LIN_DaytimeRunningLight_Indica
    LIN_DifflockOnOff_Indication
      data LIN_DifflockOnOff_Indication: type=LIN_DifflockOnOff_Indication
    LIN_RearWorkProjector_Indicati
      data LIN_RearWorkProjector_Indicati: type=LIN_RearWorkProjector_Indicati
    FSP1IndicationCmdL4
      data FSP1IndicationCmdL4: type=FSP1IndicationCmdL4
    LIN_Adjust_DeviceIndication
      data LIN_Adjust_DeviceIndication: type=LIN_Adjust_DeviceIndication
    LIN_DrivingLight_Indication
      data LIN_DrivingLight_Indication: type=LIN_DrivingLight_Indication
    LIN_Up_DeviceIndication
      data LIN_Up_DeviceIndication: type=LIN_Up_DeviceIndication
    Debug_PVT_SCIM_Ctrl_LivingPullUp_1
      data Debug_PVT_SCIM_Ctrl_LivingPullUp: type=Debug_PVT_SCIM_Ctrl_LivingPullUp_1
    Debug_PVT_SCIM_Ctrl_ParkedPullUp_1
      data Debug_PVT_SCIM_Ctrl_ParkedPullUp: type=Debug_PVT_SCIM_Ctrl_ParkedPullUp_1
    ABSInhibitRqstDenied
      data ABSInhibitRqstDenied: type=ABSInhibitRqstDenied
    Debug_PVT_SCIM_RD_12VLivingVolt_1
      data Debug_PVT_SCIM_RD_12VLivingVolt: type=Debug_PVT_SCIM_RD_12VLivingVolt_1
    Debug_PVT_SCIM_RD_12VParkedVolt_1
      data Debug_PVT_SCIM_RD_12VParkedVolt: type=Debug_PVT_SCIM_RD_12VParkedVolt_1
    Debug_PVT_SCIM_RD_12VDCDCFault_1
      data Debug_PVT_SCIM_RD_12VDCDCFault: type=Debug_PVT_SCIM_RD_12VDCDCFault_1
    Debug_PVT_SCIM_RD_12VDCDCVolt_1
      data Debug_PVT_SCIM_RD_12VDCDCVolt: type=Debug_PVT_SCIM_RD_12VDCDCVolt_1
    Debug_PVT_SCIM_RD_12VLivingFault_1
      data Debug_PVT_SCIM_RD_12VLivingFault: type=Debug_PVT_SCIM_RD_12VLivingFault_1
    Debug_PVT_SCIM_RD_12VParkedFault_1
      data Debug_PVT_SCIM_RD_12VParkedFault: type=Debug_PVT_SCIM_RD_12VParkedFault_1
    Debug_PVT_SCIM_RD_VBAT_1
      data Debug_PVT_SCIM_RD_VBAT: type=Debug_PVT_SCIM_RD_VBAT_1
    Debug_PVT_SCIM_Ctrl_WLS2Freq_1
      data Debug_PVT_SCIM_Ctrl_WLS2Freq: type=Debug_PVT_SCIM_Ctrl_WLS2Freq_1
    Debug_PVT_SCIM_Ctrl_WLS3_1
      data Debug_PVT_SCIM_Ctrl_WLS3: type=Debug_PVT_SCIM_Ctrl_WLS3_1
    Debug_PVT_SCIM_Ctrl_WLS2Duty_1
      data Debug_PVT_SCIM_Ctrl_WLS2Duty: type=Debug_PVT_SCIM_Ctrl_WLS2Duty_1
    Debug_PVT_SCIM_Ctrl_WLS1_Duty_1
      data Debug_PVT_SCIM_Ctrl_WLS1_Duty: type=Debug_PVT_SCIM_Ctrl_WLS1_Duty_1
    Debug_PVT_SCIM_Ctrl_WHS1_1
      data Debug_PVT_SCIM_Ctrl_WHS1: type=Debug_PVT_SCIM_Ctrl_WHS1_1
    Debug_PVT_SCIM_Ctrl_WHS1_Freq_1
      data Debug_PVT_SCIM_Ctrl_WHS1_Freq: type=Debug_PVT_SCIM_Ctrl_WHS1_Freq_1
    Debug_PVT_SCIM_Ctrl_WLS3Duty_1
      data Debug_PVT_SCIM_Ctrl_WLS3Duty: type=Debug_PVT_SCIM_Ctrl_WLS3Duty_1
    Debug_PVT_SCIM_Ctrl_WHS1_Duty_1
      data Debug_PVT_SCIM_Ctrl_WHS1_Duty: type=Debug_PVT_SCIM_Ctrl_WHS1_Duty_1
    Debug_PVT_SCIM_Ctrl_WLS1_Freq_1
      data Debug_PVT_SCIM_Ctrl_WLS1_Freq: type=Debug_PVT_SCIM_Ctrl_WLS1_Freq_1
    Debug_PVT_SCIM_Ctrl_WLS3Freq_1
      data Debug_PVT_SCIM_Ctrl_WLS3Freq: type=Debug_PVT_SCIM_Ctrl_WLS3Freq_1
    Debug_PVT_SCIM_Ctrl_WHS2_1
      data Debug_PVT_SCIM_Ctrl_WHS2: type=Debug_PVT_SCIM_Ctrl_WHS2_1
    Debug_PVT_SCIM_Ctrl_WLS2_1
      data Debug_PVT_SCIM_Ctrl_WLS2: type=Debug_PVT_SCIM_Ctrl_WLS2_1
    Debug_PVT_SCIM_Ctrl_WHS2_Freq_1
      data Debug_PVT_SCIM_Ctrl_WHS2_Freq: type=Debug_PVT_SCIM_Ctrl_WHS2_Freq_1
    Debug_PVT_SCIM_Ctrl_WLS1_1
      data Debug_PVT_SCIM_Ctrl_WLS1: type=Debug_PVT_SCIM_Ctrl_WLS1_1
    Debug_PVT_SCIM_Ctrl_WHS2_Duty_1
      data Debug_PVT_SCIM_Ctrl_WHS2_Duty: type=Debug_PVT_SCIM_Ctrl_WHS2_Duty_1
    Debug_PVT_SCIM_RD_WLS1_Duty_1
      data Debug_PVT_SCIM_RD_WLS1_Duty: type=Debug_PVT_SCIM_RD_WLS1_Duty_1
    Debug_PVT_SCIM_RD_WLS3_Freq_1
      data Debug_PVT_SCIM_RD_WLS3_Freq: type=Debug_PVT_SCIM_RD_WLS3_Freq_1
    Debug_PVT_SCIM_RD_WHS1_Volt_1
      data Debug_PVT_SCIM_RD_WHS1_Volt: type=Debug_PVT_SCIM_RD_WHS1_Volt_1
    Debug_PVT_SCIM_RD_WLS2_Fault_1
      data Debug_PVT_SCIM_RD_WLS2_Fault: type=Debug_PVT_SCIM_RD_WLS2_Fault_1
    Debug_PVT_SCIM_RD_WLS1_Volt_1
      data Debug_PVT_SCIM_RD_WLS1_Volt: type=Debug_PVT_SCIM_RD_WLS1_Volt_1
    Debug_PVT_SCIM_RD_WHS2_Volt_1
      data Debug_PVT_SCIM_RD_WHS2_Volt: type=Debug_PVT_SCIM_RD_WHS2_Volt_1
    Debug_PVT_SCIM_RD_WHS1_Duty_1
      data Debug_PVT_SCIM_RD_WHS1_Duty: type=Debug_PVT_SCIM_RD_WHS1_Duty_1
    Debug_PVT_SCIM_RD_WLS2_Volt_1
      data Debug_PVT_SCIM_RD_WLS2_Volt: type=Debug_PVT_SCIM_RD_WLS2_Volt_1
    Debug_PVT_SCIM_RD_WLS1_Fault_1
      data Debug_PVT_SCIM_RD_WLS1_Fault: type=Debug_PVT_SCIM_RD_WLS1_Fault_1
    Debug_PVT_SCIM_RD_WLS2_Freq_1
      data Debug_PVT_SCIM_RD_WLS2_Freq: type=Debug_PVT_SCIM_RD_WLS2_Freq_1
    Debug_PVT_SCIM_RD_WHS2_Duty_1
      data Debug_PVT_SCIM_RD_WHS2_Duty: type=Debug_PVT_SCIM_RD_WHS2_Duty_1
    Debug_PVT_SCIM_RD_WHS1_Freq_1
      data Debug_PVT_SCIM_RD_WHS1_Freq: type=Debug_PVT_SCIM_RD_WHS1_Freq_1
    Debug_PVT_SCIM_RD_WLS2_Duty_1
      data Debug_PVT_SCIM_RD_WLS2_Duty: type=Debug_PVT_SCIM_RD_WLS2_Duty_1
    Debug_PVT_SCIM_RD_WHS1_Fault_1
      data Debug_PVT_SCIM_RD_WHS1_Fault: type=Debug_PVT_SCIM_RD_WHS1_Fault_1
    Debug_PVT_SCIM_RD_WHS2_Freq_1
      data Debug_PVT_SCIM_RD_WHS2_Freq: type=Debug_PVT_SCIM_RD_WHS2_Freq_1
    Debug_PVT_SCIM_RD_WLS3_Duty_1
      data Debug_PVT_SCIM_RD_WLS3_Duty: type=Debug_PVT_SCIM_RD_WLS3_Duty_1
    Debug_PVT_SCIM_RD_WHS2_Fault_1
      data Debug_PVT_SCIM_RD_WHS2_Fault: type=Debug_PVT_SCIM_RD_WHS2_Fault_1
    Debug_PVT_SCIM_RD_WLS3_Fault_1
      data Debug_PVT_SCIM_RD_WLS3_Fault: type=Debug_PVT_SCIM_RD_WLS3_Fault_1
    Debug_PVT_SCIM_RD_WLS1_Freq_1
      data Debug_PVT_SCIM_RD_WLS1_Freq: type=Debug_PVT_SCIM_RD_WLS1_Freq_1
    Debug_PVT_SCIM_RD_WLS3_Volt_1
      data Debug_PVT_SCIM_RD_WLS3_Volt: type=Debug_PVT_SCIM_RD_WLS3_Volt_1
    Debug_PVT_SCIM_Ctrl_12VDCDC_1
      data Debug_PVT_SCIM_Ctrl_12VDCDC: type=Debug_PVT_SCIM_Ctrl_12VDCDC_1
    Debug_PVT_SCIM_Ctrl_12VParked_1
      data Debug_PVT_SCIM_Ctrl_12VParked: type=Debug_PVT_SCIM_Ctrl_12VParked_1
    Debug_PVT_SCIM_Ctrl_12VLiving_1
      data Debug_PVT_SCIM_Ctrl_12VLiving: type=Debug_PVT_SCIM_Ctrl_12VLiving_1
    RoofHatch_SwitchStatus_IF
      data A3PosSwitchStatus: type=uint8
    BunkH1RoofhatchOpenBtn_Stat_IF
      data PushButtonStatus: type=uint8
    BunkH1RoofhatchCloseBtn_Stat_IF
      data PushButtonStatus: type=uint8
    BunkH2RoofhatchOpenBtn_Stat_IF
      data PushButtonStatus: type=uint8
    BunkH2RoofhatchCloseBtn_Stat_IF
      data PushButtonStatus: type=uint8
    RoofHatch_HMI_rqst_IF
      data RoofHatch_HMI_rqst: type=uint8
    Vmode_IF
      data Vmode: type=uint8
  10 x client server interface:
    ClearHighFixCheckTimer_I  # This interface is to clear HighFixCheckTimer.
      operation CS
    LfICInit_I  # This interface is used to call RE_LFIC_Init. Gain_vehicleOption is used as an argument.
      operation CS
        arg Gain_vehicleOption: type=uint8, direction=IN, server-argument-impl-policy=USE-ARGUMENT-TYPE
    RficInit_I
      operation CS
    rficIRQActiveCheck_I  # This interface is used to call RE_rfic_IRQ_ActiveCheck, uses kb_TerminalControlState as an argument. This interface is used to call RE_rfic_IRQ_PendingCheck.
      operation CS
        arg kb_TerminalControlState: type=uint8, direction=IN, server-argument-impl-policy=USE-ARGUMENT-TYPE
    rficIRQPendingCheck_I
      operation CS
    SearchSysMode_I  # This interface is used to call RE_SearchSysmode, uses RFIC_SystemMode, RFIC_ReqCmd as arguments.
      operation CS
        arg RFIC_SystemMode: type=uint8, direction=IN, server-argument-impl-policy=USE-ARGUMENT-TYPE
        arg RFIC_ReqCmd: type=uint8, direction=IN, server-argument-impl-policy=USE-ARGUMENT-TYPE
    SetupLfTelegram_I  # This interface is used to call RE_StopLF_Periodic_Telegram. b_AntenaIndex is used as an argument. This interface is for data below. (will be used by RE_SetupLF_Telegram) - AntenaIndex: meaning. - SearchPattern - Counter_LFRawDataBit - Buffer_LFRawData
      operation CS
        4 x arg, all with direction=IN, server-argument-impl-policy=USE-ARGUMENT-TYPE:
          b_AntenaIndex: type=uint8
          b_SearchPattern: type=uint8
          Counter_LFRawDataBit: type=uint16
          Buffer_LFRawData: type=ArrayByteSize32
    SetValidFobFoundResult_I  # This interface is used to set valid fob found result.
      operation CS
        arg fob_num: type=uint8, direction=IN, server-argument-impl-policy=USE-ARGUMENT-TYPE
    StopLFPeriodicTelegram_I
      operation CS
    TimeoutTxTelegram_I  # This server port is used to call RE_Timeout_Tx_Telegram.
      operation CS
  103 x sender receiver interface:
    RficSysModeConfirm_I
      data SR_RficSysModeConfirm: type=uint8
    Debug_PVT_SCIM_RF_KeyfobSerialNb_1
      data Debug_PVT_SCIM_RF_KeyfobSerialNb: type=Debug_PVT_SCIM_RF_KeyfobSerialNb_1
    Debug_PVT_Fob_ID_1
      data Debug_PVT_Fob_ID: type=Debug_PVT_Fob_ID_1
    Debug_PVT_PEPS_GainP4_stat
      data Debug_PVT_PEPS_GainP4_stat: type=Debug_PVT_PEPS_GainP4_stat
    Debug_PVT_PEPS_Logic_stat
      data Debug_PVT_PEPS_Logic_stat: type=Debug_PVT_PEPS_Logic_stat
    Debug_PVT_PEPS_AntPi_X
      data Debug_PVT_PEPS_AntPi_X: type=Debug_PVT_PEPS_AntPi_X
    Debug_PVT_PEPS_K_AntPi
      data Debug_PVT_PEPS_K_AntPi: type=Debug_PVT_PEPS_K_AntPi
    Debug_PVT_PEPS_GainP3_stat
      data Debug_PVT_PEPS_GainP3_stat: type=Debug_PVT_PEPS_GainP3_stat
    Debug_PVT_PEPS_D_AntP3ToFob
      data Debug_PVT_PEPS_D_AntP3ToFob: type=Debug_PVT_PEPS_D_AntP3ToFob
    Debug_PVT_PEPS_P2_MaxRSSI
      data Debug_PVT_PEPS_P2_MaxRSSI: type=Debug_PVT_PEPS_P2_MaxRSSI
    Debug_PVT_PEPS_Vwidth
      data Debug_PVT_PEPS_Vwidth: type=Debug_PVT_PEPS_Vwidth
    Debug_PVT_PEPS_GainPi_stat
      data Debug_PVT_PEPS_GainPi_stat: type=Debug_PVT_PEPS_GainPi_stat
    Debug_PVT_PEPS_Fob_location
      data Debug_PVT_PEPS_Fob_location: type=Debug_PVT_PEPS_Fob_location
    Debug_PVT_PEPS_P1_MaxRSSI
      data Debug_PVT_PEPS_P1_MaxRSSI: type=Debug_PVT_PEPS_P1_MaxRSSI
    Debug_PVT_PEPS_D_AntPiToFob
      data Debug_PVT_PEPS_D_AntPiToFob: type=Debug_PVT_PEPS_D_AntPiToFob
    Debug_PVT_PEPS_A_AntP1
      data Debug_PVT_PEPS_A_AntP1: type=Debug_PVT_PEPS_A_AntP1
    Debug_PVT_PEPS_CTPoint_Y2
      data Debug_PVT_PEPS_CTPoint_Y2: type=Debug_PVT_PEPS_CTPoint_Y2
    Debug_PVT_PEPS_D_AntP4ToFob
      data Debug_PVT_PEPS_D_AntP4ToFob: type=Debug_PVT_PEPS_D_AntP4ToFob
    Debug_PVT_PEPS_Cali_Cir
      data Debug_PVT_PEPS_Cali_Cir: type=Debug_PVT_PEPS_Cali_Cir
    Debug_PVT_Fob_Found
      data Debug_PVT_Fob_Found: type=Debug_PVT_Fob_Found
    Debug_PVT_PEPS_LimitRSSIP4
      data Debug_PVT_PEPS_LimitRSSIP4: type=Debug_PVT_PEPS_LimitRSSIP4
    Debug_PVT_PEPS_D_AntP1ToFob
      data Debug_PVT_PEPS_D_AntP1ToFob: type=Debug_PVT_PEPS_D_AntP1ToFob
    Debug_PVT_PEPS_LimitRSSIP2
      data Debug_PVT_PEPS_LimitRSSIP2: type=Debug_PVT_PEPS_LimitRSSIP2
    Debug_PVT_PEPS_P3_RSSIcut
      data Debug_PVT_PEPS_P3_RSSIcut: type=Debug_PVT_PEPS_P3_RSSIcut
    Debug_PVT_PEPS_Pi_MaxRSSI
      data Debug_PVT_PEPS_Pi_MaxRSSI: type=Debug_PVT_PEPS_Pi_MaxRSSI
    Debug_PVT_PEPS_AntP1_Y
      data Debug_PVT_PEPS_AntP1_Y: type=Debug_PVT_PEPS_AntP1_Y
    Debug_PVT_PEPS_K_AntP1
      data Debug_PVT_PEPS_K_AntP1: type=Debug_PVT_PEPS_K_AntP1
    Debug_PVT_PEPS_AntPi_Y
      data Debug_PVT_PEPS_AntPi_Y: type=Debug_PVT_PEPS_AntPi_Y
    Debug_PVT_PEPS_CTPoint_X2
      data Debug_PVT_PEPS_CTPoint_X2: type=Debug_PVT_PEPS_CTPoint_X2
    Debug_PVT_PEPS_GainP1_stat
      data Debug_PVT_PEPS_GainP1_stat: type=Debug_PVT_PEPS_GainP1_stat
    Debug_PVT_PEPS_K_AntP4
      data Debug_PVT_PEPS_K_AntP4: type=Debug_PVT_PEPS_K_AntP4
    Debug_PVT_PEPS_P3_MaxRSSI
      data Debug_PVT_PEPS_P3_MaxRSSI: type=Debug_PVT_PEPS_P3_MaxRSSI
    Debug_PVT_PEPS_K_AntP3
      data Debug_PVT_PEPS_K_AntP3: type=Debug_PVT_PEPS_K_AntP3
    Debug_PVT_PEPS_A_AntP4
      data Debug_PVT_PEPS_A_AntP4: type=Debug_PVT_PEPS_A_AntP4
    Debug_PVT_PEPS_LimitRSSIP1
      data Debug_PVT_PEPS_LimitRSSIP1: type=Debug_PVT_PEPS_LimitRSSIP1
    Debug_PVT_PEPS_CTPoint_Y1
      data Debug_PVT_PEPS_CTPoint_Y1: type=Debug_PVT_PEPS_CTPoint_Y1
    Debug_PVT_PEPS_LimitRSSIPi
      data Debug_PVT_PEPS_LimitRSSIPi: type=Debug_PVT_PEPS_LimitRSSIPi
    Debug_PVT_PEPS_D_AntP1toP2_Cir
      data Debug_PVT_PEPS_D_AntP1toP2_Cir: type=Debug_PVT_PEPS_D_AntP1toP2_Cir
    Debug_PVT_PEPS_A_AntPi
      data Debug_PVT_PEPS_A_AntPi: type=Debug_PVT_PEPS_A_AntPi
    Debug_PVT_PEPS_AverRSSI1
      data Debug_PVT_PEPS_AverRSSI1: type=Debug_PVT_PEPS_AverRSSI1
    Debug_PVT_PEPS_AverRSSI2
      data Debug_PVT_PEPS_AverRSSI2: type=Debug_PVT_PEPS_AverRSSI2
    Debug_PVT_PEPS_A_AntP2
      data Debug_PVT_PEPS_A_AntP2: type=Debug_PVT_PEPS_A_AntP2
    Debug_PVT_PEPS_D_AntP1toP2_Y
      data Debug_PVT_PEPS_D_AntP1toP2_Y: type=Debug_PVT_PEPS_D_AntP1toP2_Y
    Debug_PVT_PEPS_D_AntP1toP2_X
      data Debug_PVT_PEPS_D_AntP1toP2_X: type=Debug_PVT_PEPS_D_AntP1toP2_X
    Debug_PVT_PEPS_AntP1_X
      data Debug_PVT_PEPS_AntP1_X: type=Debug_PVT_PEPS_AntP1_X
    Debug_PVT_PEPS_Vlength
      data Debug_PVT_PEPS_Vlength: type=Debug_PVT_PEPS_Vlength
    Debug_PVT_PEPS_AntCtrl_stat
      data Debug_PVT_PEPS_AntCtrl_stat: type=Debug_PVT_PEPS_AntCtrl_stat
    Debug_PVT_PEPS_Vsquare
      data Debug_PVT_PEPS_Vsquare: type=Debug_PVT_PEPS_Vsquare
    Debug_PVT_PEPS_D_AntP2ToFob
      data Debug_PVT_PEPS_D_AntP2ToFob: type=Debug_PVT_PEPS_D_AntP2ToFob
    Debug_PVT_PEPS_K_AntP2
      data Debug_PVT_PEPS_K_AntP2: type=Debug_PVT_PEPS_K_AntP2
    Debug_PVT_PEPS_P2_RSSIcut
      data Debug_PVT_PEPS_P2_RSSIcut: type=Debug_PVT_PEPS_P2_RSSIcut
    Debug_PVT_PEPS_GainP2_stat
      data Debug_PVT_PEPS_GainP2_stat: type=Debug_PVT_PEPS_GainP2_stat
    Debug_PVT_PEPS_A_AntP3
      data Debug_PVT_PEPS_A_AntP3: type=Debug_PVT_PEPS_A_AntP3
    Debug_PVT_PEPS_LimitRSSIP3
      data Debug_PVT_PEPS_LimitRSSIP3: type=Debug_PVT_PEPS_LimitRSSIP3
    Debug_PVT_PEPS_CTPoint_X1
      data Debug_PVT_PEPS_CTPoint_X1: type=Debug_PVT_PEPS_CTPoint_X1
    Debug_PVT_PEPS_VDSI_stat
      data Debug_PVT_PEPS_VDSI_stat: type=Debug_PVT_PEPS_VDSI_stat
    Debug_PVT_SCIM_RF_RollingCounter_1
      data Debug_PVT_SCIM_RF_RollingCounter: type=Debug_PVT_SCIM_RF_RollingCounter_1
    Debug_PVT_PEPS_P4_MaxRSSI
      data Debug_PVT_PEPS_P4_MaxRSSI: type=Debug_PVT_PEPS_P4_MaxRSSI
    Debug_PVT_PEPS_K_Cir
      data Debug_PVT_PEPS_K_Cir: type=Debug_PVT_PEPS_K_Cir
    Debug_PVT_Fob_RF_RollingCounter_1
      data Debug_PVT_Fob_RF_RollingCounter: type=Debug_PVT_Fob_RF_RollingCounter_1
    Debug_PVT_PEPS_DecRSSI
      data Debug_PVT_PEPS_DecRSSI: type=Debug_PVT_PEPS_DecRSSI
    Debug_PVT_PEPS_Avercut
      data Debug_PVT_PEPS_Avercut: type=Debug_PVT_PEPS_Avercut
    Debug_PVT_PEPS_TestPeriod_stat
      data Debug_PVT_PEPS_TestPeriod_stat: type=Debug_PVT_PEPS_TestPeriod_stat
    Debug_PVT_PEPS_Pi_RSSIcut
      data Debug_PVT_PEPS_Pi_RSSIcut: type=Debug_PVT_PEPS_Pi_RSSIcut
    Debug_PVT_Fob_Select_1
      data Debug_PVT_Fob_Select: type=Debug_PVT_Fob_Select_1
    Debug_PVT_PEPS_Ant_Ctrl
      data Debug_PVT_PEPS_Ant_Ctrl: type=Debug_PVT_PEPS_Ant_Ctrl
    Debug_PVT_PEPS_K_AntP4_Ctrl
      data Debug_PVT_PEPS_K_AntP4_Ctrl: type=Debug_PVT_PEPS_K_AntP4_Ctrl
    Debug_PVT_PEPS_VDSI_Ctrl
      data Debug_PVT_PEPS_VDSI_Ctrl: type=Debug_PVT_PEPS_VDSI_Ctrl
    Debug_PVT_PEPS_LimitRSSIP1_Ctrl
      data Debug_PVT_PEPS_LimitRSSIP1_Ctrl: type=Debug_PVT_PEPS_LimitRSSIP1_Ctrl
    Debug_PVT_PEPS_AntPi_X_Ctrl
      data Debug_PVT_PEPS_AntPi_X_Ctrl: type=Debug_PVT_PEPS_AntPi_X_Ctrl
    Debug_PVT_PEPS_GainP4_Ctrl
      data Debug_PVT_PEPS_GainP4_Ctrl: type=Debug_PVT_PEPS_GainP4_Ctrl
    Debug_PVT_PEPS_TestPeriod_Ctrl
      data Debug_PVT_PEPS_TestPeriod_Ctrl: type=Debug_PVT_PEPS_TestPeriod_Ctrl
    Debug_PVT_PEPS_K_AntP3_Ctrl
      data Debug_PVT_PEPS_K_AntP3_Ctrl: type=Debug_PVT_PEPS_K_AntP3_Ctrl
    Debug_PVT_PEPS_VSquare_Ctrl
      data Debug_PVT_PEPS_VSquare_Ctrl: type=Debug_PVT_PEPS_VSquare_Ctrl
    Debug_PVT_PEPS_K_AntP1_Ctrl
      data Debug_PVT_PEPS_K_AntP1_Ctrl: type=Debug_PVT_PEPS_K_AntP1_Ctrl
    Debug_PVT_PEPS_AntP1_Y_Ctrl
      data Debug_PVT_PEPS_AntP1_Y_Ctrl: type=Debug_PVT_PEPS_AntP1_Y_Ctrl
    Debug_PVT_PEPS_P2_RSSIcut_Ctrl
      data Debug_PVT_PEPS_P2_RSSIcut_Ctrl: type=Debug_PVT_PEPS_P2_RSSIcut_Ctrl
    Debug_PVT_PEPS_A_AntP4_Ctrl
      data Debug_PVT_PEPS_A_AntP4_Ctrl: type=Debug_PVT_PEPS_A_AntP4_Ctrl
    Debug_PVT_PEPS_A_AntP3_Ctrl
      data Debug_PVT_PEPS_A_AntP3_Ctrl: type=Debug_PVT_PEPS_A_AntP3_Ctrl
    Debug_PVT_PEPS_A_AntP1_Ctrl
      data Debug_PVT_PEPS_A_AntP1_Ctrl: type=Debug_PVT_PEPS_A_AntP1_Ctrl
    Debug_PVT_PEPS_GainP2_Ctrl
      data Debug_PVT_PEPS_GainP2_Ctrl: type=Debug_PVT_PEPS_GainP2_Ctrl
    Debug_PVT_PEPS_Vlength_Ctrl
      data Debug_PVT_PEPS_Vlength_Ctrl: type=Debug_PVT_PEPS_Vlength_Ctrl
    Debug_PVT_PEPS_Pi_RSSIcut_Ctrl
      data Debug_PVT_PEPS_Pi_RSSIcut_Ctrl: type=Debug_PVT_PEPS_Pi_RSSIcut_Ctrl
    Debug_PVT_PEPS_LmitRSSIPi_Ctrl
      data Debug_PVT_PEPS_LmitRSSIPi_Ctrl: type=Debug_PVT_PEPS_LmitRSSIPi_Ctrl
    Debug_PVT_PEPS_P3_RSSIcut_Ctrl
      data Debug_PVT_PEPS_P3_RSSIcut_Ctrl: type=Debug_PVT_PEPS_P3_RSSIcut_Ctrl
    Debug_PVT_PEPS_A_AntPi_Ctrl
      data Debug_PVT_PEPS_A_AntPi_Ctrl: type=Debug_PVT_PEPS_A_AntPi_Ctrl
    Debug_PVT_PEPS_AntP1_X_Ctrl
      data Debug_PVT_PEPS_AntP1_X_Ctrl: type=Debug_PVT_PEPS_AntP1_X_Ctrl
    Debug_PVT_PEPS_VWidth_Ctrl
      data Debug_PVT_PEPS_VWidth_Ctrl: type=Debug_PVT_PEPS_VWidth_Ctrl
    Debug_PVT_PEPS_K_AntPi_Ctrl
      data Debug_PVT_PEPS_K_AntPi_Ctrl: type=Debug_PVT_PEPS_K_AntPi_Ctrl
    Debug_PVT_PEPS_Logic_Ctrl
      data Debug_PVT_PEPS_Logic_Ctrl: type=Debug_PVT_PEPS_Logic_Ctrl
    Debug_PVT_PEPS_GainP3_Ctrl
      data Debug_PVT_PEPS_GainP3_Ctrl: type=Debug_PVT_PEPS_GainP3_Ctrl
    Debug_PVT_PEPS_A_AntP2_Ctrl
      data Debug_PVT_PEPS_A_AntP2_Ctrl: type=Debug_PVT_PEPS_A_AntP2_Ctrl
    Debug_PVT_PEPS_K_AntP2_Ctrl
      data Debug_PVT_PEPS_K_AntP2_Ctrl: type=Debug_PVT_PEPS_K_AntP2_Ctrl
    Debug_PVT_PEPS_LimitRSSIP3_Ctrl
      data Debug_PVT_PEPS_LimitRSSIP3_Ctrl: type=Debug_PVT_PEPS_LimitRSSIP3_Ctrl
    Debug_PVT_PEPS_GainP1_Ctrl
      data Debug_PVT_PEPS_GainP1_Ctrl: type=Debug_PVT_PEPS_GainP1_Ctrl
    Debug_PVT_PEPS_LimitRSSIP2_Ctrl
      data Debug_PVT_PEPS_LimitRSSIP2_Ctrl: type=Debug_PVT_PEPS_LimitRSSIP2_Ctrl
    Debug_PVT_PEPS_AntPi_Y_Ctrl
      data Debug_PVT_PEPS_AntPi_Y_Ctrl: type=Debug_PVT_PEPS_AntPi_Y_Ctrl
    Debug_PVT_PEPS_Avercut_Ctrl
      data Debug_PVT_PEPS_Avercut_Ctrl: type=Debug_PVT_PEPS_Avercut_Ctrl
    Debug_PVT_PEPS_LimitRSSIP4_Ctrl
      data Debug_PVT_PEPS_LimitRSSIP4_Ctrl: type=Debug_PVT_PEPS_LimitRSSIP4_Ctrl
    Debug_PVT_PEPS_GainPi_Ctrl
      data Debug_PVT_PEPS_GainPi_Ctrl: type=Debug_PVT_PEPS_GainPi_Ctrl
    IF_st_DstBlock
      5 x data:
        vehicle_serial: type=ArrayByteSize3
        challenge: type=ArrayByteSize8
        encryption: type=ArrayByteSize16
        write_fob_number: type=uint8
        security_key_number: type=ArrayByteSize3
    IF_b_DST_ResponseNG
      data SR: type=uint8
    IF_b_DST_RxCompleteFlag
      data SR: type=uint8
  6 x client server interface:
    IF_Report_DST_RegistResult
      operation CS
      error result: error-code=1
    IF_Set_DSTProcessStep_Idle
      operation CS
      error ApplicationError: error-code=1
    IF_StartDST_Telegram
      operation CS
        arg order: type=uint8, direction=IN, server-argument-impl-policy=USE-ARGUMENT-TYPE
      error ApplicationError: error-code=1
    IF_Get_DST_RunningStep
      operation CS
      error return: error-code=1
    IF_SetupDST_Telegram
      operation CS
        arg dst_order: type=uint8, direction=IN, server-argument-impl-policy=USE-ARGUMENT-TYPE
      error ApplicationError: error-code=1
    IF_Timeout_Tx_Telegram
      operation CS
      error ApplicationError: error-code=1
  sender receiver interface IF_SMKState
    data SR: type=tVAR
  sender receiver interface IF_b_Learning_RegistCnt
    data SR: type=tVAR
  sender receiver interface IF_S_TPDemodulatorResp
    data SR: type=tVAR
  client server interface IF_Reset_Encryption_Manager
    operation CS
    error ApplicationError: error-code=1
  client server interface IF_Check_FOB_Serial
    operation CS
      arg rcv_data: type=ArrayDataType, direction=IN, server-argument-impl-policy=USE-ARGUMENT-TYPE
    error ApplicationError: error-code=1
  client server interface IF_Store_RKE_Serial
    operation CS
      5 x arg, all with direction=IN, server-argument-impl-policy=USE-ARGUMENT-TYPE:
        skn: type=ArrayDataType
        rcv_data: type=ArrayDataType
        num: type=uint8
        high: type=uint8
        low: type=uint8
    error ApplicationError: error-code=1
  sender receiver interface IF_b_TP_Already_Learnt
    data SR: type=tVAR
  client server interface IF_Get_SecurityKeyNumber
    operation CS
      arg securitykeynumber: type=uint8, direction=OUT, server-argument-impl-policy=USE-ARGUMENT-TYPE
    error ApplicationError: error-code=1
  client server interface IF_Get_VehicleSerial
    operation CS
    error ApplicationError: error-code=1
  client server interface IF_StoreRKEDisableCnt
    operation CS
    error ApplicationError: error-code=1
  4 x sender receiver interface:
    IF_b_SSBPressEnabled
      data SR: type=tVAR
    IF_S_DiagSession
      data SR: type=tVAR
    IF_b_SMKLearningInProgress
      data SR: type=tVAR
    IF_S_DiagReq
      data SR: type=tVAR
  client server interface IF_Setup_DST_ProgramData
    operation CS
      arg number: type=uint8, direction=IN, server-argument-impl-policy=USE-ARGUMENT-TYPE
    error ApplicationError: error-code=1
